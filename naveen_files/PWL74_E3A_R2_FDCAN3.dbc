VERSION ""

NS_ :

BS_:

BU_: AGSM BCM BSM CADM DMSM DTCM ECM EVCU2 GNMM HCP IPC RFHM SGW TCM

BO_ 1456 ADAS_FD_HMI: 32 CADM
 SG_ ACC_Blind : 75|1@0+ (1,0) [0|1] "-" BSM,IPC
 SG_ ACC_DispPopupSts : 22|7@0+ (1,0) [0|127] "-" IPC,SGW
 SG_ ACC_FailSts : 81|1@0+ (1,0) [0|1] "-" BSM,IPC,SGW
 SG_ ACC_Limit_Fail : 73|1@0+ (1,0) [0|1] "-" IPC
 SG_ ACC_Limited : 87|1@0+ (1,0) [0|1] "-" IPC
 SG_ ACC_Set_Speed_Strike : 92|1@0+ (1,0) [0|1] "-" IPC,SGW
 SG_ AEB_Blind : 76|1@0+ (1,0) [0|1] "-" IPC
 SG_ AEB_DispPopupSts : 37|6@0+ (1,0) [0|63] "-" IPC,SGW
 SG_ AEB_FailSts : 83|1@0+ (1,0) [0|1] "-" BSM,IPC
 SG_ AEB_Limit_Fail : 74|1@0+ (1,0) [0|1] "-" IPC
 SG_ AEB_Limited : 72|1@0+ (1,0) [0|1] "-" IPC
 SG_ BlindSpotLeftWarn : 105|2@0+ (1,0) [0|2] "" BCM
 SG_ BlindSpotRightWarn : 171|2@0+ (1,0) [0|2] "" BCM
 SG_ BSS_Blind_RQSts : 101|1@0+ (1,0) [0|1] "" BCM,IPC,SGW
 SG_ BSS_CFG_STATSts : 103|2@0+ (1,0) [0|2] "" IPC
 SG_ BSS_SRV_RQSts : 88|1@0+ (1,0) [0|1] "" BCM,IPC,SGW
 SG_ Chime_Priority : 91|3@0+ (1,0) [0|4] "-" BCM,SGW
 SG_ Chime_RepRate : 43|4@0+ (1,0) [0|15] "Hz" BCM,SGW
 SG_ Chime_TypSts : 47|4@0+ (1,0) [0|15] "-" BCM,SGW
 SG_ CRC_ADAS_FD_HMI : 191|8@0+ (1,0) [0|255] "-" BSM,DMSM,ECM,IPC
 SG_ DDD_DispPopupSts : 39|2@0+ (1,0) [0|2] "-" IPC
 SG_ DDD_FailSts : 96|1@0+ (1,0) [0|1] "" IPC
 SG_ DisplaySts_ACC : 51|4@0+ (1,0) [0|15] "-" IPC,SGW
 SG_ DisplaySts_Curve : 109|2@0+ (1,0) [0|2] "" IPC
 SG_ DisplaySts_OFF : 68|3@0+ (1,0) [0|7] "-" IPC,SGW
 SG_ DisplaySts_Veh : 63|3@0+ (1,0) [0|7] "-" IPC,SGW
 SG_ DMSM_Wakeup : 119|1@0+ (1,0) [0|1] "-" DMSM
 SG_ Driver_Model : 107|2@0+ (1,0) [0|3] "" Vector__XXX
 SG_ FCW_Setting_Avail : 77|1@0+ (1,0) [0|1] "-" IPC
 SG_ HAS_Blind : 85|1@0+ (1,0) [0|1] "-" IPC
 SG_ HAS_Escalation_Sts : 117|4@0+ (1,0) [0|8] "" BCM
 SG_ HAS_FailSts : 80|1@0+ (1,0) [0|1] "-" IPC
 SG_ HAS_Hazard : 113|1@0+ (1,0) [0|1] "" BCM
 SG_ HAS_Inhibit_HMI : 143|6@0+ (1,0) [0|63] "-" IPC
 SG_ HAS_TelltaleSts : 54|3@0+ (1,0) [0|6] "-" IPC,SGW
 SG_ HAS_TurnSignalRequest : 111|2@0+ (1,0) [0|2] "" BCM
 SG_ ICA_Blind : 55|1@0+ (1,0) [0|1] "-" IPC
 SG_ Lane_DisplaySts_Left : 71|3@0+ (1,0) [0|7] "-" IPC,SGW
 SG_ Lane_DisplaySts_Right : 60|3@0+ (1,0) [0|7] "-" IPC,SGW
 SG_ Lane_DispPopupSts : 127|8@0+ (1,0) [0|255] "-" IPC,SGW
 SG_ LF_Chime_RqSts : 93|1@0+ (1,0) [0|1] "-" BCM,SGW
 SG_ LKA_Blind : 86|1@0+ (1,0) [0|1] "-" IPC
 SG_ LKA_FailSts : 84|1@0+ (1,0) [0|1] "-" IPC
 SG_ LKA_LEDControlSts : 57|2@0+ (1,0) [0|2] "-" BCM
 SG_ LKA_Status : 23|1@0+ (1,0) [0|1] "-" IPC,SGW
 SG_ LKA_Telltale : 135|3@0+ (1,0) [0|7] "" IPC
 SG_ LR_Chime_RqSts : 100|1@0+ (1,0) [0|1] "" BCM,SGW
 SG_ MessageCounter_ADAS_FD_HMI : 179|4@0+ (1,0) [0|15] "-" BSM,DMSM,ECM,IPC
 SG_ NCC_FailSts : 82|1@0+ (1,0) [0|1] "-" IPC
 SG_ PEB_Setting_Avail : 78|1@0+ (1,0) [0|1] "-" IPC
 SG_ RF_Chime_RqSts : 95|1@0+ (1,0) [0|1] "-" BCM,SGW
 SG_ RR_Chime_RqSts : 99|1@0+ (1,0) [0|1] "" BCM,SGW
 SG_ RRCC_DispPopupSts : 149|6@0+ (1,0) [0|63] "-" IPC
 SG_ RRCC_LEDSts : 25|2@0+ (1,0) [0|2] "-" BCM
 SG_ Set_Speed_KPH : 7|8@0+ (1,0) [0|255] "kph" ECM,IPC,SGW,TCM
 SG_ Set_Speed_MPH : 15|8@0+ (1,0) [0|255] "mph" IPC,SGW,TCM
 SG_ SVI_Request : 31|2@0+ (1,0) [0|3] "-" IPC,SGW

BO_ 1458 ADAS_FD_HMI_C2: 32 BCM
 SG_ ACC_FailSts_C2 : 57|1@0+ (1,0) [0|1] "" BSM
 SG_ CRC_ADAS_HMI_C2 : 191|8@0+ (1,0) [0|255] "-" BSM,IPC
 SG_ MessageCounter_ADAS_HMI_C2 : 179|4@0+ (1,0) [0|15] "-" BSM,IPC
 SG_ SVI_Request_C2 : 25|2@0+ (1,0) [0|0] "" IPC

BO_ 280 ADAS_FD_INFO: 32 CADM
 SG_ ACC_Drive_Cmd : 151|1@0+ (1,0) [0|1] "-" BSM
 SG_ ACC_DsrSpeedKPH : 119|8@0+ (1,0) [0|255] "km/h" DTCM,TCM
 SG_ ACC_StopStart : 97|2@0+ (1,0) [0|2] "-" ECM
 SG_ ACC_Systemsts : 183|4@0+ (1,0) [0|14] "-" BCM,BSM,IPC,TCM
 SG_ AEB_Sensitivity_Setting : 1|2@0+ (1,0) [0|2] "" IPC
 SG_ AEB_Systemsts : 99|2@0+ (1,0) [0|2] "-" IPC
 SG_ AEB_Type : 167|4@0+ (1,0) [0|14] "-" BSM
 SG_ BlindSpot_TrailerSts : 20|3@0+ (1,0) [0|6] "-" IPC
 SG_ Brake_Jerk_Req : 100|1@0+ (1,0) [0|1] "-" BSM
 SG_ CADM_OpStat : 7|3@0+ (1,0) [0|5] "" Vector__XXX
 SG_ CADM2_EPSSEC_FAIL : 8|1@0+ (1,0) [0|1] "" Vector__XXX
 SG_ CIPV_Fused : 101|1@0+ (1,0) [0|1] "-" Vector__XXX
 SG_ CRC_ADAS_FD_INFO : 191|8@0+ (1,0) [0|255] "-" BCM,BSM,IPC,TCM
 SG_ DDD_Setting_Avail : 102|1@0+ (1,0) [0|1] "-" IPC
 SG_ DDD_SystemSts : 103|1@0+ (1,0) [0|1] "-" Vector__XXX
 SG_ ESA_FailSts : 17|1@0+ (1,0) [0|1] "-" Vector__XXX
 SG_ ESA_LaneClear_Status : 26|3@0+ (1,0) [0|6] "-" Vector__XXX
 SG_ ESA_LAT_CTRL_RequestSts : 28|2@0+ (1,0) [0|2] "-" Vector__XXX
 SG_ ESA_TorqueOverlaySteeringReq : 39|32@0+ (0.0048828125,-5) [-5|20971514.9951172] "-" Vector__XXX
 SG_ ESASystemSts : 31|3@0+ (1,0) [0|6] "-" Vector__XXX
 SG_ ESCALATION_TYPE : 12|3@0+ (1,0) [0|4] "" Vector__XXX
 SG_ GrMax_Rq_ACC : 150|4@0+ (1,0) [0|15] "-" Vector__XXX
 SG_ HAS_LAT_CTRL_RequestSts : 110|2@0+ (1,0) [0|3] "-" Vector__XXX
 SG_ HAS_OpStat_Prim : 4|3@0+ (1,0) [0|5] "" BCM
 SG_ HAS_Status : 106|2@0+ (1,0) [0|3] "" BCM,BSM,IPC
 SG_ HIS_Req : 89|1@0+ (1,0) [0|1] "-" BSM
 SG_ Intervention : 163|12@0+ (0.01,-16) [-16|24.95] "m/s2" BSM,SGW
 SG_ LANE_CHANGE_SIDE : 95|2@0+ (1,0) [0|2] "" IPC
 SG_ LANE_CHANGE_STATUS : 71|4@0+ (1,0) [0|14] "" IPC
 SG_ LC_Jerk : 104|1@0+ (1,0) [0|1] "-" BSM
 SG_ LKA_LAT_CTRL_RequestSts : 108|2@0+ (1,0) [0|3] "-" Vector__XXX
 SG_ MessageCounter_ADAS_FD_INFO : 179|4@0+ (1,0) [0|15] "-" BCM,BSM,IPC,TCM
 SG_ MRM_STATUS : 23|3@0+ (1,0) [0|6] "" BCM,BSM,EVCU2,IPC,SGW,TCM
 SG_ Object_Dist : 127|8@0+ (1,0) [0|255] "m" DTCM,TCM
 SG_ PEB_SystemSts : 90|1@0+ (1,0) [0|1] "-" IPC
 SG_ Prefill_Req : 91|1@0+ (1,0) [0|1] "-" BSM
 SG_ SeatVib_Req : 15|3@0+ (1,0) [0|7] "" BCM
 SG_ SteeringVibration_Rq : 135|1@0+ (1,0) [0|1] "-" Vector__XXX
 SG_ SteeringVibration_Type : 67|4@0+ (1,0) [0|14] "-" Vector__XXX
 SG_ TorqueOverlaySteeringReq : 130|11@0+ (0.0048828125,-5) [-5|4.995117188] "-" Vector__XXX

BO_ 281 ADAS_FD_INFO_C2: 32 BCM
 SG_ ACC_Systemsts_C2 : 23|4@0+ (1,0) [0|14] "" BSM
 SG_ AEB_Type_C2 : 39|4@0+ (1,0) [0|14] "" BSM
 SG_ CADM2_Mode : 33|1@0+ (1,0) [0|1] "" BSM,IPC
 SG_ CRC_ADAS_INFO_C2 : 191|8@0+ (1,0) [0|255] "-" BSM,IPC,TCM
 SG_ HAS_Status_C2 : 35|2@0+ (1,0) [0|3] "" BSM,IPC
 SG_ HIS_Req_C2 : 19|1@0+ (1,0) [0|1] "" BSM
 SG_ Intervention_C2 : 3|12@0+ (0.01,-16) [-16|24.95] "m/s2" BSM
 SG_ MessageCounter_ADAS_INFO_C2 : 179|4@0+ (1,0) [0|15] "-" BSM,IPC,TCM
 SG_ MRM_STATUS_C2 : 52|3@0+ (1,0) [0|6] "" BSM,EVCU2,IPC,TCM

BO_ 610 ADAS_FD_INFO2: 32 CADM
 SG_ AHB_Blind : 156|1@0+ (1,0) [0|1] "0" BCM
 SG_ AHB_ON : 158|1@0+ (1,0) [0|1] "0" BCM
 SG_ AHBFault : 157|1@0+ (1,0) [0|1] "0" BCM,SGW
 SG_ CADM_DALM_CRC : 143|8@0+ (1,0) [0|255] "-" BCM
 SG_ CADM_DALM_MC : 131|4@0+ (1,0) [0|15] "-" BCM
 SG_ DALM_Request : 135|4@0+ (1,0) [0|14] "" BCM
 SG_ HAS_OpStat_Prim_DALM : 123|4@0+ (1,0) [0|5] "" BCM
 SG_ HAS_Status_DALM : 127|4@0+ (1,0) [0|3] "" BCM
 SG_ HAS_ValidRoad : 147|1@0+ (1,0) [0|1] "-" Vector__XXX
 SG_ SignOvertaking : 155|2@0+ (1,0) [0|3] "-" IPC
 SG_ SignSupplemVehicleSpeedLimit : 183|4@0+ (1,0) [0|15] "-" IPC
 SG_ SignVehicleSpeedLimit : 165|6@0+ (1,0) [0|63] "-" IPC
 SG_ SignVehicleSpeedLimitConditional : 173|6@0+ (1,0) [0|63] "-" IPC
 SG_ SourceFusedSpeedLimit : 167|2@0+ (1,0) [0|3] "-" IPC
 SG_ SpdUnits_Cam : 159|1@0+ (1,0) [0|1] "-" IPC
 SG_ Speed_Sign_Shape : 153|2@0+ (1,0) [0|3] "-" IPC,SGW
 SG_ TSRSts : 175|2@0+ (1,0) [0|3] "-" EVCU2,IPC,SGW
 SG_ Turn_Lever_Unlatch_Req : 7|2@0+ (1,0) [0|2] "-" BCM

BO_ 1316 ADCM_FD_A3: 20 BCM
 SG_ OffRd_FL_Lvl : 0|9@0+ (1,-255) [-255|255] "mm" IPC,SGW
 SG_ OffRd_FR_Lvl : 16|9@0+ (1,-255) [-255|255] "mm" IPC,SGW
 SG_ OffRd_RL_Lvl : 32|9@0+ (1,-255) [-255|255] "mm" IPC,SGW
 SG_ OffRd_RR_Lvl : 48|9@0+ (1,-255) [-255|255] "mm" IPC,SGW

BO_ 201 ADCM_FD_A4: 32 BCM
 SG_ FL_Lvl_RawAD_Src : 83|12@0+ (0.00122,0) [0|4.99468] "V" ECM
 SG_ FL_Lvl_Stat_Src : 71|2@0+ (1,0) [0|2] "" ECM
 SG_ FL_Z_Accel_Stat_Src : 4|3@0+ (1,0) [0|6] "" ECM
 SG_ FR_Lvl_RawAD_Src : 99|12@0+ (0.00122,0) [0|4.99468] "V" ECM
 SG_ FR_Lvl_Stat_Src : 69|2@0+ (1,0) [0|2] "" ECM
 SG_ FR_Z_Accel_Stat_Src : 20|3@0+ (1,0) [0|6] "" ECM
 SG_ RC_Z_Accel_Stat_Src : 39|3@0+ (1,0) [0|6] "" ECM
 SG_ RL_Lvl_RawAD_Src : 51|12@0+ (0.00122,0) [0|4.99468] "V" ECM
 SG_ RL_Lvl_Stat_Src : 55|2@0+ (1,0) [0|2] "" ECM
 SG_ RR_Lvl_RawAD_Src : 67|12@0+ (0.00122,0) [0|4.99468] "V" ECM
 SG_ RR_Lvl_Stat_Src : 53|2@0+ (1,0) [0|2] "" ECM
 SG_ Z_Acceleration_FL_Src : 1|10@0+ (0.003326,-1.7) [-1.7|1.699172] "G" ECM
 SG_ Z_Acceleration_FR_Src : 17|10@0+ (0.003326,-1.7) [-1.7|1.699172] "G" ECM
 SG_ Z_Acceleration_RC_Src : 33|10@0+ (0.003326,-1.7) [-1.7|1.699172] "G" ECM

BO_ 476 AGSM_FD_2: 32 AGSM
 SG_ APCM_Stat : 107|2@0+ (1,0) [0|2] "-" EVCU2,TCM
 SG_ CRC_AGSM2 : 191|8@0+ (1,0) [0|255] "-" ECM,IPC,SGW,TCM
 SG_ MessageCounter_AGSM2 : 179|4@0+ (1,0) [0|15] "-" ECM,IPC,SGW,TCM
 SG_ PRNDdisplayFailSts : 83|1@0+ (1,0) [0|1] "-" EVCU2,TCM
 SG_ PRNDFailSts : 82|1@0+ (1,0) [0|1] "-" EVCU2,IPC,SGW,TCM
 SG_ Shifter_ADAS_Inhibit : 105|1@0+ (1,0) [0|1] "-" BCM,BSM
 SG_ ShiftLever_PositionFlt : 104|1@0+ (1,0) [0|1] "-" TCM
 SG_ ShiftLeverPositionReq : 95|4@0+ (1,0) [0|15] "-" BCM,BSM,ECM,EVCU2,IPC,RFHM,SGW,TCM
 SG_ ShiftLockFailSts : 91|1@0+ (1,0) [0|1] "-" TCM
 SG_ WarningMessages : 103|3@0+ (1,0) [0|7] "-" IPC

BO_ 2654552065 APPL_ECM1: 8 SGW
 SG_ APPL_ECM1 : 7|64@0+ (1,0) [0|0] "" ECM

BO_ 2654555935 APPL_ECU_FD_AGSM: 64 SGW
 SG_ APPL_ECU_FD_AGSM : 455|64@0+ (1,0) [0|0] "" AGSM

BO_ 2654555930 APPL_ECU_FD_DTCM: 64 SGW
 SG_ APPL_ECU_FD_DTCM : 455|64@0+ (1,0) [0|0] "" DTCM

BO_ 2654555920 APPL_ECU_FD_ECM: 64 SGW
 SG_ APPL_ECU_FD_ECM : 455|64@0+ (1,0) [0|0] "" ECM

BO_ 2654555928 APPL_ECU_FD_TCM: 64 SGW
 SG_ APPL_ECU_FD_TCM : 455|64@0+ (1,0) [0|0] "" TCM

BO_ 2654552075 APPL_TCM1: 8 SGW
 SG_ AZG_to_TCM : 7|64@0+ (1,0) [0|0] "" TCM

BO_ 2654814267 APPL_TCM2: 8 SGW
 SG_ APPL_TRANSMISSION : 7|64@0+ (1,0) [0|0] "" TCM

BO_ 1327 ASCM_FD_1: 32 BCM
 SG_ CRC_ASCM1 : 191|8@0+ (1,0) [0|255] "-" CADM
 SG_ FL_Lvl : 103|8@0+ (1,-100) [-100|153] "mm" CADM,SGW
 SG_ FL_Lvl_Adj : 87|1@0+ (1,0) [0|1] "-" CADM
 SG_ FR_Lvl : 111|8@0+ (1,-100) [-100|153] "mm" CADM,SGW
 SG_ FR_Lvl_Adj : 86|1@0+ (1,0) [0|1] "-" CADM
 SG_ LvLCalCmplt : 85|1@0+ (1,0) [0|1] "-" CADM
 SG_ MessageCounter_ASCM1 : 179|4@0+ (1,0) [0|15] "-" CADM
 SG_ RL_Lvl : 119|8@0+ (1,-100) [-100|153] "mm" CADM,SGW
 SG_ RL_Lvl_Adj : 84|1@0+ (1,0) [0|1] "-" CADM
 SG_ RR_Lvl : 127|8@0+ (1,-100) [-100|153] "mm" CADM,SGW
 SG_ RR_Lvl_Adj : 83|1@0+ (1,0) [0|1] "-" CADM

BO_ 1445 ASCM_FD_2: 32 BCM
 SG_ ADC_Stat_2 : 10|3@0+ (1,0) [0|6] "-" SGW
 SG_ ADS_SrvSys : 115|1@0+ (1,0) [0|1] "-" IPC
 SG_ ASCM_HMI_Stat : 7|5@0+ (1,0) [0|31] "-" IPC
 SG_ ASCM_RemStat : 101|2@0+ (1,0) [0|0] "-" RFHM
 SG_ ASCM_Srv : 111|1@0+ (1,0) [0|1] "-" IPC,SGW
 SG_ ASCM_Stat : 135|4@0+ (1,0) [0|14] "-" BSM,CADM,ECM,IPC
 SG_ ASCM_StatDisp : 99|4@0+ (1,0) [0|14] "-" IPC
 SG_ ASCM_SysFail : 110|1@0+ (1,0) [0|1] "-" IPC,SGW
 SG_ ASCM_SYSFAIL_HMI : 93|2@0+ (1,0) [0|3] "-" IPC
 SG_ CRC_ASCM2 : 191|8@0+ (1,0) [0|255] "-" BSM,CADM,IPC
 SG_ Loading_Lv : 109|3@0+ (1,0) [0|6] "-" BSM,CADM,IPC
 SG_ MessageCounter_ASCM2 : 179|4@0+ (1,0) [0|15] "-" BSM,CADM,IPC
 SG_ Tgt_Level : 106|3@0+ (1,0) [0|6] "-" CADM
 SG_ TJM_Enbl : 0|1@0+ (1,0) [0|1] "-" IPC

CM_ "Project_DT25_ProjectStandard_FD-CAN3 [CS00155_FD]";
CM_ SG_ 1456 ACC_Blind "ACC_Blind";
CM_ SG_ 1456 ACC_DispPopupSts "ACC Dips Pop Up";
CM_ SG_ 1456 ACC_FailSts "ACC_FailSts";
CM_ SG_ 1456 ACC_Limit_Fail "ACC_Limit_Fail";
CM_ SG_ 1456 ACC_Limited "ACC_Limited";
CM_ SG_ 1456 ACC_Set_Speed_Strike "ACC Set Speed Strike";
CM_ SG_ 1456 AEB_Blind "AEB_Blind";
CM_ SG_ 1456 AEB_DispPopupSts "AEB Dips Pop Up";
CM_ SG_ 1456 AEB_FailSts "AEB_FailSts";
CM_ SG_ 1456 AEB_Limit_Fail "AEB_Limit_Fail";
CM_ SG_ 1456 AEB_Limited "AEB_Limited";
CM_ SG_ 1456 BlindSpotLeftWarn "BlindSpotLeftWarn";
CM_ SG_ 1456 BlindSpotRightWarn "BlindSpotRightWarn";
CM_ SG_ 1456 BSS_Blind_RQSts "Sensor blinded request from BSS";
CM_ SG_ 1456 BSS_CFG_STATSts "Blind Spot configuration status";
CM_ SG_ 1456 BSS_SRV_RQSts "BSS service warning request";
CM_ SG_ 1456 Chime_Priority "Chime Priority";
CM_ SG_ 1456 Chime_RepRate "DASM Chime Repetition Rate";
CM_ SG_ 1456 Chime_TypSts "DASM Chime Type Status";
CM_ SG_ 1456 CRC_ADAS_FD_HMI "CRC according to SAE J1850 standard at each frame transmission.";
CM_ SG_ 1456 DDD_DispPopupSts "DDD Disp Pop Up";
CM_ SG_ 1456 DDD_FailSts "DDD Fail Sts CADM2";
CM_ SG_ 1456 DisplaySts_ACC "Display status ACC";
CM_ SG_ 1456 DisplaySts_Curve "Indication that Curve Speed Control is reducing vehicle target speed in response to tight curve";
CM_ SG_ 1456 DisplaySts_OFF "Display Status Off";
CM_ SG_ 1456 DisplaySts_Veh "Display Status Veh";
CM_ SG_ 1456 DMSM_Wakeup "To trigger driver monitoring camera and IR LED to turn on";
CM_ SG_ 1456 Driver_Model "Overall assessment of whether driver is attentive to the driving task according to driver model";
CM_ SG_ 1456 FCW_Setting_Avail "FCW setting availability";
CM_ SG_ 1456 HAS_Blind "HAS_Blind";
CM_ SG_ 1456 HAS_Escalation_Sts "HAS_Escalation_Sts";
CM_ SG_ 1456 HAS_FailSts "HAS_FailSts";
CM_ SG_ 1456 HAS_Hazard "Request from the primary controller to actuate the Hazard lamps.";
CM_ SG_ 1456 HAS_Inhibit_HMI "L2+ inhibiting reason message";
CM_ SG_ 1456 HAS_TelltaleSts "Highway Assist telltale status in cluster";
CM_ SG_ 1456 HAS_TurnSignalRequest "Request from the primary controller to actuate the turn signals";
CM_ SG_ 1456 ICA_Blind "This signal is used to indicate the presence of an occlusion of the ICA feature";
CM_ SG_ 1456 Lane_DisplaySts_Left "Lane Display Status Left";
CM_ SG_ 1456 Lane_DisplaySts_Right "Lane Display Status Right";
CM_ SG_ 1456 Lane_DispPopupSts "2/28/23 - EI9294
Lane Management Pop-up Messages.TEXT MSG n corresponds to a raw value of 'n'";
CM_ SG_ 1456 LF_Chime_RqSts "DASM_LF_Chime_RqSts";
CM_ SG_ 1456 LKA_Blind "LKA_Blind";
CM_ SG_ 1456 LKA_FailSts "LKA_FailSts";
CM_ SG_ 1456 LKA_LEDControlSts "Lane Keep LED Control Status";
CM_ SG_ 1456 LKA_Status "None";
CM_ SG_ 1456 LKA_Telltale "LKA telltale color";
CM_ SG_ 1456 LR_Chime_RqSts "BSM Left rear chime on request";
CM_ SG_ 1456 MessageCounter_ADAS_FD_HMI "This signal is a counter used for safety checks strategies. This counter is incremented of 1 (one) unit at each frame transmission.";
CM_ SG_ 1456 NCC_FailSts "NCC_FailSts";
CM_ SG_ 1456 PEB_Setting_Avail "PEB setting availability";
CM_ SG_ 1456 RF_Chime_RqSts "DASM_RF_Chime_RqSts";
CM_ SG_ 1456 RR_Chime_RqSts "BSM right rear chime on request";
CM_ SG_ 1456 RRCC_DispPopupSts "RRCC_DispPopupSts";
CM_ SG_ 1456 RRCC_LEDSts "RRCC_LEDSts";
CM_ SG_ 1456 Set_Speed_KPH "Speed shown by IPC, which ACC is controlling in KPH";
CM_ SG_ 1456 Set_Speed_MPH "Speed shown by IPC, which ACC is controlling in MPH";
CM_ SG_ 1456 SVI_Request "Request to activate Secondary Visual Indication";
CM_ SG_ 1458 ACC_FailSts_C2 "ACC_FailSts_C2";
CM_ SG_ 1458 CRC_ADAS_HMI_C2 "CRC according to SAE J1850 standard at each frame transmission.";
CM_ SG_ 1458 MessageCounter_ADAS_HMI_C2 "This signal is a counter used for safety checks strategies. This counter is incremented of 1 (one) unit at each frame transmission.";
CM_ SG_ 1458 SVI_Request_C2 "SVI_Request_C2";
CM_ SG_ 280 ACC_Drive_Cmd "ACC Drive Command";
CM_ SG_ 280 ACC_DsrSpeedKPH "Desired speed in kilometers per hour";
CM_ SG_ 280 ACC_StopStart "Allows StopStart when ACC is engaged";
CM_ SG_ 280 ACC_Systemsts "ACC System Status";
CM_ SG_ 280 AEB_Sensitivity_Setting "AEB sensitivity status";
CM_ SG_ 280 AEB_Systemsts "AEB System Status";
CM_ SG_ 280 AEB_Type "AEB Type";
CM_ SG_ 280 BlindSpot_TrailerSts "BlindSpot_TrailerSts";
CM_ SG_ 280 Brake_Jerk_Req "Request from DASM to perform Jerk Warning";
CM_ SG_ 280 CADM_OpStat "Capability of primary controller to sense and compute a valid trajectory path based on external data dependencies and internal failures";
CM_ SG_ 280 CADM2_EPSSEC_FAIL "CADM2 detection of failure to communicate to EPS";
CM_ SG_ 280 CIPV_Fused "Closest in-path vehicle is fused True = 1";
CM_ SG_ 280 CRC_ADAS_FD_INFO "CRC according to SAE J1850 standard at each frame transmission.";
CM_ SG_ 280 DDD_Setting_Avail "DDD_Setting Av Status";
CM_ SG_ 280 DDD_SystemSts "DDD System Status";
CM_ SG_ 280 ESA_FailSts "ESA Failure Status";
CM_ SG_ 280 ESA_LaneClear_Status "Lane Clear Information";
CM_ SG_ 280 ESA_LAT_CTRL_RequestSts "ESA Lateral Control Request Status";
CM_ SG_ 280 ESA_TorqueOverlaySteeringReq "ESA Steering Torque Overlay Request";
CM_ SG_ 280 ESASystemSts "ESA System Status";
CM_ SG_ 280 ESCALATION_TYPE "Type of HMI escalation to be provided to driver from primary controller";
CM_ SG_ 280 GrMax_Rq_ACC "Used to request Max Gear from TCM";
CM_ SG_ 280 HAS_LAT_CTRL_RequestSts "HAS_LAT_CTRL_RequestSts";
CM_ SG_ 280 HAS_OpStat_Prim "Capability of the primary controller to perform sensing, computing, and actuation";
CM_ SG_ 280 HAS_Status "Highway Assist System Status as reported by the main controller";
CM_ SG_ 280 HIS_Req "Used to command Stop during Stop and Go ACC and FSFCW+";
CM_ SG_ 280 Intervention "Request to set target acceleration/deceleration for any feature";
CM_ SG_ 280 LANE_CHANGE_SIDE "Direction of the currently in-progress lane change from a vehicle perspective";
CM_ SG_ 280 LANE_CHANGE_STATUS "Status of assisted lane change maneuver";
CM_ SG_ 280 LC_Jerk "Lane Centering request for brake jerk";
CM_ SG_ 280 LKA_LAT_CTRL_RequestSts "LKA_LAT_CTRL_RequestSts";
CM_ SG_ 280 MessageCounter_ADAS_FD_INFO "This signal is a counter used for safety checks strategies. This counter is incremented of 1 (one) unit at each frame transmission.";
CM_ SG_ 280 MRM_STATUS "Status of the minimum risk maneuver to handle system faults or driver abuse as understood by primary controller";
CM_ SG_ 280 Object_Dist "It indicates the distance to the recognized object";
CM_ SG_ 280 PEB_SystemSts "PEB System Status";
CM_ SG_ 280 Prefill_Req "Prefill command of Brake System by DASM";
CM_ SG_ 280 SeatVib_Req "Seat vibration request";
CM_ SG_ 280 SteeringVibration_Rq "Request to activate Steering Wheel Vibration";
CM_ SG_ 280 SteeringVibration_Type "Type of Steering Wheel Vibration Request";
CM_ SG_ 280 TorqueOverlaySteeringReq "TorqueOverlaySteeringReq";
CM_ SG_ 281 ACC_Systemsts_C2 "ACC_Systemsts_C2";
CM_ SG_ 281 AEB_Type_C2 "AEB_Type_C2";
CM_ SG_ 281 CADM2_Mode "Mode CADM2 is currently functioning";
CM_ SG_ 281 CRC_ADAS_INFO_C2 "CRC according to SAE J1850 standard at each frame transmission.";
CM_ SG_ 281 HAS_Status_C2 "Highway Assist System Status as reported by the failover controller";
CM_ SG_ 281 HIS_Req_C2 "HIS_Req_C2";
CM_ SG_ 281 Intervention_C2 "Intervention_C2";
CM_ SG_ 281 MessageCounter_ADAS_INFO_C2 "This signal is a counter used for safety checks strategies. This counter is incremented of 1 (one) unit at each frame transmission.";
CM_ SG_ 281 MRM_STATUS_C2 "Status of the minimum risk maneuver to handle system faults or driver abuse as understood by secondary controller";
CM_ SG_ 610 AHB_Blind "This signal indicates the AHB Controller state";
CM_ SG_ 610 AHB_ON "AHB Controller tells to the BCM to turn ON/OFF the high beam lamps";
CM_ SG_ 610 AHBFault "AHB Controller sends to the BCM the fault condition";
CM_ SG_ 610 CADM_DALM_CRC "CRC according to SAE J1850 standard at each frame transmission.";
CM_ SG_ 610 CADM_DALM_MC "This signal is a counter used for safety checks strategies. This counter is incremented of 1 (one) unit at each frame transmission.";
CM_ SG_ 610 DALM_Request "Request to driver alert lighting modules to trigger patttern and color display from primary controller";
CM_ SG_ 610 HAS_OpStat_Prim_DALM "Capability of the primary controller to perform sensing, computing, and actuation";
CM_ SG_ 610 HAS_Status_DALM "Highway Assist System Status as reported by the main controller";
CM_ SG_ 610 HAS_ValidRoad "HAS Ready";
CM_ SG_ 610 SignOvertaking "This signal indicates the road sign of no overtaking";
CM_ SG_ 610 SignSupplemVehicleSpeedLimit "This signal indicates the supplementary road sign  related to vehicle speed limit";
CM_ SG_ 610 SignVehicleSpeedLimit "This signal indicates the road sign of vehicle speed limit";
CM_ SG_ 610 SignVehicleSpeedLimitConditional "This signal indicates the conditional road sign of vehicle speed limit";
CM_ SG_ 610 SourceFusedSpeedLimit "Source of the fused speed limit data";
CM_ SG_ 610 SpdUnits_Cam "Speed Units";
CM_ SG_ 610 Speed_Sign_Shape "Shape of Speed Sign";
CM_ SG_ 610 TSRSts "This signal indicates the Traffic Sign Recognition status";
CM_ SG_ 610 Turn_Lever_Unlatch_Req "L2+ turn stalk unlatch request";
CM_ SG_ 1316 OffRd_FL_Lvl "Damping Front Left Level";
CM_ SG_ 1316 OffRd_FR_Lvl "Damping Front Right Level";
CM_ SG_ 1316 OffRd_RL_Lvl "Damping Rear Left Level";
CM_ SG_ 1316 OffRd_RR_Lvl "Damping Rear Right Level";
CM_ SG_ 201 FL_Lvl_RawAD_Src "Read raw Front Left ride height sensor value";
CM_ SG_ 201 FL_Lvl_Stat_Src "To read diagnostic data of Front Left height sensor";
CM_ SG_ 201 FL_Z_Accel_Stat_Src "To capture the diagnostic data of Front left acceleration sensor";
CM_ SG_ 201 FR_Lvl_RawAD_Src "Read raw Front Right ride height sensor value";
CM_ SG_ 201 FR_Lvl_Stat_Src "To read diagnostic data of Front Right height sensor";
CM_ SG_ 201 FR_Z_Accel_Stat_Src "To capture the diagnostic data of Front right acceleration sensor";
CM_ SG_ 201 RC_Z_Accel_Stat_Src "To capture the diagnostic data of Right center acceleration sensor";
CM_ SG_ 201 RL_Lvl_RawAD_Src "Read raw Rear Left ride height sensor value";
CM_ SG_ 201 RL_Lvl_Stat_Src "To read diagnostic data of Rear Left height sensor";
CM_ SG_ 201 RR_Lvl_RawAD_Src "Read raw Rear Right ride height sensor value";
CM_ SG_ 201 RR_Lvl_Stat_Src "To read diagnostic data of Rear Right height sensor";
CM_ SG_ 201 Z_Acceleration_FL_Src "Raw Z Acceleration Front Left";
CM_ SG_ 201 Z_Acceleration_FR_Src "Raw Z Acceleration Front Right";
CM_ SG_ 201 Z_Acceleration_RC_Src "Raw Z Acceleration Rear Center";
CM_ SG_ 476 APCM_Stat "Auto position correction mode status";
CM_ SG_ 476 CRC_AGSM2 "CRC according to SAE J1850 standard at each frame transmission.";
CM_ SG_ 476 MessageCounter_AGSM2 "This signal is a counter used for safety checks strategies. This counter is incremented of 1 (one) unit at each frame transmission.";
CM_ SG_ 476 PRNDdisplayFailSts "-";
CM_ SG_ 476 PRNDFailSts "-";
CM_ SG_ 476 Shifter_ADAS_Inhibit "Indicates if the shifter is able to autocorrect";
CM_ SG_ 476 ShiftLever_PositionFlt "Shifter Position Failure";
CM_ SG_ 476 ShiftLeverPositionReq "This signal describes the shift lever position requested by the driver.";
CM_ SG_ 476 ShiftLockFailSts "-";
CM_ SG_ 476 WarningMessages "-";
CM_ SG_ 2654555935 APPL_ECU_FD_AGSM "External application to ECU";
CM_ SG_ 2654555930 APPL_ECU_FD_DTCM "External application to ECU";
CM_ SG_ 2654555920 APPL_ECU_FD_ECM "External application to ECU";
CM_ SG_ 2654555928 APPL_ECU_FD_TCM "External application to ECU";
CM_ SG_ 2654814267 APPL_TRANSMISSION "External application to ECU";
CM_ SG_ 1327 CRC_ASCM1 "CRC according to SAE J1850 standard at each frame transmission.";
CM_ SG_ 1327 FL_Lvl "Front left level";
CM_ SG_ 1327 FL_Lvl_Adj "Front left level adjust (1=adjusting)";
CM_ SG_ 1327 FR_Lvl "Front right level";
CM_ SG_ 1327 FR_Lvl_Adj "Front right level adjust (1=adjusting)";
CM_ SG_ 1327 LvLCalCmplt "Level calibration complete";
CM_ SG_ 1327 MessageCounter_ASCM1 "This signal is a counter used for safety checks strategies. This counter is incremented of 1 (one) unit at each frame transmission.";
CM_ SG_ 1327 RL_Lvl "Rear left level";
CM_ SG_ 1327 RL_Lvl_Adj "Rear left level adjust (1=adjusting)";
CM_ SG_ 1327 RR_Lvl "Rear right level";
CM_ SG_ 1327 RR_Lvl_Adj "Rear right level adjust (1=adjusting)";
CM_ SG_ 1445 ADC_Stat_2 "Active damping control status";
CM_ SG_ 1445 ADS_SrvSys "ADS service system; True = [1]";
CM_ SG_ 1445 ASCM_HMI_Stat "ASCM HMI status";
CM_ SG_ 1445 ASCM_RemStat "ASCM remote lowering status";
CM_ SG_ 1445 ASCM_Srv "Service air suspension; 1 = True";
CM_ SG_ 1445 ASCM_Stat "Air suspension status";
CM_ SG_ 1445 ASCM_StatDisp "Air suspension status for display";
CM_ SG_ 1445 ASCM_SysFail "Loss of function - system fault; 1 = True";
CM_ SG_ 1445 ASCM_SYSFAIL_HMI "Sysfail Speed Indications";
CM_ SG_ 1445 CRC_ASCM2 "CRC according to SAE J1850 standard at each frame transmission.";
CM_ SG_ 1445 Loading_Lv "Loading level";
CM_ SG_ 1445 MessageCounter_ASCM2 "This signal is a counter used for safety checks strategies. This counter is incremented of 1 (one) unit at each frame transmission.";
CM_ SG_ 1445 Tgt_Level "Target Level";
CM_ SG_ 1445 TJM_Enbl "Tire jack mode; 1 = True";

BA_DEF_ SG_ "GenSigStartValue" INT 0 2147483647;
BA_DEF_ SG_ "GenSigInactiveValue" INT 0 2147483647;
BA_DEF_ SG_ "GenSigSendType" ENUM "NotUsed","OnWrite","OnWriteWithRepetition","OnChange","OnChangeWithRepetition","IfActive","IfActiveWithRepetition","NoSigSendType";
BA_DEF_ SG_ "SystemSignalLongSymbol" STRING ;
BA_DEF_ SG_ "GenSigTimeoutTime_AGSM" INT 0 65535;
BA_DEF_ SG_ "GenSigTimeoutTime_BCM" INT 0 65535;
BA_DEF_ SG_ "GenSigTimeoutTime_BSM" INT 0 65535;
BA_DEF_ SG_ "GenSigTimeoutTime_CADM" INT 0 65535;
BA_DEF_ SG_ "GenSigTimeoutTime_DMSM" INT 0 65535;
BA_DEF_ SG_ "GenSigTimeoutTime_DTCM" INT 0 65535;
BA_DEF_ SG_ "GenSigTimeoutTime_ECM" INT 0 65535;
BA_DEF_ SG_ "GenSigTimeoutTime_EVCU2" INT 0 65535;
BA_DEF_ SG_ "GenSigTimeoutTime_GNMM" INT 0 65535;
BA_DEF_ SG_ "GenSigTimeoutTime_HCP" INT 0 65535;
BA_DEF_ SG_ "GenSigTimeoutTime_IPC" INT 0 65535;
BA_DEF_ SG_ "GenSigTimeoutTime_RFHM" INT 0 65535;
BA_DEF_ SG_ "GenSigTimeoutTime_SGW" INT 0 65535;
BA_DEF_ SG_ "GenSigTimeoutTime_TCM" INT 0 65535;
BA_DEF_ BO_ "DiagRequest" ENUM "No","Yes";
BA_DEF_ BO_ "Type" ENUM "P","C","PE","COC","PE_Cntrl","E","E_Cntrl","OC","S","BAF","DC","EM","MM","ISO-TP","-";
BA_DEF_ BO_ "DiagResponse" ENUM "No","Yes";
BA_DEF_ BO_ "NmMessage" ENUM "No","Yes";
BA_DEF_ BO_ "GenMsgSendType" ENUM "Cyclic","NotUsed","NotUsed","NotUsed","NotUsed","NotUsed","NotUsed","NotUsed","NoMsgSendType";
BA_DEF_ BO_ "GenMsgNrOfRepetition" INT 0 255;
BA_DEF_ BO_ "GenMsgILSupport" ENUM "No","Yes";
BA_DEF_ BO_ "GenMsgStartDelayTime" INT 0 65535;
BA_DEF_ BO_ "GenMsgCycleTimeFast" INT 0 65535;
BA_DEF_ BO_ "GenMsgCycleTime" INT 0 65535;
BA_DEF_ BO_ "GenMsgDelayTime" INT 0 65535;
BA_DEF_ BO_ "NmAsrMessage" ENUM "No","Yes";
BA_DEF_ BO_ "DiagState" ENUM "No","Yes";
BA_DEF_ BO_ "DiagConnection" HEX 0 65535;
BA_DEF_ BO_ "VFrameFormat" ENUM "StandardCAN","ExtendedCAN","reserved","reserved","reserved","reserved","reserved","reserved","reserved","reserved","reserved","reserved","reserved","reserved","StandardCAN_FD","ExtendedCAN_FD";
BA_DEF_ BO_ "CANFD_BRS" ENUM "No","Yes";
BA_DEF_ "Manufacturer" STRING ;
BA_DEF_ "NmType" STRING ;
BA_DEF_ "BusType" STRING ;
BA_DEF_ "Baudrate" INT 0 1000000;
BA_DEF_ "DBName" STRING ;
BA_DEF_ "NmAsrTimeoutTime" INT 1 65535;
BA_DEF_ "NmAsrWaitBusSleepTime" INT 1 65535;
BA_DEF_ "NmAsrRepeatMessageTime" INT 1 65535;
BA_DEF_ "NmAsrMessageCount" INT 1 256;
BA_DEF_ "NmAsrBaseAddress" HEX 235487232 2147483647;
BA_DEF_ "NmAsrCanMsgCycleTime" INT 1 65535;
BA_DEF_ "Version" HEX 0 255;
BA_DEF_ "VersionWeek" INT 0 53;
BA_DEF_ "VersionYear" INT 0 99;
BA_DEF_ BU_ "Description" STRING ;
BA_DEF_ BU_ "NmStationAddress" HEX 0 255;
BA_DEF_ BU_ "NmNode" ENUM "No","Yes";
BA_DEF_ BU_ "NmAsrNode" ENUM "No","Yes";
BA_DEF_ BU_ "NmAsrNodeIdentifier" HEX 0 255;
BA_DEF_ BU_ "NmAsrCanMsgReducedTime" INT 1 65535;
BA_DEF_ BU_ "NmNodeType" ENUM "+15_NotWakeable","+30_Wakeable","+30_NotWakeable","kMaster","kSlave15","kSlave30","none";
BA_DEF_ BU_ "NwmNodeType" ENUM "+15_NotWakeable","+30_Wakeable","+30_NotWakeable","kMaster","kSlave15","kSlave30","none";
BA_DEF_DEF_ "DiagRequest" "No";
BA_DEF_DEF_ "Type" "-";
BA_DEF_DEF_ "DiagResponse" "No";
BA_DEF_DEF_ "NmMessage" "No";
BA_DEF_DEF_ "GenMsgSendType" "NoMsgSendType";
BA_DEF_DEF_ "GenMsgNrOfRepetition" 0;
BA_DEF_DEF_ "GenMsgILSupport" "No";
BA_DEF_DEF_ "GenMsgStartDelayTime" 0;
BA_DEF_DEF_ "GenMsgCycleTimeFast" 0;
BA_DEF_DEF_ "GenMsgCycleTime" 0;
BA_DEF_DEF_ "GenMsgDelayTime" 0;
BA_DEF_DEF_ "NmAsrMessage" "No";
BA_DEF_DEF_ "DiagState" "No";
BA_DEF_DEF_ "DiagConnection" 0;
BA_DEF_DEF_ "VFrameFormat" "StandardCAN_FD";
BA_DEF_DEF_ "CANFD_BRS" "No";
BA_DEF_DEF_ "Manufacturer" "Fiat";
BA_DEF_DEF_ "NmType" "";
BA_DEF_DEF_ "BusType" "CAN";
BA_DEF_DEF_ "Baudrate" 500000;
BA_DEF_DEF_ "DBName" "CAN";
BA_DEF_DEF_ "NmAsrTimeoutTime" 1000;
BA_DEF_DEF_ "NmAsrWaitBusSleepTime" 750;
BA_DEF_DEF_ "NmAsrRepeatMessageTime" 800;
BA_DEF_DEF_ "NmAsrMessageCount" 256;
BA_DEF_DEF_ "NmAsrBaseAddress" 506724352;
BA_DEF_DEF_ "NmAsrCanMsgCycleTime" 200;
BA_DEF_DEF_ "Version" 160;
BA_DEF_DEF_ "VersionWeek" 13;
BA_DEF_DEF_ "VersionYear" 23;
BA_DEF_DEF_ "Description" "";
BA_DEF_DEF_ "NmStationAddress" 0;
BA_DEF_DEF_ "NmNode" "Yes";
BA_DEF_DEF_ "NmAsrNode" "Yes";
BA_DEF_DEF_ "NmAsrNodeIdentifier" 0;
BA_DEF_DEF_ "NmAsrCanMsgReducedTime" 100;
BA_DEF_DEF_ "NmNodeType" "none";
BA_DEF_DEF_ "NwmNodeType" "none";
BA_DEF_DEF_ "GenSigStartValue" 0;
BA_DEF_DEF_ "GenSigInactiveValue" 0;
BA_DEF_DEF_ "GenSigSendType" "NoSigSendType";
BA_DEF_DEF_ "SystemSignalLongSymbol" "";
BA_DEF_DEF_ "GenSigTimeoutTime_AGSM" 2500;
BA_DEF_DEF_ "GenSigTimeoutTime_BCM" 2500;
BA_DEF_DEF_ "GenSigTimeoutTime_BSM" 2500;
BA_DEF_DEF_ "GenSigTimeoutTime_CADM" 2500;
BA_DEF_DEF_ "GenSigTimeoutTime_DMSM" 2500;
BA_DEF_DEF_ "GenSigTimeoutTime_DTCM" 2500;
BA_DEF_DEF_ "GenSigTimeoutTime_ECM" 2500;
BA_DEF_DEF_ "GenSigTimeoutTime_EVCU2" 2500;
BA_DEF_DEF_ "GenSigTimeoutTime_GNMM" 2500;
BA_DEF_DEF_ "GenSigTimeoutTime_HCP" 2500;
BA_DEF_DEF_ "GenSigTimeoutTime_IPC" 2500;
BA_DEF_DEF_ "GenSigTimeoutTime_RFHM" 2500;
BA_DEF_DEF_ "GenSigTimeoutTime_SGW" 2500;
BA_DEF_DEF_ "GenSigTimeoutTime_TCM" 2500;
BA_ "Description" BU_ AGSM "Automatic Gearbox Shifter Module";
BA_ "NmStationAddress" BU_ AGSM 22;
BA_ "NmAsrNodeIdentifier" BU_ AGSM 22;
BA_ "NmAsrCanMsgReducedTime" BU_ AGSM 700;
BA_ "NmNodeType" BU_ AGSM 1;
BA_ "NwmNodeType" BU_ AGSM 1;
BA_ "Description" BU_ BCM "Body Control Module";
BA_ "NmAsrCanMsgReducedTime" BU_ BCM 500;
BA_ "NmNodeType" BU_ BCM 1;
BA_ "NwmNodeType" BU_ BCM 1;
BA_ "Description" BU_ BSM "Braking System Module";
BA_ "NmStationAddress" BU_ BSM 6;
BA_ "NmAsrNodeIdentifier" BU_ BSM 6;
BA_ "NmAsrCanMsgReducedTime" BU_ BSM 525;
BA_ "NmNodeType" BU_ BSM 1;
BA_ "NwmNodeType" BU_ BSM 1;
BA_ "Description" BU_ CADM "Central ADAS Decision Module";
BA_ "NmStationAddress" BU_ CADM 141;
BA_ "NmAsrNodeIdentifier" BU_ CADM 141;
BA_ "NmAsrCanMsgReducedTime" BU_ CADM 825;
BA_ "NmNodeType" BU_ CADM 1;
BA_ "NwmNodeType" BU_ CADM 1;
BA_ "Description" BU_ DMSM "Driver Monitoring System Module";
BA_ "NmStationAddress" BU_ DMSM 153;
BA_ "NmNode" BU_ DMSM 0;
BA_ "NmAsrNode" BU_ DMSM 0;
BA_ "NmAsrNodeIdentifier" BU_ DMSM 153;
BA_ "NmNodeType" BU_ DMSM 0;
BA_ "NwmNodeType" BU_ DMSM 0;
BA_ "Description" BU_ DTCM "Drive Train Control Module";
BA_ "NmStationAddress" BU_ DTCM 67;
BA_ "NmAsrNodeIdentifier" BU_ DTCM 67;
BA_ "NmAsrCanMsgReducedTime" BU_ DTCM 550;
BA_ "NmNodeType" BU_ DTCM 2;
BA_ "NwmNodeType" BU_ DTCM 2;
BA_ "Description" BU_ ECM "Engine Control Module";
BA_ "NmStationAddress" BU_ ECM 1;
BA_ "NmAsrNodeIdentifier" BU_ ECM 1;
BA_ "NmAsrCanMsgReducedTime" BU_ ECM 575;
BA_ "NmNodeType" BU_ ECM 1;
BA_ "NwmNodeType" BU_ ECM 1;
BA_ "Description" BU_ EVCU2 "Electric Vehicle Control Unit 2";
BA_ "NmStationAddress" BU_ EVCU2 64;
BA_ "NmAsrNodeIdentifier" BU_ EVCU2 64;
BA_ "NmAsrCanMsgReducedTime" BU_ EVCU2 950;
BA_ "NmNodeType" BU_ EVCU2 1;
BA_ "NwmNodeType" BU_ EVCU2 1;
BA_ "Description" BU_ GNMM "Global Navigation and Motion Module";
BA_ "NmStationAddress" BU_ GNMM 144;
BA_ "NmAsrNodeIdentifier" BU_ GNMM 144;
BA_ "NmAsrCanMsgReducedTime" BU_ GNMM 850;
BA_ "NmNodeType" BU_ GNMM 1;
BA_ "NwmNodeType" BU_ GNMM 1;
BA_ "Description" BU_ HCP "Hybrid Control Processor";
BA_ "NmStationAddress" BU_ HCP 98;
BA_ "NmAsrNodeIdentifier" BU_ HCP 98;
BA_ "NmAsrCanMsgReducedTime" BU_ HCP 750;
BA_ "NmNodeType" BU_ HCP 2;
BA_ "NwmNodeType" BU_ HCP 2;
BA_ "Description" BU_ IPC "Instrument Panel Cluster";
BA_ "NmStationAddress" BU_ IPC 3;
BA_ "NmAsrNodeIdentifier" BU_ IPC 3;
BA_ "NmAsrCanMsgReducedTime" BU_ IPC 650;
BA_ "NmNodeType" BU_ IPC 1;
BA_ "NwmNodeType" BU_ IPC 1;
BA_ "Description" BU_ RFHM "Radio Frequency Hub Module";
BA_ "NmStationAddress" BU_ RFHM 65;
BA_ "NmAsrNodeIdentifier" BU_ RFHM 65;
BA_ "NmAsrCanMsgReducedTime" BU_ RFHM 675;
BA_ "NmNodeType" BU_ RFHM 1;
BA_ "NwmNodeType" BU_ RFHM 1;
BA_ "Description" BU_ SGW "Security Gateway Module";
BA_ "NmStationAddress" BU_ SGW 112;
BA_ "NmAsrNodeIdentifier" BU_ SGW 112;
BA_ "NmAsrCanMsgReducedTime" BU_ SGW 800;
BA_ "NmNodeType" BU_ SGW 1;
BA_ "NwmNodeType" BU_ SGW 1;
BA_ "Description" BU_ TCM "Transmission Control Module";
BA_ "NmStationAddress" BU_ TCM 11;
BA_ "NmAsrNodeIdentifier" BU_ TCM 11;
BA_ "NmAsrCanMsgReducedTime" BU_ TCM 725;
BA_ "NmNodeType" BU_ TCM 1;
BA_ "NwmNodeType" BU_ TCM 1;
BA_ "Type" BO_ 1456 3;
BA_ "GenMsgSendType" BO_ 1456 0;
BA_ "GenMsgILSupport" BO_ 1456 1;
BA_ "GenMsgCycleTime" BO_ 1456 100;
BA_ "GenMsgDelayTime" BO_ 1456 20;
BA_ "CANFD_BRS" BO_ 1456 1;
BA_ "Type" BO_ 1458 3;
BA_ "GenMsgSendType" BO_ 1458 0;
BA_ "GenMsgILSupport" BO_ 1458 1;
BA_ "GenMsgStartDelayTime" BO_ 1458 45;
BA_ "GenMsgCycleTime" BO_ 1458 100;
BA_ "GenMsgDelayTime" BO_ 1458 20;
BA_ "CANFD_BRS" BO_ 1458 1;
BA_ "Type" BO_ 280 1;
BA_ "GenMsgSendType" BO_ 280 0;
BA_ "GenMsgILSupport" BO_ 280 1;
BA_ "GenMsgCycleTime" BO_ 280 10;
BA_ "CANFD_BRS" BO_ 280 1;
BA_ "Type" BO_ 281 1;
BA_ "GenMsgSendType" BO_ 281 0;
BA_ "GenMsgILSupport" BO_ 281 1;
BA_ "GenMsgCycleTime" BO_ 281 10;
BA_ "CANFD_BRS" BO_ 281 1;
BA_ "Type" BO_ 610 3;
BA_ "GenMsgSendType" BO_ 610 0;
BA_ "GenMsgNrOfRepetition" BO_ 610 2;
BA_ "GenMsgILSupport" BO_ 610 1;
BA_ "GenMsgCycleTimeFast" BO_ 610 20;
BA_ "GenMsgCycleTime" BO_ 610 100;
BA_ "GenMsgDelayTime" BO_ 610 20;
BA_ "CANFD_BRS" BO_ 610 1;
BA_ "Type" BO_ 1316 1;
BA_ "GenMsgSendType" BO_ 1316 0;
BA_ "GenMsgNrOfRepetition" BO_ 1316 2;
BA_ "GenMsgILSupport" BO_ 1316 1;
BA_ "GenMsgCycleTime" BO_ 1316 200;
BA_ "GenMsgDelayTime" BO_ 1316 20;
BA_ "CANFD_BRS" BO_ 1316 1;
BA_ "Type" BO_ 201 1;
BA_ "GenMsgSendType" BO_ 201 0;
BA_ "GenMsgILSupport" BO_ 201 1;
BA_ "GenMsgCycleTime" BO_ 201 10;
BA_ "CANFD_BRS" BO_ 201 1;
BA_ "Type" BO_ 476 3;
BA_ "GenMsgSendType" BO_ 476 0;
BA_ "GenMsgNrOfRepetition" BO_ 476 2;
BA_ "GenMsgILSupport" BO_ 476 1;
BA_ "GenMsgCycleTimeFast" BO_ 476 20;
BA_ "GenMsgCycleTime" BO_ 476 20;
BA_ "GenMsgDelayTime" BO_ 476 15;
BA_ "CANFD_BRS" BO_ 476 1;
BA_ "Type" BO_ 2654552065 8;
BA_ "GenMsgILSupport" BO_ 2654552065 1;
BA_ "VFrameFormat" BO_ 2654552065 1;
BA_ "Type" BO_ 2654555935 8;
BA_ "GenMsgILSupport" BO_ 2654555935 1;
BA_ "VFrameFormat" BO_ 2654555935 15;
BA_ "CANFD_BRS" BO_ 2654555935 1;
BA_ "Type" BO_ 2654555930 8;
BA_ "GenMsgILSupport" BO_ 2654555930 1;
BA_ "VFrameFormat" BO_ 2654555930 15;
BA_ "CANFD_BRS" BO_ 2654555930 1;
BA_ "Type" BO_ 2654555920 8;
BA_ "GenMsgILSupport" BO_ 2654555920 1;
BA_ "VFrameFormat" BO_ 2654555920 15;
BA_ "CANFD_BRS" BO_ 2654555920 1;
BA_ "Type" BO_ 2654555928 8;
BA_ "VFrameFormat" BO_ 2654555928 15;
BA_ "CANFD_BRS" BO_ 2654555928 1;
BA_ "Type" BO_ 2654552075 8;
BA_ "GenMsgILSupport" BO_ 2654552075 1;
BA_ "VFrameFormat" BO_ 2654552075 15;
BA_ "CANFD_BRS" BO_ 2654552075 1;
BA_ "Type" BO_ 2654814267 8;
BA_ "GenMsgILSupport" BO_ 2654814267 1;
BA_ "VFrameFormat" BO_ 2654814267 15;
BA_ "CANFD_BRS" BO_ 2654814267 1;
BA_ "Type" BO_ 1327 1;
BA_ "GenMsgSendType" BO_ 1327 0;
BA_ "GenMsgILSupport" BO_ 1327 1;
BA_ "GenMsgStartDelayTime" BO_ 1327 95;
BA_ "GenMsgCycleTime" BO_ 1327 200;
BA_ "CANFD_BRS" BO_ 1327 1;
BA_ "Type" BO_ 1445 3;
BA_ "GenMsgSendType" BO_ 1445 0;
BA_ "GenMsgNrOfRepetition" BO_ 1445 2;
BA_ "GenMsgILSupport" BO_ 1445 1;
BA_ "GenMsgStartDelayTime" BO_ 1445 375;
BA_ "GenMsgCycleTimeFast" BO_ 1445 20;
BA_ "GenMsgCycleTime" BO_ 1445 1000;
BA_ "GenMsgDelayTime" BO_ 1445 20;
BA_ "CANFD_BRS" BO_ 1445 1;
BA_ "GenSigSendType" SG_ 1456 ACC_Blind 3;
BA_ "GenSigTimeoutTime_AGSM" SG_ 1456 ACC_Blind 0;
BA_ "GenSigTimeoutTime_BCM" SG_ 1456 ACC_Blind 0;
BA_ "GenSigTimeoutTime_CADM" SG_ 1456 ACC_Blind 0;
BA_ "GenSigTimeoutTime_DMSM" SG_ 1456 ACC_Blind 0;
BA_ "GenSigTimeoutTime_DTCM" SG_ 1456 ACC_Blind 0;
BA_ "GenSigTimeoutTime_ECM" SG_ 1456 ACC_Blind 0;
BA_ "GenSigTimeoutTime_EVCU2" SG_ 1456 ACC_Blind 0;
BA_ "GenSigTimeoutTime_GNMM" SG_ 1456 ACC_Blind 0;
BA_ "GenSigTimeoutTime_HCP" SG_ 1456 ACC_Blind 0;
BA_ "GenSigTimeoutTime_RFHM" SG_ 1456 ACC_Blind 0;
BA_ "GenSigTimeoutTime_SGW" SG_ 1456 ACC_Blind 0;
BA_ "GenSigTimeoutTime_TCM" SG_ 1456 ACC_Blind 0;
BA_ "GenSigSendType" SG_ 1456 ACC_DispPopupSts 3;
BA_ "GenSigTimeoutTime_AGSM" SG_ 1456 ACC_DispPopupSts 0;
BA_ "GenSigTimeoutTime_BCM" SG_ 1456 ACC_DispPopupSts 0;
BA_ "GenSigTimeoutTime_BSM" SG_ 1456 ACC_DispPopupSts 0;
BA_ "GenSigTimeoutTime_CADM" SG_ 1456 ACC_DispPopupSts 0;
BA_ "GenSigTimeoutTime_DMSM" SG_ 1456 ACC_DispPopupSts 0;
BA_ "GenSigTimeoutTime_DTCM" SG_ 1456 ACC_DispPopupSts 0;
BA_ "GenSigTimeoutTime_ECM" SG_ 1456 ACC_DispPopupSts 0;
BA_ "GenSigTimeoutTime_EVCU2" SG_ 1456 ACC_DispPopupSts 0;
BA_ "GenSigTimeoutTime_GNMM" SG_ 1456 ACC_DispPopupSts 0;
BA_ "GenSigTimeoutTime_HCP" SG_ 1456 ACC_DispPopupSts 0;
BA_ "GenSigTimeoutTime_RFHM" SG_ 1456 ACC_DispPopupSts 0;
BA_ "GenSigTimeoutTime_TCM" SG_ 1456 ACC_DispPopupSts 0;
BA_ "GenSigSendType" SG_ 1456 ACC_FailSts 3;
BA_ "GenSigTimeoutTime_AGSM" SG_ 1456 ACC_FailSts 0;
BA_ "GenSigTimeoutTime_BCM" SG_ 1456 ACC_FailSts 0;
BA_ "GenSigTimeoutTime_CADM" SG_ 1456 ACC_FailSts 0;
BA_ "GenSigTimeoutTime_DMSM" SG_ 1456 ACC_FailSts 0;
BA_ "GenSigTimeoutTime_DTCM" SG_ 1456 ACC_FailSts 0;
BA_ "GenSigTimeoutTime_ECM" SG_ 1456 ACC_FailSts 0;
BA_ "GenSigTimeoutTime_EVCU2" SG_ 1456 ACC_FailSts 0;
BA_ "GenSigTimeoutTime_GNMM" SG_ 1456 ACC_FailSts 0;
BA_ "GenSigTimeoutTime_HCP" SG_ 1456 ACC_FailSts 0;
BA_ "GenSigTimeoutTime_RFHM" SG_ 1456 ACC_FailSts 0;
BA_ "GenSigTimeoutTime_TCM" SG_ 1456 ACC_FailSts 0;
BA_ "GenSigSendType" SG_ 1456 ACC_Limit_Fail 3;
BA_ "GenSigTimeoutTime_AGSM" SG_ 1456 ACC_Limit_Fail 0;
BA_ "GenSigTimeoutTime_BCM" SG_ 1456 ACC_Limit_Fail 0;
BA_ "GenSigTimeoutTime_BSM" SG_ 1456 ACC_Limit_Fail 0;
BA_ "GenSigTimeoutTime_CADM" SG_ 1456 ACC_Limit_Fail 0;
BA_ "GenSigTimeoutTime_DMSM" SG_ 1456 ACC_Limit_Fail 0;
BA_ "GenSigTimeoutTime_DTCM" SG_ 1456 ACC_Limit_Fail 0;
BA_ "GenSigTimeoutTime_ECM" SG_ 1456 ACC_Limit_Fail 0;
BA_ "GenSigTimeoutTime_EVCU2" SG_ 1456 ACC_Limit_Fail 0;
BA_ "GenSigTimeoutTime_GNMM" SG_ 1456 ACC_Limit_Fail 0;
BA_ "GenSigTimeoutTime_HCP" SG_ 1456 ACC_Limit_Fail 0;
BA_ "GenSigTimeoutTime_RFHM" SG_ 1456 ACC_Limit_Fail 0;
BA_ "GenSigTimeoutTime_SGW" SG_ 1456 ACC_Limit_Fail 0;
BA_ "GenSigTimeoutTime_TCM" SG_ 1456 ACC_Limit_Fail 0;
BA_ "GenSigSendType" SG_ 1456 ACC_Limited 3;
BA_ "GenSigTimeoutTime_AGSM" SG_ 1456 ACC_Limited 0;
BA_ "GenSigTimeoutTime_BCM" SG_ 1456 ACC_Limited 0;
BA_ "GenSigTimeoutTime_BSM" SG_ 1456 ACC_Limited 0;
BA_ "GenSigTimeoutTime_CADM" SG_ 1456 ACC_Limited 0;
BA_ "GenSigTimeoutTime_DMSM" SG_ 1456 ACC_Limited 0;
BA_ "GenSigTimeoutTime_DTCM" SG_ 1456 ACC_Limited 0;
BA_ "GenSigTimeoutTime_ECM" SG_ 1456 ACC_Limited 0;
BA_ "GenSigTimeoutTime_EVCU2" SG_ 1456 ACC_Limited 0;
BA_ "GenSigTimeoutTime_GNMM" SG_ 1456 ACC_Limited 0;
BA_ "GenSigTimeoutTime_HCP" SG_ 1456 ACC_Limited 0;
BA_ "GenSigTimeoutTime_RFHM" SG_ 1456 ACC_Limited 0;
BA_ "GenSigTimeoutTime_SGW" SG_ 1456 ACC_Limited 0;
BA_ "GenSigTimeoutTime_TCM" SG_ 1456 ACC_Limited 0;
BA_ "GenSigSendType" SG_ 1456 ACC_Set_Speed_Strike 3;
BA_ "GenSigTimeoutTime_AGSM" SG_ 1456 ACC_Set_Speed_Strike 0;
BA_ "GenSigTimeoutTime_BCM" SG_ 1456 ACC_Set_Speed_Strike 0;
BA_ "GenSigTimeoutTime_BSM" SG_ 1456 ACC_Set_Speed_Strike 0;
BA_ "GenSigTimeoutTime_CADM" SG_ 1456 ACC_Set_Speed_Strike 0;
BA_ "GenSigTimeoutTime_DMSM" SG_ 1456 ACC_Set_Speed_Strike 0;
BA_ "GenSigTimeoutTime_DTCM" SG_ 1456 ACC_Set_Speed_Strike 0;
BA_ "GenSigTimeoutTime_ECM" SG_ 1456 ACC_Set_Speed_Strike 0;
BA_ "GenSigTimeoutTime_EVCU2" SG_ 1456 ACC_Set_Speed_Strike 0;
BA_ "GenSigTimeoutTime_GNMM" SG_ 1456 ACC_Set_Speed_Strike 0;
BA_ "GenSigTimeoutTime_HCP" SG_ 1456 ACC_Set_Speed_Strike 0;
BA_ "GenSigTimeoutTime_RFHM" SG_ 1456 ACC_Set_Speed_Strike 0;
BA_ "GenSigTimeoutTime_TCM" SG_ 1456 ACC_Set_Speed_Strike 0;
BA_ "GenSigSendType" SG_ 1456 AEB_Blind 3;
BA_ "GenSigTimeoutTime_AGSM" SG_ 1456 AEB_Blind 0;
BA_ "GenSigTimeoutTime_BCM" SG_ 1456 AEB_Blind 0;
BA_ "GenSigTimeoutTime_BSM" SG_ 1456 AEB_Blind 0;
BA_ "GenSigTimeoutTime_CADM" SG_ 1456 AEB_Blind 0;
BA_ "GenSigTimeoutTime_DMSM" SG_ 1456 AEB_Blind 0;
BA_ "GenSigTimeoutTime_DTCM" SG_ 1456 AEB_Blind 0;
BA_ "GenSigTimeoutTime_ECM" SG_ 1456 AEB_Blind 0;
BA_ "GenSigTimeoutTime_EVCU2" SG_ 1456 AEB_Blind 0;
BA_ "GenSigTimeoutTime_GNMM" SG_ 1456 AEB_Blind 0;
BA_ "GenSigTimeoutTime_HCP" SG_ 1456 AEB_Blind 0;
BA_ "GenSigTimeoutTime_RFHM" SG_ 1456 AEB_Blind 0;
BA_ "GenSigTimeoutTime_SGW" SG_ 1456 AEB_Blind 0;
BA_ "GenSigTimeoutTime_TCM" SG_ 1456 AEB_Blind 0;
BA_ "GenSigSendType" SG_ 1456 AEB_DispPopupSts 3;
BA_ "GenSigTimeoutTime_AGSM" SG_ 1456 AEB_DispPopupSts 0;
BA_ "GenSigTimeoutTime_BCM" SG_ 1456 AEB_DispPopupSts 0;
BA_ "GenSigTimeoutTime_BSM" SG_ 1456 AEB_DispPopupSts 0;
BA_ "GenSigTimeoutTime_CADM" SG_ 1456 AEB_DispPopupSts 0;
BA_ "GenSigTimeoutTime_DMSM" SG_ 1456 AEB_DispPopupSts 0;
BA_ "GenSigTimeoutTime_DTCM" SG_ 1456 AEB_DispPopupSts 0;
BA_ "GenSigTimeoutTime_ECM" SG_ 1456 AEB_DispPopupSts 0;
BA_ "GenSigTimeoutTime_EVCU2" SG_ 1456 AEB_DispPopupSts 0;
BA_ "GenSigTimeoutTime_GNMM" SG_ 1456 AEB_DispPopupSts 0;
BA_ "GenSigTimeoutTime_HCP" SG_ 1456 AEB_DispPopupSts 0;
BA_ "GenSigTimeoutTime_RFHM" SG_ 1456 AEB_DispPopupSts 0;
BA_ "GenSigTimeoutTime_TCM" SG_ 1456 AEB_DispPopupSts 0;
BA_ "GenSigSendType" SG_ 1456 AEB_FailSts 3;
BA_ "GenSigTimeoutTime_AGSM" SG_ 1456 AEB_FailSts 0;
BA_ "GenSigTimeoutTime_BCM" SG_ 1456 AEB_FailSts 0;
BA_ "GenSigTimeoutTime_CADM" SG_ 1456 AEB_FailSts 0;
BA_ "GenSigTimeoutTime_DMSM" SG_ 1456 AEB_FailSts 0;
BA_ "GenSigTimeoutTime_DTCM" SG_ 1456 AEB_FailSts 0;
BA_ "GenSigTimeoutTime_ECM" SG_ 1456 AEB_FailSts 0;
BA_ "GenSigTimeoutTime_EVCU2" SG_ 1456 AEB_FailSts 0;
BA_ "GenSigTimeoutTime_GNMM" SG_ 1456 AEB_FailSts 0;
BA_ "GenSigTimeoutTime_HCP" SG_ 1456 AEB_FailSts 0;
BA_ "GenSigTimeoutTime_RFHM" SG_ 1456 AEB_FailSts 0;
BA_ "GenSigTimeoutTime_SGW" SG_ 1456 AEB_FailSts 0;
BA_ "GenSigTimeoutTime_TCM" SG_ 1456 AEB_FailSts 0;
BA_ "GenSigSendType" SG_ 1456 AEB_Limit_Fail 3;
BA_ "GenSigTimeoutTime_AGSM" SG_ 1456 AEB_Limit_Fail 0;
BA_ "GenSigTimeoutTime_BCM" SG_ 1456 AEB_Limit_Fail 0;
BA_ "GenSigTimeoutTime_BSM" SG_ 1456 AEB_Limit_Fail 0;
BA_ "GenSigTimeoutTime_CADM" SG_ 1456 AEB_Limit_Fail 0;
BA_ "GenSigTimeoutTime_DMSM" SG_ 1456 AEB_Limit_Fail 0;
BA_ "GenSigTimeoutTime_DTCM" SG_ 1456 AEB_Limit_Fail 0;
BA_ "GenSigTimeoutTime_ECM" SG_ 1456 AEB_Limit_Fail 0;
BA_ "GenSigTimeoutTime_EVCU2" SG_ 1456 AEB_Limit_Fail 0;
BA_ "GenSigTimeoutTime_GNMM" SG_ 1456 AEB_Limit_Fail 0;
BA_ "GenSigTimeoutTime_HCP" SG_ 1456 AEB_Limit_Fail 0;
BA_ "GenSigTimeoutTime_RFHM" SG_ 1456 AEB_Limit_Fail 0;
BA_ "GenSigTimeoutTime_SGW" SG_ 1456 AEB_Limit_Fail 0;
BA_ "GenSigTimeoutTime_TCM" SG_ 1456 AEB_Limit_Fail 0;
BA_ "GenSigSendType" SG_ 1456 AEB_Limited 3;
BA_ "GenSigTimeoutTime_AGSM" SG_ 1456 AEB_Limited 0;
BA_ "GenSigTimeoutTime_BCM" SG_ 1456 AEB_Limited 0;
BA_ "GenSigTimeoutTime_BSM" SG_ 1456 AEB_Limited 0;
BA_ "GenSigTimeoutTime_CADM" SG_ 1456 AEB_Limited 0;
BA_ "GenSigTimeoutTime_DMSM" SG_ 1456 AEB_Limited 0;
BA_ "GenSigTimeoutTime_DTCM" SG_ 1456 AEB_Limited 0;
BA_ "GenSigTimeoutTime_ECM" SG_ 1456 AEB_Limited 0;
BA_ "GenSigTimeoutTime_EVCU2" SG_ 1456 AEB_Limited 0;
BA_ "GenSigTimeoutTime_GNMM" SG_ 1456 AEB_Limited 0;
BA_ "GenSigTimeoutTime_HCP" SG_ 1456 AEB_Limited 0;
BA_ "GenSigTimeoutTime_RFHM" SG_ 1456 AEB_Limited 0;
BA_ "GenSigTimeoutTime_SGW" SG_ 1456 AEB_Limited 0;
BA_ "GenSigTimeoutTime_TCM" SG_ 1456 AEB_Limited 0;
BA_ "GenSigSendType" SG_ 1456 BlindSpotLeftWarn 3;
BA_ "GenSigTimeoutTime_AGSM" SG_ 1456 BlindSpotLeftWarn 0;
BA_ "GenSigTimeoutTime_BSM" SG_ 1456 BlindSpotLeftWarn 0;
BA_ "GenSigTimeoutTime_CADM" SG_ 1456 BlindSpotLeftWarn 0;
BA_ "GenSigTimeoutTime_DMSM" SG_ 1456 BlindSpotLeftWarn 0;
BA_ "GenSigTimeoutTime_DTCM" SG_ 1456 BlindSpotLeftWarn 0;
BA_ "GenSigTimeoutTime_ECM" SG_ 1456 BlindSpotLeftWarn 0;
BA_ "GenSigTimeoutTime_EVCU2" SG_ 1456 BlindSpotLeftWarn 0;
BA_ "GenSigTimeoutTime_GNMM" SG_ 1456 BlindSpotLeftWarn 0;
BA_ "GenSigTimeoutTime_HCP" SG_ 1456 BlindSpotLeftWarn 0;
BA_ "GenSigTimeoutTime_IPC" SG_ 1456 BlindSpotLeftWarn 0;
BA_ "GenSigTimeoutTime_RFHM" SG_ 1456 BlindSpotLeftWarn 0;
BA_ "GenSigTimeoutTime_SGW" SG_ 1456 BlindSpotLeftWarn 0;
BA_ "GenSigTimeoutTime_TCM" SG_ 1456 BlindSpotLeftWarn 0;
BA_ "GenSigSendType" SG_ 1456 BlindSpotRightWarn 3;
BA_ "GenSigTimeoutTime_AGSM" SG_ 1456 BlindSpotRightWarn 0;
BA_ "GenSigTimeoutTime_BSM" SG_ 1456 BlindSpotRightWarn 0;
BA_ "GenSigTimeoutTime_CADM" SG_ 1456 BlindSpotRightWarn 0;
BA_ "GenSigTimeoutTime_DMSM" SG_ 1456 BlindSpotRightWarn 0;
BA_ "GenSigTimeoutTime_DTCM" SG_ 1456 BlindSpotRightWarn 0;
BA_ "GenSigTimeoutTime_ECM" SG_ 1456 BlindSpotRightWarn 0;
BA_ "GenSigTimeoutTime_EVCU2" SG_ 1456 BlindSpotRightWarn 0;
BA_ "GenSigTimeoutTime_GNMM" SG_ 1456 BlindSpotRightWarn 0;
BA_ "GenSigTimeoutTime_HCP" SG_ 1456 BlindSpotRightWarn 0;
BA_ "GenSigTimeoutTime_IPC" SG_ 1456 BlindSpotRightWarn 0;
BA_ "GenSigTimeoutTime_RFHM" SG_ 1456 BlindSpotRightWarn 0;
BA_ "GenSigTimeoutTime_SGW" SG_ 1456 BlindSpotRightWarn 0;
BA_ "GenSigTimeoutTime_TCM" SG_ 1456 BlindSpotRightWarn 0;
BA_ "GenSigSendType" SG_ 1456 BSS_Blind_RQSts 3;
BA_ "GenSigTimeoutTime_AGSM" SG_ 1456 BSS_Blind_RQSts 0;
BA_ "GenSigTimeoutTime_BSM" SG_ 1456 BSS_Blind_RQSts 0;
BA_ "GenSigTimeoutTime_CADM" SG_ 1456 BSS_Blind_RQSts 0;
BA_ "GenSigTimeoutTime_DMSM" SG_ 1456 BSS_Blind_RQSts 0;
BA_ "GenSigTimeoutTime_DTCM" SG_ 1456 BSS_Blind_RQSts 0;
BA_ "GenSigTimeoutTime_ECM" SG_ 1456 BSS_Blind_RQSts 0;
BA_ "GenSigTimeoutTime_EVCU2" SG_ 1456 BSS_Blind_RQSts 0;
BA_ "GenSigTimeoutTime_GNMM" SG_ 1456 BSS_Blind_RQSts 0;
BA_ "GenSigTimeoutTime_HCP" SG_ 1456 BSS_Blind_RQSts 0;
BA_ "GenSigTimeoutTime_RFHM" SG_ 1456 BSS_Blind_RQSts 0;
BA_ "GenSigTimeoutTime_TCM" SG_ 1456 BSS_Blind_RQSts 0;
BA_ "GenSigSendType" SG_ 1456 BSS_CFG_STATSts 3;
BA_ "GenSigTimeoutTime_AGSM" SG_ 1456 BSS_CFG_STATSts 0;
BA_ "GenSigTimeoutTime_BCM" SG_ 1456 BSS_CFG_STATSts 0;
BA_ "GenSigTimeoutTime_BSM" SG_ 1456 BSS_CFG_STATSts 0;
BA_ "GenSigTimeoutTime_CADM" SG_ 1456 BSS_CFG_STATSts 0;
BA_ "GenSigTimeoutTime_DMSM" SG_ 1456 BSS_CFG_STATSts 0;
BA_ "GenSigTimeoutTime_DTCM" SG_ 1456 BSS_CFG_STATSts 0;
BA_ "GenSigTimeoutTime_ECM" SG_ 1456 BSS_CFG_STATSts 0;
BA_ "GenSigTimeoutTime_EVCU2" SG_ 1456 BSS_CFG_STATSts 0;
BA_ "GenSigTimeoutTime_GNMM" SG_ 1456 BSS_CFG_STATSts 0;
BA_ "GenSigTimeoutTime_HCP" SG_ 1456 BSS_CFG_STATSts 0;
BA_ "GenSigTimeoutTime_RFHM" SG_ 1456 BSS_CFG_STATSts 0;
BA_ "GenSigTimeoutTime_SGW" SG_ 1456 BSS_CFG_STATSts 0;
BA_ "GenSigTimeoutTime_TCM" SG_ 1456 BSS_CFG_STATSts 0;
BA_ "GenSigSendType" SG_ 1456 BSS_SRV_RQSts 3;
BA_ "GenSigTimeoutTime_AGSM" SG_ 1456 BSS_SRV_RQSts 0;
BA_ "GenSigTimeoutTime_BSM" SG_ 1456 BSS_SRV_RQSts 0;
BA_ "GenSigTimeoutTime_CADM" SG_ 1456 BSS_SRV_RQSts 0;
BA_ "GenSigTimeoutTime_DMSM" SG_ 1456 BSS_SRV_RQSts 0;
BA_ "GenSigTimeoutTime_DTCM" SG_ 1456 BSS_SRV_RQSts 0;
BA_ "GenSigTimeoutTime_ECM" SG_ 1456 BSS_SRV_RQSts 0;
BA_ "GenSigTimeoutTime_EVCU2" SG_ 1456 BSS_SRV_RQSts 0;
BA_ "GenSigTimeoutTime_GNMM" SG_ 1456 BSS_SRV_RQSts 0;
BA_ "GenSigTimeoutTime_HCP" SG_ 1456 BSS_SRV_RQSts 0;
BA_ "GenSigTimeoutTime_RFHM" SG_ 1456 BSS_SRV_RQSts 0;
BA_ "GenSigTimeoutTime_TCM" SG_ 1456 BSS_SRV_RQSts 0;
BA_ "GenSigSendType" SG_ 1456 Chime_Priority 3;
BA_ "GenSigTimeoutTime_AGSM" SG_ 1456 Chime_Priority 0;
BA_ "GenSigTimeoutTime_BSM" SG_ 1456 Chime_Priority 0;
BA_ "GenSigTimeoutTime_CADM" SG_ 1456 Chime_Priority 0;
BA_ "GenSigTimeoutTime_DMSM" SG_ 1456 Chime_Priority 0;
BA_ "GenSigTimeoutTime_DTCM" SG_ 1456 Chime_Priority 0;
BA_ "GenSigTimeoutTime_ECM" SG_ 1456 Chime_Priority 0;
BA_ "GenSigTimeoutTime_EVCU2" SG_ 1456 Chime_Priority 0;
BA_ "GenSigTimeoutTime_GNMM" SG_ 1456 Chime_Priority 0;
BA_ "GenSigTimeoutTime_HCP" SG_ 1456 Chime_Priority 0;
BA_ "GenSigTimeoutTime_IPC" SG_ 1456 Chime_Priority 0;
BA_ "GenSigTimeoutTime_RFHM" SG_ 1456 Chime_Priority 0;
BA_ "GenSigTimeoutTime_TCM" SG_ 1456 Chime_Priority 0;
BA_ "GenSigSendType" SG_ 1456 Chime_RepRate 3;
BA_ "GenSigTimeoutTime_AGSM" SG_ 1456 Chime_RepRate 0;
BA_ "GenSigTimeoutTime_BSM" SG_ 1456 Chime_RepRate 0;
BA_ "GenSigTimeoutTime_CADM" SG_ 1456 Chime_RepRate 0;
BA_ "GenSigTimeoutTime_DMSM" SG_ 1456 Chime_RepRate 0;
BA_ "GenSigTimeoutTime_DTCM" SG_ 1456 Chime_RepRate 0;
BA_ "GenSigTimeoutTime_ECM" SG_ 1456 Chime_RepRate 0;
BA_ "GenSigTimeoutTime_EVCU2" SG_ 1456 Chime_RepRate 0;
BA_ "GenSigTimeoutTime_GNMM" SG_ 1456 Chime_RepRate 0;
BA_ "GenSigTimeoutTime_HCP" SG_ 1456 Chime_RepRate 0;
BA_ "GenSigTimeoutTime_IPC" SG_ 1456 Chime_RepRate 0;
BA_ "GenSigTimeoutTime_RFHM" SG_ 1456 Chime_RepRate 0;
BA_ "GenSigTimeoutTime_TCM" SG_ 1456 Chime_RepRate 0;
BA_ "GenSigSendType" SG_ 1456 Chime_TypSts 3;
BA_ "GenSigTimeoutTime_AGSM" SG_ 1456 Chime_TypSts 0;
BA_ "GenSigTimeoutTime_BSM" SG_ 1456 Chime_TypSts 0;
BA_ "GenSigTimeoutTime_CADM" SG_ 1456 Chime_TypSts 0;
BA_ "GenSigTimeoutTime_DMSM" SG_ 1456 Chime_TypSts 0;
BA_ "GenSigTimeoutTime_DTCM" SG_ 1456 Chime_TypSts 0;
BA_ "GenSigTimeoutTime_ECM" SG_ 1456 Chime_TypSts 0;
BA_ "GenSigTimeoutTime_EVCU2" SG_ 1456 Chime_TypSts 0;
BA_ "GenSigTimeoutTime_GNMM" SG_ 1456 Chime_TypSts 0;
BA_ "GenSigTimeoutTime_HCP" SG_ 1456 Chime_TypSts 0;
BA_ "GenSigTimeoutTime_IPC" SG_ 1456 Chime_TypSts 0;
BA_ "GenSigTimeoutTime_RFHM" SG_ 1456 Chime_TypSts 0;
BA_ "GenSigTimeoutTime_TCM" SG_ 1456 Chime_TypSts 0;
BA_ "GenSigTimeoutTime_AGSM" SG_ 1456 CRC_ADAS_FD_HMI 0;
BA_ "GenSigTimeoutTime_BCM" SG_ 1456 CRC_ADAS_FD_HMI 0;
BA_ "GenSigTimeoutTime_CADM" SG_ 1456 CRC_ADAS_FD_HMI 0;
BA_ "GenSigTimeoutTime_DTCM" SG_ 1456 CRC_ADAS_FD_HMI 0;
BA_ "GenSigTimeoutTime_EVCU2" SG_ 1456 CRC_ADAS_FD_HMI 0;
BA_ "GenSigTimeoutTime_GNMM" SG_ 1456 CRC_ADAS_FD_HMI 0;
BA_ "GenSigTimeoutTime_HCP" SG_ 1456 CRC_ADAS_FD_HMI 0;
BA_ "GenSigTimeoutTime_RFHM" SG_ 1456 CRC_ADAS_FD_HMI 0;
BA_ "GenSigTimeoutTime_SGW" SG_ 1456 CRC_ADAS_FD_HMI 0;
BA_ "GenSigTimeoutTime_TCM" SG_ 1456 CRC_ADAS_FD_HMI 0;
BA_ "GenSigSendType" SG_ 1456 DDD_DispPopupSts 3;
BA_ "GenSigTimeoutTime_AGSM" SG_ 1456 DDD_DispPopupSts 0;
BA_ "GenSigTimeoutTime_BCM" SG_ 1456 DDD_DispPopupSts 0;
BA_ "GenSigTimeoutTime_BSM" SG_ 1456 DDD_DispPopupSts 0;
BA_ "GenSigTimeoutTime_CADM" SG_ 1456 DDD_DispPopupSts 0;
BA_ "GenSigTimeoutTime_DMSM" SG_ 1456 DDD_DispPopupSts 0;
BA_ "GenSigTimeoutTime_DTCM" SG_ 1456 DDD_DispPopupSts 0;
BA_ "GenSigTimeoutTime_ECM" SG_ 1456 DDD_DispPopupSts 0;
BA_ "GenSigTimeoutTime_EVCU2" SG_ 1456 DDD_DispPopupSts 0;
BA_ "GenSigTimeoutTime_GNMM" SG_ 1456 DDD_DispPopupSts 0;
BA_ "GenSigTimeoutTime_HCP" SG_ 1456 DDD_DispPopupSts 0;
BA_ "GenSigTimeoutTime_RFHM" SG_ 1456 DDD_DispPopupSts 0;
BA_ "GenSigTimeoutTime_SGW" SG_ 1456 DDD_DispPopupSts 0;
BA_ "GenSigTimeoutTime_TCM" SG_ 1456 DDD_DispPopupSts 0;
BA_ "GenSigSendType" SG_ 1456 DDD_FailSts 3;
BA_ "GenSigTimeoutTime_AGSM" SG_ 1456 DDD_FailSts 0;
BA_ "GenSigTimeoutTime_BCM" SG_ 1456 DDD_FailSts 0;
BA_ "GenSigTimeoutTime_BSM" SG_ 1456 DDD_FailSts 0;
BA_ "GenSigTimeoutTime_CADM" SG_ 1456 DDD_FailSts 0;
BA_ "GenSigTimeoutTime_DMSM" SG_ 1456 DDD_FailSts 0;
BA_ "GenSigTimeoutTime_DTCM" SG_ 1456 DDD_FailSts 0;
BA_ "GenSigTimeoutTime_ECM" SG_ 1456 DDD_FailSts 0;
BA_ "GenSigTimeoutTime_EVCU2" SG_ 1456 DDD_FailSts 0;
BA_ "GenSigTimeoutTime_GNMM" SG_ 1456 DDD_FailSts 0;
BA_ "GenSigTimeoutTime_HCP" SG_ 1456 DDD_FailSts 0;
BA_ "GenSigTimeoutTime_RFHM" SG_ 1456 DDD_FailSts 0;
BA_ "GenSigTimeoutTime_SGW" SG_ 1456 DDD_FailSts 0;
BA_ "GenSigTimeoutTime_TCM" SG_ 1456 DDD_FailSts 0;
BA_ "GenSigSendType" SG_ 1456 DisplaySts_ACC 3;
BA_ "GenSigTimeoutTime_AGSM" SG_ 1456 DisplaySts_ACC 0;
BA_ "GenSigTimeoutTime_BCM" SG_ 1456 DisplaySts_ACC 0;
BA_ "GenSigTimeoutTime_BSM" SG_ 1456 DisplaySts_ACC 0;
BA_ "GenSigTimeoutTime_CADM" SG_ 1456 DisplaySts_ACC 0;
BA_ "GenSigTimeoutTime_DMSM" SG_ 1456 DisplaySts_ACC 0;
BA_ "GenSigTimeoutTime_DTCM" SG_ 1456 DisplaySts_ACC 0;
BA_ "GenSigTimeoutTime_ECM" SG_ 1456 DisplaySts_ACC 0;
BA_ "GenSigTimeoutTime_EVCU2" SG_ 1456 DisplaySts_ACC 0;
BA_ "GenSigTimeoutTime_GNMM" SG_ 1456 DisplaySts_ACC 0;
BA_ "GenSigTimeoutTime_HCP" SG_ 1456 DisplaySts_ACC 0;
BA_ "GenSigTimeoutTime_RFHM" SG_ 1456 DisplaySts_ACC 0;
BA_ "GenSigTimeoutTime_TCM" SG_ 1456 DisplaySts_ACC 0;
BA_ "GenSigSendType" SG_ 1456 DisplaySts_Curve 3;
BA_ "GenSigTimeoutTime_AGSM" SG_ 1456 DisplaySts_Curve 0;
BA_ "GenSigTimeoutTime_BCM" SG_ 1456 DisplaySts_Curve 0;
BA_ "GenSigTimeoutTime_BSM" SG_ 1456 DisplaySts_Curve 0;
BA_ "GenSigTimeoutTime_CADM" SG_ 1456 DisplaySts_Curve 0;
BA_ "GenSigTimeoutTime_DMSM" SG_ 1456 DisplaySts_Curve 0;
BA_ "GenSigTimeoutTime_DTCM" SG_ 1456 DisplaySts_Curve 0;
BA_ "GenSigTimeoutTime_ECM" SG_ 1456 DisplaySts_Curve 0;
BA_ "GenSigTimeoutTime_EVCU2" SG_ 1456 DisplaySts_Curve 0;
BA_ "GenSigTimeoutTime_GNMM" SG_ 1456 DisplaySts_Curve 0;
BA_ "GenSigTimeoutTime_HCP" SG_ 1456 DisplaySts_Curve 0;
BA_ "GenSigTimeoutTime_RFHM" SG_ 1456 DisplaySts_Curve 0;
BA_ "GenSigTimeoutTime_SGW" SG_ 1456 DisplaySts_Curve 0;
BA_ "GenSigTimeoutTime_TCM" SG_ 1456 DisplaySts_Curve 0;
BA_ "GenSigSendType" SG_ 1456 DisplaySts_OFF 3;
BA_ "GenSigTimeoutTime_AGSM" SG_ 1456 DisplaySts_OFF 0;
BA_ "GenSigTimeoutTime_BCM" SG_ 1456 DisplaySts_OFF 0;
BA_ "GenSigTimeoutTime_BSM" SG_ 1456 DisplaySts_OFF 0;
BA_ "GenSigTimeoutTime_CADM" SG_ 1456 DisplaySts_OFF 0;
BA_ "GenSigTimeoutTime_DMSM" SG_ 1456 DisplaySts_OFF 0;
BA_ "GenSigTimeoutTime_DTCM" SG_ 1456 DisplaySts_OFF 0;
BA_ "GenSigTimeoutTime_ECM" SG_ 1456 DisplaySts_OFF 0;
BA_ "GenSigTimeoutTime_EVCU2" SG_ 1456 DisplaySts_OFF 0;
BA_ "GenSigTimeoutTime_GNMM" SG_ 1456 DisplaySts_OFF 0;
BA_ "GenSigTimeoutTime_HCP" SG_ 1456 DisplaySts_OFF 0;
BA_ "GenSigTimeoutTime_RFHM" SG_ 1456 DisplaySts_OFF 0;
BA_ "GenSigTimeoutTime_TCM" SG_ 1456 DisplaySts_OFF 0;
BA_ "GenSigSendType" SG_ 1456 DisplaySts_Veh 3;
BA_ "GenSigTimeoutTime_AGSM" SG_ 1456 DisplaySts_Veh 0;
BA_ "GenSigTimeoutTime_BCM" SG_ 1456 DisplaySts_Veh 0;
BA_ "GenSigTimeoutTime_BSM" SG_ 1456 DisplaySts_Veh 0;
BA_ "GenSigTimeoutTime_CADM" SG_ 1456 DisplaySts_Veh 0;
BA_ "GenSigTimeoutTime_DMSM" SG_ 1456 DisplaySts_Veh 0;
BA_ "GenSigTimeoutTime_DTCM" SG_ 1456 DisplaySts_Veh 0;
BA_ "GenSigTimeoutTime_ECM" SG_ 1456 DisplaySts_Veh 0;
BA_ "GenSigTimeoutTime_EVCU2" SG_ 1456 DisplaySts_Veh 0;
BA_ "GenSigTimeoutTime_GNMM" SG_ 1456 DisplaySts_Veh 0;
BA_ "GenSigTimeoutTime_HCP" SG_ 1456 DisplaySts_Veh 0;
BA_ "GenSigTimeoutTime_RFHM" SG_ 1456 DisplaySts_Veh 0;
BA_ "GenSigTimeoutTime_TCM" SG_ 1456 DisplaySts_Veh 0;
BA_ "GenSigSendType" SG_ 1456 DMSM_Wakeup 3;
BA_ "GenSigTimeoutTime_AGSM" SG_ 1456 DMSM_Wakeup 0;
BA_ "GenSigTimeoutTime_BCM" SG_ 1456 DMSM_Wakeup 0;
BA_ "GenSigTimeoutTime_BSM" SG_ 1456 DMSM_Wakeup 0;
BA_ "GenSigTimeoutTime_CADM" SG_ 1456 DMSM_Wakeup 0;
BA_ "GenSigTimeoutTime_DTCM" SG_ 1456 DMSM_Wakeup 0;
BA_ "GenSigTimeoutTime_ECM" SG_ 1456 DMSM_Wakeup 0;
BA_ "GenSigTimeoutTime_EVCU2" SG_ 1456 DMSM_Wakeup 0;
BA_ "GenSigTimeoutTime_GNMM" SG_ 1456 DMSM_Wakeup 0;
BA_ "GenSigTimeoutTime_HCP" SG_ 1456 DMSM_Wakeup 0;
BA_ "GenSigTimeoutTime_IPC" SG_ 1456 DMSM_Wakeup 0;
BA_ "GenSigTimeoutTime_RFHM" SG_ 1456 DMSM_Wakeup 0;
BA_ "GenSigTimeoutTime_SGW" SG_ 1456 DMSM_Wakeup 0;
BA_ "GenSigTimeoutTime_TCM" SG_ 1456 DMSM_Wakeup 0;
BA_ "GenSigSendType" SG_ 1456 Driver_Model 3;
BA_ "GenSigTimeoutTime_AGSM" SG_ 1456 Driver_Model 0;
BA_ "GenSigTimeoutTime_BCM" SG_ 1456 Driver_Model 0;
BA_ "GenSigTimeoutTime_BSM" SG_ 1456 Driver_Model 0;
BA_ "GenSigTimeoutTime_CADM" SG_ 1456 Driver_Model 0;
BA_ "GenSigTimeoutTime_DMSM" SG_ 1456 Driver_Model 0;
BA_ "GenSigTimeoutTime_DTCM" SG_ 1456 Driver_Model 0;
BA_ "GenSigTimeoutTime_ECM" SG_ 1456 Driver_Model 0;
BA_ "GenSigTimeoutTime_EVCU2" SG_ 1456 Driver_Model 0;
BA_ "GenSigTimeoutTime_GNMM" SG_ 1456 Driver_Model 0;
BA_ "GenSigTimeoutTime_HCP" SG_ 1456 Driver_Model 0;
BA_ "GenSigTimeoutTime_IPC" SG_ 1456 Driver_Model 0;
BA_ "GenSigTimeoutTime_RFHM" SG_ 1456 Driver_Model 0;
BA_ "GenSigTimeoutTime_SGW" SG_ 1456 Driver_Model 0;
BA_ "GenSigTimeoutTime_TCM" SG_ 1456 Driver_Model 0;
BA_ "GenSigSendType" SG_ 1456 FCW_Setting_Avail 3;
BA_ "GenSigTimeoutTime_AGSM" SG_ 1456 FCW_Setting_Avail 0;
BA_ "GenSigTimeoutTime_BCM" SG_ 1456 FCW_Setting_Avail 0;
BA_ "GenSigTimeoutTime_BSM" SG_ 1456 FCW_Setting_Avail 0;
BA_ "GenSigTimeoutTime_CADM" SG_ 1456 FCW_Setting_Avail 0;
BA_ "GenSigTimeoutTime_DMSM" SG_ 1456 FCW_Setting_Avail 0;
BA_ "GenSigTimeoutTime_DTCM" SG_ 1456 FCW_Setting_Avail 0;
BA_ "GenSigTimeoutTime_ECM" SG_ 1456 FCW_Setting_Avail 0;
BA_ "GenSigTimeoutTime_EVCU2" SG_ 1456 FCW_Setting_Avail 0;
BA_ "GenSigTimeoutTime_GNMM" SG_ 1456 FCW_Setting_Avail 0;
BA_ "GenSigTimeoutTime_HCP" SG_ 1456 FCW_Setting_Avail 0;
BA_ "GenSigTimeoutTime_RFHM" SG_ 1456 FCW_Setting_Avail 0;
BA_ "GenSigTimeoutTime_SGW" SG_ 1456 FCW_Setting_Avail 0;
BA_ "GenSigTimeoutTime_TCM" SG_ 1456 FCW_Setting_Avail 0;
BA_ "GenSigSendType" SG_ 1456 HAS_Blind 3;
BA_ "GenSigTimeoutTime_AGSM" SG_ 1456 HAS_Blind 0;
BA_ "GenSigTimeoutTime_BCM" SG_ 1456 HAS_Blind 0;
BA_ "GenSigTimeoutTime_BSM" SG_ 1456 HAS_Blind 0;
BA_ "GenSigTimeoutTime_CADM" SG_ 1456 HAS_Blind 0;
BA_ "GenSigTimeoutTime_DMSM" SG_ 1456 HAS_Blind 0;
BA_ "GenSigTimeoutTime_DTCM" SG_ 1456 HAS_Blind 0;
BA_ "GenSigTimeoutTime_ECM" SG_ 1456 HAS_Blind 0;
BA_ "GenSigTimeoutTime_EVCU2" SG_ 1456 HAS_Blind 0;
BA_ "GenSigTimeoutTime_GNMM" SG_ 1456 HAS_Blind 0;
BA_ "GenSigTimeoutTime_HCP" SG_ 1456 HAS_Blind 0;
BA_ "GenSigTimeoutTime_RFHM" SG_ 1456 HAS_Blind 0;
BA_ "GenSigTimeoutTime_SGW" SG_ 1456 HAS_Blind 0;
BA_ "GenSigTimeoutTime_TCM" SG_ 1456 HAS_Blind 0;
BA_ "GenSigSendType" SG_ 1456 HAS_Escalation_Sts 3;
BA_ "GenSigTimeoutTime_AGSM" SG_ 1456 HAS_Escalation_Sts 0;
BA_ "GenSigTimeoutTime_BSM" SG_ 1456 HAS_Escalation_Sts 0;
BA_ "GenSigTimeoutTime_CADM" SG_ 1456 HAS_Escalation_Sts 0;
BA_ "GenSigTimeoutTime_DMSM" SG_ 1456 HAS_Escalation_Sts 0;
BA_ "GenSigTimeoutTime_DTCM" SG_ 1456 HAS_Escalation_Sts 0;
BA_ "GenSigTimeoutTime_ECM" SG_ 1456 HAS_Escalation_Sts 0;
BA_ "GenSigTimeoutTime_EVCU2" SG_ 1456 HAS_Escalation_Sts 0;
BA_ "GenSigTimeoutTime_GNMM" SG_ 1456 HAS_Escalation_Sts 0;
BA_ "GenSigTimeoutTime_HCP" SG_ 1456 HAS_Escalation_Sts 0;
BA_ "GenSigTimeoutTime_IPC" SG_ 1456 HAS_Escalation_Sts 0;
BA_ "GenSigTimeoutTime_RFHM" SG_ 1456 HAS_Escalation_Sts 0;
BA_ "GenSigTimeoutTime_SGW" SG_ 1456 HAS_Escalation_Sts 0;
BA_ "GenSigTimeoutTime_TCM" SG_ 1456 HAS_Escalation_Sts 0;
BA_ "GenSigSendType" SG_ 1456 HAS_FailSts 3;
BA_ "GenSigTimeoutTime_AGSM" SG_ 1456 HAS_FailSts 0;
BA_ "GenSigTimeoutTime_BCM" SG_ 1456 HAS_FailSts 0;
BA_ "GenSigTimeoutTime_BSM" SG_ 1456 HAS_FailSts 0;
BA_ "GenSigTimeoutTime_CADM" SG_ 1456 HAS_FailSts 0;
BA_ "GenSigTimeoutTime_DMSM" SG_ 1456 HAS_FailSts 0;
BA_ "GenSigTimeoutTime_DTCM" SG_ 1456 HAS_FailSts 0;
BA_ "GenSigTimeoutTime_ECM" SG_ 1456 HAS_FailSts 0;
BA_ "GenSigTimeoutTime_EVCU2" SG_ 1456 HAS_FailSts 0;
BA_ "GenSigTimeoutTime_GNMM" SG_ 1456 HAS_FailSts 0;
BA_ "GenSigTimeoutTime_HCP" SG_ 1456 HAS_FailSts 0;
BA_ "GenSigTimeoutTime_RFHM" SG_ 1456 HAS_FailSts 0;
BA_ "GenSigTimeoutTime_SGW" SG_ 1456 HAS_FailSts 0;
BA_ "GenSigTimeoutTime_TCM" SG_ 1456 HAS_FailSts 0;
BA_ "GenSigSendType" SG_ 1456 HAS_Hazard 3;
BA_ "GenSigTimeoutTime_AGSM" SG_ 1456 HAS_Hazard 0;
BA_ "GenSigTimeoutTime_BSM" SG_ 1456 HAS_Hazard 0;
BA_ "GenSigTimeoutTime_CADM" SG_ 1456 HAS_Hazard 0;
BA_ "GenSigTimeoutTime_DMSM" SG_ 1456 HAS_Hazard 0;
BA_ "GenSigTimeoutTime_DTCM" SG_ 1456 HAS_Hazard 0;
BA_ "GenSigTimeoutTime_ECM" SG_ 1456 HAS_Hazard 0;
BA_ "GenSigTimeoutTime_EVCU2" SG_ 1456 HAS_Hazard 0;
BA_ "GenSigTimeoutTime_GNMM" SG_ 1456 HAS_Hazard 0;
BA_ "GenSigTimeoutTime_HCP" SG_ 1456 HAS_Hazard 0;
BA_ "GenSigTimeoutTime_IPC" SG_ 1456 HAS_Hazard 0;
BA_ "GenSigTimeoutTime_RFHM" SG_ 1456 HAS_Hazard 0;
BA_ "GenSigTimeoutTime_SGW" SG_ 1456 HAS_Hazard 0;
BA_ "GenSigTimeoutTime_TCM" SG_ 1456 HAS_Hazard 0;
BA_ "GenSigSendType" SG_ 1456 HAS_Inhibit_HMI 4;
BA_ "GenSigTimeoutTime_AGSM" SG_ 1456 HAS_Inhibit_HMI 0;
BA_ "GenSigTimeoutTime_BCM" SG_ 1456 HAS_Inhibit_HMI 0;
BA_ "GenSigTimeoutTime_BSM" SG_ 1456 HAS_Inhibit_HMI 0;
BA_ "GenSigTimeoutTime_CADM" SG_ 1456 HAS_Inhibit_HMI 0;
BA_ "GenSigTimeoutTime_DMSM" SG_ 1456 HAS_Inhibit_HMI 0;
BA_ "GenSigTimeoutTime_DTCM" SG_ 1456 HAS_Inhibit_HMI 0;
BA_ "GenSigTimeoutTime_ECM" SG_ 1456 HAS_Inhibit_HMI 0;
BA_ "GenSigTimeoutTime_EVCU2" SG_ 1456 HAS_Inhibit_HMI 0;
BA_ "GenSigTimeoutTime_GNMM" SG_ 1456 HAS_Inhibit_HMI 0;
BA_ "GenSigTimeoutTime_HCP" SG_ 1456 HAS_Inhibit_HMI 0;
BA_ "GenSigTimeoutTime_RFHM" SG_ 1456 HAS_Inhibit_HMI 0;
BA_ "GenSigTimeoutTime_SGW" SG_ 1456 HAS_Inhibit_HMI 0;
BA_ "GenSigTimeoutTime_TCM" SG_ 1456 HAS_Inhibit_HMI 0;
BA_ "GenSigSendType" SG_ 1456 HAS_TelltaleSts 3;
BA_ "GenSigTimeoutTime_AGSM" SG_ 1456 HAS_TelltaleSts 0;
BA_ "GenSigTimeoutTime_BCM" SG_ 1456 HAS_TelltaleSts 0;
BA_ "GenSigTimeoutTime_BSM" SG_ 1456 HAS_TelltaleSts 0;
BA_ "GenSigTimeoutTime_CADM" SG_ 1456 HAS_TelltaleSts 0;
BA_ "GenSigTimeoutTime_DMSM" SG_ 1456 HAS_TelltaleSts 0;
BA_ "GenSigTimeoutTime_DTCM" SG_ 1456 HAS_TelltaleSts 0;
BA_ "GenSigTimeoutTime_ECM" SG_ 1456 HAS_TelltaleSts 0;
BA_ "GenSigTimeoutTime_EVCU2" SG_ 1456 HAS_TelltaleSts 0;
BA_ "GenSigTimeoutTime_GNMM" SG_ 1456 HAS_TelltaleSts 0;
BA_ "GenSigTimeoutTime_HCP" SG_ 1456 HAS_TelltaleSts 0;
BA_ "GenSigTimeoutTime_RFHM" SG_ 1456 HAS_TelltaleSts 0;
BA_ "GenSigTimeoutTime_TCM" SG_ 1456 HAS_TelltaleSts 0;
BA_ "GenSigSendType" SG_ 1456 HAS_TurnSignalRequest 3;
BA_ "GenSigTimeoutTime_AGSM" SG_ 1456 HAS_TurnSignalRequest 0;
BA_ "GenSigTimeoutTime_BSM" SG_ 1456 HAS_TurnSignalRequest 0;
BA_ "GenSigTimeoutTime_CADM" SG_ 1456 HAS_TurnSignalRequest 0;
BA_ "GenSigTimeoutTime_DMSM" SG_ 1456 HAS_TurnSignalRequest 0;
BA_ "GenSigTimeoutTime_DTCM" SG_ 1456 HAS_TurnSignalRequest 0;
BA_ "GenSigTimeoutTime_ECM" SG_ 1456 HAS_TurnSignalRequest 0;
BA_ "GenSigTimeoutTime_EVCU2" SG_ 1456 HAS_TurnSignalRequest 0;
BA_ "GenSigTimeoutTime_GNMM" SG_ 1456 HAS_TurnSignalRequest 0;
BA_ "GenSigTimeoutTime_HCP" SG_ 1456 HAS_TurnSignalRequest 0;
BA_ "GenSigTimeoutTime_IPC" SG_ 1456 HAS_TurnSignalRequest 0;
BA_ "GenSigTimeoutTime_RFHM" SG_ 1456 HAS_TurnSignalRequest 0;
BA_ "GenSigTimeoutTime_SGW" SG_ 1456 HAS_TurnSignalRequest 0;
BA_ "GenSigTimeoutTime_TCM" SG_ 1456 HAS_TurnSignalRequest 0;
BA_ "GenSigSendType" SG_ 1456 ICA_Blind 3;
BA_ "GenSigTimeoutTime_AGSM" SG_ 1456 ICA_Blind 0;
BA_ "GenSigTimeoutTime_BCM" SG_ 1456 ICA_Blind 0;
BA_ "GenSigTimeoutTime_BSM" SG_ 1456 ICA_Blind 0;
BA_ "GenSigTimeoutTime_CADM" SG_ 1456 ICA_Blind 0;
BA_ "GenSigTimeoutTime_DMSM" SG_ 1456 ICA_Blind 0;
BA_ "GenSigTimeoutTime_DTCM" SG_ 1456 ICA_Blind 0;
BA_ "GenSigTimeoutTime_ECM" SG_ 1456 ICA_Blind 0;
BA_ "GenSigTimeoutTime_EVCU2" SG_ 1456 ICA_Blind 0;
BA_ "GenSigTimeoutTime_GNMM" SG_ 1456 ICA_Blind 0;
BA_ "GenSigTimeoutTime_HCP" SG_ 1456 ICA_Blind 0;
BA_ "GenSigTimeoutTime_RFHM" SG_ 1456 ICA_Blind 0;
BA_ "GenSigTimeoutTime_SGW" SG_ 1456 ICA_Blind 0;
BA_ "GenSigTimeoutTime_TCM" SG_ 1456 ICA_Blind 0;
BA_ "GenSigSendType" SG_ 1456 Lane_DisplaySts_Left 3;
BA_ "GenSigTimeoutTime_AGSM" SG_ 1456 Lane_DisplaySts_Left 0;
BA_ "GenSigTimeoutTime_BCM" SG_ 1456 Lane_DisplaySts_Left 0;
BA_ "GenSigTimeoutTime_BSM" SG_ 1456 Lane_DisplaySts_Left 0;
BA_ "GenSigTimeoutTime_CADM" SG_ 1456 Lane_DisplaySts_Left 0;
BA_ "GenSigTimeoutTime_DMSM" SG_ 1456 Lane_DisplaySts_Left 0;
BA_ "GenSigTimeoutTime_DTCM" SG_ 1456 Lane_DisplaySts_Left 0;
BA_ "GenSigTimeoutTime_ECM" SG_ 1456 Lane_DisplaySts_Left 0;
BA_ "GenSigTimeoutTime_EVCU2" SG_ 1456 Lane_DisplaySts_Left 0;
BA_ "GenSigTimeoutTime_GNMM" SG_ 1456 Lane_DisplaySts_Left 0;
BA_ "GenSigTimeoutTime_HCP" SG_ 1456 Lane_DisplaySts_Left 0;
BA_ "GenSigTimeoutTime_RFHM" SG_ 1456 Lane_DisplaySts_Left 0;
BA_ "GenSigTimeoutTime_TCM" SG_ 1456 Lane_DisplaySts_Left 0;
BA_ "GenSigSendType" SG_ 1456 Lane_DisplaySts_Right 3;
BA_ "GenSigTimeoutTime_AGSM" SG_ 1456 Lane_DisplaySts_Right 0;
BA_ "GenSigTimeoutTime_BCM" SG_ 1456 Lane_DisplaySts_Right 0;
BA_ "GenSigTimeoutTime_BSM" SG_ 1456 Lane_DisplaySts_Right 0;
BA_ "GenSigTimeoutTime_CADM" SG_ 1456 Lane_DisplaySts_Right 0;
BA_ "GenSigTimeoutTime_DMSM" SG_ 1456 Lane_DisplaySts_Right 0;
BA_ "GenSigTimeoutTime_DTCM" SG_ 1456 Lane_DisplaySts_Right 0;
BA_ "GenSigTimeoutTime_ECM" SG_ 1456 Lane_DisplaySts_Right 0;
BA_ "GenSigTimeoutTime_EVCU2" SG_ 1456 Lane_DisplaySts_Right 0;
BA_ "GenSigTimeoutTime_GNMM" SG_ 1456 Lane_DisplaySts_Right 0;
BA_ "GenSigTimeoutTime_HCP" SG_ 1456 Lane_DisplaySts_Right 0;
BA_ "GenSigTimeoutTime_RFHM" SG_ 1456 Lane_DisplaySts_Right 0;
BA_ "GenSigTimeoutTime_TCM" SG_ 1456 Lane_DisplaySts_Right 0;
BA_ "GenSigSendType" SG_ 1456 Lane_DispPopupSts 3;
BA_ "GenSigTimeoutTime_AGSM" SG_ 1456 Lane_DispPopupSts 0;
BA_ "GenSigTimeoutTime_BCM" SG_ 1456 Lane_DispPopupSts 0;
BA_ "GenSigTimeoutTime_BSM" SG_ 1456 Lane_DispPopupSts 0;
BA_ "GenSigTimeoutTime_CADM" SG_ 1456 Lane_DispPopupSts 0;
BA_ "GenSigTimeoutTime_DMSM" SG_ 1456 Lane_DispPopupSts 0;
BA_ "GenSigTimeoutTime_DTCM" SG_ 1456 Lane_DispPopupSts 0;
BA_ "GenSigTimeoutTime_ECM" SG_ 1456 Lane_DispPopupSts 0;
BA_ "GenSigTimeoutTime_EVCU2" SG_ 1456 Lane_DispPopupSts 0;
BA_ "GenSigTimeoutTime_GNMM" SG_ 1456 Lane_DispPopupSts 0;
BA_ "GenSigTimeoutTime_HCP" SG_ 1456 Lane_DispPopupSts 0;
BA_ "GenSigTimeoutTime_RFHM" SG_ 1456 Lane_DispPopupSts 0;
BA_ "GenSigTimeoutTime_TCM" SG_ 1456 Lane_DispPopupSts 0;
BA_ "GenSigSendType" SG_ 1456 LF_Chime_RqSts 3;
BA_ "GenSigTimeoutTime_AGSM" SG_ 1456 LF_Chime_RqSts 0;
BA_ "GenSigTimeoutTime_BSM" SG_ 1456 LF_Chime_RqSts 0;
BA_ "GenSigTimeoutTime_CADM" SG_ 1456 LF_Chime_RqSts 0;
BA_ "GenSigTimeoutTime_DMSM" SG_ 1456 LF_Chime_RqSts 0;
BA_ "GenSigTimeoutTime_DTCM" SG_ 1456 LF_Chime_RqSts 0;
BA_ "GenSigTimeoutTime_ECM" SG_ 1456 LF_Chime_RqSts 0;
BA_ "GenSigTimeoutTime_EVCU2" SG_ 1456 LF_Chime_RqSts 0;
BA_ "GenSigTimeoutTime_GNMM" SG_ 1456 LF_Chime_RqSts 0;
BA_ "GenSigTimeoutTime_HCP" SG_ 1456 LF_Chime_RqSts 0;
BA_ "GenSigTimeoutTime_IPC" SG_ 1456 LF_Chime_RqSts 0;
BA_ "GenSigTimeoutTime_RFHM" SG_ 1456 LF_Chime_RqSts 0;
BA_ "GenSigTimeoutTime_TCM" SG_ 1456 LF_Chime_RqSts 0;
BA_ "GenSigSendType" SG_ 1456 LKA_Blind 3;
BA_ "GenSigTimeoutTime_AGSM" SG_ 1456 LKA_Blind 0;
BA_ "GenSigTimeoutTime_BCM" SG_ 1456 LKA_Blind 0;
BA_ "GenSigTimeoutTime_BSM" SG_ 1456 LKA_Blind 0;
BA_ "GenSigTimeoutTime_CADM" SG_ 1456 LKA_Blind 0;
BA_ "GenSigTimeoutTime_DMSM" SG_ 1456 LKA_Blind 0;
BA_ "GenSigTimeoutTime_DTCM" SG_ 1456 LKA_Blind 0;
BA_ "GenSigTimeoutTime_ECM" SG_ 1456 LKA_Blind 0;
BA_ "GenSigTimeoutTime_EVCU2" SG_ 1456 LKA_Blind 0;
BA_ "GenSigTimeoutTime_GNMM" SG_ 1456 LKA_Blind 0;
BA_ "GenSigTimeoutTime_HCP" SG_ 1456 LKA_Blind 0;
BA_ "GenSigTimeoutTime_RFHM" SG_ 1456 LKA_Blind 0;
BA_ "GenSigTimeoutTime_SGW" SG_ 1456 LKA_Blind 0;
BA_ "GenSigTimeoutTime_TCM" SG_ 1456 LKA_Blind 0;
BA_ "GenSigSendType" SG_ 1456 LKA_FailSts 3;
BA_ "GenSigTimeoutTime_AGSM" SG_ 1456 LKA_FailSts 0;
BA_ "GenSigTimeoutTime_BCM" SG_ 1456 LKA_FailSts 0;
BA_ "GenSigTimeoutTime_BSM" SG_ 1456 LKA_FailSts 0;
BA_ "GenSigTimeoutTime_CADM" SG_ 1456 LKA_FailSts 0;
BA_ "GenSigTimeoutTime_DMSM" SG_ 1456 LKA_FailSts 0;
BA_ "GenSigTimeoutTime_DTCM" SG_ 1456 LKA_FailSts 0;
BA_ "GenSigTimeoutTime_ECM" SG_ 1456 LKA_FailSts 0;
BA_ "GenSigTimeoutTime_EVCU2" SG_ 1456 LKA_FailSts 0;
BA_ "GenSigTimeoutTime_GNMM" SG_ 1456 LKA_FailSts 0;
BA_ "GenSigTimeoutTime_HCP" SG_ 1456 LKA_FailSts 0;
BA_ "GenSigTimeoutTime_RFHM" SG_ 1456 LKA_FailSts 0;
BA_ "GenSigTimeoutTime_SGW" SG_ 1456 LKA_FailSts 0;
BA_ "GenSigTimeoutTime_TCM" SG_ 1456 LKA_FailSts 0;
BA_ "GenSigSendType" SG_ 1456 LKA_LEDControlSts 3;
BA_ "GenSigTimeoutTime_AGSM" SG_ 1456 LKA_LEDControlSts 0;
BA_ "GenSigTimeoutTime_BSM" SG_ 1456 LKA_LEDControlSts 0;
BA_ "GenSigTimeoutTime_CADM" SG_ 1456 LKA_LEDControlSts 0;
BA_ "GenSigTimeoutTime_DMSM" SG_ 1456 LKA_LEDControlSts 0;
BA_ "GenSigTimeoutTime_DTCM" SG_ 1456 LKA_LEDControlSts 0;
BA_ "GenSigTimeoutTime_ECM" SG_ 1456 LKA_LEDControlSts 0;
BA_ "GenSigTimeoutTime_EVCU2" SG_ 1456 LKA_LEDControlSts 0;
BA_ "GenSigTimeoutTime_GNMM" SG_ 1456 LKA_LEDControlSts 0;
BA_ "GenSigTimeoutTime_HCP" SG_ 1456 LKA_LEDControlSts 0;
BA_ "GenSigTimeoutTime_IPC" SG_ 1456 LKA_LEDControlSts 0;
BA_ "GenSigTimeoutTime_RFHM" SG_ 1456 LKA_LEDControlSts 0;
BA_ "GenSigTimeoutTime_SGW" SG_ 1456 LKA_LEDControlSts 0;
BA_ "GenSigTimeoutTime_TCM" SG_ 1456 LKA_LEDControlSts 0;
BA_ "GenSigSendType" SG_ 1456 LKA_Status 3;
BA_ "GenSigTimeoutTime_AGSM" SG_ 1456 LKA_Status 0;
BA_ "GenSigTimeoutTime_BCM" SG_ 1456 LKA_Status 0;
BA_ "GenSigTimeoutTime_BSM" SG_ 1456 LKA_Status 0;
BA_ "GenSigTimeoutTime_CADM" SG_ 1456 LKA_Status 0;
BA_ "GenSigTimeoutTime_DMSM" SG_ 1456 LKA_Status 0;
BA_ "GenSigTimeoutTime_DTCM" SG_ 1456 LKA_Status 0;
BA_ "GenSigTimeoutTime_ECM" SG_ 1456 LKA_Status 0;
BA_ "GenSigTimeoutTime_EVCU2" SG_ 1456 LKA_Status 0;
BA_ "GenSigTimeoutTime_GNMM" SG_ 1456 LKA_Status 0;
BA_ "GenSigTimeoutTime_HCP" SG_ 1456 LKA_Status 0;
BA_ "GenSigTimeoutTime_RFHM" SG_ 1456 LKA_Status 0;
BA_ "GenSigTimeoutTime_TCM" SG_ 1456 LKA_Status 0;
BA_ "GenSigSendType" SG_ 1456 LKA_Telltale 3;
BA_ "GenSigTimeoutTime_AGSM" SG_ 1456 LKA_Telltale 0;
BA_ "GenSigTimeoutTime_BCM" SG_ 1456 LKA_Telltale 0;
BA_ "GenSigTimeoutTime_BSM" SG_ 1456 LKA_Telltale 0;
BA_ "GenSigTimeoutTime_CADM" SG_ 1456 LKA_Telltale 0;
BA_ "GenSigTimeoutTime_DMSM" SG_ 1456 LKA_Telltale 0;
BA_ "GenSigTimeoutTime_DTCM" SG_ 1456 LKA_Telltale 0;
BA_ "GenSigTimeoutTime_ECM" SG_ 1456 LKA_Telltale 0;
BA_ "GenSigTimeoutTime_EVCU2" SG_ 1456 LKA_Telltale 0;
BA_ "GenSigTimeoutTime_GNMM" SG_ 1456 LKA_Telltale 0;
BA_ "GenSigTimeoutTime_HCP" SG_ 1456 LKA_Telltale 0;
BA_ "GenSigTimeoutTime_RFHM" SG_ 1456 LKA_Telltale 0;
BA_ "GenSigTimeoutTime_SGW" SG_ 1456 LKA_Telltale 0;
BA_ "GenSigTimeoutTime_TCM" SG_ 1456 LKA_Telltale 0;
BA_ "GenSigSendType" SG_ 1456 LR_Chime_RqSts 3;
BA_ "GenSigTimeoutTime_AGSM" SG_ 1456 LR_Chime_RqSts 0;
BA_ "GenSigTimeoutTime_BSM" SG_ 1456 LR_Chime_RqSts 0;
BA_ "GenSigTimeoutTime_CADM" SG_ 1456 LR_Chime_RqSts 0;
BA_ "GenSigTimeoutTime_DMSM" SG_ 1456 LR_Chime_RqSts 0;
BA_ "GenSigTimeoutTime_DTCM" SG_ 1456 LR_Chime_RqSts 0;
BA_ "GenSigTimeoutTime_ECM" SG_ 1456 LR_Chime_RqSts 0;
BA_ "GenSigTimeoutTime_EVCU2" SG_ 1456 LR_Chime_RqSts 0;
BA_ "GenSigTimeoutTime_GNMM" SG_ 1456 LR_Chime_RqSts 0;
BA_ "GenSigTimeoutTime_HCP" SG_ 1456 LR_Chime_RqSts 0;
BA_ "GenSigTimeoutTime_IPC" SG_ 1456 LR_Chime_RqSts 0;
BA_ "GenSigTimeoutTime_RFHM" SG_ 1456 LR_Chime_RqSts 0;
BA_ "GenSigTimeoutTime_TCM" SG_ 1456 LR_Chime_RqSts 0;
BA_ "GenSigTimeoutTime_AGSM" SG_ 1456 MessageCounter_ADAS_FD_HMI 0;
BA_ "GenSigTimeoutTime_BCM" SG_ 1456 MessageCounter_ADAS_FD_HMI 0;
BA_ "GenSigTimeoutTime_CADM" SG_ 1456 MessageCounter_ADAS_FD_HMI 0;
BA_ "GenSigTimeoutTime_DTCM" SG_ 1456 MessageCounter_ADAS_FD_HMI 0;
BA_ "GenSigTimeoutTime_EVCU2" SG_ 1456 MessageCounter_ADAS_FD_HMI 0;
BA_ "GenSigTimeoutTime_GNMM" SG_ 1456 MessageCounter_ADAS_FD_HMI 0;
BA_ "GenSigTimeoutTime_HCP" SG_ 1456 MessageCounter_ADAS_FD_HMI 0;
BA_ "GenSigTimeoutTime_RFHM" SG_ 1456 MessageCounter_ADAS_FD_HMI 0;
BA_ "GenSigTimeoutTime_SGW" SG_ 1456 MessageCounter_ADAS_FD_HMI 0;
BA_ "GenSigTimeoutTime_TCM" SG_ 1456 MessageCounter_ADAS_FD_HMI 0;
BA_ "GenSigSendType" SG_ 1456 NCC_FailSts 3;
BA_ "GenSigTimeoutTime_AGSM" SG_ 1456 NCC_FailSts 0;
BA_ "GenSigTimeoutTime_BCM" SG_ 1456 NCC_FailSts 0;
BA_ "GenSigTimeoutTime_BSM" SG_ 1456 NCC_FailSts 0;
BA_ "GenSigTimeoutTime_CADM" SG_ 1456 NCC_FailSts 0;
BA_ "GenSigTimeoutTime_DMSM" SG_ 1456 NCC_FailSts 0;
BA_ "GenSigTimeoutTime_DTCM" SG_ 1456 NCC_FailSts 0;
BA_ "GenSigTimeoutTime_ECM" SG_ 1456 NCC_FailSts 0;
BA_ "GenSigTimeoutTime_EVCU2" SG_ 1456 NCC_FailSts 0;
BA_ "GenSigTimeoutTime_GNMM" SG_ 1456 NCC_FailSts 0;
BA_ "GenSigTimeoutTime_HCP" SG_ 1456 NCC_FailSts 0;
BA_ "GenSigTimeoutTime_RFHM" SG_ 1456 NCC_FailSts 0;
BA_ "GenSigTimeoutTime_SGW" SG_ 1456 NCC_FailSts 0;
BA_ "GenSigTimeoutTime_TCM" SG_ 1456 NCC_FailSts 0;
BA_ "GenSigSendType" SG_ 1456 PEB_Setting_Avail 3;
BA_ "GenSigTimeoutTime_AGSM" SG_ 1456 PEB_Setting_Avail 0;
BA_ "GenSigTimeoutTime_BCM" SG_ 1456 PEB_Setting_Avail 0;
BA_ "GenSigTimeoutTime_BSM" SG_ 1456 PEB_Setting_Avail 0;
BA_ "GenSigTimeoutTime_CADM" SG_ 1456 PEB_Setting_Avail 0;
BA_ "GenSigTimeoutTime_DMSM" SG_ 1456 PEB_Setting_Avail 0;
BA_ "GenSigTimeoutTime_DTCM" SG_ 1456 PEB_Setting_Avail 0;
BA_ "GenSigTimeoutTime_ECM" SG_ 1456 PEB_Setting_Avail 0;
BA_ "GenSigTimeoutTime_EVCU2" SG_ 1456 PEB_Setting_Avail 0;
BA_ "GenSigTimeoutTime_GNMM" SG_ 1456 PEB_Setting_Avail 0;
BA_ "GenSigTimeoutTime_HCP" SG_ 1456 PEB_Setting_Avail 0;
BA_ "GenSigTimeoutTime_RFHM" SG_ 1456 PEB_Setting_Avail 0;
BA_ "GenSigTimeoutTime_SGW" SG_ 1456 PEB_Setting_Avail 0;
BA_ "GenSigTimeoutTime_TCM" SG_ 1456 PEB_Setting_Avail 0;
BA_ "GenSigSendType" SG_ 1456 RF_Chime_RqSts 3;
BA_ "GenSigTimeoutTime_AGSM" SG_ 1456 RF_Chime_RqSts 0;
BA_ "GenSigTimeoutTime_BSM" SG_ 1456 RF_Chime_RqSts 0;
BA_ "GenSigTimeoutTime_CADM" SG_ 1456 RF_Chime_RqSts 0;
BA_ "GenSigTimeoutTime_DMSM" SG_ 1456 RF_Chime_RqSts 0;
BA_ "GenSigTimeoutTime_DTCM" SG_ 1456 RF_Chime_RqSts 0;
BA_ "GenSigTimeoutTime_ECM" SG_ 1456 RF_Chime_RqSts 0;
BA_ "GenSigTimeoutTime_EVCU2" SG_ 1456 RF_Chime_RqSts 0;
BA_ "GenSigTimeoutTime_GNMM" SG_ 1456 RF_Chime_RqSts 0;
BA_ "GenSigTimeoutTime_HCP" SG_ 1456 RF_Chime_RqSts 0;
BA_ "GenSigTimeoutTime_IPC" SG_ 1456 RF_Chime_RqSts 0;
BA_ "GenSigTimeoutTime_RFHM" SG_ 1456 RF_Chime_RqSts 0;
BA_ "GenSigTimeoutTime_TCM" SG_ 1456 RF_Chime_RqSts 0;
BA_ "GenSigSendType" SG_ 1456 RR_Chime_RqSts 3;
BA_ "GenSigTimeoutTime_AGSM" SG_ 1456 RR_Chime_RqSts 0;
BA_ "GenSigTimeoutTime_BSM" SG_ 1456 RR_Chime_RqSts 0;
BA_ "GenSigTimeoutTime_CADM" SG_ 1456 RR_Chime_RqSts 0;
BA_ "GenSigTimeoutTime_DMSM" SG_ 1456 RR_Chime_RqSts 0;
BA_ "GenSigTimeoutTime_DTCM" SG_ 1456 RR_Chime_RqSts 0;
BA_ "GenSigTimeoutTime_ECM" SG_ 1456 RR_Chime_RqSts 0;
BA_ "GenSigTimeoutTime_EVCU2" SG_ 1456 RR_Chime_RqSts 0;
BA_ "GenSigTimeoutTime_GNMM" SG_ 1456 RR_Chime_RqSts 0;
BA_ "GenSigTimeoutTime_HCP" SG_ 1456 RR_Chime_RqSts 0;
BA_ "GenSigTimeoutTime_IPC" SG_ 1456 RR_Chime_RqSts 0;
BA_ "GenSigTimeoutTime_RFHM" SG_ 1456 RR_Chime_RqSts 0;
BA_ "GenSigTimeoutTime_TCM" SG_ 1456 RR_Chime_RqSts 0;
BA_ "GenSigSendType" SG_ 1456 RRCC_DispPopupSts 3;
BA_ "GenSigTimeoutTime_AGSM" SG_ 1456 RRCC_DispPopupSts 0;
BA_ "GenSigTimeoutTime_BCM" SG_ 1456 RRCC_DispPopupSts 0;
BA_ "GenSigTimeoutTime_BSM" SG_ 1456 RRCC_DispPopupSts 0;
BA_ "GenSigTimeoutTime_CADM" SG_ 1456 RRCC_DispPopupSts 0;
BA_ "GenSigTimeoutTime_DMSM" SG_ 1456 RRCC_DispPopupSts 0;
BA_ "GenSigTimeoutTime_DTCM" SG_ 1456 RRCC_DispPopupSts 0;
BA_ "GenSigTimeoutTime_ECM" SG_ 1456 RRCC_DispPopupSts 0;
BA_ "GenSigTimeoutTime_EVCU2" SG_ 1456 RRCC_DispPopupSts 0;
BA_ "GenSigTimeoutTime_GNMM" SG_ 1456 RRCC_DispPopupSts 0;
BA_ "GenSigTimeoutTime_HCP" SG_ 1456 RRCC_DispPopupSts 0;
BA_ "GenSigTimeoutTime_RFHM" SG_ 1456 RRCC_DispPopupSts 0;
BA_ "GenSigTimeoutTime_SGW" SG_ 1456 RRCC_DispPopupSts 0;
BA_ "GenSigTimeoutTime_TCM" SG_ 1456 RRCC_DispPopupSts 0;
BA_ "GenSigSendType" SG_ 1456 RRCC_LEDSts 3;
BA_ "GenSigTimeoutTime_AGSM" SG_ 1456 RRCC_LEDSts 0;
BA_ "GenSigTimeoutTime_BSM" SG_ 1456 RRCC_LEDSts 0;
BA_ "GenSigTimeoutTime_CADM" SG_ 1456 RRCC_LEDSts 0;
BA_ "GenSigTimeoutTime_DMSM" SG_ 1456 RRCC_LEDSts 0;
BA_ "GenSigTimeoutTime_DTCM" SG_ 1456 RRCC_LEDSts 0;
BA_ "GenSigTimeoutTime_ECM" SG_ 1456 RRCC_LEDSts 0;
BA_ "GenSigTimeoutTime_EVCU2" SG_ 1456 RRCC_LEDSts 0;
BA_ "GenSigTimeoutTime_GNMM" SG_ 1456 RRCC_LEDSts 0;
BA_ "GenSigTimeoutTime_HCP" SG_ 1456 RRCC_LEDSts 0;
BA_ "GenSigTimeoutTime_IPC" SG_ 1456 RRCC_LEDSts 0;
BA_ "GenSigTimeoutTime_RFHM" SG_ 1456 RRCC_LEDSts 0;
BA_ "GenSigTimeoutTime_SGW" SG_ 1456 RRCC_LEDSts 0;
BA_ "GenSigTimeoutTime_TCM" SG_ 1456 RRCC_LEDSts 0;
BA_ "GenSigSendType" SG_ 1456 Set_Speed_KPH 3;
BA_ "GenSigTimeoutTime_AGSM" SG_ 1456 Set_Speed_KPH 0;
BA_ "GenSigTimeoutTime_BCM" SG_ 1456 Set_Speed_KPH 0;
BA_ "GenSigTimeoutTime_BSM" SG_ 1456 Set_Speed_KPH 0;
BA_ "GenSigTimeoutTime_CADM" SG_ 1456 Set_Speed_KPH 0;
BA_ "GenSigTimeoutTime_DMSM" SG_ 1456 Set_Speed_KPH 0;
BA_ "GenSigTimeoutTime_DTCM" SG_ 1456 Set_Speed_KPH 0;
BA_ "GenSigTimeoutTime_EVCU2" SG_ 1456 Set_Speed_KPH 0;
BA_ "GenSigTimeoutTime_GNMM" SG_ 1456 Set_Speed_KPH 0;
BA_ "GenSigTimeoutTime_HCP" SG_ 1456 Set_Speed_KPH 0;
BA_ "GenSigTimeoutTime_RFHM" SG_ 1456 Set_Speed_KPH 0;
BA_ "GenSigSendType" SG_ 1456 Set_Speed_MPH 3;
BA_ "GenSigTimeoutTime_AGSM" SG_ 1456 Set_Speed_MPH 0;
BA_ "GenSigTimeoutTime_BCM" SG_ 1456 Set_Speed_MPH 0;
BA_ "GenSigTimeoutTime_BSM" SG_ 1456 Set_Speed_MPH 0;
BA_ "GenSigTimeoutTime_CADM" SG_ 1456 Set_Speed_MPH 0;
BA_ "GenSigTimeoutTime_DMSM" SG_ 1456 Set_Speed_MPH 0;
BA_ "GenSigTimeoutTime_DTCM" SG_ 1456 Set_Speed_MPH 0;
BA_ "GenSigTimeoutTime_ECM" SG_ 1456 Set_Speed_MPH 0;
BA_ "GenSigTimeoutTime_EVCU2" SG_ 1456 Set_Speed_MPH 0;
BA_ "GenSigTimeoutTime_GNMM" SG_ 1456 Set_Speed_MPH 0;
BA_ "GenSigTimeoutTime_HCP" SG_ 1456 Set_Speed_MPH 0;
BA_ "GenSigTimeoutTime_RFHM" SG_ 1456 Set_Speed_MPH 0;
BA_ "GenSigSendType" SG_ 1456 SVI_Request 3;
BA_ "GenSigTimeoutTime_AGSM" SG_ 1456 SVI_Request 0;
BA_ "GenSigTimeoutTime_BCM" SG_ 1456 SVI_Request 0;
BA_ "GenSigTimeoutTime_BSM" SG_ 1456 SVI_Request 0;
BA_ "GenSigTimeoutTime_CADM" SG_ 1456 SVI_Request 0;
BA_ "GenSigTimeoutTime_DMSM" SG_ 1456 SVI_Request 0;
BA_ "GenSigTimeoutTime_DTCM" SG_ 1456 SVI_Request 0;
BA_ "GenSigTimeoutTime_ECM" SG_ 1456 SVI_Request 0;
BA_ "GenSigTimeoutTime_EVCU2" SG_ 1456 SVI_Request 0;
BA_ "GenSigTimeoutTime_GNMM" SG_ 1456 SVI_Request 0;
BA_ "GenSigTimeoutTime_HCP" SG_ 1456 SVI_Request 0;
BA_ "GenSigTimeoutTime_RFHM" SG_ 1456 SVI_Request 0;
BA_ "GenSigTimeoutTime_TCM" SG_ 1456 SVI_Request 0;
BA_ "GenSigSendType" SG_ 1458 ACC_FailSts_C2 3;
BA_ "GenSigTimeoutTime_AGSM" SG_ 1458 ACC_FailSts_C2 0;
BA_ "GenSigTimeoutTime_BCM" SG_ 1458 ACC_FailSts_C2 0;
BA_ "GenSigTimeoutTime_CADM" SG_ 1458 ACC_FailSts_C2 0;
BA_ "GenSigTimeoutTime_DMSM" SG_ 1458 ACC_FailSts_C2 0;
BA_ "GenSigTimeoutTime_DTCM" SG_ 1458 ACC_FailSts_C2 0;
BA_ "GenSigTimeoutTime_ECM" SG_ 1458 ACC_FailSts_C2 0;
BA_ "GenSigTimeoutTime_EVCU2" SG_ 1458 ACC_FailSts_C2 0;
BA_ "GenSigTimeoutTime_GNMM" SG_ 1458 ACC_FailSts_C2 0;
BA_ "GenSigTimeoutTime_HCP" SG_ 1458 ACC_FailSts_C2 0;
BA_ "GenSigTimeoutTime_IPC" SG_ 1458 ACC_FailSts_C2 0;
BA_ "GenSigTimeoutTime_RFHM" SG_ 1458 ACC_FailSts_C2 0;
BA_ "GenSigTimeoutTime_SGW" SG_ 1458 ACC_FailSts_C2 0;
BA_ "GenSigTimeoutTime_TCM" SG_ 1458 ACC_FailSts_C2 0;
BA_ "GenSigTimeoutTime_AGSM" SG_ 1458 CRC_ADAS_HMI_C2 0;
BA_ "GenSigTimeoutTime_BCM" SG_ 1458 CRC_ADAS_HMI_C2 0;
BA_ "GenSigTimeoutTime_CADM" SG_ 1458 CRC_ADAS_HMI_C2 0;
BA_ "GenSigTimeoutTime_DMSM" SG_ 1458 CRC_ADAS_HMI_C2 0;
BA_ "GenSigTimeoutTime_DTCM" SG_ 1458 CRC_ADAS_HMI_C2 0;
BA_ "GenSigTimeoutTime_ECM" SG_ 1458 CRC_ADAS_HMI_C2 0;
BA_ "GenSigTimeoutTime_EVCU2" SG_ 1458 CRC_ADAS_HMI_C2 0;
BA_ "GenSigTimeoutTime_GNMM" SG_ 1458 CRC_ADAS_HMI_C2 0;
BA_ "GenSigTimeoutTime_HCP" SG_ 1458 CRC_ADAS_HMI_C2 0;
BA_ "GenSigTimeoutTime_RFHM" SG_ 1458 CRC_ADAS_HMI_C2 0;
BA_ "GenSigTimeoutTime_SGW" SG_ 1458 CRC_ADAS_HMI_C2 0;
BA_ "GenSigTimeoutTime_TCM" SG_ 1458 CRC_ADAS_HMI_C2 0;
BA_ "GenSigTimeoutTime_AGSM" SG_ 1458 MessageCounter_ADAS_HMI_C2 0;
BA_ "GenSigTimeoutTime_BCM" SG_ 1458 MessageCounter_ADAS_HMI_C2 0;
BA_ "GenSigTimeoutTime_CADM" SG_ 1458 MessageCounter_ADAS_HMI_C2 0;
BA_ "GenSigTimeoutTime_DMSM" SG_ 1458 MessageCounter_ADAS_HMI_C2 0;
BA_ "GenSigTimeoutTime_DTCM" SG_ 1458 MessageCounter_ADAS_HMI_C2 0;
BA_ "GenSigTimeoutTime_ECM" SG_ 1458 MessageCounter_ADAS_HMI_C2 0;
BA_ "GenSigTimeoutTime_EVCU2" SG_ 1458 MessageCounter_ADAS_HMI_C2 0;
BA_ "GenSigTimeoutTime_GNMM" SG_ 1458 MessageCounter_ADAS_HMI_C2 0;
BA_ "GenSigTimeoutTime_HCP" SG_ 1458 MessageCounter_ADAS_HMI_C2 0;
BA_ "GenSigTimeoutTime_RFHM" SG_ 1458 MessageCounter_ADAS_HMI_C2 0;
BA_ "GenSigTimeoutTime_SGW" SG_ 1458 MessageCounter_ADAS_HMI_C2 0;
BA_ "GenSigTimeoutTime_TCM" SG_ 1458 MessageCounter_ADAS_HMI_C2 0;
BA_ "GenSigSendType" SG_ 1458 SVI_Request_C2 3;
BA_ "GenSigTimeoutTime_AGSM" SG_ 1458 SVI_Request_C2 0;
BA_ "GenSigTimeoutTime_BCM" SG_ 1458 SVI_Request_C2 0;
BA_ "GenSigTimeoutTime_BSM" SG_ 1458 SVI_Request_C2 0;
BA_ "GenSigTimeoutTime_CADM" SG_ 1458 SVI_Request_C2 0;
BA_ "GenSigTimeoutTime_DMSM" SG_ 1458 SVI_Request_C2 0;
BA_ "GenSigTimeoutTime_DTCM" SG_ 1458 SVI_Request_C2 0;
BA_ "GenSigTimeoutTime_ECM" SG_ 1458 SVI_Request_C2 0;
BA_ "GenSigTimeoutTime_EVCU2" SG_ 1458 SVI_Request_C2 0;
BA_ "GenSigTimeoutTime_GNMM" SG_ 1458 SVI_Request_C2 0;
BA_ "GenSigTimeoutTime_HCP" SG_ 1458 SVI_Request_C2 0;
BA_ "GenSigTimeoutTime_RFHM" SG_ 1458 SVI_Request_C2 0;
BA_ "GenSigTimeoutTime_SGW" SG_ 1458 SVI_Request_C2 0;
BA_ "GenSigTimeoutTime_TCM" SG_ 1458 SVI_Request_C2 0;
BA_ "GenSigTimeoutTime_AGSM" SG_ 280 ACC_Drive_Cmd 0;
BA_ "GenSigTimeoutTime_BCM" SG_ 280 ACC_Drive_Cmd 0;
BA_ "GenSigTimeoutTime_CADM" SG_ 280 ACC_Drive_Cmd 0;
BA_ "GenSigTimeoutTime_DMSM" SG_ 280 ACC_Drive_Cmd 0;
BA_ "GenSigTimeoutTime_DTCM" SG_ 280 ACC_Drive_Cmd 0;
BA_ "GenSigTimeoutTime_ECM" SG_ 280 ACC_Drive_Cmd 0;
BA_ "GenSigTimeoutTime_EVCU2" SG_ 280 ACC_Drive_Cmd 0;
BA_ "GenSigTimeoutTime_GNMM" SG_ 280 ACC_Drive_Cmd 0;
BA_ "GenSigTimeoutTime_HCP" SG_ 280 ACC_Drive_Cmd 0;
BA_ "GenSigTimeoutTime_IPC" SG_ 280 ACC_Drive_Cmd 0;
BA_ "GenSigTimeoutTime_RFHM" SG_ 280 ACC_Drive_Cmd 0;
BA_ "GenSigTimeoutTime_SGW" SG_ 280 ACC_Drive_Cmd 0;
BA_ "GenSigTimeoutTime_TCM" SG_ 280 ACC_Drive_Cmd 0;
BA_ "GenSigStartValue" SG_ 280 ACC_DsrSpeedKPH 255;
BA_ "GenSigTimeoutTime_AGSM" SG_ 280 ACC_DsrSpeedKPH 0;
BA_ "GenSigTimeoutTime_BCM" SG_ 280 ACC_DsrSpeedKPH 0;
BA_ "GenSigTimeoutTime_BSM" SG_ 280 ACC_DsrSpeedKPH 0;
BA_ "GenSigTimeoutTime_CADM" SG_ 280 ACC_DsrSpeedKPH 0;
BA_ "GenSigTimeoutTime_DMSM" SG_ 280 ACC_DsrSpeedKPH 0;
BA_ "GenSigTimeoutTime_ECM" SG_ 280 ACC_DsrSpeedKPH 0;
BA_ "GenSigTimeoutTime_EVCU2" SG_ 280 ACC_DsrSpeedKPH 0;
BA_ "GenSigTimeoutTime_GNMM" SG_ 280 ACC_DsrSpeedKPH 0;
BA_ "GenSigTimeoutTime_HCP" SG_ 280 ACC_DsrSpeedKPH 0;
BA_ "GenSigTimeoutTime_IPC" SG_ 280 ACC_DsrSpeedKPH 0;
BA_ "GenSigTimeoutTime_RFHM" SG_ 280 ACC_DsrSpeedKPH 0;
BA_ "GenSigTimeoutTime_SGW" SG_ 280 ACC_DsrSpeedKPH 0;
BA_ "GenSigTimeoutTime_AGSM" SG_ 280 ACC_StopStart 0;
BA_ "GenSigTimeoutTime_BCM" SG_ 280 ACC_StopStart 0;
BA_ "GenSigTimeoutTime_BSM" SG_ 280 ACC_StopStart 0;
BA_ "GenSigTimeoutTime_CADM" SG_ 280 ACC_StopStart 0;
BA_ "GenSigTimeoutTime_DMSM" SG_ 280 ACC_StopStart 0;
BA_ "GenSigTimeoutTime_DTCM" SG_ 280 ACC_StopStart 0;
BA_ "GenSigTimeoutTime_EVCU2" SG_ 280 ACC_StopStart 0;
BA_ "GenSigTimeoutTime_GNMM" SG_ 280 ACC_StopStart 0;
BA_ "GenSigTimeoutTime_HCP" SG_ 280 ACC_StopStart 0;
BA_ "GenSigTimeoutTime_IPC" SG_ 280 ACC_StopStart 0;
BA_ "GenSigTimeoutTime_RFHM" SG_ 280 ACC_StopStart 0;
BA_ "GenSigTimeoutTime_SGW" SG_ 280 ACC_StopStart 0;
BA_ "GenSigTimeoutTime_TCM" SG_ 280 ACC_StopStart 0;
BA_ "GenSigTimeoutTime_AGSM" SG_ 280 ACC_Systemsts 0;
BA_ "GenSigTimeoutTime_CADM" SG_ 280 ACC_Systemsts 0;
BA_ "GenSigTimeoutTime_DMSM" SG_ 280 ACC_Systemsts 0;
BA_ "GenSigTimeoutTime_DTCM" SG_ 280 ACC_Systemsts 0;
BA_ "GenSigTimeoutTime_ECM" SG_ 280 ACC_Systemsts 0;
BA_ "GenSigTimeoutTime_EVCU2" SG_ 280 ACC_Systemsts 0;
BA_ "GenSigTimeoutTime_GNMM" SG_ 280 ACC_Systemsts 0;
BA_ "GenSigTimeoutTime_HCP" SG_ 280 ACC_Systemsts 0;
BA_ "GenSigTimeoutTime_RFHM" SG_ 280 ACC_Systemsts 0;
BA_ "GenSigTimeoutTime_SGW" SG_ 280 ACC_Systemsts 0;
BA_ "GenSigTimeoutTime_AGSM" SG_ 280 AEB_Sensitivity_Setting 0;
BA_ "GenSigTimeoutTime_BCM" SG_ 280 AEB_Sensitivity_Setting 0;
BA_ "GenSigTimeoutTime_BSM" SG_ 280 AEB_Sensitivity_Setting 0;
BA_ "GenSigTimeoutTime_CADM" SG_ 280 AEB_Sensitivity_Setting 0;
BA_ "GenSigTimeoutTime_DMSM" SG_ 280 AEB_Sensitivity_Setting 0;
BA_ "GenSigTimeoutTime_DTCM" SG_ 280 AEB_Sensitivity_Setting 0;
BA_ "GenSigTimeoutTime_ECM" SG_ 280 AEB_Sensitivity_Setting 0;
BA_ "GenSigTimeoutTime_EVCU2" SG_ 280 AEB_Sensitivity_Setting 0;
BA_ "GenSigTimeoutTime_GNMM" SG_ 280 AEB_Sensitivity_Setting 0;
BA_ "GenSigTimeoutTime_HCP" SG_ 280 AEB_Sensitivity_Setting 0;
BA_ "GenSigTimeoutTime_RFHM" SG_ 280 AEB_Sensitivity_Setting 0;
BA_ "GenSigTimeoutTime_SGW" SG_ 280 AEB_Sensitivity_Setting 0;
BA_ "GenSigTimeoutTime_TCM" SG_ 280 AEB_Sensitivity_Setting 0;
BA_ "GenSigTimeoutTime_AGSM" SG_ 280 AEB_Systemsts 0;
BA_ "GenSigTimeoutTime_BCM" SG_ 280 AEB_Systemsts 0;
BA_ "GenSigTimeoutTime_BSM" SG_ 280 AEB_Systemsts 0;
BA_ "GenSigTimeoutTime_CADM" SG_ 280 AEB_Systemsts 0;
BA_ "GenSigTimeoutTime_DMSM" SG_ 280 AEB_Systemsts 0;
BA_ "GenSigTimeoutTime_DTCM" SG_ 280 AEB_Systemsts 0;
BA_ "GenSigTimeoutTime_ECM" SG_ 280 AEB_Systemsts 0;
BA_ "GenSigTimeoutTime_EVCU2" SG_ 280 AEB_Systemsts 0;
BA_ "GenSigTimeoutTime_GNMM" SG_ 280 AEB_Systemsts 0;
BA_ "GenSigTimeoutTime_HCP" SG_ 280 AEB_Systemsts 0;
BA_ "GenSigTimeoutTime_RFHM" SG_ 280 AEB_Systemsts 0;
BA_ "GenSigTimeoutTime_SGW" SG_ 280 AEB_Systemsts 0;
BA_ "GenSigTimeoutTime_TCM" SG_ 280 AEB_Systemsts 0;
BA_ "GenSigTimeoutTime_AGSM" SG_ 280 AEB_Type 0;
BA_ "GenSigTimeoutTime_BCM" SG_ 280 AEB_Type 0;
BA_ "GenSigTimeoutTime_CADM" SG_ 280 AEB_Type 0;
BA_ "GenSigTimeoutTime_DMSM" SG_ 280 AEB_Type 0;
BA_ "GenSigTimeoutTime_DTCM" SG_ 280 AEB_Type 0;
BA_ "GenSigTimeoutTime_ECM" SG_ 280 AEB_Type 0;
BA_ "GenSigTimeoutTime_EVCU2" SG_ 280 AEB_Type 0;
BA_ "GenSigTimeoutTime_GNMM" SG_ 280 AEB_Type 0;
BA_ "GenSigTimeoutTime_HCP" SG_ 280 AEB_Type 0;
BA_ "GenSigTimeoutTime_IPC" SG_ 280 AEB_Type 0;
BA_ "GenSigTimeoutTime_RFHM" SG_ 280 AEB_Type 0;
BA_ "GenSigTimeoutTime_SGW" SG_ 280 AEB_Type 0;
BA_ "GenSigTimeoutTime_TCM" SG_ 280 AEB_Type 0;
BA_ "GenSigSendType" SG_ 280 BlindSpot_TrailerSts 3;
BA_ "GenSigTimeoutTime_AGSM" SG_ 280 BlindSpot_TrailerSts 0;
BA_ "GenSigTimeoutTime_BCM" SG_ 280 BlindSpot_TrailerSts 0;
BA_ "GenSigTimeoutTime_BSM" SG_ 280 BlindSpot_TrailerSts 0;
BA_ "GenSigTimeoutTime_CADM" SG_ 280 BlindSpot_TrailerSts 0;
BA_ "GenSigTimeoutTime_DMSM" SG_ 280 BlindSpot_TrailerSts 0;
BA_ "GenSigTimeoutTime_DTCM" SG_ 280 BlindSpot_TrailerSts 0;
BA_ "GenSigTimeoutTime_ECM" SG_ 280 BlindSpot_TrailerSts 0;
BA_ "GenSigTimeoutTime_EVCU2" SG_ 280 BlindSpot_TrailerSts 0;
BA_ "GenSigTimeoutTime_GNMM" SG_ 280 BlindSpot_TrailerSts 0;
BA_ "GenSigTimeoutTime_HCP" SG_ 280 BlindSpot_TrailerSts 0;
BA_ "GenSigTimeoutTime_RFHM" SG_ 280 BlindSpot_TrailerSts 0;
BA_ "GenSigTimeoutTime_SGW" SG_ 280 BlindSpot_TrailerSts 0;
BA_ "GenSigTimeoutTime_TCM" SG_ 280 BlindSpot_TrailerSts 0;
BA_ "GenSigTimeoutTime_AGSM" SG_ 280 Brake_Jerk_Req 0;
BA_ "GenSigTimeoutTime_BCM" SG_ 280 Brake_Jerk_Req 0;
BA_ "GenSigTimeoutTime_CADM" SG_ 280 Brake_Jerk_Req 0;
BA_ "GenSigTimeoutTime_DMSM" SG_ 280 Brake_Jerk_Req 0;
BA_ "GenSigTimeoutTime_DTCM" SG_ 280 Brake_Jerk_Req 0;
BA_ "GenSigTimeoutTime_ECM" SG_ 280 Brake_Jerk_Req 0;
BA_ "GenSigTimeoutTime_EVCU2" SG_ 280 Brake_Jerk_Req 0;
BA_ "GenSigTimeoutTime_GNMM" SG_ 280 Brake_Jerk_Req 0;
BA_ "GenSigTimeoutTime_HCP" SG_ 280 Brake_Jerk_Req 0;
BA_ "GenSigTimeoutTime_IPC" SG_ 280 Brake_Jerk_Req 0;
BA_ "GenSigTimeoutTime_RFHM" SG_ 280 Brake_Jerk_Req 0;
BA_ "GenSigTimeoutTime_SGW" SG_ 280 Brake_Jerk_Req 0;
BA_ "GenSigTimeoutTime_TCM" SG_ 280 Brake_Jerk_Req 0;
BA_ "GenSigTimeoutTime_AGSM" SG_ 280 CADM_OpStat 0;
BA_ "GenSigTimeoutTime_BCM" SG_ 280 CADM_OpStat 0;
BA_ "GenSigTimeoutTime_BSM" SG_ 280 CADM_OpStat 0;
BA_ "GenSigTimeoutTime_CADM" SG_ 280 CADM_OpStat 0;
BA_ "GenSigTimeoutTime_DMSM" SG_ 280 CADM_OpStat 0;
BA_ "GenSigTimeoutTime_DTCM" SG_ 280 CADM_OpStat 0;
BA_ "GenSigTimeoutTime_ECM" SG_ 280 CADM_OpStat 0;
BA_ "GenSigTimeoutTime_EVCU2" SG_ 280 CADM_OpStat 0;
BA_ "GenSigTimeoutTime_GNMM" SG_ 280 CADM_OpStat 0;
BA_ "GenSigTimeoutTime_HCP" SG_ 280 CADM_OpStat 0;
BA_ "GenSigTimeoutTime_IPC" SG_ 280 CADM_OpStat 0;
BA_ "GenSigTimeoutTime_RFHM" SG_ 280 CADM_OpStat 0;
BA_ "GenSigTimeoutTime_SGW" SG_ 280 CADM_OpStat 0;
BA_ "GenSigTimeoutTime_TCM" SG_ 280 CADM_OpStat 0;
BA_ "GenSigTimeoutTime_AGSM" SG_ 280 CADM2_EPSSEC_FAIL 0;
BA_ "GenSigTimeoutTime_BCM" SG_ 280 CADM2_EPSSEC_FAIL 0;
BA_ "GenSigTimeoutTime_BSM" SG_ 280 CADM2_EPSSEC_FAIL 0;
BA_ "GenSigTimeoutTime_CADM" SG_ 280 CADM2_EPSSEC_FAIL 0;
BA_ "GenSigTimeoutTime_DMSM" SG_ 280 CADM2_EPSSEC_FAIL 0;
BA_ "GenSigTimeoutTime_DTCM" SG_ 280 CADM2_EPSSEC_FAIL 0;
BA_ "GenSigTimeoutTime_ECM" SG_ 280 CADM2_EPSSEC_FAIL 0;
BA_ "GenSigTimeoutTime_EVCU2" SG_ 280 CADM2_EPSSEC_FAIL 0;
BA_ "GenSigTimeoutTime_GNMM" SG_ 280 CADM2_EPSSEC_FAIL 0;
BA_ "GenSigTimeoutTime_HCP" SG_ 280 CADM2_EPSSEC_FAIL 0;
BA_ "GenSigTimeoutTime_IPC" SG_ 280 CADM2_EPSSEC_FAIL 0;
BA_ "GenSigTimeoutTime_RFHM" SG_ 280 CADM2_EPSSEC_FAIL 0;
BA_ "GenSigTimeoutTime_SGW" SG_ 280 CADM2_EPSSEC_FAIL 0;
BA_ "GenSigTimeoutTime_TCM" SG_ 280 CADM2_EPSSEC_FAIL 0;
BA_ "GenSigTimeoutTime_AGSM" SG_ 280 CIPV_Fused 0;
BA_ "GenSigTimeoutTime_BCM" SG_ 280 CIPV_Fused 0;
BA_ "GenSigTimeoutTime_BSM" SG_ 280 CIPV_Fused 0;
BA_ "GenSigTimeoutTime_CADM" SG_ 280 CIPV_Fused 0;
BA_ "GenSigTimeoutTime_DMSM" SG_ 280 CIPV_Fused 0;
BA_ "GenSigTimeoutTime_DTCM" SG_ 280 CIPV_Fused 0;
BA_ "GenSigTimeoutTime_ECM" SG_ 280 CIPV_Fused 0;
BA_ "GenSigTimeoutTime_EVCU2" SG_ 280 CIPV_Fused 0;
BA_ "GenSigTimeoutTime_GNMM" SG_ 280 CIPV_Fused 0;
BA_ "GenSigTimeoutTime_HCP" SG_ 280 CIPV_Fused 0;
BA_ "GenSigTimeoutTime_IPC" SG_ 280 CIPV_Fused 0;
BA_ "GenSigTimeoutTime_RFHM" SG_ 280 CIPV_Fused 0;
BA_ "GenSigTimeoutTime_SGW" SG_ 280 CIPV_Fused 0;
BA_ "GenSigTimeoutTime_TCM" SG_ 280 CIPV_Fused 0;
BA_ "GenSigTimeoutTime_AGSM" SG_ 280 CRC_ADAS_FD_INFO 0;
BA_ "GenSigTimeoutTime_CADM" SG_ 280 CRC_ADAS_FD_INFO 0;
BA_ "GenSigTimeoutTime_DMSM" SG_ 280 CRC_ADAS_FD_INFO 0;
BA_ "GenSigTimeoutTime_DTCM" SG_ 280 CRC_ADAS_FD_INFO 0;
BA_ "GenSigTimeoutTime_ECM" SG_ 280 CRC_ADAS_FD_INFO 0;
BA_ "GenSigTimeoutTime_EVCU2" SG_ 280 CRC_ADAS_FD_INFO 0;
BA_ "GenSigTimeoutTime_GNMM" SG_ 280 CRC_ADAS_FD_INFO 0;
BA_ "GenSigTimeoutTime_HCP" SG_ 280 CRC_ADAS_FD_INFO 0;
BA_ "GenSigTimeoutTime_RFHM" SG_ 280 CRC_ADAS_FD_INFO 0;
BA_ "GenSigTimeoutTime_SGW" SG_ 280 CRC_ADAS_FD_INFO 0;
BA_ "GenSigTimeoutTime_AGSM" SG_ 280 DDD_Setting_Avail 0;
BA_ "GenSigTimeoutTime_BCM" SG_ 280 DDD_Setting_Avail 0;
BA_ "GenSigTimeoutTime_BSM" SG_ 280 DDD_Setting_Avail 0;
BA_ "GenSigTimeoutTime_CADM" SG_ 280 DDD_Setting_Avail 0;
BA_ "GenSigTimeoutTime_DMSM" SG_ 280 DDD_Setting_Avail 0;
BA_ "GenSigTimeoutTime_DTCM" SG_ 280 DDD_Setting_Avail 0;
BA_ "GenSigTimeoutTime_ECM" SG_ 280 DDD_Setting_Avail 0;
BA_ "GenSigTimeoutTime_EVCU2" SG_ 280 DDD_Setting_Avail 0;
BA_ "GenSigTimeoutTime_GNMM" SG_ 280 DDD_Setting_Avail 0;
BA_ "GenSigTimeoutTime_HCP" SG_ 280 DDD_Setting_Avail 0;
BA_ "GenSigTimeoutTime_RFHM" SG_ 280 DDD_Setting_Avail 0;
BA_ "GenSigTimeoutTime_SGW" SG_ 280 DDD_Setting_Avail 0;
BA_ "GenSigTimeoutTime_TCM" SG_ 280 DDD_Setting_Avail 0;
BA_ "GenSigTimeoutTime_AGSM" SG_ 280 DDD_SystemSts 0;
BA_ "GenSigTimeoutTime_BCM" SG_ 280 DDD_SystemSts 0;
BA_ "GenSigTimeoutTime_BSM" SG_ 280 DDD_SystemSts 0;
BA_ "GenSigTimeoutTime_CADM" SG_ 280 DDD_SystemSts 0;
BA_ "GenSigTimeoutTime_DMSM" SG_ 280 DDD_SystemSts 0;
BA_ "GenSigTimeoutTime_DTCM" SG_ 280 DDD_SystemSts 0;
BA_ "GenSigTimeoutTime_ECM" SG_ 280 DDD_SystemSts 0;
BA_ "GenSigTimeoutTime_EVCU2" SG_ 280 DDD_SystemSts 0;
BA_ "GenSigTimeoutTime_GNMM" SG_ 280 DDD_SystemSts 0;
BA_ "GenSigTimeoutTime_HCP" SG_ 280 DDD_SystemSts 0;
BA_ "GenSigTimeoutTime_IPC" SG_ 280 DDD_SystemSts 0;
BA_ "GenSigTimeoutTime_RFHM" SG_ 280 DDD_SystemSts 0;
BA_ "GenSigTimeoutTime_SGW" SG_ 280 DDD_SystemSts 0;
BA_ "GenSigTimeoutTime_TCM" SG_ 280 DDD_SystemSts 0;
BA_ "GenSigTimeoutTime_AGSM" SG_ 280 ESA_FailSts 0;
BA_ "GenSigTimeoutTime_BCM" SG_ 280 ESA_FailSts 0;
BA_ "GenSigTimeoutTime_BSM" SG_ 280 ESA_FailSts 0;
BA_ "GenSigTimeoutTime_CADM" SG_ 280 ESA_FailSts 0;
BA_ "GenSigTimeoutTime_DMSM" SG_ 280 ESA_FailSts 0;
BA_ "GenSigTimeoutTime_DTCM" SG_ 280 ESA_FailSts 0;
BA_ "GenSigTimeoutTime_ECM" SG_ 280 ESA_FailSts 0;
BA_ "GenSigTimeoutTime_EVCU2" SG_ 280 ESA_FailSts 0;
BA_ "GenSigTimeoutTime_GNMM" SG_ 280 ESA_FailSts 0;
BA_ "GenSigTimeoutTime_HCP" SG_ 280 ESA_FailSts 0;
BA_ "GenSigTimeoutTime_IPC" SG_ 280 ESA_FailSts 0;
BA_ "GenSigTimeoutTime_RFHM" SG_ 280 ESA_FailSts 0;
BA_ "GenSigTimeoutTime_SGW" SG_ 280 ESA_FailSts 0;
BA_ "GenSigTimeoutTime_TCM" SG_ 280 ESA_FailSts 0;
BA_ "GenSigSendType" SG_ 280 ESA_LaneClear_Status 3;
BA_ "GenSigTimeoutTime_AGSM" SG_ 280 ESA_LaneClear_Status 0;
BA_ "GenSigTimeoutTime_BCM" SG_ 280 ESA_LaneClear_Status 0;
BA_ "GenSigTimeoutTime_BSM" SG_ 280 ESA_LaneClear_Status 0;
BA_ "GenSigTimeoutTime_CADM" SG_ 280 ESA_LaneClear_Status 0;
BA_ "GenSigTimeoutTime_DMSM" SG_ 280 ESA_LaneClear_Status 0;
BA_ "GenSigTimeoutTime_DTCM" SG_ 280 ESA_LaneClear_Status 0;
BA_ "GenSigTimeoutTime_ECM" SG_ 280 ESA_LaneClear_Status 0;
BA_ "GenSigTimeoutTime_EVCU2" SG_ 280 ESA_LaneClear_Status 0;
BA_ "GenSigTimeoutTime_GNMM" SG_ 280 ESA_LaneClear_Status 0;
BA_ "GenSigTimeoutTime_HCP" SG_ 280 ESA_LaneClear_Status 0;
BA_ "GenSigTimeoutTime_IPC" SG_ 280 ESA_LaneClear_Status 0;
BA_ "GenSigTimeoutTime_RFHM" SG_ 280 ESA_LaneClear_Status 0;
BA_ "GenSigTimeoutTime_SGW" SG_ 280 ESA_LaneClear_Status 0;
BA_ "GenSigTimeoutTime_TCM" SG_ 280 ESA_LaneClear_Status 0;
BA_ "GenSigTimeoutTime_AGSM" SG_ 280 ESA_LAT_CTRL_RequestSts 0;
BA_ "GenSigTimeoutTime_BCM" SG_ 280 ESA_LAT_CTRL_RequestSts 0;
BA_ "GenSigTimeoutTime_BSM" SG_ 280 ESA_LAT_CTRL_RequestSts 0;
BA_ "GenSigTimeoutTime_CADM" SG_ 280 ESA_LAT_CTRL_RequestSts 0;
BA_ "GenSigTimeoutTime_DMSM" SG_ 280 ESA_LAT_CTRL_RequestSts 0;
BA_ "GenSigTimeoutTime_DTCM" SG_ 280 ESA_LAT_CTRL_RequestSts 0;
BA_ "GenSigTimeoutTime_ECM" SG_ 280 ESA_LAT_CTRL_RequestSts 0;
BA_ "GenSigTimeoutTime_EVCU2" SG_ 280 ESA_LAT_CTRL_RequestSts 0;
BA_ "GenSigTimeoutTime_GNMM" SG_ 280 ESA_LAT_CTRL_RequestSts 0;
BA_ "GenSigTimeoutTime_HCP" SG_ 280 ESA_LAT_CTRL_RequestSts 0;
BA_ "GenSigTimeoutTime_IPC" SG_ 280 ESA_LAT_CTRL_RequestSts 0;
BA_ "GenSigTimeoutTime_RFHM" SG_ 280 ESA_LAT_CTRL_RequestSts 0;
BA_ "GenSigTimeoutTime_SGW" SG_ 280 ESA_LAT_CTRL_RequestSts 0;
BA_ "GenSigTimeoutTime_TCM" SG_ 280 ESA_LAT_CTRL_RequestSts 0;
BA_ "GenSigStartValue" SG_ 280 ESA_TorqueOverlaySteeringReq 1024;
BA_ "GenSigTimeoutTime_AGSM" SG_ 280 ESA_TorqueOverlaySteeringReq 0;
BA_ "GenSigTimeoutTime_BCM" SG_ 280 ESA_TorqueOverlaySteeringReq 0;
BA_ "GenSigTimeoutTime_BSM" SG_ 280 ESA_TorqueOverlaySteeringReq 0;
BA_ "GenSigTimeoutTime_CADM" SG_ 280 ESA_TorqueOverlaySteeringReq 0;
BA_ "GenSigTimeoutTime_DMSM" SG_ 280 ESA_TorqueOverlaySteeringReq 0;
BA_ "GenSigTimeoutTime_DTCM" SG_ 280 ESA_TorqueOverlaySteeringReq 0;
BA_ "GenSigTimeoutTime_ECM" SG_ 280 ESA_TorqueOverlaySteeringReq 0;
BA_ "GenSigTimeoutTime_EVCU2" SG_ 280 ESA_TorqueOverlaySteeringReq 0;
BA_ "GenSigTimeoutTime_GNMM" SG_ 280 ESA_TorqueOverlaySteeringReq 0;
BA_ "GenSigTimeoutTime_HCP" SG_ 280 ESA_TorqueOverlaySteeringReq 0;
BA_ "GenSigTimeoutTime_IPC" SG_ 280 ESA_TorqueOverlaySteeringReq 0;
BA_ "GenSigTimeoutTime_RFHM" SG_ 280 ESA_TorqueOverlaySteeringReq 0;
BA_ "GenSigTimeoutTime_SGW" SG_ 280 ESA_TorqueOverlaySteeringReq 0;
BA_ "GenSigTimeoutTime_TCM" SG_ 280 ESA_TorqueOverlaySteeringReq 0;
BA_ "GenSigTimeoutTime_AGSM" SG_ 280 ESASystemSts 0;
BA_ "GenSigTimeoutTime_BCM" SG_ 280 ESASystemSts 0;
BA_ "GenSigTimeoutTime_BSM" SG_ 280 ESASystemSts 0;
BA_ "GenSigTimeoutTime_CADM" SG_ 280 ESASystemSts 0;
BA_ "GenSigTimeoutTime_DMSM" SG_ 280 ESASystemSts 0;
BA_ "GenSigTimeoutTime_DTCM" SG_ 280 ESASystemSts 0;
BA_ "GenSigTimeoutTime_ECM" SG_ 280 ESASystemSts 0;
BA_ "GenSigTimeoutTime_EVCU2" SG_ 280 ESASystemSts 0;
BA_ "GenSigTimeoutTime_GNMM" SG_ 280 ESASystemSts 0;
BA_ "GenSigTimeoutTime_HCP" SG_ 280 ESASystemSts 0;
BA_ "GenSigTimeoutTime_IPC" SG_ 280 ESASystemSts 0;
BA_ "GenSigTimeoutTime_RFHM" SG_ 280 ESASystemSts 0;
BA_ "GenSigTimeoutTime_SGW" SG_ 280 ESASystemSts 0;
BA_ "GenSigTimeoutTime_TCM" SG_ 280 ESASystemSts 0;
BA_ "GenSigTimeoutTime_AGSM" SG_ 280 ESCALATION_TYPE 0;
BA_ "GenSigTimeoutTime_BCM" SG_ 280 ESCALATION_TYPE 0;
BA_ "GenSigTimeoutTime_BSM" SG_ 280 ESCALATION_TYPE 0;
BA_ "GenSigTimeoutTime_CADM" SG_ 280 ESCALATION_TYPE 0;
BA_ "GenSigTimeoutTime_DMSM" SG_ 280 ESCALATION_TYPE 0;
BA_ "GenSigTimeoutTime_DTCM" SG_ 280 ESCALATION_TYPE 0;
BA_ "GenSigTimeoutTime_ECM" SG_ 280 ESCALATION_TYPE 0;
BA_ "GenSigTimeoutTime_EVCU2" SG_ 280 ESCALATION_TYPE 0;
BA_ "GenSigTimeoutTime_GNMM" SG_ 280 ESCALATION_TYPE 0;
BA_ "GenSigTimeoutTime_HCP" SG_ 280 ESCALATION_TYPE 0;
BA_ "GenSigTimeoutTime_IPC" SG_ 280 ESCALATION_TYPE 0;
BA_ "GenSigTimeoutTime_RFHM" SG_ 280 ESCALATION_TYPE 0;
BA_ "GenSigTimeoutTime_SGW" SG_ 280 ESCALATION_TYPE 0;
BA_ "GenSigTimeoutTime_TCM" SG_ 280 ESCALATION_TYPE 0;
BA_ "GenSigTimeoutTime_AGSM" SG_ 280 GrMax_Rq_ACC 0;
BA_ "GenSigTimeoutTime_BCM" SG_ 280 GrMax_Rq_ACC 0;
BA_ "GenSigTimeoutTime_BSM" SG_ 280 GrMax_Rq_ACC 0;
BA_ "GenSigTimeoutTime_CADM" SG_ 280 GrMax_Rq_ACC 0;
BA_ "GenSigTimeoutTime_DMSM" SG_ 280 GrMax_Rq_ACC 0;
BA_ "GenSigTimeoutTime_DTCM" SG_ 280 GrMax_Rq_ACC 0;
BA_ "GenSigTimeoutTime_ECM" SG_ 280 GrMax_Rq_ACC 0;
BA_ "GenSigTimeoutTime_EVCU2" SG_ 280 GrMax_Rq_ACC 0;
BA_ "GenSigTimeoutTime_GNMM" SG_ 280 GrMax_Rq_ACC 0;
BA_ "GenSigTimeoutTime_HCP" SG_ 280 GrMax_Rq_ACC 0;
BA_ "GenSigTimeoutTime_IPC" SG_ 280 GrMax_Rq_ACC 0;
BA_ "GenSigTimeoutTime_RFHM" SG_ 280 GrMax_Rq_ACC 0;
BA_ "GenSigTimeoutTime_SGW" SG_ 280 GrMax_Rq_ACC 0;
BA_ "GenSigTimeoutTime_TCM" SG_ 280 GrMax_Rq_ACC 0;
BA_ "GenSigTimeoutTime_AGSM" SG_ 280 HAS_LAT_CTRL_RequestSts 0;
BA_ "GenSigTimeoutTime_BCM" SG_ 280 HAS_LAT_CTRL_RequestSts 0;
BA_ "GenSigTimeoutTime_BSM" SG_ 280 HAS_LAT_CTRL_RequestSts 0;
BA_ "GenSigTimeoutTime_CADM" SG_ 280 HAS_LAT_CTRL_RequestSts 0;
BA_ "GenSigTimeoutTime_DMSM" SG_ 280 HAS_LAT_CTRL_RequestSts 0;
BA_ "GenSigTimeoutTime_DTCM" SG_ 280 HAS_LAT_CTRL_RequestSts 0;
BA_ "GenSigTimeoutTime_ECM" SG_ 280 HAS_LAT_CTRL_RequestSts 0;
BA_ "GenSigTimeoutTime_EVCU2" SG_ 280 HAS_LAT_CTRL_RequestSts 0;
BA_ "GenSigTimeoutTime_GNMM" SG_ 280 HAS_LAT_CTRL_RequestSts 0;
BA_ "GenSigTimeoutTime_HCP" SG_ 280 HAS_LAT_CTRL_RequestSts 0;
BA_ "GenSigTimeoutTime_IPC" SG_ 280 HAS_LAT_CTRL_RequestSts 0;
BA_ "GenSigTimeoutTime_RFHM" SG_ 280 HAS_LAT_CTRL_RequestSts 0;
BA_ "GenSigTimeoutTime_SGW" SG_ 280 HAS_LAT_CTRL_RequestSts 0;
BA_ "GenSigTimeoutTime_TCM" SG_ 280 HAS_LAT_CTRL_RequestSts 0;
BA_ "GenSigTimeoutTime_AGSM" SG_ 280 HAS_OpStat_Prim 0;
BA_ "GenSigTimeoutTime_BSM" SG_ 280 HAS_OpStat_Prim 0;
BA_ "GenSigTimeoutTime_CADM" SG_ 280 HAS_OpStat_Prim 0;
BA_ "GenSigTimeoutTime_DMSM" SG_ 280 HAS_OpStat_Prim 0;
BA_ "GenSigTimeoutTime_DTCM" SG_ 280 HAS_OpStat_Prim 0;
BA_ "GenSigTimeoutTime_ECM" SG_ 280 HAS_OpStat_Prim 0;
BA_ "GenSigTimeoutTime_EVCU2" SG_ 280 HAS_OpStat_Prim 0;
BA_ "GenSigTimeoutTime_GNMM" SG_ 280 HAS_OpStat_Prim 0;
BA_ "GenSigTimeoutTime_HCP" SG_ 280 HAS_OpStat_Prim 0;
BA_ "GenSigTimeoutTime_IPC" SG_ 280 HAS_OpStat_Prim 0;
BA_ "GenSigTimeoutTime_RFHM" SG_ 280 HAS_OpStat_Prim 0;
BA_ "GenSigTimeoutTime_SGW" SG_ 280 HAS_OpStat_Prim 0;
BA_ "GenSigTimeoutTime_TCM" SG_ 280 HAS_OpStat_Prim 0;
BA_ "GenSigTimeoutTime_AGSM" SG_ 280 HAS_Status 0;
BA_ "GenSigTimeoutTime_CADM" SG_ 280 HAS_Status 0;
BA_ "GenSigTimeoutTime_DMSM" SG_ 280 HAS_Status 0;
BA_ "GenSigTimeoutTime_DTCM" SG_ 280 HAS_Status 0;
BA_ "GenSigTimeoutTime_ECM" SG_ 280 HAS_Status 0;
BA_ "GenSigTimeoutTime_EVCU2" SG_ 280 HAS_Status 0;
BA_ "GenSigTimeoutTime_GNMM" SG_ 280 HAS_Status 0;
BA_ "GenSigTimeoutTime_HCP" SG_ 280 HAS_Status 0;
BA_ "GenSigTimeoutTime_RFHM" SG_ 280 HAS_Status 0;
BA_ "GenSigTimeoutTime_SGW" SG_ 280 HAS_Status 0;
BA_ "GenSigTimeoutTime_TCM" SG_ 280 HAS_Status 0;
BA_ "GenSigTimeoutTime_AGSM" SG_ 280 HIS_Req 0;
BA_ "GenSigTimeoutTime_BCM" SG_ 280 HIS_Req 0;
BA_ "GenSigTimeoutTime_CADM" SG_ 280 HIS_Req 0;
BA_ "GenSigTimeoutTime_DMSM" SG_ 280 HIS_Req 0;
BA_ "GenSigTimeoutTime_DTCM" SG_ 280 HIS_Req 0;
BA_ "GenSigTimeoutTime_ECM" SG_ 280 HIS_Req 0;
BA_ "GenSigTimeoutTime_EVCU2" SG_ 280 HIS_Req 0;
BA_ "GenSigTimeoutTime_GNMM" SG_ 280 HIS_Req 0;
BA_ "GenSigTimeoutTime_HCP" SG_ 280 HIS_Req 0;
BA_ "GenSigTimeoutTime_IPC" SG_ 280 HIS_Req 0;
BA_ "GenSigTimeoutTime_RFHM" SG_ 280 HIS_Req 0;
BA_ "GenSigTimeoutTime_SGW" SG_ 280 HIS_Req 0;
BA_ "GenSigTimeoutTime_TCM" SG_ 280 HIS_Req 0;
BA_ "GenSigStartValue" SG_ 280 Intervention 4095;
BA_ "GenSigTimeoutTime_AGSM" SG_ 280 Intervention 0;
BA_ "GenSigTimeoutTime_BCM" SG_ 280 Intervention 0;
BA_ "GenSigTimeoutTime_CADM" SG_ 280 Intervention 0;
BA_ "GenSigTimeoutTime_DMSM" SG_ 280 Intervention 0;
BA_ "GenSigTimeoutTime_DTCM" SG_ 280 Intervention 0;
BA_ "GenSigTimeoutTime_ECM" SG_ 280 Intervention 0;
BA_ "GenSigTimeoutTime_EVCU2" SG_ 280 Intervention 0;
BA_ "GenSigTimeoutTime_GNMM" SG_ 280 Intervention 0;
BA_ "GenSigTimeoutTime_HCP" SG_ 280 Intervention 0;
BA_ "GenSigTimeoutTime_IPC" SG_ 280 Intervention 0;
BA_ "GenSigTimeoutTime_RFHM" SG_ 280 Intervention 0;
BA_ "GenSigTimeoutTime_TCM" SG_ 280 Intervention 0;
BA_ "GenSigTimeoutTime_AGSM" SG_ 280 LANE_CHANGE_SIDE 0;
BA_ "GenSigTimeoutTime_BCM" SG_ 280 LANE_CHANGE_SIDE 0;
BA_ "GenSigTimeoutTime_BSM" SG_ 280 LANE_CHANGE_SIDE 0;
BA_ "GenSigTimeoutTime_CADM" SG_ 280 LANE_CHANGE_SIDE 0;
BA_ "GenSigTimeoutTime_DMSM" SG_ 280 LANE_CHANGE_SIDE 0;
BA_ "GenSigTimeoutTime_DTCM" SG_ 280 LANE_CHANGE_SIDE 0;
BA_ "GenSigTimeoutTime_ECM" SG_ 280 LANE_CHANGE_SIDE 0;
BA_ "GenSigTimeoutTime_EVCU2" SG_ 280 LANE_CHANGE_SIDE 0;
BA_ "GenSigTimeoutTime_GNMM" SG_ 280 LANE_CHANGE_SIDE 0;
BA_ "GenSigTimeoutTime_HCP" SG_ 280 LANE_CHANGE_SIDE 0;
BA_ "GenSigTimeoutTime_RFHM" SG_ 280 LANE_CHANGE_SIDE 0;
BA_ "GenSigTimeoutTime_SGW" SG_ 280 LANE_CHANGE_SIDE 0;
BA_ "GenSigTimeoutTime_TCM" SG_ 280 LANE_CHANGE_SIDE 0;
BA_ "GenSigTimeoutTime_AGSM" SG_ 280 LANE_CHANGE_STATUS 0;
BA_ "GenSigTimeoutTime_BCM" SG_ 280 LANE_CHANGE_STATUS 0;
BA_ "GenSigTimeoutTime_BSM" SG_ 280 LANE_CHANGE_STATUS 0;
BA_ "GenSigTimeoutTime_CADM" SG_ 280 LANE_CHANGE_STATUS 0;
BA_ "GenSigTimeoutTime_DMSM" SG_ 280 LANE_CHANGE_STATUS 0;
BA_ "GenSigTimeoutTime_DTCM" SG_ 280 LANE_CHANGE_STATUS 0;
BA_ "GenSigTimeoutTime_ECM" SG_ 280 LANE_CHANGE_STATUS 0;
BA_ "GenSigTimeoutTime_EVCU2" SG_ 280 LANE_CHANGE_STATUS 0;
BA_ "GenSigTimeoutTime_GNMM" SG_ 280 LANE_CHANGE_STATUS 0;
BA_ "GenSigTimeoutTime_HCP" SG_ 280 LANE_CHANGE_STATUS 0;
BA_ "GenSigTimeoutTime_RFHM" SG_ 280 LANE_CHANGE_STATUS 0;
BA_ "GenSigTimeoutTime_SGW" SG_ 280 LANE_CHANGE_STATUS 0;
BA_ "GenSigTimeoutTime_TCM" SG_ 280 LANE_CHANGE_STATUS 0;
BA_ "GenSigTimeoutTime_AGSM" SG_ 280 LC_Jerk 0;
BA_ "GenSigTimeoutTime_BCM" SG_ 280 LC_Jerk 0;
BA_ "GenSigTimeoutTime_CADM" SG_ 280 LC_Jerk 0;
BA_ "GenSigTimeoutTime_DMSM" SG_ 280 LC_Jerk 0;
BA_ "GenSigTimeoutTime_DTCM" SG_ 280 LC_Jerk 0;
BA_ "GenSigTimeoutTime_ECM" SG_ 280 LC_Jerk 0;
BA_ "GenSigTimeoutTime_EVCU2" SG_ 280 LC_Jerk 0;
BA_ "GenSigTimeoutTime_GNMM" SG_ 280 LC_Jerk 0;
BA_ "GenSigTimeoutTime_HCP" SG_ 280 LC_Jerk 0;
BA_ "GenSigTimeoutTime_IPC" SG_ 280 LC_Jerk 0;
BA_ "GenSigTimeoutTime_RFHM" SG_ 280 LC_Jerk 0;
BA_ "GenSigTimeoutTime_SGW" SG_ 280 LC_Jerk 0;
BA_ "GenSigTimeoutTime_TCM" SG_ 280 LC_Jerk 0;
BA_ "GenSigTimeoutTime_AGSM" SG_ 280 LKA_LAT_CTRL_RequestSts 0;
BA_ "GenSigTimeoutTime_BCM" SG_ 280 LKA_LAT_CTRL_RequestSts 0;
BA_ "GenSigTimeoutTime_BSM" SG_ 280 LKA_LAT_CTRL_RequestSts 0;
BA_ "GenSigTimeoutTime_CADM" SG_ 280 LKA_LAT_CTRL_RequestSts 0;
BA_ "GenSigTimeoutTime_DMSM" SG_ 280 LKA_LAT_CTRL_RequestSts 0;
BA_ "GenSigTimeoutTime_DTCM" SG_ 280 LKA_LAT_CTRL_RequestSts 0;
BA_ "GenSigTimeoutTime_ECM" SG_ 280 LKA_LAT_CTRL_RequestSts 0;
BA_ "GenSigTimeoutTime_EVCU2" SG_ 280 LKA_LAT_CTRL_RequestSts 0;
BA_ "GenSigTimeoutTime_GNMM" SG_ 280 LKA_LAT_CTRL_RequestSts 0;
BA_ "GenSigTimeoutTime_HCP" SG_ 280 LKA_LAT_CTRL_RequestSts 0;
BA_ "GenSigTimeoutTime_IPC" SG_ 280 LKA_LAT_CTRL_RequestSts 0;
BA_ "GenSigTimeoutTime_RFHM" SG_ 280 LKA_LAT_CTRL_RequestSts 0;
BA_ "GenSigTimeoutTime_SGW" SG_ 280 LKA_LAT_CTRL_RequestSts 0;
BA_ "GenSigTimeoutTime_TCM" SG_ 280 LKA_LAT_CTRL_RequestSts 0;
BA_ "GenSigTimeoutTime_AGSM" SG_ 280 MessageCounter_ADAS_FD_INFO 0;
BA_ "GenSigTimeoutTime_CADM" SG_ 280 MessageCounter_ADAS_FD_INFO 0;
BA_ "GenSigTimeoutTime_DMSM" SG_ 280 MessageCounter_ADAS_FD_INFO 0;
BA_ "GenSigTimeoutTime_DTCM" SG_ 280 MessageCounter_ADAS_FD_INFO 0;
BA_ "GenSigTimeoutTime_ECM" SG_ 280 MessageCounter_ADAS_FD_INFO 0;
BA_ "GenSigTimeoutTime_EVCU2" SG_ 280 MessageCounter_ADAS_FD_INFO 0;
BA_ "GenSigTimeoutTime_GNMM" SG_ 280 MessageCounter_ADAS_FD_INFO 0;
BA_ "GenSigTimeoutTime_HCP" SG_ 280 MessageCounter_ADAS_FD_INFO 0;
BA_ "GenSigTimeoutTime_RFHM" SG_ 280 MessageCounter_ADAS_FD_INFO 0;
BA_ "GenSigTimeoutTime_SGW" SG_ 280 MessageCounter_ADAS_FD_INFO 0;
BA_ "GenSigTimeoutTime_AGSM" SG_ 280 MRM_STATUS 0;
BA_ "GenSigTimeoutTime_CADM" SG_ 280 MRM_STATUS 0;
BA_ "GenSigTimeoutTime_DMSM" SG_ 280 MRM_STATUS 0;
BA_ "GenSigTimeoutTime_DTCM" SG_ 280 MRM_STATUS 0;
BA_ "GenSigTimeoutTime_ECM" SG_ 280 MRM_STATUS 0;
BA_ "GenSigTimeoutTime_GNMM" SG_ 280 MRM_STATUS 0;
BA_ "GenSigTimeoutTime_HCP" SG_ 280 MRM_STATUS 0;
BA_ "GenSigTimeoutTime_RFHM" SG_ 280 MRM_STATUS 0;
BA_ "GenSigStartValue" SG_ 280 Object_Dist 255;
BA_ "GenSigTimeoutTime_AGSM" SG_ 280 Object_Dist 0;
BA_ "GenSigTimeoutTime_BCM" SG_ 280 Object_Dist 0;
BA_ "GenSigTimeoutTime_BSM" SG_ 280 Object_Dist 0;
BA_ "GenSigTimeoutTime_CADM" SG_ 280 Object_Dist 0;
BA_ "GenSigTimeoutTime_DMSM" SG_ 280 Object_Dist 0;
BA_ "GenSigTimeoutTime_ECM" SG_ 280 Object_Dist 0;
BA_ "GenSigTimeoutTime_EVCU2" SG_ 280 Object_Dist 0;
BA_ "GenSigTimeoutTime_GNMM" SG_ 280 Object_Dist 0;
BA_ "GenSigTimeoutTime_HCP" SG_ 280 Object_Dist 0;
BA_ "GenSigTimeoutTime_IPC" SG_ 280 Object_Dist 0;
BA_ "GenSigTimeoutTime_RFHM" SG_ 280 Object_Dist 0;
BA_ "GenSigTimeoutTime_SGW" SG_ 280 Object_Dist 0;
BA_ "GenSigTimeoutTime_AGSM" SG_ 280 PEB_SystemSts 0;
BA_ "GenSigTimeoutTime_BCM" SG_ 280 PEB_SystemSts 0;
BA_ "GenSigTimeoutTime_BSM" SG_ 280 PEB_SystemSts 0;
BA_ "GenSigTimeoutTime_CADM" SG_ 280 PEB_SystemSts 0;
BA_ "GenSigTimeoutTime_DMSM" SG_ 280 PEB_SystemSts 0;
BA_ "GenSigTimeoutTime_DTCM" SG_ 280 PEB_SystemSts 0;
BA_ "GenSigTimeoutTime_ECM" SG_ 280 PEB_SystemSts 0;
BA_ "GenSigTimeoutTime_EVCU2" SG_ 280 PEB_SystemSts 0;
BA_ "GenSigTimeoutTime_GNMM" SG_ 280 PEB_SystemSts 0;
BA_ "GenSigTimeoutTime_HCP" SG_ 280 PEB_SystemSts 0;
BA_ "GenSigTimeoutTime_RFHM" SG_ 280 PEB_SystemSts 0;
BA_ "GenSigTimeoutTime_SGW" SG_ 280 PEB_SystemSts 0;
BA_ "GenSigTimeoutTime_TCM" SG_ 280 PEB_SystemSts 0;
BA_ "GenSigTimeoutTime_AGSM" SG_ 280 Prefill_Req 0;
BA_ "GenSigTimeoutTime_BCM" SG_ 280 Prefill_Req 0;
BA_ "GenSigTimeoutTime_CADM" SG_ 280 Prefill_Req 0;
BA_ "GenSigTimeoutTime_DMSM" SG_ 280 Prefill_Req 0;
BA_ "GenSigTimeoutTime_DTCM" SG_ 280 Prefill_Req 0;
BA_ "GenSigTimeoutTime_ECM" SG_ 280 Prefill_Req 0;
BA_ "GenSigTimeoutTime_EVCU2" SG_ 280 Prefill_Req 0;
BA_ "GenSigTimeoutTime_GNMM" SG_ 280 Prefill_Req 0;
BA_ "GenSigTimeoutTime_HCP" SG_ 280 Prefill_Req 0;
BA_ "GenSigTimeoutTime_IPC" SG_ 280 Prefill_Req 0;
BA_ "GenSigTimeoutTime_RFHM" SG_ 280 Prefill_Req 0;
BA_ "GenSigTimeoutTime_SGW" SG_ 280 Prefill_Req 0;
BA_ "GenSigTimeoutTime_TCM" SG_ 280 Prefill_Req 0;
BA_ "GenSigTimeoutTime_AGSM" SG_ 280 SeatVib_Req 0;
BA_ "GenSigTimeoutTime_BSM" SG_ 280 SeatVib_Req 0;
BA_ "GenSigTimeoutTime_CADM" SG_ 280 SeatVib_Req 0;
BA_ "GenSigTimeoutTime_DMSM" SG_ 280 SeatVib_Req 0;
BA_ "GenSigTimeoutTime_DTCM" SG_ 280 SeatVib_Req 0;
BA_ "GenSigTimeoutTime_ECM" SG_ 280 SeatVib_Req 0;
BA_ "GenSigTimeoutTime_EVCU2" SG_ 280 SeatVib_Req 0;
BA_ "GenSigTimeoutTime_GNMM" SG_ 280 SeatVib_Req 0;
BA_ "GenSigTimeoutTime_HCP" SG_ 280 SeatVib_Req 0;
BA_ "GenSigTimeoutTime_IPC" SG_ 280 SeatVib_Req 0;
BA_ "GenSigTimeoutTime_RFHM" SG_ 280 SeatVib_Req 0;
BA_ "GenSigTimeoutTime_SGW" SG_ 280 SeatVib_Req 0;
BA_ "GenSigTimeoutTime_TCM" SG_ 280 SeatVib_Req 0;
BA_ "GenSigTimeoutTime_AGSM" SG_ 280 SteeringVibration_Rq 0;
BA_ "GenSigTimeoutTime_BCM" SG_ 280 SteeringVibration_Rq 0;
BA_ "GenSigTimeoutTime_BSM" SG_ 280 SteeringVibration_Rq 0;
BA_ "GenSigTimeoutTime_CADM" SG_ 280 SteeringVibration_Rq 0;
BA_ "GenSigTimeoutTime_DMSM" SG_ 280 SteeringVibration_Rq 0;
BA_ "GenSigTimeoutTime_DTCM" SG_ 280 SteeringVibration_Rq 0;
BA_ "GenSigTimeoutTime_ECM" SG_ 280 SteeringVibration_Rq 0;
BA_ "GenSigTimeoutTime_EVCU2" SG_ 280 SteeringVibration_Rq 0;
BA_ "GenSigTimeoutTime_GNMM" SG_ 280 SteeringVibration_Rq 0;
BA_ "GenSigTimeoutTime_HCP" SG_ 280 SteeringVibration_Rq 0;
BA_ "GenSigTimeoutTime_IPC" SG_ 280 SteeringVibration_Rq 0;
BA_ "GenSigTimeoutTime_RFHM" SG_ 280 SteeringVibration_Rq 0;
BA_ "GenSigTimeoutTime_SGW" SG_ 280 SteeringVibration_Rq 0;
BA_ "GenSigTimeoutTime_TCM" SG_ 280 SteeringVibration_Rq 0;
BA_ "GenSigTimeoutTime_AGSM" SG_ 280 SteeringVibration_Type 0;
BA_ "GenSigTimeoutTime_BCM" SG_ 280 SteeringVibration_Type 0;
BA_ "GenSigTimeoutTime_BSM" SG_ 280 SteeringVibration_Type 0;
BA_ "GenSigTimeoutTime_CADM" SG_ 280 SteeringVibration_Type 0;
BA_ "GenSigTimeoutTime_DMSM" SG_ 280 SteeringVibration_Type 0;
BA_ "GenSigTimeoutTime_DTCM" SG_ 280 SteeringVibration_Type 0;
BA_ "GenSigTimeoutTime_ECM" SG_ 280 SteeringVibration_Type 0;
BA_ "GenSigTimeoutTime_EVCU2" SG_ 280 SteeringVibration_Type 0;
BA_ "GenSigTimeoutTime_GNMM" SG_ 280 SteeringVibration_Type 0;
BA_ "GenSigTimeoutTime_HCP" SG_ 280 SteeringVibration_Type 0;
BA_ "GenSigTimeoutTime_IPC" SG_ 280 SteeringVibration_Type 0;
BA_ "GenSigTimeoutTime_RFHM" SG_ 280 SteeringVibration_Type 0;
BA_ "GenSigTimeoutTime_SGW" SG_ 280 SteeringVibration_Type 0;
BA_ "GenSigTimeoutTime_TCM" SG_ 280 SteeringVibration_Type 0;
BA_ "GenSigStartValue" SG_ 280 TorqueOverlaySteeringReq 1024;
BA_ "GenSigTimeoutTime_AGSM" SG_ 280 TorqueOverlaySteeringReq 0;
BA_ "GenSigTimeoutTime_BCM" SG_ 280 TorqueOverlaySteeringReq 0;
BA_ "GenSigTimeoutTime_BSM" SG_ 280 TorqueOverlaySteeringReq 0;
BA_ "GenSigTimeoutTime_CADM" SG_ 280 TorqueOverlaySteeringReq 0;
BA_ "GenSigTimeoutTime_DMSM" SG_ 280 TorqueOverlaySteeringReq 0;
BA_ "GenSigTimeoutTime_DTCM" SG_ 280 TorqueOverlaySteeringReq 0;
BA_ "GenSigTimeoutTime_ECM" SG_ 280 TorqueOverlaySteeringReq 0;
BA_ "GenSigTimeoutTime_EVCU2" SG_ 280 TorqueOverlaySteeringReq 0;
BA_ "GenSigTimeoutTime_GNMM" SG_ 280 TorqueOverlaySteeringReq 0;
BA_ "GenSigTimeoutTime_HCP" SG_ 280 TorqueOverlaySteeringReq 0;
BA_ "GenSigTimeoutTime_IPC" SG_ 280 TorqueOverlaySteeringReq 0;
BA_ "GenSigTimeoutTime_RFHM" SG_ 280 TorqueOverlaySteeringReq 0;
BA_ "GenSigTimeoutTime_SGW" SG_ 280 TorqueOverlaySteeringReq 0;
BA_ "GenSigTimeoutTime_TCM" SG_ 280 TorqueOverlaySteeringReq 0;
BA_ "GenSigTimeoutTime_AGSM" SG_ 281 ACC_Systemsts_C2 0;
BA_ "GenSigTimeoutTime_BCM" SG_ 281 ACC_Systemsts_C2 0;
BA_ "GenSigTimeoutTime_CADM" SG_ 281 ACC_Systemsts_C2 0;
BA_ "GenSigTimeoutTime_DMSM" SG_ 281 ACC_Systemsts_C2 0;
BA_ "GenSigTimeoutTime_DTCM" SG_ 281 ACC_Systemsts_C2 0;
BA_ "GenSigTimeoutTime_ECM" SG_ 281 ACC_Systemsts_C2 0;
BA_ "GenSigTimeoutTime_EVCU2" SG_ 281 ACC_Systemsts_C2 0;
BA_ "GenSigTimeoutTime_GNMM" SG_ 281 ACC_Systemsts_C2 0;
BA_ "GenSigTimeoutTime_HCP" SG_ 281 ACC_Systemsts_C2 0;
BA_ "GenSigTimeoutTime_IPC" SG_ 281 ACC_Systemsts_C2 0;
BA_ "GenSigTimeoutTime_RFHM" SG_ 281 ACC_Systemsts_C2 0;
BA_ "GenSigTimeoutTime_SGW" SG_ 281 ACC_Systemsts_C2 0;
BA_ "GenSigTimeoutTime_TCM" SG_ 281 ACC_Systemsts_C2 0;
BA_ "GenSigTimeoutTime_AGSM" SG_ 281 AEB_Type_C2 0;
BA_ "GenSigTimeoutTime_BCM" SG_ 281 AEB_Type_C2 0;
BA_ "GenSigTimeoutTime_CADM" SG_ 281 AEB_Type_C2 0;
BA_ "GenSigTimeoutTime_DMSM" SG_ 281 AEB_Type_C2 0;
BA_ "GenSigTimeoutTime_DTCM" SG_ 281 AEB_Type_C2 0;
BA_ "GenSigTimeoutTime_ECM" SG_ 281 AEB_Type_C2 0;
BA_ "GenSigTimeoutTime_EVCU2" SG_ 281 AEB_Type_C2 0;
BA_ "GenSigTimeoutTime_GNMM" SG_ 281 AEB_Type_C2 0;
BA_ "GenSigTimeoutTime_HCP" SG_ 281 AEB_Type_C2 0;
BA_ "GenSigTimeoutTime_IPC" SG_ 281 AEB_Type_C2 0;
BA_ "GenSigTimeoutTime_RFHM" SG_ 281 AEB_Type_C2 0;
BA_ "GenSigTimeoutTime_SGW" SG_ 281 AEB_Type_C2 0;
BA_ "GenSigTimeoutTime_TCM" SG_ 281 AEB_Type_C2 0;
BA_ "GenSigTimeoutTime_AGSM" SG_ 281 CADM2_Mode 0;
BA_ "GenSigTimeoutTime_BCM" SG_ 281 CADM2_Mode 0;
BA_ "GenSigTimeoutTime_CADM" SG_ 281 CADM2_Mode 0;
BA_ "GenSigTimeoutTime_DMSM" SG_ 281 CADM2_Mode 0;
BA_ "GenSigTimeoutTime_DTCM" SG_ 281 CADM2_Mode 0;
BA_ "GenSigTimeoutTime_ECM" SG_ 281 CADM2_Mode 0;
BA_ "GenSigTimeoutTime_EVCU2" SG_ 281 CADM2_Mode 0;
BA_ "GenSigTimeoutTime_GNMM" SG_ 281 CADM2_Mode 0;
BA_ "GenSigTimeoutTime_HCP" SG_ 281 CADM2_Mode 0;
BA_ "GenSigTimeoutTime_RFHM" SG_ 281 CADM2_Mode 0;
BA_ "GenSigTimeoutTime_SGW" SG_ 281 CADM2_Mode 0;
BA_ "GenSigTimeoutTime_TCM" SG_ 281 CADM2_Mode 0;
BA_ "GenSigTimeoutTime_AGSM" SG_ 281 CRC_ADAS_INFO_C2 0;
BA_ "GenSigTimeoutTime_BCM" SG_ 281 CRC_ADAS_INFO_C2 0;
BA_ "GenSigTimeoutTime_CADM" SG_ 281 CRC_ADAS_INFO_C2 0;
BA_ "GenSigTimeoutTime_DMSM" SG_ 281 CRC_ADAS_INFO_C2 0;
BA_ "GenSigTimeoutTime_DTCM" SG_ 281 CRC_ADAS_INFO_C2 0;
BA_ "GenSigTimeoutTime_ECM" SG_ 281 CRC_ADAS_INFO_C2 0;
BA_ "GenSigTimeoutTime_EVCU2" SG_ 281 CRC_ADAS_INFO_C2 0;
BA_ "GenSigTimeoutTime_GNMM" SG_ 281 CRC_ADAS_INFO_C2 0;
BA_ "GenSigTimeoutTime_HCP" SG_ 281 CRC_ADAS_INFO_C2 0;
BA_ "GenSigTimeoutTime_RFHM" SG_ 281 CRC_ADAS_INFO_C2 0;
BA_ "GenSigTimeoutTime_SGW" SG_ 281 CRC_ADAS_INFO_C2 0;
BA_ "GenSigTimeoutTime_AGSM" SG_ 281 HAS_Status_C2 0;
BA_ "GenSigTimeoutTime_BCM" SG_ 281 HAS_Status_C2 0;
BA_ "GenSigTimeoutTime_CADM" SG_ 281 HAS_Status_C2 0;
BA_ "GenSigTimeoutTime_DMSM" SG_ 281 HAS_Status_C2 0;
BA_ "GenSigTimeoutTime_DTCM" SG_ 281 HAS_Status_C2 0;
BA_ "GenSigTimeoutTime_ECM" SG_ 281 HAS_Status_C2 0;
BA_ "GenSigTimeoutTime_EVCU2" SG_ 281 HAS_Status_C2 0;
BA_ "GenSigTimeoutTime_GNMM" SG_ 281 HAS_Status_C2 0;
BA_ "GenSigTimeoutTime_HCP" SG_ 281 HAS_Status_C2 0;
BA_ "GenSigTimeoutTime_RFHM" SG_ 281 HAS_Status_C2 0;
BA_ "GenSigTimeoutTime_SGW" SG_ 281 HAS_Status_C2 0;
BA_ "GenSigTimeoutTime_TCM" SG_ 281 HAS_Status_C2 0;
BA_ "GenSigTimeoutTime_AGSM" SG_ 281 HIS_Req_C2 0;
BA_ "GenSigTimeoutTime_BCM" SG_ 281 HIS_Req_C2 0;
BA_ "GenSigTimeoutTime_CADM" SG_ 281 HIS_Req_C2 0;
BA_ "GenSigTimeoutTime_DMSM" SG_ 281 HIS_Req_C2 0;
BA_ "GenSigTimeoutTime_DTCM" SG_ 281 HIS_Req_C2 0;
BA_ "GenSigTimeoutTime_ECM" SG_ 281 HIS_Req_C2 0;
BA_ "GenSigTimeoutTime_EVCU2" SG_ 281 HIS_Req_C2 0;
BA_ "GenSigTimeoutTime_GNMM" SG_ 281 HIS_Req_C2 0;
BA_ "GenSigTimeoutTime_HCP" SG_ 281 HIS_Req_C2 0;
BA_ "GenSigTimeoutTime_IPC" SG_ 281 HIS_Req_C2 0;
BA_ "GenSigTimeoutTime_RFHM" SG_ 281 HIS_Req_C2 0;
BA_ "GenSigTimeoutTime_SGW" SG_ 281 HIS_Req_C2 0;
BA_ "GenSigTimeoutTime_TCM" SG_ 281 HIS_Req_C2 0;
BA_ "GenSigStartValue" SG_ 281 Intervention_C2 4095;
BA_ "GenSigTimeoutTime_AGSM" SG_ 281 Intervention_C2 0;
BA_ "GenSigTimeoutTime_BCM" SG_ 281 Intervention_C2 0;
BA_ "GenSigTimeoutTime_CADM" SG_ 281 Intervention_C2 0;
BA_ "GenSigTimeoutTime_DMSM" SG_ 281 Intervention_C2 0;
BA_ "GenSigTimeoutTime_DTCM" SG_ 281 Intervention_C2 0;
BA_ "GenSigTimeoutTime_ECM" SG_ 281 Intervention_C2 0;
BA_ "GenSigTimeoutTime_EVCU2" SG_ 281 Intervention_C2 0;
BA_ "GenSigTimeoutTime_GNMM" SG_ 281 Intervention_C2 0;
BA_ "GenSigTimeoutTime_HCP" SG_ 281 Intervention_C2 0;
BA_ "GenSigTimeoutTime_IPC" SG_ 281 Intervention_C2 0;
BA_ "GenSigTimeoutTime_RFHM" SG_ 281 Intervention_C2 0;
BA_ "GenSigTimeoutTime_SGW" SG_ 281 Intervention_C2 0;
BA_ "GenSigTimeoutTime_TCM" SG_ 281 Intervention_C2 0;
BA_ "GenSigTimeoutTime_AGSM" SG_ 281 MessageCounter_ADAS_INFO_C2 0;
BA_ "GenSigTimeoutTime_BCM" SG_ 281 MessageCounter_ADAS_INFO_C2 0;
BA_ "GenSigTimeoutTime_CADM" SG_ 281 MessageCounter_ADAS_INFO_C2 0;
BA_ "GenSigTimeoutTime_DMSM" SG_ 281 MessageCounter_ADAS_INFO_C2 0;
BA_ "GenSigTimeoutTime_DTCM" SG_ 281 MessageCounter_ADAS_INFO_C2 0;
BA_ "GenSigTimeoutTime_ECM" SG_ 281 MessageCounter_ADAS_INFO_C2 0;
BA_ "GenSigTimeoutTime_EVCU2" SG_ 281 MessageCounter_ADAS_INFO_C2 0;
BA_ "GenSigTimeoutTime_GNMM" SG_ 281 MessageCounter_ADAS_INFO_C2 0;
BA_ "GenSigTimeoutTime_HCP" SG_ 281 MessageCounter_ADAS_INFO_C2 0;
BA_ "GenSigTimeoutTime_RFHM" SG_ 281 MessageCounter_ADAS_INFO_C2 0;
BA_ "GenSigTimeoutTime_SGW" SG_ 281 MessageCounter_ADAS_INFO_C2 0;
BA_ "GenSigTimeoutTime_AGSM" SG_ 281 MRM_STATUS_C2 0;
BA_ "GenSigTimeoutTime_BCM" SG_ 281 MRM_STATUS_C2 0;
BA_ "GenSigTimeoutTime_CADM" SG_ 281 MRM_STATUS_C2 0;
BA_ "GenSigTimeoutTime_DMSM" SG_ 281 MRM_STATUS_C2 0;
BA_ "GenSigTimeoutTime_DTCM" SG_ 281 MRM_STATUS_C2 0;
BA_ "GenSigTimeoutTime_ECM" SG_ 281 MRM_STATUS_C2 0;
BA_ "GenSigTimeoutTime_GNMM" SG_ 281 MRM_STATUS_C2 0;
BA_ "GenSigTimeoutTime_HCP" SG_ 281 MRM_STATUS_C2 0;
BA_ "GenSigTimeoutTime_RFHM" SG_ 281 MRM_STATUS_C2 0;
BA_ "GenSigTimeoutTime_SGW" SG_ 281 MRM_STATUS_C2 0;
BA_ "GenSigTimeoutTime_AGSM" SG_ 610 AHB_Blind 0;
BA_ "GenSigTimeoutTime_BSM" SG_ 610 AHB_Blind 0;
BA_ "GenSigTimeoutTime_CADM" SG_ 610 AHB_Blind 0;
BA_ "GenSigTimeoutTime_DMSM" SG_ 610 AHB_Blind 0;
BA_ "GenSigTimeoutTime_DTCM" SG_ 610 AHB_Blind 0;
BA_ "GenSigTimeoutTime_ECM" SG_ 610 AHB_Blind 0;
BA_ "GenSigTimeoutTime_EVCU2" SG_ 610 AHB_Blind 0;
BA_ "GenSigTimeoutTime_GNMM" SG_ 610 AHB_Blind 0;
BA_ "GenSigTimeoutTime_HCP" SG_ 610 AHB_Blind 0;
BA_ "GenSigTimeoutTime_IPC" SG_ 610 AHB_Blind 0;
BA_ "GenSigTimeoutTime_RFHM" SG_ 610 AHB_Blind 0;
BA_ "GenSigTimeoutTime_SGW" SG_ 610 AHB_Blind 0;
BA_ "GenSigTimeoutTime_TCM" SG_ 610 AHB_Blind 0;
BA_ "GenSigTimeoutTime_AGSM" SG_ 610 AHB_ON 0;
BA_ "GenSigTimeoutTime_BSM" SG_ 610 AHB_ON 0;
BA_ "GenSigTimeoutTime_CADM" SG_ 610 AHB_ON 0;
BA_ "GenSigTimeoutTime_DMSM" SG_ 610 AHB_ON 0;
BA_ "GenSigTimeoutTime_DTCM" SG_ 610 AHB_ON 0;
BA_ "GenSigTimeoutTime_ECM" SG_ 610 AHB_ON 0;
BA_ "GenSigTimeoutTime_EVCU2" SG_ 610 AHB_ON 0;
BA_ "GenSigTimeoutTime_GNMM" SG_ 610 AHB_ON 0;
BA_ "GenSigTimeoutTime_HCP" SG_ 610 AHB_ON 0;
BA_ "GenSigTimeoutTime_IPC" SG_ 610 AHB_ON 0;
BA_ "GenSigTimeoutTime_RFHM" SG_ 610 AHB_ON 0;
BA_ "GenSigTimeoutTime_SGW" SG_ 610 AHB_ON 0;
BA_ "GenSigTimeoutTime_TCM" SG_ 610 AHB_ON 0;
BA_ "GenSigTimeoutTime_AGSM" SG_ 610 AHBFault 0;
BA_ "GenSigTimeoutTime_BSM" SG_ 610 AHBFault 0;
BA_ "GenSigTimeoutTime_CADM" SG_ 610 AHBFault 0;
BA_ "GenSigTimeoutTime_DMSM" SG_ 610 AHBFault 0;
BA_ "GenSigTimeoutTime_DTCM" SG_ 610 AHBFault 0;
BA_ "GenSigTimeoutTime_ECM" SG_ 610 AHBFault 0;
BA_ "GenSigTimeoutTime_EVCU2" SG_ 610 AHBFault 0;
BA_ "GenSigTimeoutTime_GNMM" SG_ 610 AHBFault 0;
BA_ "GenSigTimeoutTime_HCP" SG_ 610 AHBFault 0;
BA_ "GenSigTimeoutTime_IPC" SG_ 610 AHBFault 0;
BA_ "GenSigTimeoutTime_RFHM" SG_ 610 AHBFault 0;
BA_ "GenSigTimeoutTime_TCM" SG_ 610 AHBFault 0;
BA_ "GenSigTimeoutTime_AGSM" SG_ 610 CADM_DALM_CRC 0;
BA_ "GenSigTimeoutTime_BSM" SG_ 610 CADM_DALM_CRC 0;
BA_ "GenSigTimeoutTime_CADM" SG_ 610 CADM_DALM_CRC 0;
BA_ "GenSigTimeoutTime_DMSM" SG_ 610 CADM_DALM_CRC 0;
BA_ "GenSigTimeoutTime_DTCM" SG_ 610 CADM_DALM_CRC 0;
BA_ "GenSigTimeoutTime_ECM" SG_ 610 CADM_DALM_CRC 0;
BA_ "GenSigTimeoutTime_EVCU2" SG_ 610 CADM_DALM_CRC 0;
BA_ "GenSigTimeoutTime_GNMM" SG_ 610 CADM_DALM_CRC 0;
BA_ "GenSigTimeoutTime_HCP" SG_ 610 CADM_DALM_CRC 0;
BA_ "GenSigTimeoutTime_IPC" SG_ 610 CADM_DALM_CRC 0;
BA_ "GenSigTimeoutTime_RFHM" SG_ 610 CADM_DALM_CRC 0;
BA_ "GenSigTimeoutTime_SGW" SG_ 610 CADM_DALM_CRC 0;
BA_ "GenSigTimeoutTime_TCM" SG_ 610 CADM_DALM_CRC 0;
BA_ "GenSigTimeoutTime_AGSM" SG_ 610 CADM_DALM_MC 0;
BA_ "GenSigTimeoutTime_BSM" SG_ 610 CADM_DALM_MC 0;
BA_ "GenSigTimeoutTime_CADM" SG_ 610 CADM_DALM_MC 0;
BA_ "GenSigTimeoutTime_DMSM" SG_ 610 CADM_DALM_MC 0;
BA_ "GenSigTimeoutTime_DTCM" SG_ 610 CADM_DALM_MC 0;
BA_ "GenSigTimeoutTime_ECM" SG_ 610 CADM_DALM_MC 0;
BA_ "GenSigTimeoutTime_EVCU2" SG_ 610 CADM_DALM_MC 0;
BA_ "GenSigTimeoutTime_GNMM" SG_ 610 CADM_DALM_MC 0;
BA_ "GenSigTimeoutTime_HCP" SG_ 610 CADM_DALM_MC 0;
BA_ "GenSigTimeoutTime_IPC" SG_ 610 CADM_DALM_MC 0;
BA_ "GenSigTimeoutTime_RFHM" SG_ 610 CADM_DALM_MC 0;
BA_ "GenSigTimeoutTime_SGW" SG_ 610 CADM_DALM_MC 0;
BA_ "GenSigTimeoutTime_TCM" SG_ 610 CADM_DALM_MC 0;
BA_ "GenSigSendType" SG_ 610 DALM_Request 3;
BA_ "GenSigTimeoutTime_AGSM" SG_ 610 DALM_Request 0;
BA_ "GenSigTimeoutTime_BSM" SG_ 610 DALM_Request 0;
BA_ "GenSigTimeoutTime_CADM" SG_ 610 DALM_Request 0;
BA_ "GenSigTimeoutTime_DMSM" SG_ 610 DALM_Request 0;
BA_ "GenSigTimeoutTime_DTCM" SG_ 610 DALM_Request 0;
BA_ "GenSigTimeoutTime_ECM" SG_ 610 DALM_Request 0;
BA_ "GenSigTimeoutTime_EVCU2" SG_ 610 DALM_Request 0;
BA_ "GenSigTimeoutTime_GNMM" SG_ 610 DALM_Request 0;
BA_ "GenSigTimeoutTime_HCP" SG_ 610 DALM_Request 0;
BA_ "GenSigTimeoutTime_IPC" SG_ 610 DALM_Request 0;
BA_ "GenSigTimeoutTime_RFHM" SG_ 610 DALM_Request 0;
BA_ "GenSigTimeoutTime_SGW" SG_ 610 DALM_Request 0;
BA_ "GenSigTimeoutTime_TCM" SG_ 610 DALM_Request 0;
BA_ "GenSigSendType" SG_ 610 HAS_OpStat_Prim_DALM 3;
BA_ "GenSigTimeoutTime_AGSM" SG_ 610 HAS_OpStat_Prim_DALM 0;
BA_ "GenSigTimeoutTime_BSM" SG_ 610 HAS_OpStat_Prim_DALM 0;
BA_ "GenSigTimeoutTime_CADM" SG_ 610 HAS_OpStat_Prim_DALM 0;
BA_ "GenSigTimeoutTime_DMSM" SG_ 610 HAS_OpStat_Prim_DALM 0;
BA_ "GenSigTimeoutTime_DTCM" SG_ 610 HAS_OpStat_Prim_DALM 0;
BA_ "GenSigTimeoutTime_ECM" SG_ 610 HAS_OpStat_Prim_DALM 0;
BA_ "GenSigTimeoutTime_EVCU2" SG_ 610 HAS_OpStat_Prim_DALM 0;
BA_ "GenSigTimeoutTime_GNMM" SG_ 610 HAS_OpStat_Prim_DALM 0;
BA_ "GenSigTimeoutTime_HCP" SG_ 610 HAS_OpStat_Prim_DALM 0;
BA_ "GenSigTimeoutTime_IPC" SG_ 610 HAS_OpStat_Prim_DALM 0;
BA_ "GenSigTimeoutTime_RFHM" SG_ 610 HAS_OpStat_Prim_DALM 0;
BA_ "GenSigTimeoutTime_SGW" SG_ 610 HAS_OpStat_Prim_DALM 0;
BA_ "GenSigTimeoutTime_TCM" SG_ 610 HAS_OpStat_Prim_DALM 0;
BA_ "GenSigSendType" SG_ 610 HAS_Status_DALM 3;
BA_ "GenSigTimeoutTime_AGSM" SG_ 610 HAS_Status_DALM 0;
BA_ "GenSigTimeoutTime_BSM" SG_ 610 HAS_Status_DALM 0;
BA_ "GenSigTimeoutTime_CADM" SG_ 610 HAS_Status_DALM 0;
BA_ "GenSigTimeoutTime_DMSM" SG_ 610 HAS_Status_DALM 0;
BA_ "GenSigTimeoutTime_DTCM" SG_ 610 HAS_Status_DALM 0;
BA_ "GenSigTimeoutTime_ECM" SG_ 610 HAS_Status_DALM 0;
BA_ "GenSigTimeoutTime_EVCU2" SG_ 610 HAS_Status_DALM 0;
BA_ "GenSigTimeoutTime_GNMM" SG_ 610 HAS_Status_DALM 0;
BA_ "GenSigTimeoutTime_HCP" SG_ 610 HAS_Status_DALM 0;
BA_ "GenSigTimeoutTime_IPC" SG_ 610 HAS_Status_DALM 0;
BA_ "GenSigTimeoutTime_RFHM" SG_ 610 HAS_Status_DALM 0;
BA_ "GenSigTimeoutTime_SGW" SG_ 610 HAS_Status_DALM 0;
BA_ "GenSigTimeoutTime_TCM" SG_ 610 HAS_Status_DALM 0;
BA_ "GenSigSendType" SG_ 610 HAS_ValidRoad 3;
BA_ "GenSigTimeoutTime_AGSM" SG_ 610 HAS_ValidRoad 0;
BA_ "GenSigTimeoutTime_BCM" SG_ 610 HAS_ValidRoad 0;
BA_ "GenSigTimeoutTime_BSM" SG_ 610 HAS_ValidRoad 0;
BA_ "GenSigTimeoutTime_CADM" SG_ 610 HAS_ValidRoad 0;
BA_ "GenSigTimeoutTime_DMSM" SG_ 610 HAS_ValidRoad 0;
BA_ "GenSigTimeoutTime_DTCM" SG_ 610 HAS_ValidRoad 0;
BA_ "GenSigTimeoutTime_ECM" SG_ 610 HAS_ValidRoad 0;
BA_ "GenSigTimeoutTime_EVCU2" SG_ 610 HAS_ValidRoad 0;
BA_ "GenSigTimeoutTime_GNMM" SG_ 610 HAS_ValidRoad 0;
BA_ "GenSigTimeoutTime_HCP" SG_ 610 HAS_ValidRoad 0;
BA_ "GenSigTimeoutTime_IPC" SG_ 610 HAS_ValidRoad 0;
BA_ "GenSigTimeoutTime_RFHM" SG_ 610 HAS_ValidRoad 0;
BA_ "GenSigTimeoutTime_SGW" SG_ 610 HAS_ValidRoad 0;
BA_ "GenSigTimeoutTime_TCM" SG_ 610 HAS_ValidRoad 0;
BA_ "GenSigSendType" SG_ 610 SignOvertaking 3;
BA_ "GenSigTimeoutTime_AGSM" SG_ 610 SignOvertaking 0;
BA_ "GenSigTimeoutTime_BCM" SG_ 610 SignOvertaking 0;
BA_ "GenSigTimeoutTime_BSM" SG_ 610 SignOvertaking 0;
BA_ "GenSigTimeoutTime_CADM" SG_ 610 SignOvertaking 0;
BA_ "GenSigTimeoutTime_DMSM" SG_ 610 SignOvertaking 0;
BA_ "GenSigTimeoutTime_DTCM" SG_ 610 SignOvertaking 0;
BA_ "GenSigTimeoutTime_ECM" SG_ 610 SignOvertaking 0;
BA_ "GenSigTimeoutTime_EVCU2" SG_ 610 SignOvertaking 0;
BA_ "GenSigTimeoutTime_GNMM" SG_ 610 SignOvertaking 0;
BA_ "GenSigTimeoutTime_HCP" SG_ 610 SignOvertaking 0;
BA_ "GenSigTimeoutTime_RFHM" SG_ 610 SignOvertaking 0;
BA_ "GenSigTimeoutTime_SGW" SG_ 610 SignOvertaking 0;
BA_ "GenSigTimeoutTime_TCM" SG_ 610 SignOvertaking 0;
BA_ "GenSigSendType" SG_ 610 SignSupplemVehicleSpeedLimit 3;
BA_ "GenSigTimeoutTime_AGSM" SG_ 610 SignSupplemVehicleSpeedLimit 0;
BA_ "GenSigTimeoutTime_BCM" SG_ 610 SignSupplemVehicleSpeedLimit 0;
BA_ "GenSigTimeoutTime_BSM" SG_ 610 SignSupplemVehicleSpeedLimit 0;
BA_ "GenSigTimeoutTime_CADM" SG_ 610 SignSupplemVehicleSpeedLimit 0;
BA_ "GenSigTimeoutTime_DMSM" SG_ 610 SignSupplemVehicleSpeedLimit 0;
BA_ "GenSigTimeoutTime_DTCM" SG_ 610 SignSupplemVehicleSpeedLimit 0;
BA_ "GenSigTimeoutTime_ECM" SG_ 610 SignSupplemVehicleSpeedLimit 0;
BA_ "GenSigTimeoutTime_EVCU2" SG_ 610 SignSupplemVehicleSpeedLimit 0;
BA_ "GenSigTimeoutTime_GNMM" SG_ 610 SignSupplemVehicleSpeedLimit 0;
BA_ "GenSigTimeoutTime_HCP" SG_ 610 SignSupplemVehicleSpeedLimit 0;
BA_ "GenSigTimeoutTime_RFHM" SG_ 610 SignSupplemVehicleSpeedLimit 0;
BA_ "GenSigTimeoutTime_SGW" SG_ 610 SignSupplemVehicleSpeedLimit 0;
BA_ "GenSigTimeoutTime_TCM" SG_ 610 SignSupplemVehicleSpeedLimit 0;
BA_ "GenSigSendType" SG_ 610 SignVehicleSpeedLimit 3;
BA_ "GenSigTimeoutTime_AGSM" SG_ 610 SignVehicleSpeedLimit 0;
BA_ "GenSigTimeoutTime_BCM" SG_ 610 SignVehicleSpeedLimit 0;
BA_ "GenSigTimeoutTime_BSM" SG_ 610 SignVehicleSpeedLimit 0;
BA_ "GenSigTimeoutTime_CADM" SG_ 610 SignVehicleSpeedLimit 0;
BA_ "GenSigTimeoutTime_DMSM" SG_ 610 SignVehicleSpeedLimit 0;
BA_ "GenSigTimeoutTime_DTCM" SG_ 610 SignVehicleSpeedLimit 0;
BA_ "GenSigTimeoutTime_ECM" SG_ 610 SignVehicleSpeedLimit 0;
BA_ "GenSigTimeoutTime_EVCU2" SG_ 610 SignVehicleSpeedLimit 0;
BA_ "GenSigTimeoutTime_GNMM" SG_ 610 SignVehicleSpeedLimit 0;
BA_ "GenSigTimeoutTime_HCP" SG_ 610 SignVehicleSpeedLimit 0;
BA_ "GenSigTimeoutTime_RFHM" SG_ 610 SignVehicleSpeedLimit 0;
BA_ "GenSigTimeoutTime_SGW" SG_ 610 SignVehicleSpeedLimit 0;
BA_ "GenSigTimeoutTime_TCM" SG_ 610 SignVehicleSpeedLimit 0;
BA_ "GenSigSendType" SG_ 610 SignVehicleSpeedLimitConditional 3;
BA_ "GenSigTimeoutTime_AGSM" SG_ 610 SignVehicleSpeedLimitConditional 0;
BA_ "GenSigTimeoutTime_BCM" SG_ 610 SignVehicleSpeedLimitConditional 0;
BA_ "GenSigTimeoutTime_BSM" SG_ 610 SignVehicleSpeedLimitConditional 0;
BA_ "GenSigTimeoutTime_CADM" SG_ 610 SignVehicleSpeedLimitConditional 0;
BA_ "GenSigTimeoutTime_DMSM" SG_ 610 SignVehicleSpeedLimitConditional 0;
BA_ "GenSigTimeoutTime_DTCM" SG_ 610 SignVehicleSpeedLimitConditional 0;
BA_ "GenSigTimeoutTime_ECM" SG_ 610 SignVehicleSpeedLimitConditional 0;
BA_ "GenSigTimeoutTime_EVCU2" SG_ 610 SignVehicleSpeedLimitConditional 0;
BA_ "GenSigTimeoutTime_GNMM" SG_ 610 SignVehicleSpeedLimitConditional 0;
BA_ "GenSigTimeoutTime_HCP" SG_ 610 SignVehicleSpeedLimitConditional 0;
BA_ "GenSigTimeoutTime_RFHM" SG_ 610 SignVehicleSpeedLimitConditional 0;
BA_ "GenSigTimeoutTime_SGW" SG_ 610 SignVehicleSpeedLimitConditional 0;
BA_ "GenSigTimeoutTime_TCM" SG_ 610 SignVehicleSpeedLimitConditional 0;
BA_ "GenSigSendType" SG_ 610 SourceFusedSpeedLimit 3;
BA_ "GenSigTimeoutTime_AGSM" SG_ 610 SourceFusedSpeedLimit 0;
BA_ "GenSigTimeoutTime_BCM" SG_ 610 SourceFusedSpeedLimit 0;
BA_ "GenSigTimeoutTime_BSM" SG_ 610 SourceFusedSpeedLimit 0;
BA_ "GenSigTimeoutTime_CADM" SG_ 610 SourceFusedSpeedLimit 0;
BA_ "GenSigTimeoutTime_DMSM" SG_ 610 SourceFusedSpeedLimit 0;
BA_ "GenSigTimeoutTime_DTCM" SG_ 610 SourceFusedSpeedLimit 0;
BA_ "GenSigTimeoutTime_ECM" SG_ 610 SourceFusedSpeedLimit 0;
BA_ "GenSigTimeoutTime_EVCU2" SG_ 610 SourceFusedSpeedLimit 0;
BA_ "GenSigTimeoutTime_GNMM" SG_ 610 SourceFusedSpeedLimit 0;
BA_ "GenSigTimeoutTime_HCP" SG_ 610 SourceFusedSpeedLimit 0;
BA_ "GenSigTimeoutTime_RFHM" SG_ 610 SourceFusedSpeedLimit 0;
BA_ "GenSigTimeoutTime_SGW" SG_ 610 SourceFusedSpeedLimit 0;
BA_ "GenSigTimeoutTime_TCM" SG_ 610 SourceFusedSpeedLimit 0;
BA_ "GenSigSendType" SG_ 610 SpdUnits_Cam 3;
BA_ "GenSigTimeoutTime_AGSM" SG_ 610 SpdUnits_Cam 0;
BA_ "GenSigTimeoutTime_BCM" SG_ 610 SpdUnits_Cam 0;
BA_ "GenSigTimeoutTime_BSM" SG_ 610 SpdUnits_Cam 0;
BA_ "GenSigTimeoutTime_CADM" SG_ 610 SpdUnits_Cam 0;
BA_ "GenSigTimeoutTime_DMSM" SG_ 610 SpdUnits_Cam 0;
BA_ "GenSigTimeoutTime_DTCM" SG_ 610 SpdUnits_Cam 0;
BA_ "GenSigTimeoutTime_ECM" SG_ 610 SpdUnits_Cam 0;
BA_ "GenSigTimeoutTime_EVCU2" SG_ 610 SpdUnits_Cam 0;
BA_ "GenSigTimeoutTime_GNMM" SG_ 610 SpdUnits_Cam 0;
BA_ "GenSigTimeoutTime_HCP" SG_ 610 SpdUnits_Cam 0;
BA_ "GenSigTimeoutTime_RFHM" SG_ 610 SpdUnits_Cam 0;
BA_ "GenSigTimeoutTime_SGW" SG_ 610 SpdUnits_Cam 0;
BA_ "GenSigTimeoutTime_TCM" SG_ 610 SpdUnits_Cam 0;
BA_ "GenSigSendType" SG_ 610 Speed_Sign_Shape 3;
BA_ "GenSigTimeoutTime_AGSM" SG_ 610 Speed_Sign_Shape 0;
BA_ "GenSigTimeoutTime_BCM" SG_ 610 Speed_Sign_Shape 0;
BA_ "GenSigTimeoutTime_BSM" SG_ 610 Speed_Sign_Shape 0;
BA_ "GenSigTimeoutTime_CADM" SG_ 610 Speed_Sign_Shape 0;
BA_ "GenSigTimeoutTime_DMSM" SG_ 610 Speed_Sign_Shape 0;
BA_ "GenSigTimeoutTime_DTCM" SG_ 610 Speed_Sign_Shape 0;
BA_ "GenSigTimeoutTime_ECM" SG_ 610 Speed_Sign_Shape 0;
BA_ "GenSigTimeoutTime_EVCU2" SG_ 610 Speed_Sign_Shape 0;
BA_ "GenSigTimeoutTime_GNMM" SG_ 610 Speed_Sign_Shape 0;
BA_ "GenSigTimeoutTime_HCP" SG_ 610 Speed_Sign_Shape 0;
BA_ "GenSigTimeoutTime_RFHM" SG_ 610 Speed_Sign_Shape 0;
BA_ "GenSigTimeoutTime_TCM" SG_ 610 Speed_Sign_Shape 0;
BA_ "GenSigSendType" SG_ 610 TSRSts 3;
BA_ "GenSigTimeoutTime_AGSM" SG_ 610 TSRSts 0;
BA_ "GenSigTimeoutTime_BCM" SG_ 610 TSRSts 0;
BA_ "GenSigTimeoutTime_BSM" SG_ 610 TSRSts 0;
BA_ "GenSigTimeoutTime_CADM" SG_ 610 TSRSts 0;
BA_ "GenSigTimeoutTime_DMSM" SG_ 610 TSRSts 0;
BA_ "GenSigTimeoutTime_DTCM" SG_ 610 TSRSts 0;
BA_ "GenSigTimeoutTime_ECM" SG_ 610 TSRSts 0;
BA_ "GenSigTimeoutTime_GNMM" SG_ 610 TSRSts 0;
BA_ "GenSigTimeoutTime_HCP" SG_ 610 TSRSts 0;
BA_ "GenSigTimeoutTime_RFHM" SG_ 610 TSRSts 0;
BA_ "GenSigTimeoutTime_TCM" SG_ 610 TSRSts 0;
BA_ "GenSigSendType" SG_ 610 Turn_Lever_Unlatch_Req 4;
BA_ "GenSigTimeoutTime_AGSM" SG_ 610 Turn_Lever_Unlatch_Req 0;
BA_ "GenSigTimeoutTime_BSM" SG_ 610 Turn_Lever_Unlatch_Req 0;
BA_ "GenSigTimeoutTime_CADM" SG_ 610 Turn_Lever_Unlatch_Req 0;
BA_ "GenSigTimeoutTime_DMSM" SG_ 610 Turn_Lever_Unlatch_Req 0;
BA_ "GenSigTimeoutTime_DTCM" SG_ 610 Turn_Lever_Unlatch_Req 0;
BA_ "GenSigTimeoutTime_ECM" SG_ 610 Turn_Lever_Unlatch_Req 0;
BA_ "GenSigTimeoutTime_EVCU2" SG_ 610 Turn_Lever_Unlatch_Req 0;
BA_ "GenSigTimeoutTime_GNMM" SG_ 610 Turn_Lever_Unlatch_Req 0;
BA_ "GenSigTimeoutTime_HCP" SG_ 610 Turn_Lever_Unlatch_Req 0;
BA_ "GenSigTimeoutTime_IPC" SG_ 610 Turn_Lever_Unlatch_Req 0;
BA_ "GenSigTimeoutTime_RFHM" SG_ 610 Turn_Lever_Unlatch_Req 0;
BA_ "GenSigTimeoutTime_SGW" SG_ 610 Turn_Lever_Unlatch_Req 0;
BA_ "GenSigTimeoutTime_TCM" SG_ 610 Turn_Lever_Unlatch_Req 0;
BA_ "GenSigStartValue" SG_ 1316 OffRd_FL_Lvl 254;
BA_ "GenSigTimeoutTime_AGSM" SG_ 1316 OffRd_FL_Lvl 0;
BA_ "GenSigTimeoutTime_BCM" SG_ 1316 OffRd_FL_Lvl 0;
BA_ "GenSigTimeoutTime_BSM" SG_ 1316 OffRd_FL_Lvl 0;
BA_ "GenSigTimeoutTime_CADM" SG_ 1316 OffRd_FL_Lvl 0;
BA_ "GenSigTimeoutTime_DMSM" SG_ 1316 OffRd_FL_Lvl 0;
BA_ "GenSigTimeoutTime_DTCM" SG_ 1316 OffRd_FL_Lvl 0;
BA_ "GenSigTimeoutTime_ECM" SG_ 1316 OffRd_FL_Lvl 0;
BA_ "GenSigTimeoutTime_EVCU2" SG_ 1316 OffRd_FL_Lvl 0;
BA_ "GenSigTimeoutTime_GNMM" SG_ 1316 OffRd_FL_Lvl 0;
BA_ "GenSigTimeoutTime_HCP" SG_ 1316 OffRd_FL_Lvl 0;
BA_ "GenSigTimeoutTime_RFHM" SG_ 1316 OffRd_FL_Lvl 0;
BA_ "GenSigTimeoutTime_TCM" SG_ 1316 OffRd_FL_Lvl 0;
BA_ "GenSigStartValue" SG_ 1316 OffRd_FR_Lvl 254;
BA_ "GenSigTimeoutTime_AGSM" SG_ 1316 OffRd_FR_Lvl 0;
BA_ "GenSigTimeoutTime_BCM" SG_ 1316 OffRd_FR_Lvl 0;
BA_ "GenSigTimeoutTime_BSM" SG_ 1316 OffRd_FR_Lvl 0;
BA_ "GenSigTimeoutTime_CADM" SG_ 1316 OffRd_FR_Lvl 0;
BA_ "GenSigTimeoutTime_DMSM" SG_ 1316 OffRd_FR_Lvl 0;
BA_ "GenSigTimeoutTime_DTCM" SG_ 1316 OffRd_FR_Lvl 0;
BA_ "GenSigTimeoutTime_ECM" SG_ 1316 OffRd_FR_Lvl 0;
BA_ "GenSigTimeoutTime_EVCU2" SG_ 1316 OffRd_FR_Lvl 0;
BA_ "GenSigTimeoutTime_GNMM" SG_ 1316 OffRd_FR_Lvl 0;
BA_ "GenSigTimeoutTime_HCP" SG_ 1316 OffRd_FR_Lvl 0;
BA_ "GenSigTimeoutTime_RFHM" SG_ 1316 OffRd_FR_Lvl 0;
BA_ "GenSigTimeoutTime_TCM" SG_ 1316 OffRd_FR_Lvl 0;
BA_ "GenSigStartValue" SG_ 1316 OffRd_RL_Lvl 254;
BA_ "GenSigTimeoutTime_AGSM" SG_ 1316 OffRd_RL_Lvl 0;
BA_ "GenSigTimeoutTime_BCM" SG_ 1316 OffRd_RL_Lvl 0;
BA_ "GenSigTimeoutTime_BSM" SG_ 1316 OffRd_RL_Lvl 0;
BA_ "GenSigTimeoutTime_CADM" SG_ 1316 OffRd_RL_Lvl 0;
BA_ "GenSigTimeoutTime_DMSM" SG_ 1316 OffRd_RL_Lvl 0;
BA_ "GenSigTimeoutTime_DTCM" SG_ 1316 OffRd_RL_Lvl 0;
BA_ "GenSigTimeoutTime_ECM" SG_ 1316 OffRd_RL_Lvl 0;
BA_ "GenSigTimeoutTime_EVCU2" SG_ 1316 OffRd_RL_Lvl 0;
BA_ "GenSigTimeoutTime_GNMM" SG_ 1316 OffRd_RL_Lvl 0;
BA_ "GenSigTimeoutTime_HCP" SG_ 1316 OffRd_RL_Lvl 0;
BA_ "GenSigTimeoutTime_RFHM" SG_ 1316 OffRd_RL_Lvl 0;
BA_ "GenSigTimeoutTime_TCM" SG_ 1316 OffRd_RL_Lvl 0;
BA_ "GenSigStartValue" SG_ 1316 OffRd_RR_Lvl 254;
BA_ "GenSigTimeoutTime_AGSM" SG_ 1316 OffRd_RR_Lvl 0;
BA_ "GenSigTimeoutTime_BCM" SG_ 1316 OffRd_RR_Lvl 0;
BA_ "GenSigTimeoutTime_BSM" SG_ 1316 OffRd_RR_Lvl 0;
BA_ "GenSigTimeoutTime_CADM" SG_ 1316 OffRd_RR_Lvl 0;
BA_ "GenSigTimeoutTime_DMSM" SG_ 1316 OffRd_RR_Lvl 0;
BA_ "GenSigTimeoutTime_DTCM" SG_ 1316 OffRd_RR_Lvl 0;
BA_ "GenSigTimeoutTime_ECM" SG_ 1316 OffRd_RR_Lvl 0;
BA_ "GenSigTimeoutTime_EVCU2" SG_ 1316 OffRd_RR_Lvl 0;
BA_ "GenSigTimeoutTime_GNMM" SG_ 1316 OffRd_RR_Lvl 0;
BA_ "GenSigTimeoutTime_HCP" SG_ 1316 OffRd_RR_Lvl 0;
BA_ "GenSigTimeoutTime_RFHM" SG_ 1316 OffRd_RR_Lvl 0;
BA_ "GenSigTimeoutTime_TCM" SG_ 1316 OffRd_RR_Lvl 0;
BA_ "GenSigTimeoutTime_AGSM" SG_ 201 FL_Lvl_RawAD_Src 0;
BA_ "GenSigTimeoutTime_BCM" SG_ 201 FL_Lvl_RawAD_Src 0;
BA_ "GenSigTimeoutTime_BSM" SG_ 201 FL_Lvl_RawAD_Src 0;
BA_ "GenSigTimeoutTime_CADM" SG_ 201 FL_Lvl_RawAD_Src 0;
BA_ "GenSigTimeoutTime_DMSM" SG_ 201 FL_Lvl_RawAD_Src 0;
BA_ "GenSigTimeoutTime_DTCM" SG_ 201 FL_Lvl_RawAD_Src 0;
BA_ "GenSigTimeoutTime_EVCU2" SG_ 201 FL_Lvl_RawAD_Src 0;
BA_ "GenSigTimeoutTime_GNMM" SG_ 201 FL_Lvl_RawAD_Src 0;
BA_ "GenSigTimeoutTime_HCP" SG_ 201 FL_Lvl_RawAD_Src 0;
BA_ "GenSigTimeoutTime_IPC" SG_ 201 FL_Lvl_RawAD_Src 0;
BA_ "GenSigTimeoutTime_RFHM" SG_ 201 FL_Lvl_RawAD_Src 0;
BA_ "GenSigTimeoutTime_SGW" SG_ 201 FL_Lvl_RawAD_Src 0;
BA_ "GenSigTimeoutTime_TCM" SG_ 201 FL_Lvl_RawAD_Src 0;
BA_ "GenSigStartValue" SG_ 201 FL_Lvl_Stat_Src 3;
BA_ "GenSigTimeoutTime_AGSM" SG_ 201 FL_Lvl_Stat_Src 0;
BA_ "GenSigTimeoutTime_BCM" SG_ 201 FL_Lvl_Stat_Src 0;
BA_ "GenSigTimeoutTime_BSM" SG_ 201 FL_Lvl_Stat_Src 0;
BA_ "GenSigTimeoutTime_CADM" SG_ 201 FL_Lvl_Stat_Src 0;
BA_ "GenSigTimeoutTime_DMSM" SG_ 201 FL_Lvl_Stat_Src 0;
BA_ "GenSigTimeoutTime_DTCM" SG_ 201 FL_Lvl_Stat_Src 0;
BA_ "GenSigTimeoutTime_EVCU2" SG_ 201 FL_Lvl_Stat_Src 0;
BA_ "GenSigTimeoutTime_GNMM" SG_ 201 FL_Lvl_Stat_Src 0;
BA_ "GenSigTimeoutTime_HCP" SG_ 201 FL_Lvl_Stat_Src 0;
BA_ "GenSigTimeoutTime_IPC" SG_ 201 FL_Lvl_Stat_Src 0;
BA_ "GenSigTimeoutTime_RFHM" SG_ 201 FL_Lvl_Stat_Src 0;
BA_ "GenSigTimeoutTime_SGW" SG_ 201 FL_Lvl_Stat_Src 0;
BA_ "GenSigTimeoutTime_TCM" SG_ 201 FL_Lvl_Stat_Src 0;
BA_ "GenSigStartValue" SG_ 201 FL_Z_Accel_Stat_Src 6;
BA_ "GenSigTimeoutTime_AGSM" SG_ 201 FL_Z_Accel_Stat_Src 0;
BA_ "GenSigTimeoutTime_BCM" SG_ 201 FL_Z_Accel_Stat_Src 0;
BA_ "GenSigTimeoutTime_BSM" SG_ 201 FL_Z_Accel_Stat_Src 0;
BA_ "GenSigTimeoutTime_CADM" SG_ 201 FL_Z_Accel_Stat_Src 0;
BA_ "GenSigTimeoutTime_DMSM" SG_ 201 FL_Z_Accel_Stat_Src 0;
BA_ "GenSigTimeoutTime_DTCM" SG_ 201 FL_Z_Accel_Stat_Src 0;
BA_ "GenSigTimeoutTime_EVCU2" SG_ 201 FL_Z_Accel_Stat_Src 0;
BA_ "GenSigTimeoutTime_GNMM" SG_ 201 FL_Z_Accel_Stat_Src 0;
BA_ "GenSigTimeoutTime_HCP" SG_ 201 FL_Z_Accel_Stat_Src 0;
BA_ "GenSigTimeoutTime_IPC" SG_ 201 FL_Z_Accel_Stat_Src 0;
BA_ "GenSigTimeoutTime_RFHM" SG_ 201 FL_Z_Accel_Stat_Src 0;
BA_ "GenSigTimeoutTime_SGW" SG_ 201 FL_Z_Accel_Stat_Src 0;
BA_ "GenSigTimeoutTime_TCM" SG_ 201 FL_Z_Accel_Stat_Src 0;
BA_ "GenSigTimeoutTime_AGSM" SG_ 201 FR_Lvl_RawAD_Src 0;
BA_ "GenSigTimeoutTime_BCM" SG_ 201 FR_Lvl_RawAD_Src 0;
BA_ "GenSigTimeoutTime_BSM" SG_ 201 FR_Lvl_RawAD_Src 0;
BA_ "GenSigTimeoutTime_CADM" SG_ 201 FR_Lvl_RawAD_Src 0;
BA_ "GenSigTimeoutTime_DMSM" SG_ 201 FR_Lvl_RawAD_Src 0;
BA_ "GenSigTimeoutTime_DTCM" SG_ 201 FR_Lvl_RawAD_Src 0;
BA_ "GenSigTimeoutTime_EVCU2" SG_ 201 FR_Lvl_RawAD_Src 0;
BA_ "GenSigTimeoutTime_GNMM" SG_ 201 FR_Lvl_RawAD_Src 0;
BA_ "GenSigTimeoutTime_HCP" SG_ 201 FR_Lvl_RawAD_Src 0;
BA_ "GenSigTimeoutTime_IPC" SG_ 201 FR_Lvl_RawAD_Src 0;
BA_ "GenSigTimeoutTime_RFHM" SG_ 201 FR_Lvl_RawAD_Src 0;
BA_ "GenSigTimeoutTime_SGW" SG_ 201 FR_Lvl_RawAD_Src 0;
BA_ "GenSigTimeoutTime_TCM" SG_ 201 FR_Lvl_RawAD_Src 0;
BA_ "GenSigStartValue" SG_ 201 FR_Lvl_Stat_Src 3;
BA_ "GenSigTimeoutTime_AGSM" SG_ 201 FR_Lvl_Stat_Src 0;
BA_ "GenSigTimeoutTime_BCM" SG_ 201 FR_Lvl_Stat_Src 0;
BA_ "GenSigTimeoutTime_BSM" SG_ 201 FR_Lvl_Stat_Src 0;
BA_ "GenSigTimeoutTime_CADM" SG_ 201 FR_Lvl_Stat_Src 0;
BA_ "GenSigTimeoutTime_DMSM" SG_ 201 FR_Lvl_Stat_Src 0;
BA_ "GenSigTimeoutTime_DTCM" SG_ 201 FR_Lvl_Stat_Src 0;
BA_ "GenSigTimeoutTime_EVCU2" SG_ 201 FR_Lvl_Stat_Src 0;
BA_ "GenSigTimeoutTime_GNMM" SG_ 201 FR_Lvl_Stat_Src 0;
BA_ "GenSigTimeoutTime_HCP" SG_ 201 FR_Lvl_Stat_Src 0;
BA_ "GenSigTimeoutTime_IPC" SG_ 201 FR_Lvl_Stat_Src 0;
BA_ "GenSigTimeoutTime_RFHM" SG_ 201 FR_Lvl_Stat_Src 0;
BA_ "GenSigTimeoutTime_SGW" SG_ 201 FR_Lvl_Stat_Src 0;
BA_ "GenSigTimeoutTime_TCM" SG_ 201 FR_Lvl_Stat_Src 0;
BA_ "GenSigStartValue" SG_ 201 FR_Z_Accel_Stat_Src 6;
BA_ "GenSigTimeoutTime_AGSM" SG_ 201 FR_Z_Accel_Stat_Src 0;
BA_ "GenSigTimeoutTime_BCM" SG_ 201 FR_Z_Accel_Stat_Src 0;
BA_ "GenSigTimeoutTime_BSM" SG_ 201 FR_Z_Accel_Stat_Src 0;
BA_ "GenSigTimeoutTime_CADM" SG_ 201 FR_Z_Accel_Stat_Src 0;
BA_ "GenSigTimeoutTime_DMSM" SG_ 201 FR_Z_Accel_Stat_Src 0;
BA_ "GenSigTimeoutTime_DTCM" SG_ 201 FR_Z_Accel_Stat_Src 0;
BA_ "GenSigTimeoutTime_EVCU2" SG_ 201 FR_Z_Accel_Stat_Src 0;
BA_ "GenSigTimeoutTime_GNMM" SG_ 201 FR_Z_Accel_Stat_Src 0;
BA_ "GenSigTimeoutTime_HCP" SG_ 201 FR_Z_Accel_Stat_Src 0;
BA_ "GenSigTimeoutTime_IPC" SG_ 201 FR_Z_Accel_Stat_Src 0;
BA_ "GenSigTimeoutTime_RFHM" SG_ 201 FR_Z_Accel_Stat_Src 0;
BA_ "GenSigTimeoutTime_SGW" SG_ 201 FR_Z_Accel_Stat_Src 0;
BA_ "GenSigTimeoutTime_TCM" SG_ 201 FR_Z_Accel_Stat_Src 0;
BA_ "GenSigStartValue" SG_ 201 RC_Z_Accel_Stat_Src 6;
BA_ "GenSigTimeoutTime_AGSM" SG_ 201 RC_Z_Accel_Stat_Src 0;
BA_ "GenSigTimeoutTime_BCM" SG_ 201 RC_Z_Accel_Stat_Src 0;
BA_ "GenSigTimeoutTime_BSM" SG_ 201 RC_Z_Accel_Stat_Src 0;
BA_ "GenSigTimeoutTime_CADM" SG_ 201 RC_Z_Accel_Stat_Src 0;
BA_ "GenSigTimeoutTime_DMSM" SG_ 201 RC_Z_Accel_Stat_Src 0;
BA_ "GenSigTimeoutTime_DTCM" SG_ 201 RC_Z_Accel_Stat_Src 0;
BA_ "GenSigTimeoutTime_EVCU2" SG_ 201 RC_Z_Accel_Stat_Src 0;
BA_ "GenSigTimeoutTime_GNMM" SG_ 201 RC_Z_Accel_Stat_Src 0;
BA_ "GenSigTimeoutTime_HCP" SG_ 201 RC_Z_Accel_Stat_Src 0;
BA_ "GenSigTimeoutTime_IPC" SG_ 201 RC_Z_Accel_Stat_Src 0;
BA_ "GenSigTimeoutTime_RFHM" SG_ 201 RC_Z_Accel_Stat_Src 0;
BA_ "GenSigTimeoutTime_SGW" SG_ 201 RC_Z_Accel_Stat_Src 0;
BA_ "GenSigTimeoutTime_TCM" SG_ 201 RC_Z_Accel_Stat_Src 0;
BA_ "GenSigTimeoutTime_AGSM" SG_ 201 RL_Lvl_RawAD_Src 0;
BA_ "GenSigTimeoutTime_BCM" SG_ 201 RL_Lvl_RawAD_Src 0;
BA_ "GenSigTimeoutTime_BSM" SG_ 201 RL_Lvl_RawAD_Src 0;
BA_ "GenSigTimeoutTime_CADM" SG_ 201 RL_Lvl_RawAD_Src 0;
BA_ "GenSigTimeoutTime_DMSM" SG_ 201 RL_Lvl_RawAD_Src 0;
BA_ "GenSigTimeoutTime_DTCM" SG_ 201 RL_Lvl_RawAD_Src 0;
BA_ "GenSigTimeoutTime_EVCU2" SG_ 201 RL_Lvl_RawAD_Src 0;
BA_ "GenSigTimeoutTime_GNMM" SG_ 201 RL_Lvl_RawAD_Src 0;
BA_ "GenSigTimeoutTime_HCP" SG_ 201 RL_Lvl_RawAD_Src 0;
BA_ "GenSigTimeoutTime_IPC" SG_ 201 RL_Lvl_RawAD_Src 0;
BA_ "GenSigTimeoutTime_RFHM" SG_ 201 RL_Lvl_RawAD_Src 0;
BA_ "GenSigTimeoutTime_SGW" SG_ 201 RL_Lvl_RawAD_Src 0;
BA_ "GenSigTimeoutTime_TCM" SG_ 201 RL_Lvl_RawAD_Src 0;
BA_ "GenSigStartValue" SG_ 201 RL_Lvl_Stat_Src 3;
BA_ "GenSigTimeoutTime_AGSM" SG_ 201 RL_Lvl_Stat_Src 0;
BA_ "GenSigTimeoutTime_BCM" SG_ 201 RL_Lvl_Stat_Src 0;
BA_ "GenSigTimeoutTime_BSM" SG_ 201 RL_Lvl_Stat_Src 0;
BA_ "GenSigTimeoutTime_CADM" SG_ 201 RL_Lvl_Stat_Src 0;
BA_ "GenSigTimeoutTime_DMSM" SG_ 201 RL_Lvl_Stat_Src 0;
BA_ "GenSigTimeoutTime_DTCM" SG_ 201 RL_Lvl_Stat_Src 0;
BA_ "GenSigTimeoutTime_EVCU2" SG_ 201 RL_Lvl_Stat_Src 0;
BA_ "GenSigTimeoutTime_GNMM" SG_ 201 RL_Lvl_Stat_Src 0;
BA_ "GenSigTimeoutTime_HCP" SG_ 201 RL_Lvl_Stat_Src 0;
BA_ "GenSigTimeoutTime_IPC" SG_ 201 RL_Lvl_Stat_Src 0;
BA_ "GenSigTimeoutTime_RFHM" SG_ 201 RL_Lvl_Stat_Src 0;
BA_ "GenSigTimeoutTime_SGW" SG_ 201 RL_Lvl_Stat_Src 0;
BA_ "GenSigTimeoutTime_TCM" SG_ 201 RL_Lvl_Stat_Src 0;
BA_ "GenSigTimeoutTime_AGSM" SG_ 201 RR_Lvl_RawAD_Src 0;
BA_ "GenSigTimeoutTime_BCM" SG_ 201 RR_Lvl_RawAD_Src 0;
BA_ "GenSigTimeoutTime_BSM" SG_ 201 RR_Lvl_RawAD_Src 0;
BA_ "GenSigTimeoutTime_CADM" SG_ 201 RR_Lvl_RawAD_Src 0;
BA_ "GenSigTimeoutTime_DMSM" SG_ 201 RR_Lvl_RawAD_Src 0;
BA_ "GenSigTimeoutTime_DTCM" SG_ 201 RR_Lvl_RawAD_Src 0;
BA_ "GenSigTimeoutTime_EVCU2" SG_ 201 RR_Lvl_RawAD_Src 0;
BA_ "GenSigTimeoutTime_GNMM" SG_ 201 RR_Lvl_RawAD_Src 0;
BA_ "GenSigTimeoutTime_HCP" SG_ 201 RR_Lvl_RawAD_Src 0;
BA_ "GenSigTimeoutTime_IPC" SG_ 201 RR_Lvl_RawAD_Src 0;
BA_ "GenSigTimeoutTime_RFHM" SG_ 201 RR_Lvl_RawAD_Src 0;
BA_ "GenSigTimeoutTime_SGW" SG_ 201 RR_Lvl_RawAD_Src 0;
BA_ "GenSigTimeoutTime_TCM" SG_ 201 RR_Lvl_RawAD_Src 0;
BA_ "GenSigStartValue" SG_ 201 RR_Lvl_Stat_Src 3;
BA_ "GenSigTimeoutTime_AGSM" SG_ 201 RR_Lvl_Stat_Src 0;
BA_ "GenSigTimeoutTime_BCM" SG_ 201 RR_Lvl_Stat_Src 0;
BA_ "GenSigTimeoutTime_BSM" SG_ 201 RR_Lvl_Stat_Src 0;
BA_ "GenSigTimeoutTime_CADM" SG_ 201 RR_Lvl_Stat_Src 0;
BA_ "GenSigTimeoutTime_DMSM" SG_ 201 RR_Lvl_Stat_Src 0;
BA_ "GenSigTimeoutTime_DTCM" SG_ 201 RR_Lvl_Stat_Src 0;
BA_ "GenSigTimeoutTime_EVCU2" SG_ 201 RR_Lvl_Stat_Src 0;
BA_ "GenSigTimeoutTime_GNMM" SG_ 201 RR_Lvl_Stat_Src 0;
BA_ "GenSigTimeoutTime_HCP" SG_ 201 RR_Lvl_Stat_Src 0;
BA_ "GenSigTimeoutTime_IPC" SG_ 201 RR_Lvl_Stat_Src 0;
BA_ "GenSigTimeoutTime_RFHM" SG_ 201 RR_Lvl_Stat_Src 0;
BA_ "GenSigTimeoutTime_SGW" SG_ 201 RR_Lvl_Stat_Src 0;
BA_ "GenSigTimeoutTime_TCM" SG_ 201 RR_Lvl_Stat_Src 0;
BA_ "GenSigStartValue" SG_ 201 Z_Acceleration_FL_Src 512;
BA_ "GenSigTimeoutTime_AGSM" SG_ 201 Z_Acceleration_FL_Src 0;
BA_ "GenSigTimeoutTime_BCM" SG_ 201 Z_Acceleration_FL_Src 0;
BA_ "GenSigTimeoutTime_BSM" SG_ 201 Z_Acceleration_FL_Src 0;
BA_ "GenSigTimeoutTime_CADM" SG_ 201 Z_Acceleration_FL_Src 0;
BA_ "GenSigTimeoutTime_DMSM" SG_ 201 Z_Acceleration_FL_Src 0;
BA_ "GenSigTimeoutTime_DTCM" SG_ 201 Z_Acceleration_FL_Src 0;
BA_ "GenSigTimeoutTime_EVCU2" SG_ 201 Z_Acceleration_FL_Src 0;
BA_ "GenSigTimeoutTime_GNMM" SG_ 201 Z_Acceleration_FL_Src 0;
BA_ "GenSigTimeoutTime_HCP" SG_ 201 Z_Acceleration_FL_Src 0;
BA_ "GenSigTimeoutTime_IPC" SG_ 201 Z_Acceleration_FL_Src 0;
BA_ "GenSigTimeoutTime_RFHM" SG_ 201 Z_Acceleration_FL_Src 0;
BA_ "GenSigTimeoutTime_SGW" SG_ 201 Z_Acceleration_FL_Src 0;
BA_ "GenSigTimeoutTime_TCM" SG_ 201 Z_Acceleration_FL_Src 0;
BA_ "GenSigStartValue" SG_ 201 Z_Acceleration_FR_Src 512;
BA_ "GenSigTimeoutTime_AGSM" SG_ 201 Z_Acceleration_FR_Src 0;
BA_ "GenSigTimeoutTime_BCM" SG_ 201 Z_Acceleration_FR_Src 0;
BA_ "GenSigTimeoutTime_BSM" SG_ 201 Z_Acceleration_FR_Src 0;
BA_ "GenSigTimeoutTime_CADM" SG_ 201 Z_Acceleration_FR_Src 0;
BA_ "GenSigTimeoutTime_DMSM" SG_ 201 Z_Acceleration_FR_Src 0;
BA_ "GenSigTimeoutTime_DTCM" SG_ 201 Z_Acceleration_FR_Src 0;
BA_ "GenSigTimeoutTime_EVCU2" SG_ 201 Z_Acceleration_FR_Src 0;
BA_ "GenSigTimeoutTime_GNMM" SG_ 201 Z_Acceleration_FR_Src 0;
BA_ "GenSigTimeoutTime_HCP" SG_ 201 Z_Acceleration_FR_Src 0;
BA_ "GenSigTimeoutTime_IPC" SG_ 201 Z_Acceleration_FR_Src 0;
BA_ "GenSigTimeoutTime_RFHM" SG_ 201 Z_Acceleration_FR_Src 0;
BA_ "GenSigTimeoutTime_SGW" SG_ 201 Z_Acceleration_FR_Src 0;
BA_ "GenSigTimeoutTime_TCM" SG_ 201 Z_Acceleration_FR_Src 0;
BA_ "GenSigStartValue" SG_ 201 Z_Acceleration_RC_Src 512;
BA_ "GenSigTimeoutTime_AGSM" SG_ 201 Z_Acceleration_RC_Src 0;
BA_ "GenSigTimeoutTime_BCM" SG_ 201 Z_Acceleration_RC_Src 0;
BA_ "GenSigTimeoutTime_BSM" SG_ 201 Z_Acceleration_RC_Src 0;
BA_ "GenSigTimeoutTime_CADM" SG_ 201 Z_Acceleration_RC_Src 0;
BA_ "GenSigTimeoutTime_DMSM" SG_ 201 Z_Acceleration_RC_Src 0;
BA_ "GenSigTimeoutTime_DTCM" SG_ 201 Z_Acceleration_RC_Src 0;
BA_ "GenSigTimeoutTime_EVCU2" SG_ 201 Z_Acceleration_RC_Src 0;
BA_ "GenSigTimeoutTime_GNMM" SG_ 201 Z_Acceleration_RC_Src 0;
BA_ "GenSigTimeoutTime_HCP" SG_ 201 Z_Acceleration_RC_Src 0;
BA_ "GenSigTimeoutTime_IPC" SG_ 201 Z_Acceleration_RC_Src 0;
BA_ "GenSigTimeoutTime_RFHM" SG_ 201 Z_Acceleration_RC_Src 0;
BA_ "GenSigTimeoutTime_SGW" SG_ 201 Z_Acceleration_RC_Src 0;
BA_ "GenSigTimeoutTime_TCM" SG_ 201 Z_Acceleration_RC_Src 0;
BA_ "GenSigTimeoutTime_AGSM" SG_ 476 APCM_Stat 0;
BA_ "GenSigTimeoutTime_BCM" SG_ 476 APCM_Stat 0;
BA_ "GenSigTimeoutTime_BSM" SG_ 476 APCM_Stat 0;
BA_ "GenSigTimeoutTime_CADM" SG_ 476 APCM_Stat 0;
BA_ "GenSigTimeoutTime_DMSM" SG_ 476 APCM_Stat 0;
BA_ "GenSigTimeoutTime_DTCM" SG_ 476 APCM_Stat 0;
BA_ "GenSigTimeoutTime_ECM" SG_ 476 APCM_Stat 0;
BA_ "GenSigTimeoutTime_GNMM" SG_ 476 APCM_Stat 0;
BA_ "GenSigTimeoutTime_HCP" SG_ 476 APCM_Stat 0;
BA_ "GenSigTimeoutTime_IPC" SG_ 476 APCM_Stat 0;
BA_ "GenSigTimeoutTime_RFHM" SG_ 476 APCM_Stat 0;
BA_ "GenSigTimeoutTime_SGW" SG_ 476 APCM_Stat 0;
BA_ "GenSigTimeoutTime_AGSM" SG_ 476 CRC_AGSM2 0;
BA_ "GenSigTimeoutTime_BCM" SG_ 476 CRC_AGSM2 0;
BA_ "GenSigTimeoutTime_BSM" SG_ 476 CRC_AGSM2 0;
BA_ "GenSigTimeoutTime_CADM" SG_ 476 CRC_AGSM2 0;
BA_ "GenSigTimeoutTime_DMSM" SG_ 476 CRC_AGSM2 0;
BA_ "GenSigTimeoutTime_DTCM" SG_ 476 CRC_AGSM2 0;
BA_ "GenSigTimeoutTime_EVCU2" SG_ 476 CRC_AGSM2 0;
BA_ "GenSigTimeoutTime_GNMM" SG_ 476 CRC_AGSM2 0;
BA_ "GenSigTimeoutTime_HCP" SG_ 476 CRC_AGSM2 0;
BA_ "GenSigTimeoutTime_RFHM" SG_ 476 CRC_AGSM2 0;
BA_ "GenSigTimeoutTime_AGSM" SG_ 476 MessageCounter_AGSM2 0;
BA_ "GenSigTimeoutTime_BCM" SG_ 476 MessageCounter_AGSM2 0;
BA_ "GenSigTimeoutTime_BSM" SG_ 476 MessageCounter_AGSM2 0;
BA_ "GenSigTimeoutTime_CADM" SG_ 476 MessageCounter_AGSM2 0;
BA_ "GenSigTimeoutTime_DMSM" SG_ 476 MessageCounter_AGSM2 0;
BA_ "GenSigTimeoutTime_DTCM" SG_ 476 MessageCounter_AGSM2 0;
BA_ "GenSigTimeoutTime_EVCU2" SG_ 476 MessageCounter_AGSM2 0;
BA_ "GenSigTimeoutTime_GNMM" SG_ 476 MessageCounter_AGSM2 0;
BA_ "GenSigTimeoutTime_HCP" SG_ 476 MessageCounter_AGSM2 0;
BA_ "GenSigTimeoutTime_RFHM" SG_ 476 MessageCounter_AGSM2 0;
BA_ "GenSigTimeoutTime_AGSM" SG_ 476 PRNDdisplayFailSts 0;
BA_ "GenSigTimeoutTime_BCM" SG_ 476 PRNDdisplayFailSts 0;
BA_ "GenSigTimeoutTime_BSM" SG_ 476 PRNDdisplayFailSts 0;
BA_ "GenSigTimeoutTime_CADM" SG_ 476 PRNDdisplayFailSts 0;
BA_ "GenSigTimeoutTime_DMSM" SG_ 476 PRNDdisplayFailSts 0;
BA_ "GenSigTimeoutTime_DTCM" SG_ 476 PRNDdisplayFailSts 0;
BA_ "GenSigTimeoutTime_ECM" SG_ 476 PRNDdisplayFailSts 0;
BA_ "GenSigTimeoutTime_GNMM" SG_ 476 PRNDdisplayFailSts 0;
BA_ "GenSigTimeoutTime_HCP" SG_ 476 PRNDdisplayFailSts 0;
BA_ "GenSigTimeoutTime_IPC" SG_ 476 PRNDdisplayFailSts 0;
BA_ "GenSigTimeoutTime_RFHM" SG_ 476 PRNDdisplayFailSts 0;
BA_ "GenSigTimeoutTime_SGW" SG_ 476 PRNDdisplayFailSts 0;
BA_ "GenSigTimeoutTime_AGSM" SG_ 476 PRNDFailSts 0;
BA_ "GenSigTimeoutTime_BCM" SG_ 476 PRNDFailSts 0;
BA_ "GenSigTimeoutTime_BSM" SG_ 476 PRNDFailSts 0;
BA_ "GenSigTimeoutTime_CADM" SG_ 476 PRNDFailSts 0;
BA_ "GenSigTimeoutTime_DMSM" SG_ 476 PRNDFailSts 0;
BA_ "GenSigTimeoutTime_DTCM" SG_ 476 PRNDFailSts 0;
BA_ "GenSigTimeoutTime_ECM" SG_ 476 PRNDFailSts 0;
BA_ "GenSigTimeoutTime_GNMM" SG_ 476 PRNDFailSts 0;
BA_ "GenSigTimeoutTime_HCP" SG_ 476 PRNDFailSts 0;
BA_ "GenSigTimeoutTime_RFHM" SG_ 476 PRNDFailSts 0;
BA_ "GenSigTimeoutTime_AGSM" SG_ 476 Shifter_ADAS_Inhibit 0;
BA_ "GenSigTimeoutTime_CADM" SG_ 476 Shifter_ADAS_Inhibit 0;
BA_ "GenSigTimeoutTime_DMSM" SG_ 476 Shifter_ADAS_Inhibit 0;
BA_ "GenSigTimeoutTime_DTCM" SG_ 476 Shifter_ADAS_Inhibit 0;
BA_ "GenSigTimeoutTime_ECM" SG_ 476 Shifter_ADAS_Inhibit 0;
BA_ "GenSigTimeoutTime_EVCU2" SG_ 476 Shifter_ADAS_Inhibit 0;
BA_ "GenSigTimeoutTime_GNMM" SG_ 476 Shifter_ADAS_Inhibit 0;
BA_ "GenSigTimeoutTime_HCP" SG_ 476 Shifter_ADAS_Inhibit 0;
BA_ "GenSigTimeoutTime_IPC" SG_ 476 Shifter_ADAS_Inhibit 0;
BA_ "GenSigTimeoutTime_RFHM" SG_ 476 Shifter_ADAS_Inhibit 0;
BA_ "GenSigTimeoutTime_SGW" SG_ 476 Shifter_ADAS_Inhibit 0;
BA_ "GenSigTimeoutTime_TCM" SG_ 476 Shifter_ADAS_Inhibit 0;
BA_ "GenSigTimeoutTime_AGSM" SG_ 476 ShiftLever_PositionFlt 0;
BA_ "GenSigTimeoutTime_BCM" SG_ 476 ShiftLever_PositionFlt 0;
BA_ "GenSigTimeoutTime_BSM" SG_ 476 ShiftLever_PositionFlt 0;
BA_ "GenSigTimeoutTime_CADM" SG_ 476 ShiftLever_PositionFlt 0;
BA_ "GenSigTimeoutTime_DMSM" SG_ 476 ShiftLever_PositionFlt 0;
BA_ "GenSigTimeoutTime_DTCM" SG_ 476 ShiftLever_PositionFlt 0;
BA_ "GenSigTimeoutTime_ECM" SG_ 476 ShiftLever_PositionFlt 0;
BA_ "GenSigTimeoutTime_EVCU2" SG_ 476 ShiftLever_PositionFlt 0;
BA_ "GenSigTimeoutTime_GNMM" SG_ 476 ShiftLever_PositionFlt 0;
BA_ "GenSigTimeoutTime_HCP" SG_ 476 ShiftLever_PositionFlt 0;
BA_ "GenSigTimeoutTime_IPC" SG_ 476 ShiftLever_PositionFlt 0;
BA_ "GenSigTimeoutTime_RFHM" SG_ 476 ShiftLever_PositionFlt 0;
BA_ "GenSigTimeoutTime_SGW" SG_ 476 ShiftLever_PositionFlt 0;
BA_ "GenSigSendType" SG_ 476 ShiftLeverPositionReq 3;
BA_ "GenSigTimeoutTime_AGSM" SG_ 476 ShiftLeverPositionReq 0;
BA_ "GenSigTimeoutTime_CADM" SG_ 476 ShiftLeverPositionReq 0;
BA_ "GenSigTimeoutTime_DMSM" SG_ 476 ShiftLeverPositionReq 0;
BA_ "GenSigTimeoutTime_DTCM" SG_ 476 ShiftLeverPositionReq 0;
BA_ "GenSigTimeoutTime_GNMM" SG_ 476 ShiftLeverPositionReq 0;
BA_ "GenSigTimeoutTime_HCP" SG_ 476 ShiftLeverPositionReq 0;
BA_ "GenSigTimeoutTime_AGSM" SG_ 476 ShiftLockFailSts 0;
BA_ "GenSigTimeoutTime_BCM" SG_ 476 ShiftLockFailSts 0;
BA_ "GenSigTimeoutTime_BSM" SG_ 476 ShiftLockFailSts 0;
BA_ "GenSigTimeoutTime_CADM" SG_ 476 ShiftLockFailSts 0;
BA_ "GenSigTimeoutTime_DMSM" SG_ 476 ShiftLockFailSts 0;
BA_ "GenSigTimeoutTime_DTCM" SG_ 476 ShiftLockFailSts 0;
BA_ "GenSigTimeoutTime_ECM" SG_ 476 ShiftLockFailSts 0;
BA_ "GenSigTimeoutTime_EVCU2" SG_ 476 ShiftLockFailSts 0;
BA_ "GenSigTimeoutTime_GNMM" SG_ 476 ShiftLockFailSts 0;
BA_ "GenSigTimeoutTime_HCP" SG_ 476 ShiftLockFailSts 0;
BA_ "GenSigTimeoutTime_IPC" SG_ 476 ShiftLockFailSts 0;
BA_ "GenSigTimeoutTime_RFHM" SG_ 476 ShiftLockFailSts 0;
BA_ "GenSigTimeoutTime_SGW" SG_ 476 ShiftLockFailSts 0;
BA_ "GenSigSendType" SG_ 476 WarningMessages 3;
BA_ "GenSigTimeoutTime_AGSM" SG_ 476 WarningMessages 0;
BA_ "GenSigTimeoutTime_BCM" SG_ 476 WarningMessages 0;
BA_ "GenSigTimeoutTime_BSM" SG_ 476 WarningMessages 0;
BA_ "GenSigTimeoutTime_CADM" SG_ 476 WarningMessages 0;
BA_ "GenSigTimeoutTime_DMSM" SG_ 476 WarningMessages 0;
BA_ "GenSigTimeoutTime_DTCM" SG_ 476 WarningMessages 0;
BA_ "GenSigTimeoutTime_ECM" SG_ 476 WarningMessages 0;
BA_ "GenSigTimeoutTime_EVCU2" SG_ 476 WarningMessages 0;
BA_ "GenSigTimeoutTime_GNMM" SG_ 476 WarningMessages 0;
BA_ "GenSigTimeoutTime_HCP" SG_ 476 WarningMessages 0;
BA_ "GenSigTimeoutTime_RFHM" SG_ 476 WarningMessages 0;
BA_ "GenSigTimeoutTime_SGW" SG_ 476 WarningMessages 0;
BA_ "GenSigTimeoutTime_TCM" SG_ 476 WarningMessages 0;
BA_ "GenSigTimeoutTime_AGSM" SG_ 2654552065 APPL_ECM1 0;
BA_ "GenSigTimeoutTime_BCM" SG_ 2654552065 APPL_ECM1 0;
BA_ "GenSigTimeoutTime_BSM" SG_ 2654552065 APPL_ECM1 0;
BA_ "GenSigTimeoutTime_CADM" SG_ 2654552065 APPL_ECM1 0;
BA_ "GenSigTimeoutTime_DMSM" SG_ 2654552065 APPL_ECM1 0;
BA_ "GenSigTimeoutTime_DTCM" SG_ 2654552065 APPL_ECM1 0;
BA_ "GenSigTimeoutTime_EVCU2" SG_ 2654552065 APPL_ECM1 0;
BA_ "GenSigTimeoutTime_GNMM" SG_ 2654552065 APPL_ECM1 0;
BA_ "GenSigTimeoutTime_HCP" SG_ 2654552065 APPL_ECM1 0;
BA_ "GenSigTimeoutTime_IPC" SG_ 2654552065 APPL_ECM1 0;
BA_ "GenSigTimeoutTime_RFHM" SG_ 2654552065 APPL_ECM1 0;
BA_ "GenSigTimeoutTime_SGW" SG_ 2654552065 APPL_ECM1 0;
BA_ "GenSigTimeoutTime_TCM" SG_ 2654552065 APPL_ECM1 0;
BA_ "GenSigTimeoutTime_BCM" SG_ 2654555935 APPL_ECU_FD_AGSM 0;
BA_ "GenSigTimeoutTime_BSM" SG_ 2654555935 APPL_ECU_FD_AGSM 0;
BA_ "GenSigTimeoutTime_CADM" SG_ 2654555935 APPL_ECU_FD_AGSM 0;
BA_ "GenSigTimeoutTime_DMSM" SG_ 2654555935 APPL_ECU_FD_AGSM 0;
BA_ "GenSigTimeoutTime_DTCM" SG_ 2654555935 APPL_ECU_FD_AGSM 0;
BA_ "GenSigTimeoutTime_ECM" SG_ 2654555935 APPL_ECU_FD_AGSM 0;
BA_ "GenSigTimeoutTime_EVCU2" SG_ 2654555935 APPL_ECU_FD_AGSM 0;
BA_ "GenSigTimeoutTime_GNMM" SG_ 2654555935 APPL_ECU_FD_AGSM 0;
BA_ "GenSigTimeoutTime_HCP" SG_ 2654555935 APPL_ECU_FD_AGSM 0;
BA_ "GenSigTimeoutTime_IPC" SG_ 2654555935 APPL_ECU_FD_AGSM 0;
BA_ "GenSigTimeoutTime_RFHM" SG_ 2654555935 APPL_ECU_FD_AGSM 0;
BA_ "GenSigTimeoutTime_SGW" SG_ 2654555935 APPL_ECU_FD_AGSM 0;
BA_ "GenSigTimeoutTime_TCM" SG_ 2654555935 APPL_ECU_FD_AGSM 0;
BA_ "GenSigTimeoutTime_AGSM" SG_ 2654555930 APPL_ECU_FD_DTCM 0;
BA_ "GenSigTimeoutTime_BCM" SG_ 2654555930 APPL_ECU_FD_DTCM 0;
BA_ "GenSigTimeoutTime_BSM" SG_ 2654555930 APPL_ECU_FD_DTCM 0;
BA_ "GenSigTimeoutTime_CADM" SG_ 2654555930 APPL_ECU_FD_DTCM 0;
BA_ "GenSigTimeoutTime_DMSM" SG_ 2654555930 APPL_ECU_FD_DTCM 0;
BA_ "GenSigTimeoutTime_ECM" SG_ 2654555930 APPL_ECU_FD_DTCM 0;
BA_ "GenSigTimeoutTime_EVCU2" SG_ 2654555930 APPL_ECU_FD_DTCM 0;
BA_ "GenSigTimeoutTime_GNMM" SG_ 2654555930 APPL_ECU_FD_DTCM 0;
BA_ "GenSigTimeoutTime_HCP" SG_ 2654555930 APPL_ECU_FD_DTCM 0;
BA_ "GenSigTimeoutTime_IPC" SG_ 2654555930 APPL_ECU_FD_DTCM 0;
BA_ "GenSigTimeoutTime_RFHM" SG_ 2654555930 APPL_ECU_FD_DTCM 0;
BA_ "GenSigTimeoutTime_SGW" SG_ 2654555930 APPL_ECU_FD_DTCM 0;
BA_ "GenSigTimeoutTime_TCM" SG_ 2654555930 APPL_ECU_FD_DTCM 0;
BA_ "GenSigTimeoutTime_AGSM" SG_ 2654555920 APPL_ECU_FD_ECM 0;
BA_ "GenSigTimeoutTime_BCM" SG_ 2654555920 APPL_ECU_FD_ECM 0;
BA_ "GenSigTimeoutTime_BSM" SG_ 2654555920 APPL_ECU_FD_ECM 0;
BA_ "GenSigTimeoutTime_CADM" SG_ 2654555920 APPL_ECU_FD_ECM 0;
BA_ "GenSigTimeoutTime_DMSM" SG_ 2654555920 APPL_ECU_FD_ECM 0;
BA_ "GenSigTimeoutTime_DTCM" SG_ 2654555920 APPL_ECU_FD_ECM 0;
BA_ "GenSigTimeoutTime_EVCU2" SG_ 2654555920 APPL_ECU_FD_ECM 0;
BA_ "GenSigTimeoutTime_GNMM" SG_ 2654555920 APPL_ECU_FD_ECM 0;
BA_ "GenSigTimeoutTime_HCP" SG_ 2654555920 APPL_ECU_FD_ECM 0;
BA_ "GenSigTimeoutTime_IPC" SG_ 2654555920 APPL_ECU_FD_ECM 0;
BA_ "GenSigTimeoutTime_RFHM" SG_ 2654555920 APPL_ECU_FD_ECM 0;
BA_ "GenSigTimeoutTime_SGW" SG_ 2654555920 APPL_ECU_FD_ECM 0;
BA_ "GenSigTimeoutTime_TCM" SG_ 2654555920 APPL_ECU_FD_ECM 0;
BA_ "GenSigTimeoutTime_AGSM" SG_ 2654555928 APPL_ECU_FD_TCM 0;
BA_ "GenSigTimeoutTime_BCM" SG_ 2654555928 APPL_ECU_FD_TCM 0;
BA_ "GenSigTimeoutTime_BSM" SG_ 2654555928 APPL_ECU_FD_TCM 0;
BA_ "GenSigTimeoutTime_CADM" SG_ 2654555928 APPL_ECU_FD_TCM 0;
BA_ "GenSigTimeoutTime_DMSM" SG_ 2654555928 APPL_ECU_FD_TCM 0;
BA_ "GenSigTimeoutTime_DTCM" SG_ 2654555928 APPL_ECU_FD_TCM 0;
BA_ "GenSigTimeoutTime_ECM" SG_ 2654555928 APPL_ECU_FD_TCM 0;
BA_ "GenSigTimeoutTime_EVCU2" SG_ 2654555928 APPL_ECU_FD_TCM 0;
BA_ "GenSigTimeoutTime_GNMM" SG_ 2654555928 APPL_ECU_FD_TCM 0;
BA_ "GenSigTimeoutTime_HCP" SG_ 2654555928 APPL_ECU_FD_TCM 0;
BA_ "GenSigTimeoutTime_IPC" SG_ 2654555928 APPL_ECU_FD_TCM 0;
BA_ "GenSigTimeoutTime_RFHM" SG_ 2654555928 APPL_ECU_FD_TCM 0;
BA_ "GenSigTimeoutTime_SGW" SG_ 2654555928 APPL_ECU_FD_TCM 0;
BA_ "GenSigTimeoutTime_TCM" SG_ 2654555928 APPL_ECU_FD_TCM 0;
BA_ "GenSigTimeoutTime_AGSM" SG_ 2654552075 AZG_to_TCM 0;
BA_ "GenSigTimeoutTime_BCM" SG_ 2654552075 AZG_to_TCM 0;
BA_ "GenSigTimeoutTime_BSM" SG_ 2654552075 AZG_to_TCM 0;
BA_ "GenSigTimeoutTime_CADM" SG_ 2654552075 AZG_to_TCM 0;
BA_ "GenSigTimeoutTime_DMSM" SG_ 2654552075 AZG_to_TCM 0;
BA_ "GenSigTimeoutTime_DTCM" SG_ 2654552075 AZG_to_TCM 0;
BA_ "GenSigTimeoutTime_ECM" SG_ 2654552075 AZG_to_TCM 0;
BA_ "GenSigTimeoutTime_EVCU2" SG_ 2654552075 AZG_to_TCM 0;
BA_ "GenSigTimeoutTime_GNMM" SG_ 2654552075 AZG_to_TCM 0;
BA_ "GenSigTimeoutTime_HCP" SG_ 2654552075 AZG_to_TCM 0;
BA_ "GenSigTimeoutTime_IPC" SG_ 2654552075 AZG_to_TCM 0;
BA_ "GenSigTimeoutTime_RFHM" SG_ 2654552075 AZG_to_TCM 0;
BA_ "GenSigTimeoutTime_SGW" SG_ 2654552075 AZG_to_TCM 0;
BA_ "GenSigTimeoutTime_AGSM" SG_ 2654814267 APPL_TRANSMISSION 0;
BA_ "GenSigTimeoutTime_BCM" SG_ 2654814267 APPL_TRANSMISSION 0;
BA_ "GenSigTimeoutTime_BSM" SG_ 2654814267 APPL_TRANSMISSION 0;
BA_ "GenSigTimeoutTime_CADM" SG_ 2654814267 APPL_TRANSMISSION 0;
BA_ "GenSigTimeoutTime_DMSM" SG_ 2654814267 APPL_TRANSMISSION 0;
BA_ "GenSigTimeoutTime_DTCM" SG_ 2654814267 APPL_TRANSMISSION 0;
BA_ "GenSigTimeoutTime_ECM" SG_ 2654814267 APPL_TRANSMISSION 0;
BA_ "GenSigTimeoutTime_EVCU2" SG_ 2654814267 APPL_TRANSMISSION 0;
BA_ "GenSigTimeoutTime_GNMM" SG_ 2654814267 APPL_TRANSMISSION 0;
BA_ "GenSigTimeoutTime_HCP" SG_ 2654814267 APPL_TRANSMISSION 0;
BA_ "GenSigTimeoutTime_IPC" SG_ 2654814267 APPL_TRANSMISSION 0;
BA_ "GenSigTimeoutTime_RFHM" SG_ 2654814267 APPL_TRANSMISSION 0;
BA_ "GenSigTimeoutTime_SGW" SG_ 2654814267 APPL_TRANSMISSION 0;
BA_ "GenSigTimeoutTime_AGSM" SG_ 1327 CRC_ASCM1 0;
BA_ "GenSigTimeoutTime_BCM" SG_ 1327 CRC_ASCM1 0;
BA_ "GenSigTimeoutTime_BSM" SG_ 1327 CRC_ASCM1 0;
BA_ "GenSigTimeoutTime_DMSM" SG_ 1327 CRC_ASCM1 0;
BA_ "GenSigTimeoutTime_DTCM" SG_ 1327 CRC_ASCM1 0;
BA_ "GenSigTimeoutTime_ECM" SG_ 1327 CRC_ASCM1 0;
BA_ "GenSigTimeoutTime_EVCU2" SG_ 1327 CRC_ASCM1 0;
BA_ "GenSigTimeoutTime_GNMM" SG_ 1327 CRC_ASCM1 0;
BA_ "GenSigTimeoutTime_HCP" SG_ 1327 CRC_ASCM1 0;
BA_ "GenSigTimeoutTime_IPC" SG_ 1327 CRC_ASCM1 0;
BA_ "GenSigTimeoutTime_RFHM" SG_ 1327 CRC_ASCM1 0;
BA_ "GenSigTimeoutTime_SGW" SG_ 1327 CRC_ASCM1 0;
BA_ "GenSigTimeoutTime_TCM" SG_ 1327 CRC_ASCM1 0;
BA_ "GenSigStartValue" SG_ 1327 FL_Lvl 254;
BA_ "GenSigTimeoutTime_AGSM" SG_ 1327 FL_Lvl 0;
BA_ "GenSigTimeoutTime_BCM" SG_ 1327 FL_Lvl 0;
BA_ "GenSigTimeoutTime_BSM" SG_ 1327 FL_Lvl 0;
BA_ "GenSigTimeoutTime_DMSM" SG_ 1327 FL_Lvl 0;
BA_ "GenSigTimeoutTime_DTCM" SG_ 1327 FL_Lvl 0;
BA_ "GenSigTimeoutTime_ECM" SG_ 1327 FL_Lvl 0;
BA_ "GenSigTimeoutTime_EVCU2" SG_ 1327 FL_Lvl 0;
BA_ "GenSigTimeoutTime_GNMM" SG_ 1327 FL_Lvl 0;
BA_ "GenSigTimeoutTime_HCP" SG_ 1327 FL_Lvl 0;
BA_ "GenSigTimeoutTime_IPC" SG_ 1327 FL_Lvl 0;
BA_ "GenSigTimeoutTime_RFHM" SG_ 1327 FL_Lvl 0;
BA_ "GenSigTimeoutTime_TCM" SG_ 1327 FL_Lvl 0;
BA_ "GenSigTimeoutTime_AGSM" SG_ 1327 FL_Lvl_Adj 0;
BA_ "GenSigTimeoutTime_BCM" SG_ 1327 FL_Lvl_Adj 0;
BA_ "GenSigTimeoutTime_BSM" SG_ 1327 FL_Lvl_Adj 0;
BA_ "GenSigTimeoutTime_DMSM" SG_ 1327 FL_Lvl_Adj 0;
BA_ "GenSigTimeoutTime_DTCM" SG_ 1327 FL_Lvl_Adj 0;
BA_ "GenSigTimeoutTime_ECM" SG_ 1327 FL_Lvl_Adj 0;
BA_ "GenSigTimeoutTime_EVCU2" SG_ 1327 FL_Lvl_Adj 0;
BA_ "GenSigTimeoutTime_GNMM" SG_ 1327 FL_Lvl_Adj 0;
BA_ "GenSigTimeoutTime_HCP" SG_ 1327 FL_Lvl_Adj 0;
BA_ "GenSigTimeoutTime_IPC" SG_ 1327 FL_Lvl_Adj 0;
BA_ "GenSigTimeoutTime_RFHM" SG_ 1327 FL_Lvl_Adj 0;
BA_ "GenSigTimeoutTime_SGW" SG_ 1327 FL_Lvl_Adj 0;
BA_ "GenSigTimeoutTime_TCM" SG_ 1327 FL_Lvl_Adj 0;
BA_ "GenSigStartValue" SG_ 1327 FR_Lvl 254;
BA_ "GenSigTimeoutTime_AGSM" SG_ 1327 FR_Lvl 0;
BA_ "GenSigTimeoutTime_BCM" SG_ 1327 FR_Lvl 0;
BA_ "GenSigTimeoutTime_BSM" SG_ 1327 FR_Lvl 0;
BA_ "GenSigTimeoutTime_DMSM" SG_ 1327 FR_Lvl 0;
BA_ "GenSigTimeoutTime_DTCM" SG_ 1327 FR_Lvl 0;
BA_ "GenSigTimeoutTime_ECM" SG_ 1327 FR_Lvl 0;
BA_ "GenSigTimeoutTime_EVCU2" SG_ 1327 FR_Lvl 0;
BA_ "GenSigTimeoutTime_GNMM" SG_ 1327 FR_Lvl 0;
BA_ "GenSigTimeoutTime_HCP" SG_ 1327 FR_Lvl 0;
BA_ "GenSigTimeoutTime_IPC" SG_ 1327 FR_Lvl 0;
BA_ "GenSigTimeoutTime_RFHM" SG_ 1327 FR_Lvl 0;
BA_ "GenSigTimeoutTime_TCM" SG_ 1327 FR_Lvl 0;
BA_ "GenSigTimeoutTime_AGSM" SG_ 1327 FR_Lvl_Adj 0;
BA_ "GenSigTimeoutTime_BCM" SG_ 1327 FR_Lvl_Adj 0;
BA_ "GenSigTimeoutTime_BSM" SG_ 1327 FR_Lvl_Adj 0;
BA_ "GenSigTimeoutTime_DMSM" SG_ 1327 FR_Lvl_Adj 0;
BA_ "GenSigTimeoutTime_DTCM" SG_ 1327 FR_Lvl_Adj 0;
BA_ "GenSigTimeoutTime_ECM" SG_ 1327 FR_Lvl_Adj 0;
BA_ "GenSigTimeoutTime_EVCU2" SG_ 1327 FR_Lvl_Adj 0;
BA_ "GenSigTimeoutTime_GNMM" SG_ 1327 FR_Lvl_Adj 0;
BA_ "GenSigTimeoutTime_HCP" SG_ 1327 FR_Lvl_Adj 0;
BA_ "GenSigTimeoutTime_IPC" SG_ 1327 FR_Lvl_Adj 0;
BA_ "GenSigTimeoutTime_RFHM" SG_ 1327 FR_Lvl_Adj 0;
BA_ "GenSigTimeoutTime_SGW" SG_ 1327 FR_Lvl_Adj 0;
BA_ "GenSigTimeoutTime_TCM" SG_ 1327 FR_Lvl_Adj 0;
BA_ "GenSigTimeoutTime_AGSM" SG_ 1327 LvLCalCmplt 0;
BA_ "GenSigTimeoutTime_BCM" SG_ 1327 LvLCalCmplt 0;
BA_ "GenSigTimeoutTime_BSM" SG_ 1327 LvLCalCmplt 0;
BA_ "GenSigTimeoutTime_DMSM" SG_ 1327 LvLCalCmplt 0;
BA_ "GenSigTimeoutTime_DTCM" SG_ 1327 LvLCalCmplt 0;
BA_ "GenSigTimeoutTime_ECM" SG_ 1327 LvLCalCmplt 0;
BA_ "GenSigTimeoutTime_EVCU2" SG_ 1327 LvLCalCmplt 0;
BA_ "GenSigTimeoutTime_GNMM" SG_ 1327 LvLCalCmplt 0;
BA_ "GenSigTimeoutTime_HCP" SG_ 1327 LvLCalCmplt 0;
BA_ "GenSigTimeoutTime_IPC" SG_ 1327 LvLCalCmplt 0;
BA_ "GenSigTimeoutTime_RFHM" SG_ 1327 LvLCalCmplt 0;
BA_ "GenSigTimeoutTime_SGW" SG_ 1327 LvLCalCmplt 0;
BA_ "GenSigTimeoutTime_TCM" SG_ 1327 LvLCalCmplt 0;
BA_ "GenSigTimeoutTime_AGSM" SG_ 1327 MessageCounter_ASCM1 0;
BA_ "GenSigTimeoutTime_BCM" SG_ 1327 MessageCounter_ASCM1 0;
BA_ "GenSigTimeoutTime_BSM" SG_ 1327 MessageCounter_ASCM1 0;
BA_ "GenSigTimeoutTime_DMSM" SG_ 1327 MessageCounter_ASCM1 0;
BA_ "GenSigTimeoutTime_DTCM" SG_ 1327 MessageCounter_ASCM1 0;
BA_ "GenSigTimeoutTime_ECM" SG_ 1327 MessageCounter_ASCM1 0;
BA_ "GenSigTimeoutTime_EVCU2" SG_ 1327 MessageCounter_ASCM1 0;
BA_ "GenSigTimeoutTime_GNMM" SG_ 1327 MessageCounter_ASCM1 0;
BA_ "GenSigTimeoutTime_HCP" SG_ 1327 MessageCounter_ASCM1 0;
BA_ "GenSigTimeoutTime_IPC" SG_ 1327 MessageCounter_ASCM1 0;
BA_ "GenSigTimeoutTime_RFHM" SG_ 1327 MessageCounter_ASCM1 0;
BA_ "GenSigTimeoutTime_SGW" SG_ 1327 MessageCounter_ASCM1 0;
BA_ "GenSigTimeoutTime_TCM" SG_ 1327 MessageCounter_ASCM1 0;
BA_ "GenSigStartValue" SG_ 1327 RL_Lvl 254;
BA_ "GenSigTimeoutTime_AGSM" SG_ 1327 RL_Lvl 0;
BA_ "GenSigTimeoutTime_BCM" SG_ 1327 RL_Lvl 0;
BA_ "GenSigTimeoutTime_BSM" SG_ 1327 RL_Lvl 0;
BA_ "GenSigTimeoutTime_DMSM" SG_ 1327 RL_Lvl 0;
BA_ "GenSigTimeoutTime_DTCM" SG_ 1327 RL_Lvl 0;
BA_ "GenSigTimeoutTime_ECM" SG_ 1327 RL_Lvl 0;
BA_ "GenSigTimeoutTime_EVCU2" SG_ 1327 RL_Lvl 0;
BA_ "GenSigTimeoutTime_GNMM" SG_ 1327 RL_Lvl 0;
BA_ "GenSigTimeoutTime_HCP" SG_ 1327 RL_Lvl 0;
BA_ "GenSigTimeoutTime_IPC" SG_ 1327 RL_Lvl 0;
BA_ "GenSigTimeoutTime_RFHM" SG_ 1327 RL_Lvl 0;
BA_ "GenSigTimeoutTime_TCM" SG_ 1327 RL_Lvl 0;
BA_ "GenSigTimeoutTime_AGSM" SG_ 1327 RL_Lvl_Adj 0;
BA_ "GenSigTimeoutTime_BCM" SG_ 1327 RL_Lvl_Adj 0;
BA_ "GenSigTimeoutTime_BSM" SG_ 1327 RL_Lvl_Adj 0;
BA_ "GenSigTimeoutTime_DMSM" SG_ 1327 RL_Lvl_Adj 0;
BA_ "GenSigTimeoutTime_DTCM" SG_ 1327 RL_Lvl_Adj 0;
BA_ "GenSigTimeoutTime_ECM" SG_ 1327 RL_Lvl_Adj 0;
BA_ "GenSigTimeoutTime_EVCU2" SG_ 1327 RL_Lvl_Adj 0;
BA_ "GenSigTimeoutTime_GNMM" SG_ 1327 RL_Lvl_Adj 0;
BA_ "GenSigTimeoutTime_HCP" SG_ 1327 RL_Lvl_Adj 0;
BA_ "GenSigTimeoutTime_IPC" SG_ 1327 RL_Lvl_Adj 0;
BA_ "GenSigTimeoutTime_RFHM" SG_ 1327 RL_Lvl_Adj 0;
BA_ "GenSigTimeoutTime_SGW" SG_ 1327 RL_Lvl_Adj 0;
BA_ "GenSigTimeoutTime_TCM" SG_ 1327 RL_Lvl_Adj 0;
BA_ "GenSigStartValue" SG_ 1327 RR_Lvl 254;
BA_ "GenSigTimeoutTime_AGSM" SG_ 1327 RR_Lvl 0;
BA_ "GenSigTimeoutTime_BCM" SG_ 1327 RR_Lvl 0;
BA_ "GenSigTimeoutTime_BSM" SG_ 1327 RR_Lvl 0;
BA_ "GenSigTimeoutTime_DMSM" SG_ 1327 RR_Lvl 0;
BA_ "GenSigTimeoutTime_DTCM" SG_ 1327 RR_Lvl 0;
BA_ "GenSigTimeoutTime_ECM" SG_ 1327 RR_Lvl 0;
BA_ "GenSigTimeoutTime_EVCU2" SG_ 1327 RR_Lvl 0;
BA_ "GenSigTimeoutTime_GNMM" SG_ 1327 RR_Lvl 0;
BA_ "GenSigTimeoutTime_HCP" SG_ 1327 RR_Lvl 0;
BA_ "GenSigTimeoutTime_IPC" SG_ 1327 RR_Lvl 0;
BA_ "GenSigTimeoutTime_RFHM" SG_ 1327 RR_Lvl 0;
BA_ "GenSigTimeoutTime_TCM" SG_ 1327 RR_Lvl 0;
BA_ "GenSigTimeoutTime_AGSM" SG_ 1327 RR_Lvl_Adj 0;
BA_ "GenSigTimeoutTime_BCM" SG_ 1327 RR_Lvl_Adj 0;
BA_ "GenSigTimeoutTime_BSM" SG_ 1327 RR_Lvl_Adj 0;
BA_ "GenSigTimeoutTime_DMSM" SG_ 1327 RR_Lvl_Adj 0;
BA_ "GenSigTimeoutTime_DTCM" SG_ 1327 RR_Lvl_Adj 0;
BA_ "GenSigTimeoutTime_ECM" SG_ 1327 RR_Lvl_Adj 0;
BA_ "GenSigTimeoutTime_EVCU2" SG_ 1327 RR_Lvl_Adj 0;
BA_ "GenSigTimeoutTime_GNMM" SG_ 1327 RR_Lvl_Adj 0;
BA_ "GenSigTimeoutTime_HCP" SG_ 1327 RR_Lvl_Adj 0;
BA_ "GenSigTimeoutTime_IPC" SG_ 1327 RR_Lvl_Adj 0;
BA_ "GenSigTimeoutTime_RFHM" SG_ 1327 RR_Lvl_Adj 0;
BA_ "GenSigTimeoutTime_SGW" SG_ 1327 RR_Lvl_Adj 0;
BA_ "GenSigTimeoutTime_TCM" SG_ 1327 RR_Lvl_Adj 0;
BA_ "GenSigSendType" SG_ 1445 ADC_Stat_2 3;
BA_ "GenSigTimeoutTime_AGSM" SG_ 1445 ADC_Stat_2 0;
BA_ "GenSigTimeoutTime_BCM" SG_ 1445 ADC_Stat_2 0;
BA_ "GenSigTimeoutTime_BSM" SG_ 1445 ADC_Stat_2 0;
BA_ "GenSigTimeoutTime_CADM" SG_ 1445 ADC_Stat_2 0;
BA_ "GenSigTimeoutTime_DMSM" SG_ 1445 ADC_Stat_2 0;
BA_ "GenSigTimeoutTime_DTCM" SG_ 1445 ADC_Stat_2 0;
BA_ "GenSigTimeoutTime_ECM" SG_ 1445 ADC_Stat_2 0;
BA_ "GenSigTimeoutTime_EVCU2" SG_ 1445 ADC_Stat_2 0;
BA_ "GenSigTimeoutTime_GNMM" SG_ 1445 ADC_Stat_2 0;
BA_ "GenSigTimeoutTime_HCP" SG_ 1445 ADC_Stat_2 0;
BA_ "GenSigTimeoutTime_IPC" SG_ 1445 ADC_Stat_2 0;
BA_ "GenSigTimeoutTime_RFHM" SG_ 1445 ADC_Stat_2 0;
BA_ "GenSigTimeoutTime_TCM" SG_ 1445 ADC_Stat_2 0;
BA_ "GenSigSendType" SG_ 1445 ADS_SrvSys 3;
BA_ "GenSigTimeoutTime_AGSM" SG_ 1445 ADS_SrvSys 0;
BA_ "GenSigTimeoutTime_BCM" SG_ 1445 ADS_SrvSys 0;
BA_ "GenSigTimeoutTime_BSM" SG_ 1445 ADS_SrvSys 0;
BA_ "GenSigTimeoutTime_CADM" SG_ 1445 ADS_SrvSys 0;
BA_ "GenSigTimeoutTime_DMSM" SG_ 1445 ADS_SrvSys 0;
BA_ "GenSigTimeoutTime_DTCM" SG_ 1445 ADS_SrvSys 0;
BA_ "GenSigTimeoutTime_ECM" SG_ 1445 ADS_SrvSys 0;
BA_ "GenSigTimeoutTime_EVCU2" SG_ 1445 ADS_SrvSys 0;
BA_ "GenSigTimeoutTime_GNMM" SG_ 1445 ADS_SrvSys 0;
BA_ "GenSigTimeoutTime_HCP" SG_ 1445 ADS_SrvSys 0;
BA_ "GenSigTimeoutTime_RFHM" SG_ 1445 ADS_SrvSys 0;
BA_ "GenSigTimeoutTime_SGW" SG_ 1445 ADS_SrvSys 0;
BA_ "GenSigTimeoutTime_TCM" SG_ 1445 ADS_SrvSys 0;
BA_ "GenSigSendType" SG_ 1445 ASCM_HMI_Stat 3;
BA_ "GenSigTimeoutTime_AGSM" SG_ 1445 ASCM_HMI_Stat 0;
BA_ "GenSigTimeoutTime_BCM" SG_ 1445 ASCM_HMI_Stat 0;
BA_ "GenSigTimeoutTime_BSM" SG_ 1445 ASCM_HMI_Stat 0;
BA_ "GenSigTimeoutTime_CADM" SG_ 1445 ASCM_HMI_Stat 0;
BA_ "GenSigTimeoutTime_DMSM" SG_ 1445 ASCM_HMI_Stat 0;
BA_ "GenSigTimeoutTime_DTCM" SG_ 1445 ASCM_HMI_Stat 0;
BA_ "GenSigTimeoutTime_ECM" SG_ 1445 ASCM_HMI_Stat 0;
BA_ "GenSigTimeoutTime_EVCU2" SG_ 1445 ASCM_HMI_Stat 0;
BA_ "GenSigTimeoutTime_GNMM" SG_ 1445 ASCM_HMI_Stat 0;
BA_ "GenSigTimeoutTime_HCP" SG_ 1445 ASCM_HMI_Stat 0;
BA_ "GenSigTimeoutTime_RFHM" SG_ 1445 ASCM_HMI_Stat 0;
BA_ "GenSigTimeoutTime_SGW" SG_ 1445 ASCM_HMI_Stat 0;
BA_ "GenSigTimeoutTime_TCM" SG_ 1445 ASCM_HMI_Stat 0;
BA_ "GenSigSendType" SG_ 1445 ASCM_RemStat 3;
BA_ "GenSigTimeoutTime_AGSM" SG_ 1445 ASCM_RemStat 0;
BA_ "GenSigTimeoutTime_BCM" SG_ 1445 ASCM_RemStat 0;
BA_ "GenSigTimeoutTime_BSM" SG_ 1445 ASCM_RemStat 0;
BA_ "GenSigTimeoutTime_CADM" SG_ 1445 ASCM_RemStat 0;
BA_ "GenSigTimeoutTime_DMSM" SG_ 1445 ASCM_RemStat 0;
BA_ "GenSigTimeoutTime_DTCM" SG_ 1445 ASCM_RemStat 0;
BA_ "GenSigTimeoutTime_ECM" SG_ 1445 ASCM_RemStat 0;
BA_ "GenSigTimeoutTime_EVCU2" SG_ 1445 ASCM_RemStat 0;
BA_ "GenSigTimeoutTime_GNMM" SG_ 1445 ASCM_RemStat 0;
BA_ "GenSigTimeoutTime_HCP" SG_ 1445 ASCM_RemStat 0;
BA_ "GenSigTimeoutTime_IPC" SG_ 1445 ASCM_RemStat 0;
BA_ "GenSigTimeoutTime_SGW" SG_ 1445 ASCM_RemStat 0;
BA_ "GenSigTimeoutTime_TCM" SG_ 1445 ASCM_RemStat 0;
BA_ "GenSigSendType" SG_ 1445 ASCM_Srv 3;
BA_ "GenSigTimeoutTime_AGSM" SG_ 1445 ASCM_Srv 0;
BA_ "GenSigTimeoutTime_BCM" SG_ 1445 ASCM_Srv 0;
BA_ "GenSigTimeoutTime_BSM" SG_ 1445 ASCM_Srv 0;
BA_ "GenSigTimeoutTime_CADM" SG_ 1445 ASCM_Srv 0;
BA_ "GenSigTimeoutTime_DMSM" SG_ 1445 ASCM_Srv 0;
BA_ "GenSigTimeoutTime_DTCM" SG_ 1445 ASCM_Srv 0;
BA_ "GenSigTimeoutTime_ECM" SG_ 1445 ASCM_Srv 0;
BA_ "GenSigTimeoutTime_EVCU2" SG_ 1445 ASCM_Srv 0;
BA_ "GenSigTimeoutTime_GNMM" SG_ 1445 ASCM_Srv 0;
BA_ "GenSigTimeoutTime_HCP" SG_ 1445 ASCM_Srv 0;
BA_ "GenSigTimeoutTime_RFHM" SG_ 1445 ASCM_Srv 0;
BA_ "GenSigTimeoutTime_TCM" SG_ 1445 ASCM_Srv 0;
BA_ "GenSigSendType" SG_ 1445 ASCM_Stat 3;
BA_ "GenSigTimeoutTime_AGSM" SG_ 1445 ASCM_Stat 0;
BA_ "GenSigTimeoutTime_BCM" SG_ 1445 ASCM_Stat 0;
BA_ "GenSigTimeoutTime_DMSM" SG_ 1445 ASCM_Stat 0;
BA_ "GenSigTimeoutTime_DTCM" SG_ 1445 ASCM_Stat 0;
BA_ "GenSigTimeoutTime_EVCU2" SG_ 1445 ASCM_Stat 0;
BA_ "GenSigTimeoutTime_GNMM" SG_ 1445 ASCM_Stat 0;
BA_ "GenSigTimeoutTime_HCP" SG_ 1445 ASCM_Stat 0;
BA_ "GenSigTimeoutTime_RFHM" SG_ 1445 ASCM_Stat 0;
BA_ "GenSigTimeoutTime_SGW" SG_ 1445 ASCM_Stat 0;
BA_ "GenSigTimeoutTime_TCM" SG_ 1445 ASCM_Stat 0;
BA_ "GenSigSendType" SG_ 1445 ASCM_StatDisp 3;
BA_ "GenSigTimeoutTime_AGSM" SG_ 1445 ASCM_StatDisp 0;
BA_ "GenSigTimeoutTime_BCM" SG_ 1445 ASCM_StatDisp 0;
BA_ "GenSigTimeoutTime_BSM" SG_ 1445 ASCM_StatDisp 0;
BA_ "GenSigTimeoutTime_CADM" SG_ 1445 ASCM_StatDisp 0;
BA_ "GenSigTimeoutTime_DMSM" SG_ 1445 ASCM_StatDisp 0;
BA_ "GenSigTimeoutTime_DTCM" SG_ 1445 ASCM_StatDisp 0;
BA_ "GenSigTimeoutTime_ECM" SG_ 1445 ASCM_StatDisp 0;
BA_ "GenSigTimeoutTime_EVCU2" SG_ 1445 ASCM_StatDisp 0;
BA_ "GenSigTimeoutTime_GNMM" SG_ 1445 ASCM_StatDisp 0;
BA_ "GenSigTimeoutTime_HCP" SG_ 1445 ASCM_StatDisp 0;
BA_ "GenSigTimeoutTime_RFHM" SG_ 1445 ASCM_StatDisp 0;
BA_ "GenSigTimeoutTime_SGW" SG_ 1445 ASCM_StatDisp 0;
BA_ "GenSigTimeoutTime_TCM" SG_ 1445 ASCM_StatDisp 0;
BA_ "GenSigSendType" SG_ 1445 ASCM_SysFail 3;
BA_ "GenSigTimeoutTime_AGSM" SG_ 1445 ASCM_SysFail 0;
BA_ "GenSigTimeoutTime_BCM" SG_ 1445 ASCM_SysFail 0;
BA_ "GenSigTimeoutTime_BSM" SG_ 1445 ASCM_SysFail 0;
BA_ "GenSigTimeoutTime_CADM" SG_ 1445 ASCM_SysFail 0;
BA_ "GenSigTimeoutTime_DMSM" SG_ 1445 ASCM_SysFail 0;
BA_ "GenSigTimeoutTime_DTCM" SG_ 1445 ASCM_SysFail 0;
BA_ "GenSigTimeoutTime_ECM" SG_ 1445 ASCM_SysFail 0;
BA_ "GenSigTimeoutTime_EVCU2" SG_ 1445 ASCM_SysFail 0;
BA_ "GenSigTimeoutTime_GNMM" SG_ 1445 ASCM_SysFail 0;
BA_ "GenSigTimeoutTime_HCP" SG_ 1445 ASCM_SysFail 0;
BA_ "GenSigTimeoutTime_RFHM" SG_ 1445 ASCM_SysFail 0;
BA_ "GenSigTimeoutTime_TCM" SG_ 1445 ASCM_SysFail 0;
BA_ "GenSigSendType" SG_ 1445 ASCM_SYSFAIL_HMI 3;
BA_ "GenSigTimeoutTime_AGSM" SG_ 1445 ASCM_SYSFAIL_HMI 0;
BA_ "GenSigTimeoutTime_BCM" SG_ 1445 ASCM_SYSFAIL_HMI 0;
BA_ "GenSigTimeoutTime_BSM" SG_ 1445 ASCM_SYSFAIL_HMI 0;
BA_ "GenSigTimeoutTime_CADM" SG_ 1445 ASCM_SYSFAIL_HMI 0;
BA_ "GenSigTimeoutTime_DMSM" SG_ 1445 ASCM_SYSFAIL_HMI 0;
BA_ "GenSigTimeoutTime_DTCM" SG_ 1445 ASCM_SYSFAIL_HMI 0;
BA_ "GenSigTimeoutTime_ECM" SG_ 1445 ASCM_SYSFAIL_HMI 0;
BA_ "GenSigTimeoutTime_EVCU2" SG_ 1445 ASCM_SYSFAIL_HMI 0;
BA_ "GenSigTimeoutTime_GNMM" SG_ 1445 ASCM_SYSFAIL_HMI 0;
BA_ "GenSigTimeoutTime_HCP" SG_ 1445 ASCM_SYSFAIL_HMI 0;
BA_ "GenSigTimeoutTime_RFHM" SG_ 1445 ASCM_SYSFAIL_HMI 0;
BA_ "GenSigTimeoutTime_SGW" SG_ 1445 ASCM_SYSFAIL_HMI 0;
BA_ "GenSigTimeoutTime_TCM" SG_ 1445 ASCM_SYSFAIL_HMI 0;
BA_ "GenSigTimeoutTime_AGSM" SG_ 1445 CRC_ASCM2 0;
BA_ "GenSigTimeoutTime_BCM" SG_ 1445 CRC_ASCM2 0;
BA_ "GenSigTimeoutTime_DMSM" SG_ 1445 CRC_ASCM2 0;
BA_ "GenSigTimeoutTime_DTCM" SG_ 1445 CRC_ASCM2 0;
BA_ "GenSigTimeoutTime_ECM" SG_ 1445 CRC_ASCM2 0;
BA_ "GenSigTimeoutTime_EVCU2" SG_ 1445 CRC_ASCM2 0;
BA_ "GenSigTimeoutTime_GNMM" SG_ 1445 CRC_ASCM2 0;
BA_ "GenSigTimeoutTime_HCP" SG_ 1445 CRC_ASCM2 0;
BA_ "GenSigTimeoutTime_RFHM" SG_ 1445 CRC_ASCM2 0;
BA_ "GenSigTimeoutTime_SGW" SG_ 1445 CRC_ASCM2 0;
BA_ "GenSigTimeoutTime_TCM" SG_ 1445 CRC_ASCM2 0;
BA_ "GenSigStartValue" SG_ 1445 Loading_Lv 7;
BA_ "GenSigSendType" SG_ 1445 Loading_Lv 3;
BA_ "GenSigTimeoutTime_AGSM" SG_ 1445 Loading_Lv 0;
BA_ "GenSigTimeoutTime_BCM" SG_ 1445 Loading_Lv 0;
BA_ "GenSigTimeoutTime_DMSM" SG_ 1445 Loading_Lv 0;
BA_ "GenSigTimeoutTime_DTCM" SG_ 1445 Loading_Lv 0;
BA_ "GenSigTimeoutTime_ECM" SG_ 1445 Loading_Lv 0;
BA_ "GenSigTimeoutTime_EVCU2" SG_ 1445 Loading_Lv 0;
BA_ "GenSigTimeoutTime_GNMM" SG_ 1445 Loading_Lv 0;
BA_ "GenSigTimeoutTime_HCP" SG_ 1445 Loading_Lv 0;
BA_ "GenSigTimeoutTime_RFHM" SG_ 1445 Loading_Lv 0;
BA_ "GenSigTimeoutTime_SGW" SG_ 1445 Loading_Lv 0;
BA_ "GenSigTimeoutTime_TCM" SG_ 1445 Loading_Lv 0;
BA_ "GenSigTimeoutTime_AGSM" SG_ 1445 MessageCounter_ASCM2 0;
BA_ "GenSigTimeoutTime_BCM" SG_ 1445 MessageCounter_ASCM2 0;
BA_ "GenSigTimeoutTime_DMSM" SG_ 1445 MessageCounter_ASCM2 0;
BA_ "GenSigTimeoutTime_DTCM" SG_ 1445 MessageCounter_ASCM2 0;
BA_ "GenSigTimeoutTime_ECM" SG_ 1445 MessageCounter_ASCM2 0;
BA_ "GenSigTimeoutTime_EVCU2" SG_ 1445 MessageCounter_ASCM2 0;
BA_ "GenSigTimeoutTime_GNMM" SG_ 1445 MessageCounter_ASCM2 0;
BA_ "GenSigTimeoutTime_HCP" SG_ 1445 MessageCounter_ASCM2 0;
BA_ "GenSigTimeoutTime_RFHM" SG_ 1445 MessageCounter_ASCM2 0;
BA_ "GenSigTimeoutTime_SGW" SG_ 1445 MessageCounter_ASCM2 0;
BA_ "GenSigTimeoutTime_TCM" SG_ 1445 MessageCounter_ASCM2 0;
BA_ "GenSigStartValue" SG_ 1445 Tgt_Level 7;
BA_ "GenSigSendType" SG_ 1445 Tgt_Level 3;
BA_ "GenSigTimeoutTime_AGSM" SG_ 1445 Tgt_Level 0;
BA_ "GenSigTimeoutTime_BCM" SG_ 1445 Tgt_Level 0;
BA_ "GenSigTimeoutTime_BSM" SG_ 1445 Tgt_Level 0;
BA_ "GenSigTimeoutTime_DMSM" SG_ 1445 Tgt_Level 0;
BA_ "GenSigTimeoutTime_DTCM" SG_ 1445 Tgt_Level 0;
BA_ "GenSigTimeoutTime_ECM" SG_ 1445 Tgt_Level 0;
BA_ "GenSigTimeoutTime_EVCU2" SG_ 1445 Tgt_Level 0;
BA_ "GenSigTimeoutTime_GNMM" SG_ 1445 Tgt_Level 0;
BA_ "GenSigTimeoutTime_HCP" SG_ 1445 Tgt_Level 0;
BA_ "GenSigTimeoutTime_IPC" SG_ 1445 Tgt_Level 0;
BA_ "GenSigTimeoutTime_RFHM" SG_ 1445 Tgt_Level 0;
BA_ "GenSigTimeoutTime_SGW" SG_ 1445 Tgt_Level 0;
BA_ "GenSigTimeoutTime_TCM" SG_ 1445 Tgt_Level 0;
BA_ "GenSigSendType" SG_ 1445 TJM_Enbl 3;
BA_ "GenSigTimeoutTime_AGSM" SG_ 1445 TJM_Enbl 0;
BA_ "GenSigTimeoutTime_BCM" SG_ 1445 TJM_Enbl 0;
BA_ "GenSigTimeoutTime_BSM" SG_ 1445 TJM_Enbl 0;
BA_ "GenSigTimeoutTime_CADM" SG_ 1445 TJM_Enbl 0;
BA_ "GenSigTimeoutTime_DMSM" SG_ 1445 TJM_Enbl 0;
BA_ "GenSigTimeoutTime_DTCM" SG_ 1445 TJM_Enbl 0;
BA_ "GenSigTimeoutTime_ECM" SG_ 1445 TJM_Enbl 0;
BA_ "GenSigTimeoutTime_EVCU2" SG_ 1445 TJM_Enbl 0;
BA_ "GenSigTimeoutTime_GNMM" SG_ 1445 TJM_Enbl 0;
BA_ "GenSigTimeoutTime_HCP" SG_ 1445 TJM_Enbl 0;
BA_ "GenSigTimeoutTime_RFHM" SG_ 1445 TJM_Enbl 0;
BA_ "GenSigTimeoutTime_SGW" SG_ 1445 TJM_Enbl 0;
BA_ "GenSigTimeoutTime_TCM" SG_ 1445 TJM_Enbl 0;
BA_ "NmType" "NmAsr";
BA_ "BusType" "CAN FD";
BA_ "DBName" "FDCAN3";
BA_ "NmAsrTimeoutTime" 8000;
BA_ "NmAsrWaitBusSleepTime" 1000;
BA_ "NmAsrRepeatMessageTime" 5000;
BA_ "NmAsrBaseAddress" 507002880;
BA_ "NmAsrCanMsgCycleTime" 1000;
VAL_ 1456 ACC_Blind 0 "Fail_Not_Present" 1 "Fail_Present";
VAL_ 1456 ACC_DispPopupSts 0 "No_Code" 1 "ACC_Unavailable" 2 "ACC_Unavailable_4WD_Low" 3 "ACC_Unavailable_ESC_Off" 4 "ACC_Unavailable_ESC_Event" 5 "ACC_Unavailable_Brakes_Cooling" 6 "ACC_Unavailable_Below_Min_Speed" 7 "ACC_Unavailable_Above_Max_Speed" 8 "ACC_Unavailable_EPB_Active" 9 "ACC_Unavailable_Shift_D" 10 "ACC_Unavailable_Door_Open" 11 "ACC_Unavailable_Seatbelt_Unbuckled" 12 "ACC_Unavailable_Road_to_Steep" 13 "ACC_Unavailable_Wrong_Gear" 14 "ACC_Unavailable_Low_RPM" 15 "ACC_Unavailable_High_RPM" 16 "ACC_Unavailable_Clutch_Engaged" 17 "ACC_Cancel" 18 "ACC_AEB_Cancel_ESC_Off" 19 "ACC_Cancel_ESC_Off" 20 "ACC_Cancel_ESC_Event" 21 "ACC_Cancel_Brakes_Cooling" 22 "ACC_Cancel_Below_Min_Speed" 23 "ACC_Cancel_Above_Max_Speed" 24 "ACC_Cancel_EPB_Active" 25 "ACC_Cancel_Shift_D" 26 "ACC_Cancel_Door_Open" 27 "ACC_Cancel_Seatbelt_Unbuckled" 28 "ACC_Cancel_Road_to_Steep" 29 "ACC_Cancel_Wrong_gear" 30 "ACC_Cancel_Low_RPM" 31 "ACC_Cancel_High_RPM" 32 "ACC_Stop_Vehicle_Object_Detected" 33 "ACC_Warning_Clutch_Engaged" 34 "ACC_Warning_Neutral_Engaged" 35 "ACC_Off_ESC_Fault" 36 "ACC_Proximity_Warning" 37 "NCC_Unavailable" 38 "NCC_Unavailable_4WD_Low" 39 "NCC_Unavailable_ESC_Off" 40 "NCC_Unavailable_ESC_Event" 41 "NCC_Unavailable_Brakes_Cooling" 42 "NCC_Unavailable_Below_Min_Speed" 43 "NCC_Unavailable_Above_Max_Speed" 44 "NCC_Unavailable_EPB_Active" 45 "NCC_Unavailable_Shift_D" 46 "NCC_Unavailable_Wrong_Gear" 47 "NCC_Unavailable_Low_RPM" 48 "NCC_Unavailable_High_RPM" 49 "NCC_Unavailable_Clutch_Engaged" 50 "NCC_Cancel" 51 "NCC_AEB_Cancel_ESC_Off" 52 "NCC_Cancel_ESC_Off" 53 "NCC_Cancel_ESC_Event" 54 "NCC_Cancel_Brakes_Cooling" 55 "NCC_Cancel_Below_Min_Speed" 56 "NCC_Cancel_Above_Max_Speed" 57 "NCC_Cancel_EPB_Active" 58 "NCC_Cancel_Shift_D" 59 "NCC_Cancel_Wrong_Gear" 60 "NCC_Cancel_Low_RPM" 61 "NCC_Cancel_High_RPM" 62 "NCC_Warning_Clutch_Engaged" 63 "NCC_Warning_Neutral_Engaged" 64 "ACC_User_Enabled" 68 "ACC_Set" 76 "ACC_Override" 77 "ACC_User_Disabled" 78 "NCC_User_Enabled" 79 "NCC_Set" 80 "NCC_User_Disbaled" 81 "NCC_Override" 82 "Front_Radar_Sensor_Plant_Mode" 83 "ACC_AEB_LKA_Cam_Blind" 84 "ACC_AEB_Cam_Blind" 85 "ACC_LKA_Cam_Blind" 86 "ACC_Cam_Blind" 87 "ACC_AEB_LKA_LIMITED_Fail" 88 "ACC_AEB_LIMITED_Fail" 89 "ACC_LKA_LIMITED_Fail" 90 "ACC_LIMITED_Fail" 91 "ACC_AEB_Radar_Blind" 92 "ACC_Radar_Blind" 93 "ACC_AEB_LKA_Fail" 94 "ACC_AEB_Fail" 95 "ACC_LKA_Fail" 96 "ACC_Fail" 97 "NCC_AEB_LKA_Fail" 98 "NCC_AEB_Fail" 99 "NCC_LKA_Fail" 100 "NCC_Fail" 101 "Alignment_Mode" 102 "Misaligned_Radar" 103 "ACC_Unavail_Corsa" 104 "NCC_Unavail_Corsa" 105 "ACC_Unavailable_Off_Road" 106 "NCC_Unavailable_Off_Road" 107 "ACC_Resume_Reminder" 108 "ACC_Cancel_Off_Road" 109 "ACC_Unavail_HDC" 110 "NCC_Unavail_HDC" 111 "ACC_AEB_Cancel_Off_Road" 112 "Stopping_Ahead" 113 "Press_xx_Confirm_To_Pass" 114 "ACC_Unavailable_Race";
VAL_ 1456 ACC_FailSts 0 "Fail_Not_Present" 1 "Fail_Present";
VAL_ 1456 ACC_Limit_Fail 0 "Fail_Not_Present" 1 "Fail_Present";
VAL_ 1456 ACC_Limited 0 "Fail_Not_Present" 1 "Fail_Present";
VAL_ 1456 ACC_Set_Speed_Strike 0 "Not_Present" 1 "Present";
VAL_ 1456 AEB_Blind 0 "Fail_Not_Present" 1 "Fail_Present";
VAL_ 1456 AEB_DispPopupSts 0 "No_Code" 1 "Pre_Intervention_Warning" 4 "Braking_Complete" 5 "AEB_Unavailble_ESC_Off" 6 "AEB_Unavailble_4WD_Low" 7 "Active_Braking_Enabled" 8 "Active_Braking_Disabled" 9 "AEB_User_Disabled" 10 "AEB_Radar_Blind" 11 "Pre_Intervention_Warning_VRU_L" 12 "AEB_Fail" 13 "Pre_Intervention_Warning_VRU_R" 14 "AEB_Cam_Blind" 15 "Not_used3" 16 "AEB_LIMITED_Fail" 17 "PEB_Off" 18 "PEB_On" 19 "PEB_Radar_Blind" 20 "PEB_Fail" 21 "PEB_Cam_Blind" 22 "FCW_Limited_PEB_Off_Camera_Blinded" 23 "FCW_Limited_PEB_Off_Camera_Fail" 24 "Pre_Intervention_Warning_ICA_L" 25 "Pre_Intervention_Warning_ICA_R" 26 "AEB_Limit_Corner_Blind" 27 "AEB_Unavail_Corsa" 28 "AEB_Unavail_Off_Road" 29 "AEB_Cancel_ESC_Off" 30 "AEB_Cancel_Off_Road" 31 "AEB_Unavail_HDC" 32 "AEB_Initializing_Phase_Ongoing";
VAL_ 1456 AEB_FailSts 0 "Fail_Not_Present" 1 "Fail_Present";
VAL_ 1456 AEB_Limit_Fail 0 "Fail_Not_Present" 1 "Fail_Present";
VAL_ 1456 AEB_Limited 0 "Fail_Not_Present" 1 "Fail_Present";
VAL_ 1456 BlindSpotLeftWarn 0 "No_Req" 1 "Solid" 2 "Flashing";
VAL_ 1456 BlindSpotRightWarn 0 "No_Req" 1 "Solid" 2 "Flashing";
VAL_ 1456 BSS_Blind_RQSts 0 "No_Sensor_Blocked_Request" 1 "Sensor_Blocked_Request";
VAL_ 1456 BSS_CFG_STATSts 0 "Not_enabled" 1 "Enabled_for_LED" 2 "Enabled_for_LED_and_Chime" 3 "SNA";
VAL_ 1456 BSS_SRV_RQSts 0 "No_Service_Request" 1 "Service_Request";
VAL_ 1456 Chime_Priority 0 "A" 1 "B" 2 "C" 3 "D" 4 "E";
VAL_ 1456 Chime_TypSts 0 "Default" 1 "Chime 1" 2 "Chime 2" 3 "Chime 3" 4 "Chime 4" 5 "Chime 5" 6 "Chime 6" 7 "Chime 7" 8 "Chime 8" 9 "Chime 9" 10 "Chime 10";
VAL_ 1456 DDD_DispPopupSts 0 "No_Code" 1 "Drowsniness_Detected" 2 "DDD_Perm_Fail" 3 "SNA";
VAL_ 1456 DDD_FailSts 0 "Fail_Not_Present" 1 "Fail_Present";
VAL_ 1456 DisplaySts_ACC 0 "Off" 1 "Ready_TG1" 2 "Ready_TG2" 3 "Ready_TG3" 4 "Ready_TG4" 5 "ACC_E_NT_TG1" 6 "ACC_E_NT_TG2" 7 "ACC_E_NT_TG3" 8 "ACC_E_NT_TG4" 9 "ACC_E_WT_TG1" 10 "ACC_E_WT_TG2" 11 "ACC_E_WT_TG3" 12 "ACC_E_WT_TG4" 13 "NCC_Ready" 14 "NCC_Engaged";
VAL_ 1456 DisplaySts_Curve 0 "No_Req" 1 "Left" 2 "Right";
VAL_ 1456 DisplaySts_OFF 0 "No_Code" 1 "ACC_LKA_HAS" 2 "ACC_LKA" 3 "ACC_HAS" 4 "ACC" 5 "LKA";
VAL_ 1456 DisplaySts_Veh 0 "Off" 1 "Center_White" 2 "Center_Green" 3 "Right_Crossing_1" 4 "Left_Crossing_1" 5 "Right_Crossing_2" 6 "Left_Crossing_2";
VAL_ 1456 DMSM_Wakeup 0 "Off" 1 "On";
VAL_ 1456 Driver_Model 0 "Attention_Unknown" 1 "Attention_Criteria_Met" 2 "Attention_Criteria_Not_Met" 3 "Faulted";
VAL_ 1456 FCW_Setting_Avail 0 "Available" 1 "Not_Available";
VAL_ 1456 HAS_Blind 0 "Fail_Not_Present" 1 "Fail_Present";
VAL_ 1456 HAS_Escalation_Sts 0 "No_State" 1 "State0" 2 "State1" 3 "State2" 4 "State3a" 5 "State3b" 6 "State4a" 7 "State4b" 8 "State5";
VAL_ 1456 HAS_FailSts 0 "Fail_Not_Present" 1 "Fail_Present";
VAL_ 1456 HAS_Hazard 0 "No_Request" 1 "Request";
VAL_ 1456 HAS_Inhibit_HMI 0 "No_Request" 1 "Msg_1" 2 "Msg_2" 3 "Msg_3" 4 "Msg_4" 5 "Msg_5" 6 "Msg_6" 7 "Msg_7" 8 "Msg_8" 9 "Msg_9" 10 "Msg_10" 11 "Msg_11" 12 "Msg_12" 13 "Msg_13" 14 "Msg_14" 15 "Msg_15" 16 "Msg_16" 17 "Msg_17" 18 "Msg_18" 19 "Msg_19" 20 "Msg_20" 21 "Msg_21" 22 "Msg_22" 23 "Msg_23" 24 "Msg_24" 25 "Msg_25" 26 "Msg_26" 27 "Msg_27" 28 "Msg_28" 29 "Msg_29" 30 "Msg_30" 31 "Msg_31" 32 "Msg_32" 33 "Msg_33" 34 "Msg_34" 35 "Msg_35" 36 "Msg_36" 37 "Msg_37" 38 "Msg_38" 39 "Msg_39" 40 "Msg_40" 41 "Msg_41" 42 "Msg_42" 43 "Msg_43" 44 "Msg_44" 45 "Msg_45" 46 "Msg_46" 47 "Msg_47" 48 "Msg_48" 49 "Msg_49" 50 "Msg_50" 51 "Msg_51" 52 "Msg_52" 53 "Msg_53" 54 "Msg_54" 55 "Msg_55" 56 "Msg_56" 57 "Msg_57" 58 "Msg_58" 59 "Msg_59" 60 "Msg_60" 61 "Msg_61" 62 "Msg_62" 63 "SNA";
VAL_ 1456 HAS_TelltaleSts 0 "OFF" 1 "GREY" 2 "GREEN" 3 "YELLOW" 4 "RED" 5 "GREEN_HANDS_FREE" 6 "YELLOW_HANDS_FREE" 7 "SNA";
VAL_ 1456 HAS_TurnSignalRequest 0 "No_Request" 1 "Left" 2 "Right";
VAL_ 1456 ICA_Blind 0 "Blinded" 1 "Not_Blinded";
VAL_ 1456 Lane_DisplaySts_Left 0 "Off" 1 "Gray" 2 "Green" 3 "Yellow" 4 "Yellow_Flashing" 5 "Red" 6 "Dashed" 7 "White";
VAL_ 1456 Lane_DisplaySts_Right 0 "Off" 1 "Gray" 2 "Green" 3 "Yellow" 4 "Yellow_Flashing" 5 "Red" 6 "Dashed" 7 "White";
VAL_ 1456 Lane_DispPopupSts 0 "No_Code" 1 "LKA_On" 2 "LKA_Off" 3 "LKA_Hands_Off" 4 "HAS_Eyes_Off_Yellow" 5 "Take_Control_Red" 6 "HAS_Ready_Highway" 7 "Blind_Spot_OFF" 8 "HAS_Ready_ACC_Set" 9 "HAS_Unavailable_Speed_to_High" 10 "HAS_Unavailable_Trailer" 11 "HAS_Unavailable_TempNAP" 12 "HAS_Cancel_FOW" 13 "HAS_Cancel_Lane" 15 "HAS_Cancel_Curve" 16 "Unsupport_Lane_Ahead_Take_Control" 17 "MRM_In_Prog" 18 "MRM_Complete" 19 "HAS_Unavail_Lane" 20 "HAS_Hands_Off_Yellow" 21 "HAS_Hands_Off_Red" 22 "HAS_Cancel_Hands_Off" 23 "HAS_AEB_LKA_Cam_Blind" 24 "HAS_AEB_Cam_Blind" 25 "HAS_LKA_Cam_Blind" 26 "HAS_Cam_Blind" 27 "LKA_AEB_Cam_Blind" 28 "LKA_Cam_Blind" 29 "HAS_AEB_Radar_Blind" 30 "HAS_Radar_Blind" 31 "HAS_AEB_LKA_LIMITED_Fail" 32 "HAS_AEB_LIMITED_Fail" 33 "LKA_AEB_LIMITED_Fail" 34 "HAS_AEB_LKA_Fail" 35 "HAS_AEB_Fail" 36 "HAS_LKA_Fail" 37 "HAS_Fail" 38 "LKA_AEB_Fail" 39 "LKA_Fail" 40 "HAS_Cancel" 42 "HAS_ON" 43 "HAS_OFF" 44 "BSS_Blind_ALM_On" 45 "BSS_Blind_ALM_Off" 46 "BSS_OPR_ALM_Off" 47 "BSS_OPR_ALM_On" 48 "BSS_SRV_ALM_Off" 49 "BSS_SRV_ALM_On" 50 "HAS_Unavail_Road_Data" 51 "HAS_Unavail_No_Eyes_On" 52 "HAS_Unavail_Map_OOD" 53 "HAS_Unavail_Locked_Out" 54 "HAS_Cancel_Road_Data" 55 "HAS_Cancel_Driver_Not_Attent" 56 "HAS_Cancel_Brake_Event" 57 "HAS_Cancel_Speed_Too_High" 58 "HAS_Cancel_Control_Limit" 59 "HAS_ACC_Unavailable_4WD_Low" 60 "HAS_ACC_Unavailable_ESC_Off" 61 "HAS_ACC_Unavailable_ESC_Event" 62 "HAS_ACC_Unavailable_Brakes_Cooling" 63 "HAS_ACC_Unavailable_EPB_Active" 64 "HAS_ACC_Unavailable_Shift_D" 65 "HAS_ACC_Unavailable_Door_Open" 66 "HAS_ACC_Unavailable_Seatbelt_Unbuckled" 67 "HAS_ACC_Unavailable_Road_to_Steep" 68 "HAS_ACC_Unavailable_Low_RPM" 69 "HAS_ACC_Unavailable_High_RPM" 70 "HAS_ACC_Cancel" 71 "HAS_ACC_AEB_Cancel_ESC_Off" 72 "HAS_ACC_Cancel_ESC_Off" 73 "HAS_ACC_Cancel_ESC_Event" 74 "HAS_ACC_Cancel_Brakes_Cooling" 75 "HAS_ACC_Cancel_EPB_Active" 76 "HAS_ACC_Cancel_Shift_D" 77 "HAS_ACC_Cancel_Door_Open" 78 "HAS_ACC_Cancel_Seatbelt_Unbuckled" 79 "HAS_ACC_Cancel_Road_to_Steep" 80 "HAS_ACC_Cancel_Low_RPM" 81 "HAS_ACC_Cancel_High_RPM" 82 "HAS_ACC_Stop_Vehicle_Object_Detected" 83 "HAS_ACC_User_Enabled" 84 "HAS_ACC_Set" 85 "LKA_Off_Check" 86 "HAS_Curve_Too_Tight" 87 "HAS_Lane_Split" 88 "HAS_On_Reminder" 89 "HAS_ACC_Unavail_Corsa" 90 "LKA_Unavail_Corsa" 91 "HAS_ACC_Unavailable_Off_Road" 92 "BSS_Unavail_Corsa" 93 "BSS_Trailer_On" 94 "BSS_Trailer_Max" 95 "ADAS_Unavailable_Snow_Plow_Detected" 96 "HF_ADA_Set" 97 "Ready_No_Road_HF" 98 "Adjust_Seat_State_2" 99 "Drowsy_State_2" 100 "HF_To_HO_Generic" 101 "HF_To_HO_Hwy_Ending" 102 "HF_Cancel_Not_Attentive" 103 "DA_Set_HF_Service" 104 "Stay_In_Lane" 105 "ALM_Unavail_ESC_Off" 106 "ALM_Off_ESC_Off" 107 "HAS_ACC_Unavail_HDC" 108 "HAS_ACC_AEB_Cancel_Off_Road" 109 "HAS_ACC_Cancel_Off_Road" 110 "HAS_Only_Fail" 111 "HAS_Only_ALM_Fail" 112 "MRM_Complete_Shift_P" 113 "HAS_Eyes_Off_Red" 114 "LKA_Cancel_Hands_Off" 115 "Change_Lane_To_Follow_the_Route" 116 "Route_Lane_Guidance_Aborted_Chime" 117 "Route_Lane_Guidance_Aborted_No_Chime" 118 "HAS_Unavailable_Race";
VAL_ 1456 LF_Chime_RqSts 0 "No_Request" 1 "Request";
VAL_ 1456 LKA_Blind 0 "Fail_Not_Present" 1 "Fail_Present";
VAL_ 1456 LKA_FailSts 0 "Fail_Not_Present" 1 "Fail_Present";
VAL_ 1456 LKA_LEDControlSts 0 "OFF" 1 "CONT" 2 "BLINK" 3 "SNA";
VAL_ 1456 LKA_Status 0 "OFF" 1 "ON";
VAL_ 1456 LKA_Telltale 0 "No_Req" 1 "White" 2 "Green" 3 "Yellow" 4 "Yellow_Flashing";
VAL_ 1456 LR_Chime_RqSts 0 "No_left_rear_chime_on_req" 1 "Left_rear_chime_on_req";
VAL_ 1456 NCC_FailSts 0 "Fail_Not_Present" 1 "Fail_Present";
VAL_ 1456 PEB_Setting_Avail 0 "Available" 1 "Not_Available";
VAL_ 1456 RF_Chime_RqSts 0 "No_Request" 1 "Request";
VAL_ 1456 RR_Chime_RqSts 0 "No_rght_rear_chime_on_req" 1 "Right_rear_chime_on_req";
VAL_ 1456 RRCC_DispPopupSts 0 "No_Code";
VAL_ 1456 RRCC_LEDSts 0 "OFF" 1 "Cont" 2 "Blink" 3 "SNA";
VAL_ 1456 Set_Speed_KPH 255 "SNA";
VAL_ 1456 Set_Speed_MPH 255 "SNA";
VAL_ 1456 SVI_Request 0 "OFF" 1 "Green" 2 "YELLOW" 3 "Red";
VAL_ 1458 ACC_FailSts_C2 0 "Fail_Not_Present" 1 "Fail_Present";
VAL_ 1458 SVI_Request_C2 0 "OFF" 1 "Green" 2 "YELLOW" 3 "Red";
VAL_ 280 ACC_Drive_Cmd 0 "Not_Enabled" 1 "Enabled";
VAL_ 280 ACC_DsrSpeedKPH 255 "SNA";
VAL_ 280 ACC_StopStart 0 "DEFAULT" 1 "AutoStop_Allowed" 2 "AutoStart_Allowed" 3 "SNA";
VAL_ 280 ACC_Systemsts 0 "OFF" 1 "ACC_Enabled" 2 "ACC_Engaged" 3 "ACC_Engaged_BrakeOnly" 4 "ACC_Cancel" 5 "NCC_Enabled" 6 "NCC_Engaged" 7 "NCC_Cancel" 8 "HAS_BSoC" 9 "RRCC_Enabled_No_Set_Speed" 10 "RRCC_Enabled_With_Set_Speed" 11 "RRCC_Engaged" 15 "SNA";
VAL_ 280 AEB_Sensitivity_Setting 0 "NEAR" 1 "MEDIUM" 2 "FAR";
VAL_ 280 AEB_Systemsts 0 "FCW_Off" 1 "FCW_On_Only_Warning" 2 "FCW_On_Full";
VAL_ 280 AEB_Type 0 "NONE" 1 "ACC" 2 "CMS" 3 "CMS_XTD" 4 "ABA" 5 "LSCM" 6 "PEB" 7 "ICA_L" 8 "ICA_R" 9 "HAS_MRM" 10 "RRCC" 15 "SNA";
VAL_ 280 BlindSpot_TrailerSts 0 "NONE" 1 "TRAILER_0_3" 2 "TRAILER_3_6" 3 "TRAILER_6_9" 4 "TRAILER_MAX" 5 "TRAILER_AUTO" 7 "SNA";
VAL_ 280 Brake_Jerk_Req 0 "Not_Active" 1 "Active";
VAL_ 280 CADM_OpStat 0 "Inactive" 1 "FullService" 2 "FailOperational" 3 "FailDegraded" 4 "Emergency" 5 "No_Function";
VAL_ 280 CADM2_EPSSEC_FAIL 0 "False" 1 "True";
VAL_ 280 CIPV_Fused 0 "Not_Active" 1 "Active";
VAL_ 280 DDD_Setting_Avail 0 "Available" 1 "Not_Available";
VAL_ 280 DDD_SystemSts 0 "OFF" 1 "ON";
VAL_ 280 ESA_FailSts 0 "False" 1 "True";
VAL_ 280 ESA_LaneClear_Status 0 "NONE" 1 " Left_Clear" 2 "Right_Clear" 3 "Both_Clear" 4 "Neither-Clear" 5 "Undetermined" 7 "SNA";
VAL_ 280 ESA_LAT_CTRL_RequestSts 0 "No_Request" 1 "ESA_Request" 2 "Faulted" 3 "SNA";
VAL_ 280 ESASystemSts 0 "Not_Enabled" 1 "Pending" 2 "Pre_Active" 3 "Active" 4 "Locked" 5 "Temporarily_Not_Avail" 6 "Permanently_Not_Available" 7 "SNA";
VAL_ 280 ESCALATION_TYPE 0 "None" 1 "Driver_Inattention" 2 "Low_Urgency" 3 "Med_Urgency" 4 "High_Urgency";
VAL_ 280 GrMax_Rq_ACC 0 "Passive" 1 "G1" 2 "G2" 3 "G3" 4 "G4" 5 "G5" 6 "G6" 7 "G7" 8 "G8" 9 "G9" 10 "G10" 11 "G11" 12 "G12" 13 "G13" 14 "G14" 15 "G15";
VAL_ 280 HAS_LAT_CTRL_RequestSts 0 "Idle" 1 "Faulted" 2 "HAS_Request";
VAL_ 280 HAS_OpStat_Prim 0 "Inactive" 1 "FullService" 2 "FailOperational" 3 "FailDegraded" 4 "Emergency" 5 "No_Function";
VAL_ 280 HAS_Status 0 "Disabled" 1 "Enabled" 2 "Engaged" 3 "Faulted";
VAL_ 280 HIS_Req 0 "Not_Active" 1 "Active";
VAL_ 280 Intervention 4095 "SNA";
VAL_ 280 LANE_CHANGE_SIDE 0 "NO_CHNG" 1 "RIGHT" 2 "LEFT";
VAL_ 280 LANE_CHANGE_STATUS 0 "NO_CHNG" 1 "PEND" 2 "EARLY1" 3 "EARLY2" 4 "LATE" 5 "ABORTING" 6 "ABORTED" 7 "COMPL" 8 "LOCKOUT" 9 "CANCELLING" 10 "CANCELLED" 11 "Msg_11" 12 "Msg_12" 13 "Msg_13" 14 "Msg_14" 15 "SNA";
VAL_ 280 LC_Jerk 0 "Not_Active" 1 "Active";
VAL_ 280 LKA_LAT_CTRL_RequestSts 0 "Idle" 1 "Faulted" 2 "LKA_Request";
VAL_ 280 MRM_STATUS 0 "Not_Active" 1 "MRM_in_Process" 2 "Vehicle_Secure_Request" 3 "Vehicle_Securement_Complete" 4 "Canceled" 7 "SNA";
VAL_ 280 Object_Dist 255 "SNA";
VAL_ 280 PEB_SystemSts 0 "OFF" 1 "ON";
VAL_ 280 Prefill_Req 0 "No_Prefill_Requested" 1 "Prefill_Requested";
VAL_ 280 SeatVib_Req 0 "No_Request" 1 "Type_1" 2 "Type_2" 3 "Type_3" 4 "Type_4";
VAL_ 280 SteeringVibration_Rq 0 "NOT_REQUESTED" 1 "REQUESTED";
VAL_ 280 SteeringVibration_Type 0 "TYPE_0" 1 "TYPE_1" 2 "TYPE_2" 3 "TYPE_3" 4 "TYPE_4" 5 "TYPE_5" 6 "TYPE_6" 7 "TYPE_7" 8 "TYPE_8" 9 "TYPE_9" 10 "TYPE_10" 11 "TYPE_11" 15 "SNA";
VAL_ 281 ACC_Systemsts_C2 0 "OFF" 1 "ACC_Enabled" 2 "ACC_Engaged" 3 "ACC_Engaged_BrakeOnly" 4 "ACC_Cancel" 5 "NCC_Enabled" 6 "NCC_Engaged" 7 "NCC_Cancel" 8 "HAS_BSoC" 15 "SNA";
VAL_ 281 AEB_Type_C2 0 "NONE" 1 "ACC" 2 "CMS" 3 "CMS_XTD" 4 "ABA" 5 "LSCM" 6 "PEB" 7 "ICA_L" 8 "ICA_R" 9 "HAS_MRM" 15 "SNA";
VAL_ 281 CADM2_Mode 0 "Gate" 1 "Control";
VAL_ 281 HAS_Status_C2 0 "Disabled" 1 "Enabled" 2 "Engaged" 3 "Faulted";
VAL_ 281 HIS_Req_C2 0 "Not_Active" 1 "Active";
VAL_ 281 Intervention_C2 4095 "SNA";
VAL_ 281 MRM_STATUS_C2 0 "Not_Active" 1 "MRM_in_Process" 2 "Vehicle_Secure_Request" 3 "Vehicle_Securement_Complete" 4 "Canceled" 7 "SNA";
VAL_ 610 AHB_Blind 0 "OFF" 1 "ON";
VAL_ 610 AHB_ON 0 "OFF" 1 "ON";
VAL_ 610 AHBFault 0 "OFF" 1 "ON";
VAL_ 610 DALM_Request 0 "No_Req" 1 "Yellow_Solid" 2 "Yellow_Runway" 3 "Red_Solid" 4 "Red_Runway" 5 "Blue_Solid" 6 "Blue_Runway" 7 "Green_Solid" 15 "SNA";
VAL_ 610 HAS_OpStat_Prim_DALM 0 "Inactive" 1 "FullService" 2 "FailOperational" 3 "FailDegraded" 4 "Emergency" 5 "No_Function";
VAL_ 610 HAS_Status_DALM 0 "Disabled" 1 "Enabled" 2 "Engaged" 3 "Faulted";
VAL_ 610 HAS_ValidRoad 0 "False" 1 "True";
VAL_ 610 SignOvertaking 0 "Sign_Not_Detected" 1 "Overtaking" 2 "No_Overtaking";
VAL_ 610 SignSupplemVehicleSpeedLimit 0 "Sign_Not_Detected" 1 "Generic_Sign" 2 "Fog" 3 "Rain" 4 "Snow" 5 "Trailer" 6 "Time" 7 "Right_Arrow" 8 "Left_Arrow" 9 "School_Zone" 10 "Work_Zone" 11 "Night" 15 "End_Limit";
VAL_ 610 SignVehicleSpeedLimit 0 "Sign_Not_Detected" 1 "Speed_Limit_5" 2 "Speed_Limit_10" 3 "Speed_Limit_15" 4 "Speed_Limit_20" 5 "Speed_Limit_25" 6 "Speed_Limit_30" 7 "Speed_Limit_35" 8 "Speed_Limit_40" 9 "Speed_Limit_45" 10 "Speed_Limit_50" 11 "Speed_Limit_55" 12 "Speed_Limit_60" 13 "Speed_Limit_65" 14 "Speed_Limit_70" 15 "Speed_Limit_75" 16 "Speed_Limit_80" 17 "Speed_Limit_85" 18 "Speed_Limit_90" 19 "Speed_Limit_95" 20 "Speed_Limit_100" 21 "Speed_Limit_105" 22 "Speed_Limit_110" 23 "Speed_Limit_115" 24 "Speed_Limit_120" 25 "Speed_Limit_125" 26 "Speed_Limit_130" 27 "Speed_Limit_135" 28 "Speed_Limit_140" 29 "Speed_Limit_145" 62 "Speed_Limit_Unlimited" 63 "End_Speed_Limit";
VAL_ 610 SignVehicleSpeedLimitConditional 0 "Sign_Not_Detected" 1 "Speed_Limit_5" 2 "Speed_Limit_10" 3 "Speed_Limit_15" 4 "Speed_Limit_20" 5 "Speed_Limit_25" 6 "Speed_Limit_30" 7 "Speed_Limit_35" 8 "Speed_Limit_40" 9 "Speed_Limit_45" 10 "Speed_Limit_50" 11 "Speed_Limit_55" 12 "Speed_Limit_60" 13 "Speed_Limit_65" 14 "Speed_Limit_70" 15 "Speed_Limit_75" 16 "Speed_Limit_80" 17 "Speed_Limit_85" 18 "Speed_Limit_90" 19 "Speed_Limit_95" 20 "Speed_Limit_100" 21 "Speed_Limit_105" 22 "Speed_Limit_110" 23 "Speed_Limit_115" 24 "Speed_Limit_120" 25 "Speed_Limit_125" 26 "Speed_Limit_130" 27 "Speed_Limit_135" 28 "Speed_Limit_140" 29 "Speed_Limit_145" 62 "Speed_Limit_Unlimited" 63 "End_Speed_Limit";
VAL_ 610 SourceFusedSpeedLimit 0 "None" 1 "Camera" 2 "Map" 3 "Camera_and_Map";
VAL_ 610 SpdUnits_Cam 0 "km_h" 1 "mph";
VAL_ 610 Speed_Sign_Shape 0 "Not_Detected" 1 "Shape_1_Square" 2 "Shape_2_Round" 3 "TBD";
VAL_ 610 TSRSts 0 "Not_Active" 1 "Active" 2 "Blinded" 3 "Fault";
VAL_ 610 Turn_Lever_Unlatch_Req 0 "No_Request" 1 "Unlatch_Requested" 3 "SNA";
VAL_ 1316 OffRd_FL_Lvl 510 "NOT_INIT" 511 "SNA";
VAL_ 1316 OffRd_FR_Lvl 510 "NOT_INIT" 511 "SNA";
VAL_ 1316 OffRd_RL_Lvl 510 "NOT_INIT" 511 "SNA";
VAL_ 1316 OffRd_RR_Lvl 510 "NOT_INIT" 511 "SNA";
VAL_ 201 FL_Lvl_RawAD_Src 4095 "SNA";
VAL_ 201 FL_Lvl_Stat_Src 0 "No_Fault" 1 "Faulted" 2 "Implausible" 3 "SNA";
VAL_ 201 FL_Z_Accel_Stat_Src 0 "No_Fault" 1 "Faulted" 2 "Implausible" 3 "Initialization" 6 "Startup" 7 "SNA";
VAL_ 201 FR_Lvl_RawAD_Src 4095 "SNA";
VAL_ 201 FR_Lvl_Stat_Src 0 "No_Fault" 1 "Faulted" 2 "Implausible" 3 "SNA";
VAL_ 201 FR_Z_Accel_Stat_Src 0 "No_Fault" 1 "Faulted" 2 "Implausible" 3 "Initialization" 6 "Startup" 7 "SNA";
VAL_ 201 RC_Z_Accel_Stat_Src 0 "No_Fault" 1 "Faulted" 2 "Implausible" 3 "Initialization" 6 "Startup" 7 "SNA";
VAL_ 201 RL_Lvl_RawAD_Src 4095 "SNA";
VAL_ 201 RL_Lvl_Stat_Src 0 "No_Fault" 1 "Faulted" 2 "Implausible" 3 "SNA";
VAL_ 201 RR_Lvl_RawAD_Src 4095 "SNA";
VAL_ 201 RR_Lvl_Stat_Src 0 "No_Fault" 1 "Faulted" 2 "Implausible" 3 "SNA";
VAL_ 201 Z_Acceleration_FL_Src 1023 "SNA";
VAL_ 201 Z_Acceleration_FR_Src 1023 "SNA";
VAL_ 201 Z_Acceleration_RC_Src 1023 "SNA";
VAL_ 476 APCM_Stat 0 "OFF" 1 "ON" 2 "PENDING" 3 "SNA";
VAL_ 476 PRNDdisplayFailSts 0 "Fail_not_present" 1 "Fail_present";
VAL_ 476 PRNDFailSts 0 "Fail_Not_Present" 1 "Fail_Present";
VAL_ 476 Shifter_ADAS_Inhibit 0 "Faulted" 1 "Available";
VAL_ 476 ShiftLever_PositionFlt 0 "No Fault" 1 "Fault";
VAL_ 476 ShiftLeverPositionReq 0 "No_Selection_Active_Or_Available" 1 "P" 2 "R" 3 "N" 4 "D" 5 "L" 6 "TIP_Autostick" 7 "Plus" 8 "Minus" 9 "Sport" 10 "Not_Used" 11 "Not_Used" 12 "Not_Used" 13 "Not_Used" 14 "Not_Used" 15 "SNA";
VAL_ 476 ShiftLockFailSts 0 "Fail_not_Present" 1 "Fail_Present";
VAL_ 476 WarningMessages 0 "No_Warning" 1 "Stop Vehicle to Shift" 2 "Service Transmission__Stop vehicle_Restart Vehicle in P to Continue Driving" 3 "Service Transmission_Stop Vehicle to Shift_Restart Vehicle in P to Continue Driving" 4 "Service Transmission_Stop Vehicle to Shift" 5 "Service_Shifter" 6 "Release Shifter Knob (dial) And Press Brake to Shift Into Gear" 7 "SNA";
VAL_ 1327 FL_Lvl 254 "NOT_INIT" 255 "SNA";
VAL_ 1327 FL_Lvl_Adj 1 "Adjusting";
VAL_ 1327 FR_Lvl 254 "NOT_INIT" 255 "SNA";
VAL_ 1327 FR_Lvl_Adj 1 "Adjusting";
VAL_ 1327 RL_Lvl 254 "NOT_INIT" 255 "SNA";
VAL_ 1327 RL_Lvl_Adj 1 "Adjusting";
VAL_ 1327 RR_Lvl 254 "NOT_INIT" 255 "SNA";
VAL_ 1327 RR_Lvl_Adj 1 "Adjusting";
VAL_ 1445 ADC_Stat_2 0 "MODE_1" 1 "MODE_2" 2 "MODE_3" 3 "MODE_4" 4 "MODE_4" 5 "MODE_5" 6 "MODE_6" 7 "SNA";
VAL_ 1445 ADS_SrvSys 0 "FALSE" 1 "TRUE";
VAL_ 1445 ASCM_HMI_Stat 0 "NONE" 1 "ASCM_RedSpd" 2 "ASCM_LvlnPrmt" 3 "ASCM_Cooldn" 4 "ASCM_Dr" 5 "ASCM_Srv" 6 "ASCM_SysFail" 7 "ASCM_VLSt" 8 "ASCM_TJM_Disp" 9 "ASCM_LowClr" 10 "ASCM_Highlr" 11 "ASCM_TM_Disp" 12 "ASCM_WAL_Disp" 14 "ASCM_AeroDslb" 15 "ASCM_LNP_Speed" 16 "ASCM_LNP_MaxPayload" 17 "ASCM_LNP_Minload" 18 "ASCM_LNP_LimitedPayload" 19 "ASCM_BDL_Enbl" 20 "ASCM_BDL_Complete" 21 "ASCM_BDL_Unsucc" 22 "ASCM_EEHNA" 23 "ASCM_START_STOP" 24 "ASCM_PARK" 25 "ASCM_AERO" 26 "ASCM_NVL" 27 "ASCM_OR1" 28 "ASCM_ORL2" 29 "ASCM_PSS" 30 "OFFROAD_HEIGHT_AUTO_TERRAIN" 31 "SNA";
VAL_ 1445 ASCM_RemStat 0 "NONE" 1 "ACTIVE" 2 "DISABLE" 3 "SNA";
VAL_ 1445 ASCM_Srv 0 "FALSE" 1 "TRUE";
VAL_ 1445 ASCM_Stat 0 "NONE" 1 "DUMP" 2 "PARK" 3 "AERO" 4 "NVL" 5 "OR1" 6 "ORL2" 7 "Lifter" 8 "RAISE" 9 "LOWER" 10 "SYSFAIL" 11 "SRVS" 12 "AERO2" 15 "SNA";
VAL_ 1445 ASCM_StatDisp 0 "NONE" 1 "DUMP" 2 "PARK" 3 "AERO" 4 "NVL" 5 "OR1" 6 "ORL2" 7 "Lifter" 8 "RAISE" 9 "LOWER" 10 "BDL" 11 "AERO2" 12 "AUTOMATIC_LEVEL_ONLY" 15 "SNA";
VAL_ 1445 ASCM_SysFail 0 "FALSE" 1 "TRUE";
VAL_ 1445 ASCM_SYSFAIL_HMI 0 "None" 1 "ASCM_Sysfail_OR1" 2 "ASCM_Sysfail_ORL2" 3 "Not_Used";
VAL_ 1445 Loading_Lv 0 "LND" 1 "LIGHT" 2 "FULL" 3 "OVERLOAD_1" 4 "OVERLOAD_2" 5 "PROTECTION" 6 "MIP" 7 "SNA";
VAL_ 1445 Tgt_Level 0 "TR_Dump" 1 "Park" 2 "AERO" 3 "STD" 4 "OR1" 5 "ORL2" 6 "AERO2" 7 "SNA";
VAL_ 1445 TJM_Enbl 0 "FALSE" 1 "TRUE";
