VERSION ""

NS_ :

BS_:

BU_: AGSM BCM BSM CADM DMSM DTCM ECM EVCU2 GNMM HCP IPC RFHM SGW TCM
BO_ 1831 IPC_FD_3: 32 IPC
 SG_ ABS_IND_STAT : 83|2@0+ (1,0) [0|3] "" SGW
 SG_ ACC_WARN_STAT : 9|2@0+ (1,0) [0|3] "" SGW
 SG_ AIR_BAG_STAT : 11|2@0+ (1,0) [0|3] "" SGW
 SG_ AWD_IND_STAT : 141|2@0+ (1,0) [0|3] "" SGW
 SG_ AWD_SERVICE_STAT : 133|2@0+ (1,0) [0|3] "" SGW
 SG_ BATTERY_CHARGE_STAT : 73|2@0+ (1,0) [0|3] "" SGW
 SG_ BRAKE_PAD_STAT : 123|2@0+ (1,0) [0|3] "" SGW
 SG_ BRK_IND_STAT : 85|2@0+ (1,0) [0|3] "" SGW
 SG_ CARGO_LT_STAT : 137|2@0+ (1,0) [0|3] "" SGW
 SG_ CATALYST_TEMP_STAT : 99|2@0+ (1,0) [0|3] "" SGW
 SG_ COOLENT_LEVEL_STAT : 115|2@0+ (1,0) [0|3] "" SGW
 SG_ CRUISE_SET_STAT : 139|2@0+ (1,0) [0|3] "" SGW
 SG_ DAMPING_SYSTEM_STAT : 125|2@0+ (1,0) [0|3] "" SGW
 SG_ DEF_STAT : 119|2@0+ (1,0) [0|3] "" SGW
 SG_ DOORS_STAT : 151|2@0+ (1,0) [0|3] "" SGW
 SG_ ECO_MODE_STAT : 13|2@0+ (1,0) [0|3] "" SGW
 SG_ ELEC_STAB_STAT : 91|2@0+ (1,0) [0|3] "" SGW
 SG_ ELECTRIC_WRENCH_STAT : 129|2@0+ (1,0) [0|3] "" SGW
 SG_ ENGINE_MIL_STAT : 81|2@0+ (1,0) [0|3] "" SGW
 SG_ ENGINE_TEMP_STAT : 75|2@0+ (1,0) [0|3] "" SGW
 SG_ EPB_WARN_STAT : 131|2@0+ (1,0) [0|3] "" SGW
 SG_ EPS_STAT : 101|2@0+ (1,0) [0|3] "" SGW
 SG_ ESC_OFF_STAT : 147|2@0+ (1,0) [0|3] "" SGW
 SG_ ETC_CONTROL_STAT : 93|2@0+ (1,0) [0|3] "" SGW
 SG_ EXH_BRK_STAT : 171|2@0+ (1,0) [0|3] "" SGW
 SG_ FCW_SYSTEM_STAT : 111|2@0+ (1,0) [0|3] "" SGW
 SG_ FOUR_WD_SERVICE_STAT : 121|2@0+ (1,0) [0|3] "" SGW
 SG_ FT_FOG_STAT : 145|2@0+ (1,0) [0|3] "" SGW
 SG_ FUEL_CAP_STAT : 97|2@0+ (1,0) [0|3] "" SGW
 SG_ FUEL_CUT_OFF_STAT : 159|2@0+ (1,0) [0|3] "" SGW
 SG_ HDLT_LVL_STAT : 157|2@0+ (1,0) [0|3] "" SGW
 SG_ HI_BEAM_STAT : 153|2@0+ (1,0) [0|3] "" SGW
 SG_ HILL_DESCENT_STAT : 167|2@0+ (1,0) [0|3] "" SGW
 SG_ HVY_EXH_STAT : 155|2@0+ (1,0) [0|3] "" SGW
 SG_ LANE_DEPART_FAIL_STAT : 163|2@0+ (1,0) [0|3] "" SGW
 SG_ LANE_DEPART_STAT : 165|2@0+ (1,0) [0|3] "" SGW
 SG_ LANE_SENSE_STAT : 135|2@0+ (1,0) [0|3] "" SGW
 SG_ LIFT_GATE_STAT : 161|2@0+ (1,0) [0|3] "" SGW
 SG_ LT_EXH_STAT : 175|2@0+ (1,0) [0|3] "" SGW
 SG_ NAT_GAS_STAT : 173|2@0+ (1,0) [0|3] "" SGW
 SG_ OIL_LEVEL_STAT : 127|2@0+ (1,0) [0|3] "" SGW
 SG_ OIL_PRESSURE_STAT : 87|2@0+ (1,0) [0|3] "" SGW
 SG_ OIL_TEMP_STAT : 117|2@0+ (1,0) [0|3] "" SGW
 SG_ OVER_TEMP_STAT : 89|2@0+ (1,0) [0|3] "" SGW
 SG_ PARK_BRAKE_STAT : 149|2@0+ (1,0) [0|3] "" SGW
 SG_ POS_LIGHT_STAT : 169|2@0+ (1,0) [0|3] "" SGW
 SG_ SEAT_BELT_STAT : 183|2@0+ (1,0) [0|3] "" SGW
 SG_ SERVICE_ACC_STAT : 107|2@0+ (1,0) [0|3] "" SGW
 SG_ SERVICE_STAT : 113|2@0+ (1,0) [0|3] "" SGW
 SG_ SPEED_CTRL_STAT : 181|2@0+ (1,0) [0|3] "" SGW
 SG_ SPEED_LMT_STAT : 7|2@0+ (1,0) [0|3] "" SGW
 SG_ STOP_START_STAT : 103|2@0+ (1,0) [0|3] "" SGW
 SG_ STR_DIR_LT_STAT : 5|2@0+ (1,0) [0|3] "" SGW
 SG_ THEFT_ALARM_STAT : 15|2@0+ (1,0) [0|3] "" SGW
 SG_ TIRE_PRESSURE_STAT : 95|2@0+ (1,0) [0|3] "" SGW
 SG_ TORQUE_STAT : 143|2@0+ (1,0) [0|3] "" SGW
 SG_ TOW_HAUL_STAT : 3|2@0+ (1,0) [0|3] "" SGW
 SG_ TRK_OPN_STAT : 1|2@0+ (1,0) [0|3] "" SGW
 SG_ WATER_IN_FUEL_STAT : 105|2@0+ (1,0) [0|3] "" SGW
 SG_ WINDSHIELD_FLUID_STAT : 109|2@0+ (1,0) [0|3] "" SGW

BO_ 600 IPC_FD_4: 32 IPC
 SG_ AirBagLamp_FailSts : 143|2@0+ (1,0) [0|3] "-" BCM,SGW
 SG_ DisplayedSpeedLimSts : 119|8@0+ (1,0) [0|255] "" EVCU2,SGW
 SG_ OilChgRst : 162|1@0+ (1,0) [0|1] "" ECM

BO_ 1154 IPC_FD_5: 32 IPC
 SG_ Est_Range_Disp : 7|8@0+ (1,0) [0|254] "-" SGW
 SG_ Est_Range_Disp_Long : 119|11@0+ (1,0) [0|2047] "km,mi" SGW
 SG_ VehSpd_MPH : 93|1@0+ (1,0) [0|1] "" SGW
 SG_ VehSpdDisp : 103|16@0+ (1,0) [0|65534] "-" SGW

BO_ 1432 IPC_FD_6: 32 IPC
 SG_ AverageFuelConsumptionAPlus : 105|10@0+ (0.1,0) [0|102.3] "km/l, l/100km, km/kWh, or kWh/100km" SGW
 SG_ AverageFuelConsumptionBPlus : 121|10@0+ (0.1,0) [0|102.3] "km/l, l/100km, km/kWh, or kWh/100km" SGW
 SG_ CRC_IPC6 : 191|8@0+ (1,0) [0|255] "-" BCM,CADM
 SG_ HAS_SoH_IPC : 76|1@0+ (1,0) [0|1] "" BCM,CADM
 SG_ MessageCounter_IPC6 : 179|4@0+ (1,0) [0|15] "-" BCM,CADM
 SG_ PartialOdometerAPlus : 75|20@0+ (0.1,0) [0|104857.5] "km or mi." SGW
 SG_ PartialOdometerBPlus : 27|20@0+ (0.1,0) [0|104857.5] "km or mi." SGW
 SG_ PowerMode_RQ : 4|3@0+ (1,0) [0|6] "" BCM
 SG_ TravelingTimeAPlus_Hour : 137|10@0+ (1,0) [0|1023] "Hour" SGW
 SG_ TravelingTimeAPlus_Minute : 127|6@0+ (1,0) [0|63] "Minute" SGW
 SG_ TravelingTimeAPlus_Second : 111|6@0+ (1,0) [0|63] "Second" SGW
 SG_ TravelingTimeBPlus_Hour : 161|10@0+ (1,0) [0|1023] "Hour" SGW
 SG_ TravelingTimeBPlus_Minute : 167|6@0+ (1,0) [0|63] "Minute" SGW
 SG_ TravelingTimeBPlus_Second : 143|6@0+ (1,0) [0|63] "Second" SGW

BO_ 1897 IPC_FD_7: 48 IPC
 SG_ VehPerfAccelPeak_X_Neg : 21|9@0+ (0.08,0) [0|40.88] "m/s2" SGW
 SG_ VehPerfAccelPeak_X_Pos : 7|9@0+ (0.08,0) [0|40.88] "m/s2" SGW
 SG_ VehPerfAccelPeak_Y_Neg : 14|9@0+ (0.08,0) [0|40.88] "m/s2" SGW
 SG_ VehPerfAccelPeak_Y_Pos : 28|9@0+ (0.08,0) [0|40.88] "m/s2" SGW

BO_ 604 IPC_SRT_FD_1: 64 IPC
 SG_ SRT_100mphTm_B : 111|8@0+ (0.1,0) [0|25.1] "sec" SGW
 SG_ SRT_100mphTm_C : 103|8@0+ (0.1,0) [0|25.1] "sec" SGW
 SG_ SRT_100mphTm_L : 119|8@0+ (0.1,0) [0|25.1] "sec" SGW
 SG_ SRT_100mphTmB : 135|8@0+ (0.1,0) [0|25.1] "sec" SGW
 SG_ SRT_100mphTmC : 127|8@0+ (0.1,0) [0|25.1] "sec" SGW
 SG_ SRT_100mphTmL : 143|8@0+ (0.1,0) [0|25.1] "sec" SGW
 SG_ SRT_60mphTm_B : 87|8@0+ (0.1,0) [0|25.1] "sec" SGW
 SG_ SRT_60mphTm_C : 79|8@0+ (0.1,0) [0|25.1] "sec" SGW
 SG_ SRT_60mphTm_L : 95|8@0+ (0.1,0) [0|25.1] "sec" SGW
 SG_ SRT_60mphTmB : 63|8@0+ (0.1,0) [0|25.1] "sec" SGW
 SG_ SRT_60mphTmC : 55|8@0+ (0.1,0) [0|25.1] "sec" SGW
 SG_ SRT_60mphTmL : 71|8@0+ (0.1,0) [0|25.1] "sec" SGW
 SG_ SRT_BrkTm_B : 375|8@0+ (0.1,0) [0|25.1] "sec" SGW
 SG_ SRT_BrkTm_C : 367|8@0+ (0.1,0) [0|25.1] "sec" SGW
 SG_ SRT_BrkTm_L : 383|8@0+ (0.1,0) [0|25.1] "sec" SGW
 SG_ SRT_BrkTmB : 351|8@0+ (0.1,0) [0|25.1] "sec" SGW
 SG_ SRT_BrkTmC : 343|8@0+ (0.1,0) [0|25.1] "sec" SGW
 SG_ SRT_BrkTmL : 359|8@0+ (0.1,0) [0|25.1] "sec" SGW
 SG_ SRT_eighthTm_B : 183|8@0+ (0.1,0) [0|25.1] "sec" SGW
 SG_ SRT_eighthTm_C : 175|8@0+ (0.1,0) [0|25.1] "sec" SGW
 SG_ SRT_eighthTm_L : 191|8@0+ (0.1,0) [0|25.1] "sec" SGW
 SG_ SRT_eighthTmB : 159|8@0+ (0.1,0) [0|25.1] "sec" SGW
 SG_ SRT_eighthTmC : 151|8@0+ (0.1,0) [0|25.1] "sec" SGW
 SG_ SRT_eighthTmL : 167|8@0+ (0.1,0) [0|25.1] "sec" SGW
 SG_ SRT_EthSpdB_M : 255|8@0+ (1,0) [0|254] "km/h" SGW
 SG_ SRT_EthSpdB_US : 279|8@0+ (1,0) [0|254] "mph" SGW
 SG_ SRT_EthSpdC_M : 247|8@0+ (1,0) [0|254] "km/h" SGW
 SG_ SRT_EthSpdC_US : 271|8@0+ (1,0) [0|254] "mph" SGW
 SG_ SRT_EthSpdL_M : 263|8@0+ (1,0) [0|254] "km/h" SGW
 SG_ SRT_EthSpdL_US : 287|8@0+ (1,0) [0|254] "mph" SGW
 SG_ SRT_QrtSpdB_M : 303|8@0+ (1,0) [0|254] "km/h" SGW
 SG_ SRT_QrtSpdB_US : 327|8@0+ (1,0) [0|254] "mph" SGW
 SG_ SRT_QrtSpdC_M : 295|8@0+ (1,0) [0|254] "km/h" SGW
 SG_ SRT_QrtSpdC_US : 319|8@0+ (1,0) [0|254] "mph" SGW
 SG_ SRT_QrtSpdL_M : 311|8@0+ (1,0) [0|254] "km/h" SGW
 SG_ SRT_QrtSpdL_US : 335|8@0+ (1,0) [0|254] "mph" SGW
 SG_ SRT_quarterTm_B : 231|8@0+ (0.1,0) [0|25.1] "sec" SGW
 SG_ SRT_quarterTm_C : 223|8@0+ (0.1,0) [0|25.1] "sec" SGW
 SG_ SRT_quarterTm_L : 239|8@0+ (0.1,0) [0|25.1] "sec" SGW
 SG_ SRT_quarterTmB : 207|8@0+ (0.1,0) [0|25.1] "sec" SGW
 SG_ SRT_quarterTmC : 199|8@0+ (0.1,0) [0|25.1] "sec" SGW
 SG_ SRT_quarterTmL : 215|8@0+ (0.1,0) [0|25.1] "sec" SGW
 SG_ SRT_ReactTm_B : 39|8@0+ (0.01,-1.25) [-1.25|1.25] "sec" SGW
 SG_ SRT_ReactTm_C : 31|8@0+ (0.01,-1.25) [-1.25|1.25] "sec" SGW
 SG_ SRT_ReactTm_L : 47|8@0+ (0.01,-1.25) [-1.25|1.25] "sec" SGW
 SG_ SRT_ReactTmB : 15|8@0+ (0.01,-1.25) [-1.25|1.25] "sec" SGW
 SG_ SRT_ReactTmC : 7|8@0+ (0.01,-1.25) [-1.25|1.25] "sec" SGW
 SG_ SRT_ReactTmL : 23|8@0+ (0.01,-1.25) [-1.25|1.25] "sec" SGW

BO_ 605 IPC_SRT_FD_2: 64 IPC
 SG_ SRT_1000ftTm_B : 183|8@0+ (0.1,0) [0|25.1] "sec" SGW
 SG_ SRT_1000ftTm_C : 175|8@0+ (0.1,0) [0|25.1] "sec" SGW
 SG_ SRT_1000ftTm_L : 191|8@0+ (0.1,0) [0|25.1] "sec" SGW
 SG_ SRT_1000ftTmB : 159|8@0+ (0.1,0) [0|25.1] "sec" SGW
 SG_ SRT_1000ftTmC : 151|8@0+ (0.1,0) [0|25.1] "sec" SGW
 SG_ SRT_1000ftTmL : 167|8@0+ (0.1,0) [0|25.1] "sec" SGW
 SG_ SRT_330ftTm_B : 135|8@0+ (0.1,0) [0|25.1] "sec" SGW
 SG_ SRT_330ftTm_C : 127|8@0+ (0.1,0) [0|25.1] "sec" SGW
 SG_ SRT_330ftTm_L : 143|8@0+ (0.1,0) [0|25.1] "sec" SGW
 SG_ SRT_330ftTmB : 111|8@0+ (0.1,0) [0|25.1] "sec" SGW
 SG_ SRT_330ftTmC : 103|8@0+ (0.1,0) [0|25.1] "sec" SGW
 SG_ SRT_330ftTmL : 119|8@0+ (0.1,0) [0|25.1] "sec" SGW
 SG_ SRT_60ftTm_B : 224|9@0+ (0.01,0) [0|5.02] "sec" SGW
 SG_ SRT_60ftTm_C : 208|9@0+ (0.01,0) [0|5.02] "sec" SGW
 SG_ SRT_60ftTm_L : 240|9@0+ (0.01,0) [0|5.02] "sec" SGW
 SG_ SRT_60ftTmB : 256|9@0+ (0.01,0) [0|5.11] "sec" SGW
 SG_ SRT_60ftTmC : 272|9@0+ (0.01,0) [0|5.02] "sec" SGW
 SG_ SRT_60ftTmL : 192|9@0+ (0.01,0) [0|5.02] "sec" SGW
 SG_ SRT_BrkDistB_M : 15|8@0+ (1,0) [0|251] "m" SGW
 SG_ SRT_BrkDistB_US : 39|8@0+ (1,0) [0|251] "Yards" SGW
 SG_ SRT_BrkDistC_M : 7|8@0+ (1,0) [0|251] "m" SGW
 SG_ SRT_BrkDistC_US : 31|8@0+ (1,0) [0|251] "Yards" SGW
 SG_ SRT_BrkDistL_M : 23|8@0+ (1,0) [0|251] "m" SGW
 SG_ SRT_BrkDistL_US : 47|8@0+ (1,0) [0|251] "Yards" SGW
 SG_ SRT_BrkSpdB_M : 63|8@0+ (1,0) [0|254] "km/h" SGW
 SG_ SRT_BrkSpdB_US : 87|8@0+ (1,0) [0|254] "mph" SGW
 SG_ SRT_BrkSpdC_M : 55|8@0+ (1,0) [0|254] "km/h" SGW
 SG_ SRT_BrkSpdC_US : 79|8@0+ (1,0) [0|254] "mph" SGW
 SG_ SRT_BrkSpdL_M : 71|8@0+ (1,0) [0|254] "km/h" SGW
 SG_ SRT_BrkSpdL_US : 95|8@0+ (1,0) [0|254] "mph" SGW

CM_ SG_ 1831 ABS_IND_STAT "Anti-lock Brake System";
CM_ SG_ 1831 ACC_WARN_STAT "ACC Ready";
CM_ SG_ 1831 AIR_BAG_STAT "Air Bag";
CM_ SG_ 1831 AWD_IND_STAT "4WD Low Indicator";
CM_ SG_ 1831 AWD_SERVICE_STAT "Service AWD";
CM_ SG_ 1831 BATTERY_CHARGE_STAT "Battery Charge";
CM_ SG_ 1831 BRAKE_PAD_STAT "Brake Pad Failure";
CM_ SG_ 1831 BRK_IND_STAT "Parking Brake and Low Brake Fluid";
CM_ SG_ 1831 CARGO_LT_STAT "Cargo Light";
CM_ SG_ 1831 CATALYST_TEMP_STAT "Catalyst Overtemp";
CM_ SG_ 1831 COOLENT_LEVEL_STAT "Low Coolent Level";
CM_ SG_ 1831 CRUISE_SET_STAT "Cruise Set";
CM_ SG_ 1831 DAMPING_SYSTEM_STAT "Damping System Failure";
CM_ SG_ 1831 DEF_STAT "LowDieselExhaustFuel";
CM_ SG_ 1831 DOORS_STAT "Door(s) Open";
CM_ SG_ 1831 ECO_MODE_STAT "Eco Mode";
CM_ SG_ 1831 ELEC_STAB_STAT "Electronic Stability Control";
CM_ SG_ 1831 ELECTRIC_WRENCH_STAT "Electric Wrench";
CM_ SG_ 1831 ENGINE_MIL_STAT "Check Engine / MIL";
CM_ SG_ 1831 ENGINE_TEMP_STAT "Engine Temperature";
CM_ SG_ 1831 EPB_WARN_STAT "EPB Warning";
CM_ SG_ 1831 EPS_STAT "EPS Fail";
CM_ SG_ 1831 ESC_OFF_STAT "Electronic Stability Control off";
CM_ SG_ 1831 ETC_CONTROL_STAT "ETC(Electronic Throttle Control)";
CM_ SG_ 1831 EXH_BRK_STAT "Medium Exhaust Brake Mode";
CM_ SG_ 1831 FCW_SYSTEM_STAT "Service FCW System";
CM_ SG_ 1831 FOUR_WD_SERVICE_STAT "Service 4WD";
CM_ SG_ 1831 FT_FOG_STAT "Front Fog Lamps";
CM_ SG_ 1831 FUEL_CAP_STAT "Fuel Cap Unfastened";
CM_ SG_ 1831 FUEL_CUT_OFF_STAT "Fuel  Cut Off";
CM_ SG_ 1831 HDLT_LVL_STAT "Headlight Levelling";
CM_ SG_ 1831 HI_BEAM_STAT "High Beam";
CM_ SG_ 1831 HILL_DESCENT_STAT "Hill Descent Control";
CM_ SG_ 1831 HVY_EXH_STAT "Heavy Exhaust Brake mode";
CM_ SG_ 1831 LANE_DEPART_FAIL_STAT "Lane Departure Failure";
CM_ SG_ 1831 LANE_DEPART_STAT "Lane Departure";
CM_ SG_ 1831 LANE_SENSE_STAT "Lane Sense Failure";
CM_ SG_ 1831 LIFT_GATE_STAT "Lift Gate Open";
CM_ SG_ 1831 LT_EXH_STAT "Light Exhaust Brake Mode";
CM_ SG_ 1831 NAT_GAS_STAT "Low Compressed Natural Gas";
CM_ SG_ 1831 OIL_LEVEL_STAT "Oil Level";
CM_ SG_ 1831 OIL_PRESSURE_STAT "Oil Pressure";
CM_ SG_ 1831 OIL_TEMP_STAT "OilTemperature";
CM_ SG_ 1831 OVER_TEMP_STAT "Transmission Over Temperature";
CM_ SG_ 1831 PARK_BRAKE_STAT "Electronic Park Brake";
CM_ SG_ 1831 POS_LIGHT_STAT "Position Lights";
CM_ SG_ 1831 SEAT_BELT_STAT "Seat Belt";
CM_ SG_ 1831 SERVICE_ACC_STAT "Service ACC System";
CM_ SG_ 1831 SERVICE_STAT "Service";
CM_ SG_ 1831 SPEED_CTRL_STAT "SelectSpeedControlLamp";
CM_ SG_ 1831 SPEED_LMT_STAT "Speed Limiter Indicator";
CM_ SG_ 1831 STOP_START_STAT "Stop/Start Service";
CM_ SG_ 1831 STR_DIR_LT_STAT "Steering Directed Head Lights";
CM_ SG_ 1831 THEFT_ALARM_STAT "Vehicle Theft Alarm";
CM_ SG_ 1831 TIRE_PRESSURE_STAT "Tire pressure Monitoring";
CM_ SG_ 1831 TORQUE_STAT "Torque Limited";
CM_ SG_ 1831 TOW_HAUL_STAT "Tow/Haul";
CM_ SG_ 1831 TRK_OPN_STAT "Trunk Open";
CM_ SG_ 1831 WATER_IN_FUEL_STAT "Water In Fuel";
CM_ SG_ 1831 WINDSHIELD_FLUID_STAT "Windshield Water Fluid";
CM_ SG_ 600 AirBagLamp_FailSts "This signal is used to inform about the airbag warning light status";
CM_ SG_ 600 DisplayedSpeedLimSts "This signal indicates the road sign of vehicle speed limit displayed by IPC";
CM_ SG_ 600 OilChgRst "This signal sends the reset command via the EVIC.";
CM_ SG_ 1154 Est_Range_Disp "Estimated electric range for display";
CM_ SG_ 1154 Est_Range_Disp_Long "Estimate vehicle range";
CM_ SG_ 1154 VehSpd_MPH "Vehicle speed signal is in miles per hour format";
CM_ SG_ 1154 VehSpdDisp "Vehicle speed - displayed";
CM_ SG_ 1432 AverageFuelConsumptionAPlus "Used to give information about the average fuel consumption for Trip A.";
CM_ SG_ 1432 AverageFuelConsumptionBPlus "Used to give information about the average fuel consumption for Trip B.";
CM_ SG_ 1432 CRC_IPC6 "CRC according to SAE J1850 standard at each frame transmission.";
CM_ SG_ 1432 HAS_SoH_IPC "HAS SoH IPC";
CM_ SG_ 1432 MessageCounter_IPC6 "This signal is a counter used for safety checks strategies. This counter is incremented of 1 (one) unit at each frame transmission.";
CM_ SG_ 1432 PartialOdometerAPlus "Used to give information about the partial odometer for Trip A";
CM_ SG_ 1432 PartialOdometerBPlus "Used to give information about the partial odometer for Trip B.";
CM_ SG_ 1432 PowerMode_RQ "Power Mode Request";
CM_ SG_ 1432 TravelingTimeAPlus_Hour "Used to give information about hours of travel time for Trip A.";
CM_ SG_ 1432 TravelingTimeAPlus_Minute "Used to give information about minutes of travel time for Trip A.";
CM_ SG_ 1432 TravelingTimeAPlus_Second "Used to give information about seconds of travel time for Trip A";
CM_ SG_ 1432 TravelingTimeBPlus_Hour "Used to give information about hours of travel time for Trip B.";
CM_ SG_ 1432 TravelingTimeBPlus_Minute "Used to give information about minutes of travel time for Trip B.";
CM_ SG_ 1432 TravelingTimeBPlus_Second "Used to give information about seconds of travel time for Trip B";
CM_ SG_ 1897 VehPerfAccelPeak_X_Neg "Vehicle lateral acceleration peak (forward)";
CM_ SG_ 1897 VehPerfAccelPeak_X_Pos "Vehicle longitudinal acceleration peak (forward)";
CM_ SG_ 1897 VehPerfAccelPeak_Y_Neg "Vehicle lateral acceleration peak (backward)";
CM_ SG_ 1897 VehPerfAccelPeak_Y_Pos "Vehicle longitudinal acceleration peak (backward)";
CM_ SG_ 604 SRT_100mphTm_B "SRT 0 to 100  timer - best";
CM_ SG_ 604 SRT_100mphTm_C "SRT 0 to 100  timer - current";
CM_ SG_ 604 SRT_100mphTm_L "SRT 0 to 100 to 0 timer - last";
CM_ SG_ 604 SRT_100mphTmB "SRT 0 to 100  timer - best";
CM_ SG_ 604 SRT_100mphTmC "SRT 0 to 100  timer - current";
CM_ SG_ 604 SRT_100mphTmL "SRT 0 to 100  timer - last";
CM_ SG_ 604 SRT_60mphTm_B "SRT 0 to 60 timer - best";
CM_ SG_ 604 SRT_60mphTm_C "SRT 0 to 60 timer - current";
CM_ SG_ 604 SRT_60mphTm_L "SRT 0 to 60 timer - last";
CM_ SG_ 604 SRT_60mphTmB "SRT 0 to 60 timer - best";
CM_ SG_ 604 SRT_60mphTmC "SRT 0 to 60 timer - current";
CM_ SG_ 604 SRT_60mphTmL "SRT 0 to 60 timer - last";
CM_ SG_ 604 SRT_BrkTm_B "SRT braking timer - best";
CM_ SG_ 604 SRT_BrkTm_C "SRT braking timer - current";
CM_ SG_ 604 SRT_BrkTm_L "SRT braking timer - last";
CM_ SG_ 604 SRT_BrkTmB "SRT braking timer - best";
CM_ SG_ 604 SRT_BrkTmC "SRT braking timer - current";
CM_ SG_ 604 SRT_BrkTmL "SRT braking timer - last";
CM_ SG_ 604 SRT_eighthTm_B "SRT eighth mile timer - best";
CM_ SG_ 604 SRT_eighthTm_C "SRT eighth mile timer - current";
CM_ SG_ 604 SRT_eighthTm_L "SRT eighth mile timer - last";
CM_ SG_ 604 SRT_eighthTmB "SRT eighth mile timer - best";
CM_ SG_ 604 SRT_eighthTmC "SRT eighth mile timer - current";
CM_ SG_ 604 SRT_eighthTmL "SRT eighth mile timer - last";
CM_ SG_ 604 SRT_EthSpdB_M "SRT eighth mile speed - best in kmph";
CM_ SG_ 604 SRT_EthSpdB_US "SRT eighth mile speed - best in mph";
CM_ SG_ 604 SRT_EthSpdC_M "SRT eighth mile speed - current in kmph";
CM_ SG_ 604 SRT_EthSpdC_US "SRT eighth mile speed - current in mph";
CM_ SG_ 604 SRT_EthSpdL_M "SRT eighth mile speed - last in kmph";
CM_ SG_ 604 SRT_EthSpdL_US "SRT eighth mile speed - last in mph";
CM_ SG_ 604 SRT_QrtSpdB_M "SRT quarter mile speed - best in kmph";
CM_ SG_ 604 SRT_QrtSpdB_US "SRT quarter mile speed - best in mph";
CM_ SG_ 604 SRT_QrtSpdC_M "SRT quarter mile speed - current in kmph";
CM_ SG_ 604 SRT_QrtSpdC_US "SRT quarter mile speed - current in mph";
CM_ SG_ 604 SRT_QrtSpdL_M "SRT quarter mile speed - last in kmph";
CM_ SG_ 604 SRT_QrtSpdL_US "SRT quarter mile speed - last in mph";
CM_ SG_ 604 SRT_quarterTm_B "SRT quarter mile timer - best";
CM_ SG_ 604 SRT_quarterTm_C "SRT quarter mile timer - current";
CM_ SG_ 604 SRT_quarterTm_L "SRT quarter mile timer - last";
CM_ SG_ 604 SRT_quarterTmB "SRT quarter mile timer - best";
CM_ SG_ 604 SRT_quarterTmC "SRT quarter mile timer - current";
CM_ SG_ 604 SRT_quarterTmL "SRT quarter mile timer - last";
CM_ SG_ 604 SRT_ReactTm_B "SRT reaction time - best";
CM_ SG_ 604 SRT_ReactTm_C "SRT reaction time - current";
CM_ SG_ 604 SRT_ReactTm_L "SRT reaction time - last";
CM_ SG_ 604 SRT_ReactTmB "SRT reaction time - best";
CM_ SG_ 604 SRT_ReactTmC "SRT reaction time - current";
CM_ SG_ 604 SRT_ReactTmL "SRT reaction time - last";
CM_ SG_ 605 SRT_1000ftTm_B "SRT 1000 ft time - Best (U)";
CM_ SG_ 605 SRT_1000ftTm_C "SRT 1000 ft time - Current (U)";
CM_ SG_ 605 SRT_1000ftTm_L "SRT 1000 ft time - Last (U)";
CM_ SG_ 605 SRT_1000ftTmB "SRT 1000 ft time - Best (M)";
CM_ SG_ 605 SRT_1000ftTmC "SRT 1000 ft time - Current (M)";
CM_ SG_ 605 SRT_1000ftTmL "SRT 1000 ft time - Last (M)";
CM_ SG_ 605 SRT_330ftTm_B "SRT 300 ft time - Best (U)";
CM_ SG_ 605 SRT_330ftTm_C "SRT 300 ft time - Current (U)";
CM_ SG_ 605 SRT_330ftTm_L "SRT 300 ft time - Last (U)";
CM_ SG_ 605 SRT_330ftTmB "SRT 300 ft time - Best (M)";
CM_ SG_ 605 SRT_330ftTmC "SRT 300 ft time - Current (M)";
CM_ SG_ 605 SRT_330ftTmL "SRT 300 ft time - Last (M)";
CM_ SG_ 605 SRT_60ftTm_B "SRT 60 foot time - best";
CM_ SG_ 605 SRT_60ftTm_C "SRT 60 foot time - current";
CM_ SG_ 605 SRT_60ftTm_L "SRT 60 foot time - last";
CM_ SG_ 605 SRT_60ftTmB "SRT 60 foot time - Best (U)";
CM_ SG_ 605 SRT_60ftTmC "SRT 60 foot time - current";
CM_ SG_ 605 SRT_60ftTmL "SRT 60 foot time - last";
CM_ SG_ 605 SRT_BrkDistB_M "SRT braking distance - best in meters";
CM_ SG_ 605 SRT_BrkDistB_US "SRT braking distance - best in yards";
CM_ SG_ 605 SRT_BrkDistC_M "SRT braking distance - current in meters";
CM_ SG_ 605 SRT_BrkDistC_US "SRT braking distance - current in yards";
CM_ SG_ 605 SRT_BrkDistL_M "SRT braking distance - last in meters";
CM_ SG_ 605 SRT_BrkDistL_US "SRT braking distance - last in yards";
CM_ SG_ 605 SRT_BrkSpdB_M "SRT braking speed - best in kmph";
CM_ SG_ 605 SRT_BrkSpdB_US "SRT braking speed - best in mph";
CM_ SG_ 605 SRT_BrkSpdC_M "SRT braking speed - current in kmph";
CM_ SG_ 605 SRT_BrkSpdC_US "SRT braking speed - current in mph";
CM_ SG_ 605 SRT_BrkSpdL_M "SRT braking speed - last in kmph";
CM_ SG_ 605 SRT_BrkSpdL_US "SRT braking speed - last in mph";

BA_DEF_ SG_ "GenSigStartValue" INT 0 2147483647;
BA_DEF_ SG_ "GenSigInactiveValue" INT 0 2147483647;
BA_DEF_ SG_ "GenSigSendType" ENUM "NotUsed","OnWrite","OnWriteWithRepetition","OnChange","OnChangeWithRepetition","IfActive","IfActiveWithRepetition","NoSigSendType";
BA_DEF_ SG_ "SystemSignalLongSymbol" STRING ;
BA_DEF_ SG_ "GenSigTimeoutTime_AGSM" INT 0 65535;
BA_DEF_ SG_ "GenSigTimeoutTime_BCM" INT 0 65535;
BA_DEF_ SG_ "GenSigTimeoutTime_BSM" INT 0 65535;
BA_DEF_ SG_ "GenSigTimeoutTime_CADM" INT 0 65535;
BA_DEF_ SG_ "GenSigTimeoutTime_DMSM" INT 0 65535;
BA_DEF_ SG_ "GenSigTimeoutTime_DTCM" INT 0 65535;
BA_DEF_ SG_ "GenSigTimeoutTime_ECM" INT 0 65535;
BA_DEF_ SG_ "GenSigTimeoutTime_EVCU2" INT 0 65535;
BA_DEF_ SG_ "GenSigTimeoutTime_GNMM" INT 0 65535;
BA_DEF_ SG_ "GenSigTimeoutTime_HCP" INT 0 65535;
BA_DEF_ SG_ "GenSigTimeoutTime_IPC" INT 0 65535;
BA_DEF_ SG_ "GenSigTimeoutTime_RFHM" INT 0 65535;
BA_DEF_ SG_ "GenSigTimeoutTime_SGW" INT 0 65535;
BA_DEF_ SG_ "GenSigTimeoutTime_TCM" INT 0 65535;
BA_DEF_ BO_ "DiagRequest" ENUM "No","Yes";
BA_DEF_ BO_ "Type" ENUM "P","C","PE","COC","PE_Cntrl","E","E_Cntrl","OC","S","BAF","DC","EM","MM","ISO-TP","-";
BA_DEF_ BO_ "DiagResponse" ENUM "No","Yes";
BA_DEF_ BO_ "NmMessage" ENUM "No","Yes";
BA_DEF_ BO_ "GenMsgSendType" ENUM "Cyclic","NotUsed","NotUsed","NotUsed","NotUsed","NotUsed","NotUsed","NotUsed","NoMsgSendType";
BA_DEF_ BO_ "GenMsgNrOfRepetition" INT 0 255;
BA_DEF_ BO_ "GenMsgILSupport" ENUM "No","Yes";
BA_DEF_ BO_ "GenMsgStartDelayTime" INT 0 65535;
BA_DEF_ BO_ "GenMsgCycleTimeFast" INT 0 65535;
BA_DEF_ BO_ "GenMsgCycleTime" INT 0 65535;
BA_DEF_ BO_ "GenMsgDelayTime" INT 0 65535;
BA_DEF_ BO_ "NmAsrMessage" ENUM "No","Yes";
BA_DEF_ BO_ "DiagState" ENUM "No","Yes";
BA_DEF_ BO_ "DiagConnection" HEX 0 65535;
BA_DEF_ BO_ "VFrameFormat" ENUM "StandardCAN","ExtendedCAN","reserved","reserved","reserved","reserved","reserved","reserved","reserved","reserved","reserved","reserved","reserved","reserved","StandardCAN_FD","ExtendedCAN_FD";
BA_DEF_ BO_ "CANFD_BRS" ENUM "No","Yes";
BA_DEF_DEF_ "DiagRequest" "No";
BA_DEF_DEF_ "Type" "-";
BA_DEF_DEF_ "DiagResponse" "No";
BA_DEF_DEF_ "NmMessage" "No";
BA_DEF_DEF_ "GenMsgSendType" "NoMsgSendType";
BA_DEF_DEF_ "GenMsgNrOfRepetition" 0;
BA_DEF_DEF_ "GenMsgILSupport" "No";
BA_DEF_DEF_ "GenMsgStartDelayTime" 0;
BA_DEF_DEF_ "GenMsgCycleTimeFast" 0;
BA_DEF_DEF_ "GenMsgCycleTime" 0;
BA_DEF_DEF_ "GenMsgDelayTime" 0;
BA_DEF_DEF_ "NmAsrMessage" "No";
BA_DEF_DEF_ "DiagState" "No";
BA_DEF_DEF_ "DiagConnection" 0;
BA_DEF_DEF_ "VFrameFormat" "StandardCAN_FD";
BA_DEF_DEF_ "CANFD_BRS" "No";
BA_DEF_DEF_ "GenSigStartValue" 0;
BA_DEF_DEF_ "GenSigInactiveValue" 0;
BA_DEF_DEF_ "GenSigSendType" "NoSigSendType";
BA_DEF_DEF_ "SystemSignalLongSymbol" "";
BA_DEF_DEF_ "GenSigTimeoutTime_AGSM" 2500;
BA_DEF_DEF_ "GenSigTimeoutTime_BCM" 2500;
BA_DEF_DEF_ "GenSigTimeoutTime_BSM" 2500;
BA_DEF_DEF_ "GenSigTimeoutTime_CADM" 2500;
BA_DEF_DEF_ "GenSigTimeoutTime_DMSM" 2500;
BA_DEF_DEF_ "GenSigTimeoutTime_DTCM" 2500;
BA_DEF_DEF_ "GenSigTimeoutTime_ECM" 2500;
BA_DEF_DEF_ "GenSigTimeoutTime_EVCU2" 2500;
BA_DEF_DEF_ "GenSigTimeoutTime_GNMM" 2500;
BA_DEF_DEF_ "GenSigTimeoutTime_HCP" 2500;
BA_DEF_DEF_ "GenSigTimeoutTime_IPC" 2500;
BA_DEF_DEF_ "GenSigTimeoutTime_RFHM" 2500;
BA_DEF_DEF_ "GenSigTimeoutTime_SGW" 2500;
BA_DEF_DEF_ "GenSigTimeoutTime_TCM" 2500;
BA_ "Type" BO_ 1831 1;
BA_ "GenMsgSendType" BO_ 1831 0;
BA_ "GenMsgILSupport" BO_ 1831 1;
BA_ "GenMsgCycleTime" BO_ 1831 1000;
BA_ "CANFD_BRS" BO_ 1831 1;
BA_ "Type" BO_ 600 3;
BA_ "GenMsgSendType" BO_ 600 0;
BA_ "GenMsgNrOfRepetition" BO_ 600 2;
BA_ "GenMsgILSupport" BO_ 600 1;
BA_ "GenMsgCycleTimeFast" BO_ 600 20;
BA_ "GenMsgCycleTime" BO_ 600 100;
BA_ "GenMsgDelayTime" BO_ 600 20;
BA_ "CANFD_BRS" BO_ 600 1;
BA_ "Type" BO_ 1154 3;
BA_ "GenMsgSendType" BO_ 1154 0;
BA_ "GenMsgNrOfRepetition" BO_ 1154 2;
BA_ "GenMsgILSupport" BO_ 1154 1;
BA_ "GenMsgCycleTime" BO_ 1154 500;
BA_ "GenMsgDelayTime" BO_ 1154 20;
BA_ "CANFD_BRS" BO_ 1154 1;
BA_ "Type" BO_ 1432 3;
BA_ "GenMsgSendType" BO_ 1432 0;
BA_ "GenMsgNrOfRepetition" BO_ 1432 2;
BA_ "GenMsgILSupport" BO_ 1432 1;
BA_ "GenMsgCycleTimeFast" BO_ 1432 20;
BA_ "GenMsgCycleTime" BO_ 1432 1000;
BA_ "GenMsgDelayTime" BO_ 1432 20;
BA_ "CANFD_BRS" BO_ 1432 1;
BA_ "Type" BO_ 1897 1;
BA_ "GenMsgSendType" BO_ 1897 0;
BA_ "GenMsgNrOfRepetition" BO_ 1897 2;
BA_ "GenMsgILSupport" BO_ 1897 1;
BA_ "GenMsgCycleTimeFast" BO_ 1897 20;
BA_ "GenMsgCycleTime" BO_ 1897 1000;
BA_ "GenMsgDelayTime" BO_ 1897 20;
BA_ "CANFD_BRS" BO_ 1897 1;
BA_ "Type" BO_ 604 3;
BA_ "GenMsgSendType" BO_ 604 0;
BA_ "GenMsgNrOfRepetition" BO_ 604 2;
BA_ "GenMsgILSupport" BO_ 604 1;
BA_ "GenMsgCycleTimeFast" BO_ 604 20;
BA_ "GenMsgCycleTime" BO_ 604 1000;
BA_ "GenMsgDelayTime" BO_ 604 20;
BA_ "CANFD_BRS" BO_ 604 1;
BA_ "Type" BO_ 605 3;
BA_ "GenMsgSendType" BO_ 605 0;
BA_ "GenMsgNrOfRepetition" BO_ 605 2;
BA_ "GenMsgILSupport" BO_ 605 1;
BA_ "GenMsgCycleTimeFast" BO_ 605 20;
BA_ "GenMsgCycleTime" BO_ 605 1000;
BA_ "GenMsgDelayTime" BO_ 605 20;
BA_ "CANFD_BRS" BO_ 605 1;
BA_ "GenSigTimeoutTime_AGSM" SG_ 1831 ABS_IND_STAT 0;
BA_ "GenSigTimeoutTime_BCM" SG_ 1831 ABS_IND_STAT 0;
BA_ "GenSigTimeoutTime_BSM" SG_ 1831 ABS_IND_STAT 0;
BA_ "GenSigTimeoutTime_CADM" SG_ 1831 ABS_IND_STAT 0;
BA_ "GenSigTimeoutTime_DMSM" SG_ 1831 ABS_IND_STAT 0;
BA_ "GenSigTimeoutTime_DTCM" SG_ 1831 ABS_IND_STAT 0;
BA_ "GenSigTimeoutTime_ECM" SG_ 1831 ABS_IND_STAT 0;
BA_ "GenSigTimeoutTime_EVCU2" SG_ 1831 ABS_IND_STAT 0;
BA_ "GenSigTimeoutTime_GNMM" SG_ 1831 ABS_IND_STAT 0;
BA_ "GenSigTimeoutTime_HCP" SG_ 1831 ABS_IND_STAT 0;
BA_ "GenSigTimeoutTime_IPC" SG_ 1831 ABS_IND_STAT 0;
BA_ "GenSigTimeoutTime_RFHM" SG_ 1831 ABS_IND_STAT 0;
BA_ "GenSigTimeoutTime_TCM" SG_ 1831 ABS_IND_STAT 0;
BA_ "GenSigTimeoutTime_AGSM" SG_ 1831 ACC_WARN_STAT 0;
BA_ "GenSigTimeoutTime_BCM" SG_ 1831 ACC_WARN_STAT 0;
BA_ "GenSigTimeoutTime_BSM" SG_ 1831 ACC_WARN_STAT 0;
BA_ "GenSigTimeoutTime_CADM" SG_ 1831 ACC_WARN_STAT 0;
BA_ "GenSigTimeoutTime_DMSM" SG_ 1831 ACC_WARN_STAT 0;
BA_ "GenSigTimeoutTime_DTCM" SG_ 1831 ACC_WARN_STAT 0;
BA_ "GenSigTimeoutTime_ECM" SG_ 1831 ACC_WARN_STAT 0;
BA_ "GenSigTimeoutTime_EVCU2" SG_ 1831 ACC_WARN_STAT 0;
BA_ "GenSigTimeoutTime_GNMM" SG_ 1831 ACC_WARN_STAT 0;
BA_ "GenSigTimeoutTime_HCP" SG_ 1831 ACC_WARN_STAT 0;
BA_ "GenSigTimeoutTime_IPC" SG_ 1831 ACC_WARN_STAT 0;
BA_ "GenSigTimeoutTime_RFHM" SG_ 1831 ACC_WARN_STAT 0;
BA_ "GenSigTimeoutTime_TCM" SG_ 1831 ACC_WARN_STAT 0;
BA_ "GenSigTimeoutTime_AGSM" SG_ 1831 AIR_BAG_STAT 0;
BA_ "GenSigTimeoutTime_BCM" SG_ 1831 AIR_BAG_STAT 0;
BA_ "GenSigTimeoutTime_BSM" SG_ 1831 AIR_BAG_STAT 0;
BA_ "GenSigTimeoutTime_CADM" SG_ 1831 AIR_BAG_STAT 0;
BA_ "GenSigTimeoutTime_DMSM" SG_ 1831 AIR_BAG_STAT 0;
BA_ "GenSigTimeoutTime_DTCM" SG_ 1831 AIR_BAG_STAT 0;
BA_ "GenSigTimeoutTime_ECM" SG_ 1831 AIR_BAG_STAT 0;
BA_ "GenSigTimeoutTime_EVCU2" SG_ 1831 AIR_BAG_STAT 0;
BA_ "GenSigTimeoutTime_GNMM" SG_ 1831 AIR_BAG_STAT 0;
BA_ "GenSigTimeoutTime_HCP" SG_ 1831 AIR_BAG_STAT 0;
BA_ "GenSigTimeoutTime_IPC" SG_ 1831 AIR_BAG_STAT 0;
BA_ "GenSigTimeoutTime_RFHM" SG_ 1831 AIR_BAG_STAT 0;
BA_ "GenSigTimeoutTime_TCM" SG_ 1831 AIR_BAG_STAT 0;
BA_ "GenSigTimeoutTime_AGSM" SG_ 1831 AWD_IND_STAT 0;
BA_ "GenSigTimeoutTime_BCM" SG_ 1831 AWD_IND_STAT 0;
BA_ "GenSigTimeoutTime_BSM" SG_ 1831 AWD_IND_STAT 0;
BA_ "GenSigTimeoutTime_CADM" SG_ 1831 AWD_IND_STAT 0;
BA_ "GenSigTimeoutTime_DMSM" SG_ 1831 AWD_IND_STAT 0;
BA_ "GenSigTimeoutTime_DTCM" SG_ 1831 AWD_IND_STAT 0;
BA_ "GenSigTimeoutTime_ECM" SG_ 1831 AWD_IND_STAT 0;
BA_ "GenSigTimeoutTime_EVCU2" SG_ 1831 AWD_IND_STAT 0;
BA_ "GenSigTimeoutTime_GNMM" SG_ 1831 AWD_IND_STAT 0;
BA_ "GenSigTimeoutTime_HCP" SG_ 1831 AWD_IND_STAT 0;
BA_ "GenSigTimeoutTime_IPC" SG_ 1831 AWD_IND_STAT 0;
BA_ "GenSigTimeoutTime_RFHM" SG_ 1831 AWD_IND_STAT 0;
BA_ "GenSigTimeoutTime_TCM" SG_ 1831 AWD_IND_STAT 0;
BA_ "GenSigTimeoutTime_AGSM" SG_ 1831 AWD_SERVICE_STAT 0;
BA_ "GenSigTimeoutTime_BCM" SG_ 1831 AWD_SERVICE_STAT 0;
BA_ "GenSigTimeoutTime_BSM" SG_ 1831 AWD_SERVICE_STAT 0;
BA_ "GenSigTimeoutTime_CADM" SG_ 1831 AWD_SERVICE_STAT 0;
BA_ "GenSigTimeoutTime_DMSM" SG_ 1831 AWD_SERVICE_STAT 0;
BA_ "GenSigTimeoutTime_DTCM" SG_ 1831 AWD_SERVICE_STAT 0;
BA_ "GenSigTimeoutTime_ECM" SG_ 1831 AWD_SERVICE_STAT 0;
BA_ "GenSigTimeoutTime_EVCU2" SG_ 1831 AWD_SERVICE_STAT 0;
BA_ "GenSigTimeoutTime_GNMM" SG_ 1831 AWD_SERVICE_STAT 0;
BA_ "GenSigTimeoutTime_HCP" SG_ 1831 AWD_SERVICE_STAT 0;
BA_ "GenSigTimeoutTime_IPC" SG_ 1831 AWD_SERVICE_STAT 0;
BA_ "GenSigTimeoutTime_RFHM" SG_ 1831 AWD_SERVICE_STAT 0;
BA_ "GenSigTimeoutTime_TCM" SG_ 1831 AWD_SERVICE_STAT 0;
BA_ "GenSigTimeoutTime_AGSM" SG_ 1831 BATTERY_CHARGE_STAT 0;
BA_ "GenSigTimeoutTime_BCM" SG_ 1831 BATTERY_CHARGE_STAT 0;
BA_ "GenSigTimeoutTime_BSM" SG_ 1831 BATTERY_CHARGE_STAT 0;
BA_ "GenSigTimeoutTime_CADM" SG_ 1831 BATTERY_CHARGE_STAT 0;
BA_ "GenSigTimeoutTime_DMSM" SG_ 1831 BATTERY_CHARGE_STAT 0;
BA_ "GenSigTimeoutTime_DTCM" SG_ 1831 BATTERY_CHARGE_STAT 0;
BA_ "GenSigTimeoutTime_ECM" SG_ 1831 BATTERY_CHARGE_STAT 0;
BA_ "GenSigTimeoutTime_EVCU2" SG_ 1831 BATTERY_CHARGE_STAT 0;
BA_ "GenSigTimeoutTime_GNMM" SG_ 1831 BATTERY_CHARGE_STAT 0;
BA_ "GenSigTimeoutTime_HCP" SG_ 1831 BATTERY_CHARGE_STAT 0;
BA_ "GenSigTimeoutTime_IPC" SG_ 1831 BATTERY_CHARGE_STAT 0;
BA_ "GenSigTimeoutTime_RFHM" SG_ 1831 BATTERY_CHARGE_STAT 0;
BA_ "GenSigTimeoutTime_TCM" SG_ 1831 BATTERY_CHARGE_STAT 0;
BA_ "GenSigTimeoutTime_AGSM" SG_ 1831 BRAKE_PAD_STAT 0;
BA_ "GenSigTimeoutTime_BCM" SG_ 1831 BRAKE_PAD_STAT 0;
BA_ "GenSigTimeoutTime_BSM" SG_ 1831 BRAKE_PAD_STAT 0;
BA_ "GenSigTimeoutTime_CADM" SG_ 1831 BRAKE_PAD_STAT 0;
BA_ "GenSigTimeoutTime_DMSM" SG_ 1831 BRAKE_PAD_STAT 0;
BA_ "GenSigTimeoutTime_DTCM" SG_ 1831 BRAKE_PAD_STAT 0;
BA_ "GenSigTimeoutTime_ECM" SG_ 1831 BRAKE_PAD_STAT 0;
BA_ "GenSigTimeoutTime_EVCU2" SG_ 1831 BRAKE_PAD_STAT 0;
BA_ "GenSigTimeoutTime_GNMM" SG_ 1831 BRAKE_PAD_STAT 0;
BA_ "GenSigTimeoutTime_HCP" SG_ 1831 BRAKE_PAD_STAT 0;
BA_ "GenSigTimeoutTime_IPC" SG_ 1831 BRAKE_PAD_STAT 0;
BA_ "GenSigTimeoutTime_RFHM" SG_ 1831 BRAKE_PAD_STAT 0;
BA_ "GenSigTimeoutTime_TCM" SG_ 1831 BRAKE_PAD_STAT 0;
BA_ "GenSigTimeoutTime_AGSM" SG_ 1831 BRK_IND_STAT 0;
BA_ "GenSigTimeoutTime_BCM" SG_ 1831 BRK_IND_STAT 0;
BA_ "GenSigTimeoutTime_BSM" SG_ 1831 BRK_IND_STAT 0;
BA_ "GenSigTimeoutTime_CADM" SG_ 1831 BRK_IND_STAT 0;
BA_ "GenSigTimeoutTime_DMSM" SG_ 1831 BRK_IND_STAT 0;
BA_ "GenSigTimeoutTime_DTCM" SG_ 1831 BRK_IND_STAT 0;
BA_ "GenSigTimeoutTime_ECM" SG_ 1831 BRK_IND_STAT 0;
BA_ "GenSigTimeoutTime_EVCU2" SG_ 1831 BRK_IND_STAT 0;
BA_ "GenSigTimeoutTime_GNMM" SG_ 1831 BRK_IND_STAT 0;
BA_ "GenSigTimeoutTime_HCP" SG_ 1831 BRK_IND_STAT 0;
BA_ "GenSigTimeoutTime_IPC" SG_ 1831 BRK_IND_STAT 0;
BA_ "GenSigTimeoutTime_RFHM" SG_ 1831 BRK_IND_STAT 0;
BA_ "GenSigTimeoutTime_TCM" SG_ 1831 BRK_IND_STAT 0;
BA_ "GenSigTimeoutTime_AGSM" SG_ 1831 CARGO_LT_STAT 0;
BA_ "GenSigTimeoutTime_BCM" SG_ 1831 CARGO_LT_STAT 0;
BA_ "GenSigTimeoutTime_BSM" SG_ 1831 CARGO_LT_STAT 0;
BA_ "GenSigTimeoutTime_CADM" SG_ 1831 CARGO_LT_STAT 0;
BA_ "GenSigTimeoutTime_DMSM" SG_ 1831 CARGO_LT_STAT 0;
BA_ "GenSigTimeoutTime_DTCM" SG_ 1831 CARGO_LT_STAT 0;
BA_ "GenSigTimeoutTime_ECM" SG_ 1831 CARGO_LT_STAT 0;
BA_ "GenSigTimeoutTime_EVCU2" SG_ 1831 CARGO_LT_STAT 0;
BA_ "GenSigTimeoutTime_GNMM" SG_ 1831 CARGO_LT_STAT 0;
BA_ "GenSigTimeoutTime_HCP" SG_ 1831 CARGO_LT_STAT 0;
BA_ "GenSigTimeoutTime_IPC" SG_ 1831 CARGO_LT_STAT 0;
BA_ "GenSigTimeoutTime_RFHM" SG_ 1831 CARGO_LT_STAT 0;
BA_ "GenSigTimeoutTime_TCM" SG_ 1831 CARGO_LT_STAT 0;
BA_ "GenSigTimeoutTime_AGSM" SG_ 1831 CATALYST_TEMP_STAT 0;
BA_ "GenSigTimeoutTime_BCM" SG_ 1831 CATALYST_TEMP_STAT 0;
BA_ "GenSigTimeoutTime_BSM" SG_ 1831 CATALYST_TEMP_STAT 0;
BA_ "GenSigTimeoutTime_CADM" SG_ 1831 CATALYST_TEMP_STAT 0;
BA_ "GenSigTimeoutTime_DMSM" SG_ 1831 CATALYST_TEMP_STAT 0;
BA_ "GenSigTimeoutTime_DTCM" SG_ 1831 CATALYST_TEMP_STAT 0;
BA_ "GenSigTimeoutTime_ECM" SG_ 1831 CATALYST_TEMP_STAT 0;
BA_ "GenSigTimeoutTime_EVCU2" SG_ 1831 CATALYST_TEMP_STAT 0;
BA_ "GenSigTimeoutTime_GNMM" SG_ 1831 CATALYST_TEMP_STAT 0;
BA_ "GenSigTimeoutTime_HCP" SG_ 1831 CATALYST_TEMP_STAT 0;
BA_ "GenSigTimeoutTime_IPC" SG_ 1831 CATALYST_TEMP_STAT 0;
BA_ "GenSigTimeoutTime_RFHM" SG_ 1831 CATALYST_TEMP_STAT 0;
BA_ "GenSigTimeoutTime_TCM" SG_ 1831 CATALYST_TEMP_STAT 0;
BA_ "GenSigTimeoutTime_AGSM" SG_ 1831 COOLENT_LEVEL_STAT 0;
BA_ "GenSigTimeoutTime_BCM" SG_ 1831 COOLENT_LEVEL_STAT 0;
BA_ "GenSigTimeoutTime_BSM" SG_ 1831 COOLENT_LEVEL_STAT 0;
BA_ "GenSigTimeoutTime_CADM" SG_ 1831 COOLENT_LEVEL_STAT 0;
BA_ "GenSigTimeoutTime_DMSM" SG_ 1831 COOLENT_LEVEL_STAT 0;
BA_ "GenSigTimeoutTime_DTCM" SG_ 1831 COOLENT_LEVEL_STAT 0;
BA_ "GenSigTimeoutTime_ECM" SG_ 1831 COOLENT_LEVEL_STAT 0;
BA_ "GenSigTimeoutTime_EVCU2" SG_ 1831 COOLENT_LEVEL_STAT 0;
BA_ "GenSigTimeoutTime_GNMM" SG_ 1831 COOLENT_LEVEL_STAT 0;
BA_ "GenSigTimeoutTime_HCP" SG_ 1831 COOLENT_LEVEL_STAT 0;
BA_ "GenSigTimeoutTime_IPC" SG_ 1831 COOLENT_LEVEL_STAT 0;
BA_ "GenSigTimeoutTime_RFHM" SG_ 1831 COOLENT_LEVEL_STAT 0;
BA_ "GenSigTimeoutTime_TCM" SG_ 1831 COOLENT_LEVEL_STAT 0;
BA_ "GenSigTimeoutTime_AGSM" SG_ 1831 CRUISE_SET_STAT 0;
BA_ "GenSigTimeoutTime_BCM" SG_ 1831 CRUISE_SET_STAT 0;
BA_ "GenSigTimeoutTime_BSM" SG_ 1831 CRUISE_SET_STAT 0;
BA_ "GenSigTimeoutTime_CADM" SG_ 1831 CRUISE_SET_STAT 0;
BA_ "GenSigTimeoutTime_DMSM" SG_ 1831 CRUISE_SET_STAT 0;
BA_ "GenSigTimeoutTime_DTCM" SG_ 1831 CRUISE_SET_STAT 0;
BA_ "GenSigTimeoutTime_ECM" SG_ 1831 CRUISE_SET_STAT 0;
BA_ "GenSigTimeoutTime_EVCU2" SG_ 1831 CRUISE_SET_STAT 0;
BA_ "GenSigTimeoutTime_GNMM" SG_ 1831 CRUISE_SET_STAT 0;
BA_ "GenSigTimeoutTime_HCP" SG_ 1831 CRUISE_SET_STAT 0;
BA_ "GenSigTimeoutTime_IPC" SG_ 1831 CRUISE_SET_STAT 0;
BA_ "GenSigTimeoutTime_RFHM" SG_ 1831 CRUISE_SET_STAT 0;
BA_ "GenSigTimeoutTime_TCM" SG_ 1831 CRUISE_SET_STAT 0;
BA_ "GenSigTimeoutTime_AGSM" SG_ 1831 DAMPING_SYSTEM_STAT 0;
BA_ "GenSigTimeoutTime_BCM" SG_ 1831 DAMPING_SYSTEM_STAT 0;
BA_ "GenSigTimeoutTime_BSM" SG_ 1831 DAMPING_SYSTEM_STAT 0;
BA_ "GenSigTimeoutTime_CADM" SG_ 1831 DAMPING_SYSTEM_STAT 0;
BA_ "GenSigTimeoutTime_DMSM" SG_ 1831 DAMPING_SYSTEM_STAT 0;
BA_ "GenSigTimeoutTime_DTCM" SG_ 1831 DAMPING_SYSTEM_STAT 0;
BA_ "GenSigTimeoutTime_ECM" SG_ 1831 DAMPING_SYSTEM_STAT 0;
BA_ "GenSigTimeoutTime_EVCU2" SG_ 1831 DAMPING_SYSTEM_STAT 0;
BA_ "GenSigTimeoutTime_GNMM" SG_ 1831 DAMPING_SYSTEM_STAT 0;
BA_ "GenSigTimeoutTime_HCP" SG_ 1831 DAMPING_SYSTEM_STAT 0;
BA_ "GenSigTimeoutTime_IPC" SG_ 1831 DAMPING_SYSTEM_STAT 0;
BA_ "GenSigTimeoutTime_RFHM" SG_ 1831 DAMPING_SYSTEM_STAT 0;
BA_ "GenSigTimeoutTime_TCM" SG_ 1831 DAMPING_SYSTEM_STAT 0;
BA_ "GenSigTimeoutTime_AGSM" SG_ 1831 DEF_STAT 0;
BA_ "GenSigTimeoutTime_BCM" SG_ 1831 DEF_STAT 0;
BA_ "GenSigTimeoutTime_BSM" SG_ 1831 DEF_STAT 0;
BA_ "GenSigTimeoutTime_CADM" SG_ 1831 DEF_STAT 0;
BA_ "GenSigTimeoutTime_DMSM" SG_ 1831 DEF_STAT 0;
BA_ "GenSigTimeoutTime_DTCM" SG_ 1831 DEF_STAT 0;
BA_ "GenSigTimeoutTime_ECM" SG_ 1831 DEF_STAT 0;
BA_ "GenSigTimeoutTime_EVCU2" SG_ 1831 DEF_STAT 0;
BA_ "GenSigTimeoutTime_GNMM" SG_ 1831 DEF_STAT 0;
BA_ "GenSigTimeoutTime_HCP" SG_ 1831 DEF_STAT 0;
BA_ "GenSigTimeoutTime_IPC" SG_ 1831 DEF_STAT 0;
BA_ "GenSigTimeoutTime_RFHM" SG_ 1831 DEF_STAT 0;
BA_ "GenSigTimeoutTime_TCM" SG_ 1831 DEF_STAT 0;
BA_ "GenSigTimeoutTime_AGSM" SG_ 1831 DOORS_STAT 0;
BA_ "GenSigTimeoutTime_BCM" SG_ 1831 DOORS_STAT 0;
BA_ "GenSigTimeoutTime_BSM" SG_ 1831 DOORS_STAT 0;
BA_ "GenSigTimeoutTime_CADM" SG_ 1831 DOORS_STAT 0;
BA_ "GenSigTimeoutTime_DMSM" SG_ 1831 DOORS_STAT 0;
BA_ "GenSigTimeoutTime_DTCM" SG_ 1831 DOORS_STAT 0;
BA_ "GenSigTimeoutTime_ECM" SG_ 1831 DOORS_STAT 0;
BA_ "GenSigTimeoutTime_EVCU2" SG_ 1831 DOORS_STAT 0;
BA_ "GenSigTimeoutTime_GNMM" SG_ 1831 DOORS_STAT 0;
BA_ "GenSigTimeoutTime_HCP" SG_ 1831 DOORS_STAT 0;
BA_ "GenSigTimeoutTime_IPC" SG_ 1831 DOORS_STAT 0;
BA_ "GenSigTimeoutTime_RFHM" SG_ 1831 DOORS_STAT 0;
BA_ "GenSigTimeoutTime_TCM" SG_ 1831 DOORS_STAT 0;
BA_ "GenSigTimeoutTime_AGSM" SG_ 1831 ECO_MODE_STAT 0;
BA_ "GenSigTimeoutTime_BCM" SG_ 1831 ECO_MODE_STAT 0;
BA_ "GenSigTimeoutTime_BSM" SG_ 1831 ECO_MODE_STAT 0;
BA_ "GenSigTimeoutTime_CADM" SG_ 1831 ECO_MODE_STAT 0;
BA_ "GenSigTimeoutTime_DMSM" SG_ 1831 ECO_MODE_STAT 0;
BA_ "GenSigTimeoutTime_DTCM" SG_ 1831 ECO_MODE_STAT 0;
BA_ "GenSigTimeoutTime_ECM" SG_ 1831 ECO_MODE_STAT 0;
BA_ "GenSigTimeoutTime_EVCU2" SG_ 1831 ECO_MODE_STAT 0;
BA_ "GenSigTimeoutTime_GNMM" SG_ 1831 ECO_MODE_STAT 0;
BA_ "GenSigTimeoutTime_HCP" SG_ 1831 ECO_MODE_STAT 0;
BA_ "GenSigTimeoutTime_IPC" SG_ 1831 ECO_MODE_STAT 0;
BA_ "GenSigTimeoutTime_RFHM" SG_ 1831 ECO_MODE_STAT 0;
BA_ "GenSigTimeoutTime_TCM" SG_ 1831 ECO_MODE_STAT 0;
BA_ "GenSigTimeoutTime_AGSM" SG_ 1831 ELEC_STAB_STAT 0;
BA_ "GenSigTimeoutTime_BCM" SG_ 1831 ELEC_STAB_STAT 0;
BA_ "GenSigTimeoutTime_BSM" SG_ 1831 ELEC_STAB_STAT 0;
BA_ "GenSigTimeoutTime_CADM" SG_ 1831 ELEC_STAB_STAT 0;
BA_ "GenSigTimeoutTime_DMSM" SG_ 1831 ELEC_STAB_STAT 0;
BA_ "GenSigTimeoutTime_DTCM" SG_ 1831 ELEC_STAB_STAT 0;
BA_ "GenSigTimeoutTime_ECM" SG_ 1831 ELEC_STAB_STAT 0;
BA_ "GenSigTimeoutTime_EVCU2" SG_ 1831 ELEC_STAB_STAT 0;
BA_ "GenSigTimeoutTime_GNMM" SG_ 1831 ELEC_STAB_STAT 0;
BA_ "GenSigTimeoutTime_HCP" SG_ 1831 ELEC_STAB_STAT 0;
BA_ "GenSigTimeoutTime_IPC" SG_ 1831 ELEC_STAB_STAT 0;
BA_ "GenSigTimeoutTime_RFHM" SG_ 1831 ELEC_STAB_STAT 0;
BA_ "GenSigTimeoutTime_TCM" SG_ 1831 ELEC_STAB_STAT 0;
BA_ "GenSigTimeoutTime_AGSM" SG_ 1831 ELECTRIC_WRENCH_STAT 0;
BA_ "GenSigTimeoutTime_BCM" SG_ 1831 ELECTRIC_WRENCH_STAT 0;
BA_ "GenSigTimeoutTime_BSM" SG_ 1831 ELECTRIC_WRENCH_STAT 0;
BA_ "GenSigTimeoutTime_CADM" SG_ 1831 ELECTRIC_WRENCH_STAT 0;
BA_ "GenSigTimeoutTime_DMSM" SG_ 1831 ELECTRIC_WRENCH_STAT 0;
BA_ "GenSigTimeoutTime_DTCM" SG_ 1831 ELECTRIC_WRENCH_STAT 0;
BA_ "GenSigTimeoutTime_ECM" SG_ 1831 ELECTRIC_WRENCH_STAT 0;
BA_ "GenSigTimeoutTime_EVCU2" SG_ 1831 ELECTRIC_WRENCH_STAT 0;
BA_ "GenSigTimeoutTime_GNMM" SG_ 1831 ELECTRIC_WRENCH_STAT 0;
BA_ "GenSigTimeoutTime_HCP" SG_ 1831 ELECTRIC_WRENCH_STAT 0;
BA_ "GenSigTimeoutTime_IPC" SG_ 1831 ELECTRIC_WRENCH_STAT 0;
BA_ "GenSigTimeoutTime_RFHM" SG_ 1831 ELECTRIC_WRENCH_STAT 0;
BA_ "GenSigTimeoutTime_TCM" SG_ 1831 ELECTRIC_WRENCH_STAT 0;
BA_ "GenSigTimeoutTime_AGSM" SG_ 1831 ENGINE_MIL_STAT 0;
BA_ "GenSigTimeoutTime_BCM" SG_ 1831 ENGINE_MIL_STAT 0;
BA_ "GenSigTimeoutTime_BSM" SG_ 1831 ENGINE_MIL_STAT 0;
BA_ "GenSigTimeoutTime_CADM" SG_ 1831 ENGINE_MIL_STAT 0;
BA_ "GenSigTimeoutTime_DMSM" SG_ 1831 ENGINE_MIL_STAT 0;
BA_ "GenSigTimeoutTime_DTCM" SG_ 1831 ENGINE_MIL_STAT 0;
BA_ "GenSigTimeoutTime_ECM" SG_ 1831 ENGINE_MIL_STAT 0;
BA_ "GenSigTimeoutTime_EVCU2" SG_ 1831 ENGINE_MIL_STAT 0;
BA_ "GenSigTimeoutTime_GNMM" SG_ 1831 ENGINE_MIL_STAT 0;
BA_ "GenSigTimeoutTime_HCP" SG_ 1831 ENGINE_MIL_STAT 0;
BA_ "GenSigTimeoutTime_IPC" SG_ 1831 ENGINE_MIL_STAT 0;
BA_ "GenSigTimeoutTime_RFHM" SG_ 1831 ENGINE_MIL_STAT 0;
BA_ "GenSigTimeoutTime_TCM" SG_ 1831 ENGINE_MIL_STAT 0;
BA_ "GenSigTimeoutTime_AGSM" SG_ 1831 ENGINE_TEMP_STAT 0;
BA_ "GenSigTimeoutTime_BCM" SG_ 1831 ENGINE_TEMP_STAT 0;
BA_ "GenSigTimeoutTime_BSM" SG_ 1831 ENGINE_TEMP_STAT 0;
BA_ "GenSigTimeoutTime_CADM" SG_ 1831 ENGINE_TEMP_STAT 0;
BA_ "GenSigTimeoutTime_DMSM" SG_ 1831 ENGINE_TEMP_STAT 0;
BA_ "GenSigTimeoutTime_DTCM" SG_ 1831 ENGINE_TEMP_STAT 0;
BA_ "GenSigTimeoutTime_ECM" SG_ 1831 ENGINE_TEMP_STAT 0;
BA_ "GenSigTimeoutTime_EVCU2" SG_ 1831 ENGINE_TEMP_STAT 0;
BA_ "GenSigTimeoutTime_GNMM" SG_ 1831 ENGINE_TEMP_STAT 0;
BA_ "GenSigTimeoutTime_HCP" SG_ 1831 ENGINE_TEMP_STAT 0;
BA_ "GenSigTimeoutTime_IPC" SG_ 1831 ENGINE_TEMP_STAT 0;
BA_ "GenSigTimeoutTime_RFHM" SG_ 1831 ENGINE_TEMP_STAT 0;
BA_ "GenSigTimeoutTime_TCM" SG_ 1831 ENGINE_TEMP_STAT 0;
BA_ "GenSigTimeoutTime_AGSM" SG_ 1831 EPB_WARN_STAT 0;
BA_ "GenSigTimeoutTime_BCM" SG_ 1831 EPB_WARN_STAT 0;
BA_ "GenSigTimeoutTime_BSM" SG_ 1831 EPB_WARN_STAT 0;
BA_ "GenSigTimeoutTime_CADM" SG_ 1831 EPB_WARN_STAT 0;
BA_ "GenSigTimeoutTime_DMSM" SG_ 1831 EPB_WARN_STAT 0;
BA_ "GenSigTimeoutTime_DTCM" SG_ 1831 EPB_WARN_STAT 0;
BA_ "GenSigTimeoutTime_ECM" SG_ 1831 EPB_WARN_STAT 0;
BA_ "GenSigTimeoutTime_EVCU2" SG_ 1831 EPB_WARN_STAT 0;
BA_ "GenSigTimeoutTime_GNMM" SG_ 1831 EPB_WARN_STAT 0;
BA_ "GenSigTimeoutTime_HCP" SG_ 1831 EPB_WARN_STAT 0;
BA_ "GenSigTimeoutTime_IPC" SG_ 1831 EPB_WARN_STAT 0;
BA_ "GenSigTimeoutTime_RFHM" SG_ 1831 EPB_WARN_STAT 0;
BA_ "GenSigTimeoutTime_TCM" SG_ 1831 EPB_WARN_STAT 0;
BA_ "GenSigTimeoutTime_AGSM" SG_ 1831 EPS_STAT 0;
BA_ "GenSigTimeoutTime_BCM" SG_ 1831 EPS_STAT 0;
BA_ "GenSigTimeoutTime_BSM" SG_ 1831 EPS_STAT 0;
BA_ "GenSigTimeoutTime_CADM" SG_ 1831 EPS_STAT 0;
BA_ "GenSigTimeoutTime_DMSM" SG_ 1831 EPS_STAT 0;
BA_ "GenSigTimeoutTime_DTCM" SG_ 1831 EPS_STAT 0;
BA_ "GenSigTimeoutTime_ECM" SG_ 1831 EPS_STAT 0;
BA_ "GenSigTimeoutTime_EVCU2" SG_ 1831 EPS_STAT 0;
BA_ "GenSigTimeoutTime_GNMM" SG_ 1831 EPS_STAT 0;
BA_ "GenSigTimeoutTime_HCP" SG_ 1831 EPS_STAT 0;
BA_ "GenSigTimeoutTime_IPC" SG_ 1831 EPS_STAT 0;
BA_ "GenSigTimeoutTime_RFHM" SG_ 1831 EPS_STAT 0;
BA_ "GenSigTimeoutTime_TCM" SG_ 1831 EPS_STAT 0;
BA_ "GenSigTimeoutTime_AGSM" SG_ 1831 ESC_OFF_STAT 0;
BA_ "GenSigTimeoutTime_BCM" SG_ 1831 ESC_OFF_STAT 0;
BA_ "GenSigTimeoutTime_BSM" SG_ 1831 ESC_OFF_STAT 0;
BA_ "GenSigTimeoutTime_CADM" SG_ 1831 ESC_OFF_STAT 0;
BA_ "GenSigTimeoutTime_DMSM" SG_ 1831 ESC_OFF_STAT 0;
BA_ "GenSigTimeoutTime_DTCM" SG_ 1831 ESC_OFF_STAT 0;
BA_ "GenSigTimeoutTime_ECM" SG_ 1831 ESC_OFF_STAT 0;
BA_ "GenSigTimeoutTime_EVCU2" SG_ 1831 ESC_OFF_STAT 0;
BA_ "GenSigTimeoutTime_GNMM" SG_ 1831 ESC_OFF_STAT 0;
BA_ "GenSigTimeoutTime_HCP" SG_ 1831 ESC_OFF_STAT 0;
BA_ "GenSigTimeoutTime_IPC" SG_ 1831 ESC_OFF_STAT 0;
BA_ "GenSigTimeoutTime_RFHM" SG_ 1831 ESC_OFF_STAT 0;
BA_ "GenSigTimeoutTime_TCM" SG_ 1831 ESC_OFF_STAT 0;
BA_ "GenSigTimeoutTime_AGSM" SG_ 1831 ETC_CONTROL_STAT 0;
BA_ "GenSigTimeoutTime_BCM" SG_ 1831 ETC_CONTROL_STAT 0;
BA_ "GenSigTimeoutTime_BSM" SG_ 1831 ETC_CONTROL_STAT 0;
BA_ "GenSigTimeoutTime_CADM" SG_ 1831 ETC_CONTROL_STAT 0;
BA_ "GenSigTimeoutTime_DMSM" SG_ 1831 ETC_CONTROL_STAT 0;
BA_ "GenSigTimeoutTime_DTCM" SG_ 1831 ETC_CONTROL_STAT 0;
BA_ "GenSigTimeoutTime_ECM" SG_ 1831 ETC_CONTROL_STAT 0;
BA_ "GenSigTimeoutTime_EVCU2" SG_ 1831 ETC_CONTROL_STAT 0;
BA_ "GenSigTimeoutTime_GNMM" SG_ 1831 ETC_CONTROL_STAT 0;
BA_ "GenSigTimeoutTime_HCP" SG_ 1831 ETC_CONTROL_STAT 0;
BA_ "GenSigTimeoutTime_IPC" SG_ 1831 ETC_CONTROL_STAT 0;
BA_ "GenSigTimeoutTime_RFHM" SG_ 1831 ETC_CONTROL_STAT 0;
BA_ "GenSigTimeoutTime_TCM" SG_ 1831 ETC_CONTROL_STAT 0;
BA_ "GenSigTimeoutTime_AGSM" SG_ 1831 EXH_BRK_STAT 0;
BA_ "GenSigTimeoutTime_BCM" SG_ 1831 EXH_BRK_STAT 0;
BA_ "GenSigTimeoutTime_BSM" SG_ 1831 EXH_BRK_STAT 0;
BA_ "GenSigTimeoutTime_CADM" SG_ 1831 EXH_BRK_STAT 0;
BA_ "GenSigTimeoutTime_DMSM" SG_ 1831 EXH_BRK_STAT 0;
BA_ "GenSigTimeoutTime_DTCM" SG_ 1831 EXH_BRK_STAT 0;
BA_ "GenSigTimeoutTime_ECM" SG_ 1831 EXH_BRK_STAT 0;
BA_ "GenSigTimeoutTime_EVCU2" SG_ 1831 EXH_BRK_STAT 0;
BA_ "GenSigTimeoutTime_GNMM" SG_ 1831 EXH_BRK_STAT 0;
BA_ "GenSigTimeoutTime_HCP" SG_ 1831 EXH_BRK_STAT 0;
BA_ "GenSigTimeoutTime_IPC" SG_ 1831 EXH_BRK_STAT 0;
BA_ "GenSigTimeoutTime_RFHM" SG_ 1831 EXH_BRK_STAT 0;
BA_ "GenSigTimeoutTime_TCM" SG_ 1831 EXH_BRK_STAT 0;
BA_ "GenSigTimeoutTime_AGSM" SG_ 1831 FCW_SYSTEM_STAT 0;
BA_ "GenSigTimeoutTime_BCM" SG_ 1831 FCW_SYSTEM_STAT 0;
BA_ "GenSigTimeoutTime_BSM" SG_ 1831 FCW_SYSTEM_STAT 0;
BA_ "GenSigTimeoutTime_CADM" SG_ 1831 FCW_SYSTEM_STAT 0;
BA_ "GenSigTimeoutTime_DMSM" SG_ 1831 FCW_SYSTEM_STAT 0;
BA_ "GenSigTimeoutTime_DTCM" SG_ 1831 FCW_SYSTEM_STAT 0;
BA_ "GenSigTimeoutTime_ECM" SG_ 1831 FCW_SYSTEM_STAT 0;
BA_ "GenSigTimeoutTime_EVCU2" SG_ 1831 FCW_SYSTEM_STAT 0;
BA_ "GenSigTimeoutTime_GNMM" SG_ 1831 FCW_SYSTEM_STAT 0;
BA_ "GenSigTimeoutTime_HCP" SG_ 1831 FCW_SYSTEM_STAT 0;
BA_ "GenSigTimeoutTime_IPC" SG_ 1831 FCW_SYSTEM_STAT 0;
BA_ "GenSigTimeoutTime_RFHM" SG_ 1831 FCW_SYSTEM_STAT 0;
BA_ "GenSigTimeoutTime_TCM" SG_ 1831 FCW_SYSTEM_STAT 0;
BA_ "GenSigTimeoutTime_AGSM" SG_ 1831 FOUR_WD_SERVICE_STAT 0;
BA_ "GenSigTimeoutTime_BCM" SG_ 1831 FOUR_WD_SERVICE_STAT 0;
BA_ "GenSigTimeoutTime_BSM" SG_ 1831 FOUR_WD_SERVICE_STAT 0;
BA_ "GenSigTimeoutTime_CADM" SG_ 1831 FOUR_WD_SERVICE_STAT 0;
BA_ "GenSigTimeoutTime_DMSM" SG_ 1831 FOUR_WD_SERVICE_STAT 0;
BA_ "GenSigTimeoutTime_DTCM" SG_ 1831 FOUR_WD_SERVICE_STAT 0;
BA_ "GenSigTimeoutTime_ECM" SG_ 1831 FOUR_WD_SERVICE_STAT 0;
BA_ "GenSigTimeoutTime_EVCU2" SG_ 1831 FOUR_WD_SERVICE_STAT 0;
BA_ "GenSigTimeoutTime_GNMM" SG_ 1831 FOUR_WD_SERVICE_STAT 0;
BA_ "GenSigTimeoutTime_HCP" SG_ 1831 FOUR_WD_SERVICE_STAT 0;
BA_ "GenSigTimeoutTime_IPC" SG_ 1831 FOUR_WD_SERVICE_STAT 0;
BA_ "GenSigTimeoutTime_RFHM" SG_ 1831 FOUR_WD_SERVICE_STAT 0;
BA_ "GenSigTimeoutTime_TCM" SG_ 1831 FOUR_WD_SERVICE_STAT 0;
BA_ "GenSigTimeoutTime_AGSM" SG_ 1831 FT_FOG_STAT 0;
BA_ "GenSigTimeoutTime_BCM" SG_ 1831 FT_FOG_STAT 0;
BA_ "GenSigTimeoutTime_BSM" SG_ 1831 FT_FOG_STAT 0;
BA_ "GenSigTimeoutTime_CADM" SG_ 1831 FT_FOG_STAT 0;
BA_ "GenSigTimeoutTime_DMSM" SG_ 1831 FT_FOG_STAT 0;
BA_ "GenSigTimeoutTime_DTCM" SG_ 1831 FT_FOG_STAT 0;
BA_ "GenSigTimeoutTime_ECM" SG_ 1831 FT_FOG_STAT 0;
BA_ "GenSigTimeoutTime_EVCU2" SG_ 1831 FT_FOG_STAT 0;
BA_ "GenSigTimeoutTime_GNMM" SG_ 1831 FT_FOG_STAT 0;
BA_ "GenSigTimeoutTime_HCP" SG_ 1831 FT_FOG_STAT 0;
BA_ "GenSigTimeoutTime_IPC" SG_ 1831 FT_FOG_STAT 0;
BA_ "GenSigTimeoutTime_RFHM" SG_ 1831 FT_FOG_STAT 0;
BA_ "GenSigTimeoutTime_TCM" SG_ 1831 FT_FOG_STAT 0;
BA_ "GenSigTimeoutTime_AGSM" SG_ 1831 FUEL_CAP_STAT 0;
BA_ "GenSigTimeoutTime_BCM" SG_ 1831 FUEL_CAP_STAT 0;
BA_ "GenSigTimeoutTime_BSM" SG_ 1831 FUEL_CAP_STAT 0;
BA_ "GenSigTimeoutTime_CADM" SG_ 1831 FUEL_CAP_STAT 0;
BA_ "GenSigTimeoutTime_DMSM" SG_ 1831 FUEL_CAP_STAT 0;
BA_ "GenSigTimeoutTime_DTCM" SG_ 1831 FUEL_CAP_STAT 0;
BA_ "GenSigTimeoutTime_ECM" SG_ 1831 FUEL_CAP_STAT 0;
BA_ "GenSigTimeoutTime_EVCU2" SG_ 1831 FUEL_CAP_STAT 0;
BA_ "GenSigTimeoutTime_GNMM" SG_ 1831 FUEL_CAP_STAT 0;
BA_ "GenSigTimeoutTime_HCP" SG_ 1831 FUEL_CAP_STAT 0;
BA_ "GenSigTimeoutTime_IPC" SG_ 1831 FUEL_CAP_STAT 0;
BA_ "GenSigTimeoutTime_RFHM" SG_ 1831 FUEL_CAP_STAT 0;
BA_ "GenSigTimeoutTime_TCM" SG_ 1831 FUEL_CAP_STAT 0;
BA_ "GenSigTimeoutTime_AGSM" SG_ 1831 FUEL_CUT_OFF_STAT 0;
BA_ "GenSigTimeoutTime_BCM" SG_ 1831 FUEL_CUT_OFF_STAT 0;
BA_ "GenSigTimeoutTime_BSM" SG_ 1831 FUEL_CUT_OFF_STAT 0;
BA_ "GenSigTimeoutTime_CADM" SG_ 1831 FUEL_CUT_OFF_STAT 0;
BA_ "GenSigTimeoutTime_DMSM" SG_ 1831 FUEL_CUT_OFF_STAT 0;
BA_ "GenSigTimeoutTime_DTCM" SG_ 1831 FUEL_CUT_OFF_STAT 0;
BA_ "GenSigTimeoutTime_ECM" SG_ 1831 FUEL_CUT_OFF_STAT 0;
BA_ "GenSigTimeoutTime_EVCU2" SG_ 1831 FUEL_CUT_OFF_STAT 0;
BA_ "GenSigTimeoutTime_GNMM" SG_ 1831 FUEL_CUT_OFF_STAT 0;
BA_ "GenSigTimeoutTime_HCP" SG_ 1831 FUEL_CUT_OFF_STAT 0;
BA_ "GenSigTimeoutTime_IPC" SG_ 1831 FUEL_CUT_OFF_STAT 0;
BA_ "GenSigTimeoutTime_RFHM" SG_ 1831 FUEL_CUT_OFF_STAT 0;
BA_ "GenSigTimeoutTime_TCM" SG_ 1831 FUEL_CUT_OFF_STAT 0;
BA_ "GenSigTimeoutTime_AGSM" SG_ 1831 HDLT_LVL_STAT 0;
BA_ "GenSigTimeoutTime_BCM" SG_ 1831 HDLT_LVL_STAT 0;
BA_ "GenSigTimeoutTime_BSM" SG_ 1831 HDLT_LVL_STAT 0;
BA_ "GenSigTimeoutTime_CADM" SG_ 1831 HDLT_LVL_STAT 0;
BA_ "GenSigTimeoutTime_DMSM" SG_ 1831 HDLT_LVL_STAT 0;
BA_ "GenSigTimeoutTime_DTCM" SG_ 1831 HDLT_LVL_STAT 0;
BA_ "GenSigTimeoutTime_ECM" SG_ 1831 HDLT_LVL_STAT 0;
BA_ "GenSigTimeoutTime_EVCU2" SG_ 1831 HDLT_LVL_STAT 0;
BA_ "GenSigTimeoutTime_GNMM" SG_ 1831 HDLT_LVL_STAT 0;
BA_ "GenSigTimeoutTime_HCP" SG_ 1831 HDLT_LVL_STAT 0;
BA_ "GenSigTimeoutTime_IPC" SG_ 1831 HDLT_LVL_STAT 0;
BA_ "GenSigTimeoutTime_RFHM" SG_ 1831 HDLT_LVL_STAT 0;
BA_ "GenSigTimeoutTime_TCM" SG_ 1831 HDLT_LVL_STAT 0;
BA_ "GenSigTimeoutTime_AGSM" SG_ 1831 HI_BEAM_STAT 0;
BA_ "GenSigTimeoutTime_BCM" SG_ 1831 HI_BEAM_STAT 0;
BA_ "GenSigTimeoutTime_BSM" SG_ 1831 HI_BEAM_STAT 0;
BA_ "GenSigTimeoutTime_CADM" SG_ 1831 HI_BEAM_STAT 0;
BA_ "GenSigTimeoutTime_DMSM" SG_ 1831 HI_BEAM_STAT 0;
BA_ "GenSigTimeoutTime_DTCM" SG_ 1831 HI_BEAM_STAT 0;
BA_ "GenSigTimeoutTime_ECM" SG_ 1831 HI_BEAM_STAT 0;
BA_ "GenSigTimeoutTime_EVCU2" SG_ 1831 HI_BEAM_STAT 0;
BA_ "GenSigTimeoutTime_GNMM" SG_ 1831 HI_BEAM_STAT 0;
BA_ "GenSigTimeoutTime_HCP" SG_ 1831 HI_BEAM_STAT 0;
BA_ "GenSigTimeoutTime_IPC" SG_ 1831 HI_BEAM_STAT 0;
BA_ "GenSigTimeoutTime_RFHM" SG_ 1831 HI_BEAM_STAT 0;
BA_ "GenSigTimeoutTime_TCM" SG_ 1831 HI_BEAM_STAT 0;
BA_ "GenSigTimeoutTime_AGSM" SG_ 1831 HILL_DESCENT_STAT 0;
BA_ "GenSigTimeoutTime_BCM" SG_ 1831 HILL_DESCENT_STAT 0;
BA_ "GenSigTimeoutTime_BSM" SG_ 1831 HILL_DESCENT_STAT 0;
BA_ "GenSigTimeoutTime_CADM" SG_ 1831 HILL_DESCENT_STAT 0;
BA_ "GenSigTimeoutTime_DMSM" SG_ 1831 HILL_DESCENT_STAT 0;
BA_ "GenSigTimeoutTime_DTCM" SG_ 1831 HILL_DESCENT_STAT 0;
BA_ "GenSigTimeoutTime_ECM" SG_ 1831 HILL_DESCENT_STAT 0;
BA_ "GenSigTimeoutTime_EVCU2" SG_ 1831 HILL_DESCENT_STAT 0;
BA_ "GenSigTimeoutTime_GNMM" SG_ 1831 HILL_DESCENT_STAT 0;
BA_ "GenSigTimeoutTime_HCP" SG_ 1831 HILL_DESCENT_STAT 0;
BA_ "GenSigTimeoutTime_IPC" SG_ 1831 HILL_DESCENT_STAT 0;
BA_ "GenSigTimeoutTime_RFHM" SG_ 1831 HILL_DESCENT_STAT 0;
BA_ "GenSigTimeoutTime_TCM" SG_ 1831 HILL_DESCENT_STAT 0;
BA_ "GenSigTimeoutTime_AGSM" SG_ 1831 HVY_EXH_STAT 0;
BA_ "GenSigTimeoutTime_BCM" SG_ 1831 HVY_EXH_STAT 0;
BA_ "GenSigTimeoutTime_BSM" SG_ 1831 HVY_EXH_STAT 0;
BA_ "GenSigTimeoutTime_CADM" SG_ 1831 HVY_EXH_STAT 0;
BA_ "GenSigTimeoutTime_DMSM" SG_ 1831 HVY_EXH_STAT 0;
BA_ "GenSigTimeoutTime_DTCM" SG_ 1831 HVY_EXH_STAT 0;
BA_ "GenSigTimeoutTime_ECM" SG_ 1831 HVY_EXH_STAT 0;
BA_ "GenSigTimeoutTime_EVCU2" SG_ 1831 HVY_EXH_STAT 0;
BA_ "GenSigTimeoutTime_GNMM" SG_ 1831 HVY_EXH_STAT 0;
BA_ "GenSigTimeoutTime_HCP" SG_ 1831 HVY_EXH_STAT 0;
BA_ "GenSigTimeoutTime_IPC" SG_ 1831 HVY_EXH_STAT 0;
BA_ "GenSigTimeoutTime_RFHM" SG_ 1831 HVY_EXH_STAT 0;
BA_ "GenSigTimeoutTime_TCM" SG_ 1831 HVY_EXH_STAT 0;
BA_ "GenSigTimeoutTime_AGSM" SG_ 1831 LANE_DEPART_FAIL_STAT 0;
BA_ "GenSigTimeoutTime_BCM" SG_ 1831 LANE_DEPART_FAIL_STAT 0;
BA_ "GenSigTimeoutTime_BSM" SG_ 1831 LANE_DEPART_FAIL_STAT 0;
BA_ "GenSigTimeoutTime_CADM" SG_ 1831 LANE_DEPART_FAIL_STAT 0;
BA_ "GenSigTimeoutTime_DMSM" SG_ 1831 LANE_DEPART_FAIL_STAT 0;
BA_ "GenSigTimeoutTime_DTCM" SG_ 1831 LANE_DEPART_FAIL_STAT 0;
BA_ "GenSigTimeoutTime_ECM" SG_ 1831 LANE_DEPART_FAIL_STAT 0;
BA_ "GenSigTimeoutTime_EVCU2" SG_ 1831 LANE_DEPART_FAIL_STAT 0;
BA_ "GenSigTimeoutTime_GNMM" SG_ 1831 LANE_DEPART_FAIL_STAT 0;
BA_ "GenSigTimeoutTime_HCP" SG_ 1831 LANE_DEPART_FAIL_STAT 0;
BA_ "GenSigTimeoutTime_IPC" SG_ 1831 LANE_DEPART_FAIL_STAT 0;
BA_ "GenSigTimeoutTime_RFHM" SG_ 1831 LANE_DEPART_FAIL_STAT 0;
BA_ "GenSigTimeoutTime_TCM" SG_ 1831 LANE_DEPART_FAIL_STAT 0;
BA_ "GenSigTimeoutTime_AGSM" SG_ 1831 LANE_DEPART_STAT 0;
BA_ "GenSigTimeoutTime_BCM" SG_ 1831 LANE_DEPART_STAT 0;
BA_ "GenSigTimeoutTime_BSM" SG_ 1831 LANE_DEPART_STAT 0;
BA_ "GenSigTimeoutTime_CADM" SG_ 1831 LANE_DEPART_STAT 0;
BA_ "GenSigTimeoutTime_DMSM" SG_ 1831 LANE_DEPART_STAT 0;
BA_ "GenSigTimeoutTime_DTCM" SG_ 1831 LANE_DEPART_STAT 0;
BA_ "GenSigTimeoutTime_ECM" SG_ 1831 LANE_DEPART_STAT 0;
BA_ "GenSigTimeoutTime_EVCU2" SG_ 1831 LANE_DEPART_STAT 0;
BA_ "GenSigTimeoutTime_GNMM" SG_ 1831 LANE_DEPART_STAT 0;
BA_ "GenSigTimeoutTime_HCP" SG_ 1831 LANE_DEPART_STAT 0;
BA_ "GenSigTimeoutTime_IPC" SG_ 1831 LANE_DEPART_STAT 0;
BA_ "GenSigTimeoutTime_RFHM" SG_ 1831 LANE_DEPART_STAT 0;
BA_ "GenSigTimeoutTime_TCM" SG_ 1831 LANE_DEPART_STAT 0;
BA_ "GenSigTimeoutTime_AGSM" SG_ 1831 LANE_SENSE_STAT 0;
BA_ "GenSigTimeoutTime_BCM" SG_ 1831 LANE_SENSE_STAT 0;
BA_ "GenSigTimeoutTime_BSM" SG_ 1831 LANE_SENSE_STAT 0;
BA_ "GenSigTimeoutTime_CADM" SG_ 1831 LANE_SENSE_STAT 0;
BA_ "GenSigTimeoutTime_DMSM" SG_ 1831 LANE_SENSE_STAT 0;
BA_ "GenSigTimeoutTime_DTCM" SG_ 1831 LANE_SENSE_STAT 0;
BA_ "GenSigTimeoutTime_ECM" SG_ 1831 LANE_SENSE_STAT 0;
BA_ "GenSigTimeoutTime_EVCU2" SG_ 1831 LANE_SENSE_STAT 0;
BA_ "GenSigTimeoutTime_GNMM" SG_ 1831 LANE_SENSE_STAT 0;
BA_ "GenSigTimeoutTime_HCP" SG_ 1831 LANE_SENSE_STAT 0;
BA_ "GenSigTimeoutTime_IPC" SG_ 1831 LANE_SENSE_STAT 0;
BA_ "GenSigTimeoutTime_RFHM" SG_ 1831 LANE_SENSE_STAT 0;
BA_ "GenSigTimeoutTime_TCM" SG_ 1831 LANE_SENSE_STAT 0;
BA_ "GenSigTimeoutTime_AGSM" SG_ 1831 LIFT_GATE_STAT 0;
BA_ "GenSigTimeoutTime_BCM" SG_ 1831 LIFT_GATE_STAT 0;
BA_ "GenSigTimeoutTime_BSM" SG_ 1831 LIFT_GATE_STAT 0;
BA_ "GenSigTimeoutTime_CADM" SG_ 1831 LIFT_GATE_STAT 0;
BA_ "GenSigTimeoutTime_DMSM" SG_ 1831 LIFT_GATE_STAT 0;
BA_ "GenSigTimeoutTime_DTCM" SG_ 1831 LIFT_GATE_STAT 0;
BA_ "GenSigTimeoutTime_ECM" SG_ 1831 LIFT_GATE_STAT 0;
BA_ "GenSigTimeoutTime_EVCU2" SG_ 1831 LIFT_GATE_STAT 0;
BA_ "GenSigTimeoutTime_GNMM" SG_ 1831 LIFT_GATE_STAT 0;
BA_ "GenSigTimeoutTime_HCP" SG_ 1831 LIFT_GATE_STAT 0;
BA_ "GenSigTimeoutTime_IPC" SG_ 1831 LIFT_GATE_STAT 0;
BA_ "GenSigTimeoutTime_RFHM" SG_ 1831 LIFT_GATE_STAT 0;
BA_ "GenSigTimeoutTime_TCM" SG_ 1831 LIFT_GATE_STAT 0;
BA_ "GenSigTimeoutTime_AGSM" SG_ 1831 LT_EXH_STAT 0;
BA_ "GenSigTimeoutTime_BCM" SG_ 1831 LT_EXH_STAT 0;
BA_ "GenSigTimeoutTime_BSM" SG_ 1831 LT_EXH_STAT 0;
BA_ "GenSigTimeoutTime_CADM" SG_ 1831 LT_EXH_STAT 0;
BA_ "GenSigTimeoutTime_DMSM" SG_ 1831 LT_EXH_STAT 0;
BA_ "GenSigTimeoutTime_DTCM" SG_ 1831 LT_EXH_STAT 0;
BA_ "GenSigTimeoutTime_ECM" SG_ 1831 LT_EXH_STAT 0;
BA_ "GenSigTimeoutTime_EVCU2" SG_ 1831 LT_EXH_STAT 0;
BA_ "GenSigTimeoutTime_GNMM" SG_ 1831 LT_EXH_STAT 0;
BA_ "GenSigTimeoutTime_HCP" SG_ 1831 LT_EXH_STAT 0;
BA_ "GenSigTimeoutTime_IPC" SG_ 1831 LT_EXH_STAT 0;
BA_ "GenSigTimeoutTime_RFHM" SG_ 1831 LT_EXH_STAT 0;
BA_ "GenSigTimeoutTime_TCM" SG_ 1831 LT_EXH_STAT 0;
BA_ "GenSigTimeoutTime_AGSM" SG_ 1831 NAT_GAS_STAT 0;
BA_ "GenSigTimeoutTime_BCM" SG_ 1831 NAT_GAS_STAT 0;
BA_ "GenSigTimeoutTime_BSM" SG_ 1831 NAT_GAS_STAT 0;
BA_ "GenSigTimeoutTime_CADM" SG_ 1831 NAT_GAS_STAT 0;
BA_ "GenSigTimeoutTime_DMSM" SG_ 1831 NAT_GAS_STAT 0;
BA_ "GenSigTimeoutTime_DTCM" SG_ 1831 NAT_GAS_STAT 0;
BA_ "GenSigTimeoutTime_ECM" SG_ 1831 NAT_GAS_STAT 0;
BA_ "GenSigTimeoutTime_EVCU2" SG_ 1831 NAT_GAS_STAT 0;
BA_ "GenSigTimeoutTime_GNMM" SG_ 1831 NAT_GAS_STAT 0;
BA_ "GenSigTimeoutTime_HCP" SG_ 1831 NAT_GAS_STAT 0;
BA_ "GenSigTimeoutTime_IPC" SG_ 1831 NAT_GAS_STAT 0;
BA_ "GenSigTimeoutTime_RFHM" SG_ 1831 NAT_GAS_STAT 0;
BA_ "GenSigTimeoutTime_TCM" SG_ 1831 NAT_GAS_STAT 0;
BA_ "GenSigTimeoutTime_AGSM" SG_ 1831 OIL_LEVEL_STAT 0;
BA_ "GenSigTimeoutTime_BCM" SG_ 1831 OIL_LEVEL_STAT 0;
BA_ "GenSigTimeoutTime_BSM" SG_ 1831 OIL_LEVEL_STAT 0;
BA_ "GenSigTimeoutTime_CADM" SG_ 1831 OIL_LEVEL_STAT 0;
BA_ "GenSigTimeoutTime_DMSM" SG_ 1831 OIL_LEVEL_STAT 0;
BA_ "GenSigTimeoutTime_DTCM" SG_ 1831 OIL_LEVEL_STAT 0;
BA_ "GenSigTimeoutTime_ECM" SG_ 1831 OIL_LEVEL_STAT 0;
BA_ "GenSigTimeoutTime_EVCU2" SG_ 1831 OIL_LEVEL_STAT 0;
BA_ "GenSigTimeoutTime_GNMM" SG_ 1831 OIL_LEVEL_STAT 0;
BA_ "GenSigTimeoutTime_HCP" SG_ 1831 OIL_LEVEL_STAT 0;
BA_ "GenSigTimeoutTime_IPC" SG_ 1831 OIL_LEVEL_STAT 0;
BA_ "GenSigTimeoutTime_RFHM" SG_ 1831 OIL_LEVEL_STAT 0;
BA_ "GenSigTimeoutTime_TCM" SG_ 1831 OIL_LEVEL_STAT 0;
BA_ "GenSigTimeoutTime_AGSM" SG_ 1831 OIL_PRESSURE_STAT 0;
BA_ "GenSigTimeoutTime_BCM" SG_ 1831 OIL_PRESSURE_STAT 0;
BA_ "GenSigTimeoutTime_BSM" SG_ 1831 OIL_PRESSURE_STAT 0;
BA_ "GenSigTimeoutTime_CADM" SG_ 1831 OIL_PRESSURE_STAT 0;
BA_ "GenSigTimeoutTime_DMSM" SG_ 1831 OIL_PRESSURE_STAT 0;
BA_ "GenSigTimeoutTime_DTCM" SG_ 1831 OIL_PRESSURE_STAT 0;
BA_ "GenSigTimeoutTime_ECM" SG_ 1831 OIL_PRESSURE_STAT 0;
BA_ "GenSigTimeoutTime_EVCU2" SG_ 1831 OIL_PRESSURE_STAT 0;
BA_ "GenSigTimeoutTime_GNMM" SG_ 1831 OIL_PRESSURE_STAT 0;
BA_ "GenSigTimeoutTime_HCP" SG_ 1831 OIL_PRESSURE_STAT 0;
BA_ "GenSigTimeoutTime_IPC" SG_ 1831 OIL_PRESSURE_STAT 0;
BA_ "GenSigTimeoutTime_RFHM" SG_ 1831 OIL_PRESSURE_STAT 0;
BA_ "GenSigTimeoutTime_TCM" SG_ 1831 OIL_PRESSURE_STAT 0;
BA_ "GenSigTimeoutTime_AGSM" SG_ 1831 OIL_TEMP_STAT 0;
BA_ "GenSigTimeoutTime_BCM" SG_ 1831 OIL_TEMP_STAT 0;
BA_ "GenSigTimeoutTime_BSM" SG_ 1831 OIL_TEMP_STAT 0;
BA_ "GenSigTimeoutTime_CADM" SG_ 1831 OIL_TEMP_STAT 0;
BA_ "GenSigTimeoutTime_DMSM" SG_ 1831 OIL_TEMP_STAT 0;
BA_ "GenSigTimeoutTime_DTCM" SG_ 1831 OIL_TEMP_STAT 0;
BA_ "GenSigTimeoutTime_ECM" SG_ 1831 OIL_TEMP_STAT 0;
BA_ "GenSigTimeoutTime_EVCU2" SG_ 1831 OIL_TEMP_STAT 0;
BA_ "GenSigTimeoutTime_GNMM" SG_ 1831 OIL_TEMP_STAT 0;
BA_ "GenSigTimeoutTime_HCP" SG_ 1831 OIL_TEMP_STAT 0;
BA_ "GenSigTimeoutTime_IPC" SG_ 1831 OIL_TEMP_STAT 0;
BA_ "GenSigTimeoutTime_RFHM" SG_ 1831 OIL_TEMP_STAT 0;
BA_ "GenSigTimeoutTime_TCM" SG_ 1831 OIL_TEMP_STAT 0;
BA_ "GenSigTimeoutTime_AGSM" SG_ 1831 OVER_TEMP_STAT 0;
BA_ "GenSigTimeoutTime_BCM" SG_ 1831 OVER_TEMP_STAT 0;
BA_ "GenSigTimeoutTime_BSM" SG_ 1831 OVER_TEMP_STAT 0;
BA_ "GenSigTimeoutTime_CADM" SG_ 1831 OVER_TEMP_STAT 0;
BA_ "GenSigTimeoutTime_DMSM" SG_ 1831 OVER_TEMP_STAT 0;
BA_ "GenSigTimeoutTime_DTCM" SG_ 1831 OVER_TEMP_STAT 0;
BA_ "GenSigTimeoutTime_ECM" SG_ 1831 OVER_TEMP_STAT 0;
BA_ "GenSigTimeoutTime_EVCU2" SG_ 1831 OVER_TEMP_STAT 0;
BA_ "GenSigTimeoutTime_GNMM" SG_ 1831 OVER_TEMP_STAT 0;
BA_ "GenSigTimeoutTime_HCP" SG_ 1831 OVER_TEMP_STAT 0;
BA_ "GenSigTimeoutTime_IPC" SG_ 1831 OVER_TEMP_STAT 0;
BA_ "GenSigTimeoutTime_RFHM" SG_ 1831 OVER_TEMP_STAT 0;
BA_ "GenSigTimeoutTime_TCM" SG_ 1831 OVER_TEMP_STAT 0;
BA_ "GenSigTimeoutTime_AGSM" SG_ 1831 PARK_BRAKE_STAT 0;
BA_ "GenSigTimeoutTime_BCM" SG_ 1831 PARK_BRAKE_STAT 0;
BA_ "GenSigTimeoutTime_BSM" SG_ 1831 PARK_BRAKE_STAT 0;
BA_ "GenSigTimeoutTime_CADM" SG_ 1831 PARK_BRAKE_STAT 0;
BA_ "GenSigTimeoutTime_DMSM" SG_ 1831 PARK_BRAKE_STAT 0;
BA_ "GenSigTimeoutTime_DTCM" SG_ 1831 PARK_BRAKE_STAT 0;
BA_ "GenSigTimeoutTime_ECM" SG_ 1831 PARK_BRAKE_STAT 0;
BA_ "GenSigTimeoutTime_EVCU2" SG_ 1831 PARK_BRAKE_STAT 0;
BA_ "GenSigTimeoutTime_GNMM" SG_ 1831 PARK_BRAKE_STAT 0;
BA_ "GenSigTimeoutTime_HCP" SG_ 1831 PARK_BRAKE_STAT 0;
BA_ "GenSigTimeoutTime_IPC" SG_ 1831 PARK_BRAKE_STAT 0;
BA_ "GenSigTimeoutTime_RFHM" SG_ 1831 PARK_BRAKE_STAT 0;
BA_ "GenSigTimeoutTime_TCM" SG_ 1831 PARK_BRAKE_STAT 0;
BA_ "GenSigTimeoutTime_AGSM" SG_ 1831 POS_LIGHT_STAT 0;
BA_ "GenSigTimeoutTime_BCM" SG_ 1831 POS_LIGHT_STAT 0;
BA_ "GenSigTimeoutTime_BSM" SG_ 1831 POS_LIGHT_STAT 0;
BA_ "GenSigTimeoutTime_CADM" SG_ 1831 POS_LIGHT_STAT 0;
BA_ "GenSigTimeoutTime_DMSM" SG_ 1831 POS_LIGHT_STAT 0;
BA_ "GenSigTimeoutTime_DTCM" SG_ 1831 POS_LIGHT_STAT 0;
BA_ "GenSigTimeoutTime_ECM" SG_ 1831 POS_LIGHT_STAT 0;
BA_ "GenSigTimeoutTime_EVCU2" SG_ 1831 POS_LIGHT_STAT 0;
BA_ "GenSigTimeoutTime_GNMM" SG_ 1831 POS_LIGHT_STAT 0;
BA_ "GenSigTimeoutTime_HCP" SG_ 1831 POS_LIGHT_STAT 0;
BA_ "GenSigTimeoutTime_IPC" SG_ 1831 POS_LIGHT_STAT 0;
BA_ "GenSigTimeoutTime_RFHM" SG_ 1831 POS_LIGHT_STAT 0;
BA_ "GenSigTimeoutTime_TCM" SG_ 1831 POS_LIGHT_STAT 0;
BA_ "GenSigTimeoutTime_AGSM" SG_ 1831 SEAT_BELT_STAT 0;
BA_ "GenSigTimeoutTime_BCM" SG_ 1831 SEAT_BELT_STAT 0;
BA_ "GenSigTimeoutTime_BSM" SG_ 1831 SEAT_BELT_STAT 0;
BA_ "GenSigTimeoutTime_CADM" SG_ 1831 SEAT_BELT_STAT 0;
BA_ "GenSigTimeoutTime_DMSM" SG_ 1831 SEAT_BELT_STAT 0;
BA_ "GenSigTimeoutTime_DTCM" SG_ 1831 SEAT_BELT_STAT 0;
BA_ "GenSigTimeoutTime_ECM" SG_ 1831 SEAT_BELT_STAT 0;
BA_ "GenSigTimeoutTime_EVCU2" SG_ 1831 SEAT_BELT_STAT 0;
BA_ "GenSigTimeoutTime_GNMM" SG_ 1831 SEAT_BELT_STAT 0;
BA_ "GenSigTimeoutTime_HCP" SG_ 1831 SEAT_BELT_STAT 0;
BA_ "GenSigTimeoutTime_IPC" SG_ 1831 SEAT_BELT_STAT 0;
BA_ "GenSigTimeoutTime_RFHM" SG_ 1831 SEAT_BELT_STAT 0;
BA_ "GenSigTimeoutTime_TCM" SG_ 1831 SEAT_BELT_STAT 0;
BA_ "GenSigTimeoutTime_AGSM" SG_ 1831 SERVICE_ACC_STAT 0;
BA_ "GenSigTimeoutTime_BCM" SG_ 1831 SERVICE_ACC_STAT 0;
BA_ "GenSigTimeoutTime_BSM" SG_ 1831 SERVICE_ACC_STAT 0;
BA_ "GenSigTimeoutTime_CADM" SG_ 1831 SERVICE_ACC_STAT 0;
BA_ "GenSigTimeoutTime_DMSM" SG_ 1831 SERVICE_ACC_STAT 0;
BA_ "GenSigTimeoutTime_DTCM" SG_ 1831 SERVICE_ACC_STAT 0;
BA_ "GenSigTimeoutTime_ECM" SG_ 1831 SERVICE_ACC_STAT 0;
BA_ "GenSigTimeoutTime_EVCU2" SG_ 1831 SERVICE_ACC_STAT 0;
BA_ "GenSigTimeoutTime_GNMM" SG_ 1831 SERVICE_ACC_STAT 0;
BA_ "GenSigTimeoutTime_HCP" SG_ 1831 SERVICE_ACC_STAT 0;
BA_ "GenSigTimeoutTime_IPC" SG_ 1831 SERVICE_ACC_STAT 0;
BA_ "GenSigTimeoutTime_RFHM" SG_ 1831 SERVICE_ACC_STAT 0;
BA_ "GenSigTimeoutTime_TCM" SG_ 1831 SERVICE_ACC_STAT 0;
BA_ "GenSigTimeoutTime_AGSM" SG_ 1831 SERVICE_STAT 0;
BA_ "GenSigTimeoutTime_BCM" SG_ 1831 SERVICE_STAT 0;
BA_ "GenSigTimeoutTime_BSM" SG_ 1831 SERVICE_STAT 0;
BA_ "GenSigTimeoutTime_CADM" SG_ 1831 SERVICE_STAT 0;
BA_ "GenSigTimeoutTime_DMSM" SG_ 1831 SERVICE_STAT 0;
BA_ "GenSigTimeoutTime_DTCM" SG_ 1831 SERVICE_STAT 0;
BA_ "GenSigTimeoutTime_ECM" SG_ 1831 SERVICE_STAT 0;
BA_ "GenSigTimeoutTime_EVCU2" SG_ 1831 SERVICE_STAT 0;
BA_ "GenSigTimeoutTime_GNMM" SG_ 1831 SERVICE_STAT 0;
BA_ "GenSigTimeoutTime_HCP" SG_ 1831 SERVICE_STAT 0;
BA_ "GenSigTimeoutTime_IPC" SG_ 1831 SERVICE_STAT 0;
BA_ "GenSigTimeoutTime_RFHM" SG_ 1831 SERVICE_STAT 0;
BA_ "GenSigTimeoutTime_TCM" SG_ 1831 SERVICE_STAT 0;
BA_ "GenSigTimeoutTime_AGSM" SG_ 1831 SPEED_CTRL_STAT 0;
BA_ "GenSigTimeoutTime_BCM" SG_ 1831 SPEED_CTRL_STAT 0;
BA_ "GenSigTimeoutTime_BSM" SG_ 1831 SPEED_CTRL_STAT 0;
BA_ "GenSigTimeoutTime_CADM" SG_ 1831 SPEED_CTRL_STAT 0;
BA_ "GenSigTimeoutTime_DMSM" SG_ 1831 SPEED_CTRL_STAT 0;
BA_ "GenSigTimeoutTime_DTCM" SG_ 1831 SPEED_CTRL_STAT 0;
BA_ "GenSigTimeoutTime_ECM" SG_ 1831 SPEED_CTRL_STAT 0;
BA_ "GenSigTimeoutTime_EVCU2" SG_ 1831 SPEED_CTRL_STAT 0;
BA_ "GenSigTimeoutTime_GNMM" SG_ 1831 SPEED_CTRL_STAT 0;
BA_ "GenSigTimeoutTime_HCP" SG_ 1831 SPEED_CTRL_STAT 0;
BA_ "GenSigTimeoutTime_IPC" SG_ 1831 SPEED_CTRL_STAT 0;
BA_ "GenSigTimeoutTime_RFHM" SG_ 1831 SPEED_CTRL_STAT 0;
BA_ "GenSigTimeoutTime_TCM" SG_ 1831 SPEED_CTRL_STAT 0;
BA_ "GenSigTimeoutTime_AGSM" SG_ 1831 SPEED_LMT_STAT 0;
BA_ "GenSigTimeoutTime_BCM" SG_ 1831 SPEED_LMT_STAT 0;
BA_ "GenSigTimeoutTime_BSM" SG_ 1831 SPEED_LMT_STAT 0;
BA_ "GenSigTimeoutTime_CADM" SG_ 1831 SPEED_LMT_STAT 0;
BA_ "GenSigTimeoutTime_DMSM" SG_ 1831 SPEED_LMT_STAT 0;
BA_ "GenSigTimeoutTime_DTCM" SG_ 1831 SPEED_LMT_STAT 0;
BA_ "GenSigTimeoutTime_ECM" SG_ 1831 SPEED_LMT_STAT 0;
BA_ "GenSigTimeoutTime_EVCU2" SG_ 1831 SPEED_LMT_STAT 0;
BA_ "GenSigTimeoutTime_GNMM" SG_ 1831 SPEED_LMT_STAT 0;
BA_ "GenSigTimeoutTime_HCP" SG_ 1831 SPEED_LMT_STAT 0;
BA_ "GenSigTimeoutTime_IPC" SG_ 1831 SPEED_LMT_STAT 0;
BA_ "GenSigTimeoutTime_RFHM" SG_ 1831 SPEED_LMT_STAT 0;
BA_ "GenSigTimeoutTime_TCM" SG_ 1831 SPEED_LMT_STAT 0;
BA_ "GenSigTimeoutTime_AGSM" SG_ 1831 STOP_START_STAT 0;
BA_ "GenSigTimeoutTime_BCM" SG_ 1831 STOP_START_STAT 0;
BA_ "GenSigTimeoutTime_BSM" SG_ 1831 STOP_START_STAT 0;
BA_ "GenSigTimeoutTime_CADM" SG_ 1831 STOP_START_STAT 0;
BA_ "GenSigTimeoutTime_DMSM" SG_ 1831 STOP_START_STAT 0;
BA_ "GenSigTimeoutTime_DTCM" SG_ 1831 STOP_START_STAT 0;
BA_ "GenSigTimeoutTime_ECM" SG_ 1831 STOP_START_STAT 0;
BA_ "GenSigTimeoutTime_EVCU2" SG_ 1831 STOP_START_STAT 0;
BA_ "GenSigTimeoutTime_GNMM" SG_ 1831 STOP_START_STAT 0;
BA_ "GenSigTimeoutTime_HCP" SG_ 1831 STOP_START_STAT 0;
BA_ "GenSigTimeoutTime_IPC" SG_ 1831 STOP_START_STAT 0;
BA_ "GenSigTimeoutTime_RFHM" SG_ 1831 STOP_START_STAT 0;
BA_ "GenSigTimeoutTime_TCM" SG_ 1831 STOP_START_STAT 0;
BA_ "GenSigTimeoutTime_AGSM" SG_ 1831 STR_DIR_LT_STAT 0;
BA_ "GenSigTimeoutTime_BCM" SG_ 1831 STR_DIR_LT_STAT 0;
BA_ "GenSigTimeoutTime_BSM" SG_ 1831 STR_DIR_LT_STAT 0;
BA_ "GenSigTimeoutTime_CADM" SG_ 1831 STR_DIR_LT_STAT 0;
BA_ "GenSigTimeoutTime_DMSM" SG_ 1831 STR_DIR_LT_STAT 0;
BA_ "GenSigTimeoutTime_DTCM" SG_ 1831 STR_DIR_LT_STAT 0;
BA_ "GenSigTimeoutTime_ECM" SG_ 1831 STR_DIR_LT_STAT 0;
BA_ "GenSigTimeoutTime_EVCU2" SG_ 1831 STR_DIR_LT_STAT 0;
BA_ "GenSigTimeoutTime_GNMM" SG_ 1831 STR_DIR_LT_STAT 0;
BA_ "GenSigTimeoutTime_HCP" SG_ 1831 STR_DIR_LT_STAT 0;
BA_ "GenSigTimeoutTime_IPC" SG_ 1831 STR_DIR_LT_STAT 0;
BA_ "GenSigTimeoutTime_RFHM" SG_ 1831 STR_DIR_LT_STAT 0;
BA_ "GenSigTimeoutTime_TCM" SG_ 1831 STR_DIR_LT_STAT 0;
BA_ "GenSigTimeoutTime_AGSM" SG_ 1831 THEFT_ALARM_STAT 0;
BA_ "GenSigTimeoutTime_BCM" SG_ 1831 THEFT_ALARM_STAT 0;
BA_ "GenSigTimeoutTime_BSM" SG_ 1831 THEFT_ALARM_STAT 0;
BA_ "GenSigTimeoutTime_CADM" SG_ 1831 THEFT_ALARM_STAT 0;
BA_ "GenSigTimeoutTime_DMSM" SG_ 1831 THEFT_ALARM_STAT 0;
BA_ "GenSigTimeoutTime_DTCM" SG_ 1831 THEFT_ALARM_STAT 0;
BA_ "GenSigTimeoutTime_ECM" SG_ 1831 THEFT_ALARM_STAT 0;
BA_ "GenSigTimeoutTime_EVCU2" SG_ 1831 THEFT_ALARM_STAT 0;
BA_ "GenSigTimeoutTime_GNMM" SG_ 1831 THEFT_ALARM_STAT 0;
BA_ "GenSigTimeoutTime_HCP" SG_ 1831 THEFT_ALARM_STAT 0;
BA_ "GenSigTimeoutTime_IPC" SG_ 1831 THEFT_ALARM_STAT 0;
BA_ "GenSigTimeoutTime_RFHM" SG_ 1831 THEFT_ALARM_STAT 0;
BA_ "GenSigTimeoutTime_TCM" SG_ 1831 THEFT_ALARM_STAT 0;
BA_ "GenSigTimeoutTime_AGSM" SG_ 1831 TIRE_PRESSURE_STAT 0;
BA_ "GenSigTimeoutTime_BCM" SG_ 1831 TIRE_PRESSURE_STAT 0;
BA_ "GenSigTimeoutTime_BSM" SG_ 1831 TIRE_PRESSURE_STAT 0;
BA_ "GenSigTimeoutTime_CADM" SG_ 1831 TIRE_PRESSURE_STAT 0;
BA_ "GenSigTimeoutTime_DMSM" SG_ 1831 TIRE_PRESSURE_STAT 0;
BA_ "GenSigTimeoutTime_DTCM" SG_ 1831 TIRE_PRESSURE_STAT 0;
BA_ "GenSigTimeoutTime_ECM" SG_ 1831 TIRE_PRESSURE_STAT 0;
BA_ "GenSigTimeoutTime_EVCU2" SG_ 1831 TIRE_PRESSURE_STAT 0;
BA_ "GenSigTimeoutTime_GNMM" SG_ 1831 TIRE_PRESSURE_STAT 0;
BA_ "GenSigTimeoutTime_HCP" SG_ 1831 TIRE_PRESSURE_STAT 0;
BA_ "GenSigTimeoutTime_IPC" SG_ 1831 TIRE_PRESSURE_STAT 0;
BA_ "GenSigTimeoutTime_RFHM" SG_ 1831 TIRE_PRESSURE_STAT 0;
BA_ "GenSigTimeoutTime_TCM" SG_ 1831 TIRE_PRESSURE_STAT 0;
BA_ "GenSigTimeoutTime_AGSM" SG_ 1831 TORQUE_STAT 0;
BA_ "GenSigTimeoutTime_BCM" SG_ 1831 TORQUE_STAT 0;
BA_ "GenSigTimeoutTime_BSM" SG_ 1831 TORQUE_STAT 0;
BA_ "GenSigTimeoutTime_CADM" SG_ 1831 TORQUE_STAT 0;
BA_ "GenSigTimeoutTime_DMSM" SG_ 1831 TORQUE_STAT 0;
BA_ "GenSigTimeoutTime_DTCM" SG_ 1831 TORQUE_STAT 0;
BA_ "GenSigTimeoutTime_ECM" SG_ 1831 TORQUE_STAT 0;
BA_ "GenSigTimeoutTime_EVCU2" SG_ 1831 TORQUE_STAT 0;
BA_ "GenSigTimeoutTime_GNMM" SG_ 1831 TORQUE_STAT 0;
BA_ "GenSigTimeoutTime_HCP" SG_ 1831 TORQUE_STAT 0;
BA_ "GenSigTimeoutTime_IPC" SG_ 1831 TORQUE_STAT 0;
BA_ "GenSigTimeoutTime_RFHM" SG_ 1831 TORQUE_STAT 0;
BA_ "GenSigTimeoutTime_TCM" SG_ 1831 TORQUE_STAT 0;
BA_ "GenSigTimeoutTime_AGSM" SG_ 1831 TOW_HAUL_STAT 0;
BA_ "GenSigTimeoutTime_BCM" SG_ 1831 TOW_HAUL_STAT 0;
BA_ "GenSigTimeoutTime_BSM" SG_ 1831 TOW_HAUL_STAT 0;
BA_ "GenSigTimeoutTime_CADM" SG_ 1831 TOW_HAUL_STAT 0;
BA_ "GenSigTimeoutTime_DMSM" SG_ 1831 TOW_HAUL_STAT 0;
BA_ "GenSigTimeoutTime_DTCM" SG_ 1831 TOW_HAUL_STAT 0;
BA_ "GenSigTimeoutTime_ECM" SG_ 1831 TOW_HAUL_STAT 0;
BA_ "GenSigTimeoutTime_EVCU2" SG_ 1831 TOW_HAUL_STAT 0;
BA_ "GenSigTimeoutTime_GNMM" SG_ 1831 TOW_HAUL_STAT 0;
BA_ "GenSigTimeoutTime_HCP" SG_ 1831 TOW_HAUL_STAT 0;
BA_ "GenSigTimeoutTime_IPC" SG_ 1831 TOW_HAUL_STAT 0;
BA_ "GenSigTimeoutTime_RFHM" SG_ 1831 TOW_HAUL_STAT 0;
BA_ "GenSigTimeoutTime_TCM" SG_ 1831 TOW_HAUL_STAT 0;
BA_ "GenSigTimeoutTime_AGSM" SG_ 1831 TRK_OPN_STAT 0;
BA_ "GenSigTimeoutTime_BCM" SG_ 1831 TRK_OPN_STAT 0;
BA_ "GenSigTimeoutTime_BSM" SG_ 1831 TRK_OPN_STAT 0;
BA_ "GenSigTimeoutTime_CADM" SG_ 1831 TRK_OPN_STAT 0;
BA_ "GenSigTimeoutTime_DMSM" SG_ 1831 TRK_OPN_STAT 0;
BA_ "GenSigTimeoutTime_DTCM" SG_ 1831 TRK_OPN_STAT 0;
BA_ "GenSigTimeoutTime_ECM" SG_ 1831 TRK_OPN_STAT 0;
BA_ "GenSigTimeoutTime_EVCU2" SG_ 1831 TRK_OPN_STAT 0;
BA_ "GenSigTimeoutTime_GNMM" SG_ 1831 TRK_OPN_STAT 0;
BA_ "GenSigTimeoutTime_HCP" SG_ 1831 TRK_OPN_STAT 0;
BA_ "GenSigTimeoutTime_IPC" SG_ 1831 TRK_OPN_STAT 0;
BA_ "GenSigTimeoutTime_RFHM" SG_ 1831 TRK_OPN_STAT 0;
BA_ "GenSigTimeoutTime_TCM" SG_ 1831 TRK_OPN_STAT 0;
BA_ "GenSigTimeoutTime_AGSM" SG_ 1831 WATER_IN_FUEL_STAT 0;
BA_ "GenSigTimeoutTime_BCM" SG_ 1831 WATER_IN_FUEL_STAT 0;
BA_ "GenSigTimeoutTime_BSM" SG_ 1831 WATER_IN_FUEL_STAT 0;
BA_ "GenSigTimeoutTime_CADM" SG_ 1831 WATER_IN_FUEL_STAT 0;
BA_ "GenSigTimeoutTime_DMSM" SG_ 1831 WATER_IN_FUEL_STAT 0;
BA_ "GenSigTimeoutTime_DTCM" SG_ 1831 WATER_IN_FUEL_STAT 0;
BA_ "GenSigTimeoutTime_ECM" SG_ 1831 WATER_IN_FUEL_STAT 0;
BA_ "GenSigTimeoutTime_EVCU2" SG_ 1831 WATER_IN_FUEL_STAT 0;
BA_ "GenSigTimeoutTime_GNMM" SG_ 1831 WATER_IN_FUEL_STAT 0;
BA_ "GenSigTimeoutTime_HCP" SG_ 1831 WATER_IN_FUEL_STAT 0;
BA_ "GenSigTimeoutTime_IPC" SG_ 1831 WATER_IN_FUEL_STAT 0;
BA_ "GenSigTimeoutTime_RFHM" SG_ 1831 WATER_IN_FUEL_STAT 0;
BA_ "GenSigTimeoutTime_TCM" SG_ 1831 WATER_IN_FUEL_STAT 0;
BA_ "GenSigTimeoutTime_AGSM" SG_ 1831 WINDSHIELD_FLUID_STAT 0;
BA_ "GenSigTimeoutTime_BCM" SG_ 1831 WINDSHIELD_FLUID_STAT 0;
BA_ "GenSigTimeoutTime_BSM" SG_ 1831 WINDSHIELD_FLUID_STAT 0;
BA_ "GenSigTimeoutTime_CADM" SG_ 1831 WINDSHIELD_FLUID_STAT 0;
BA_ "GenSigTimeoutTime_DMSM" SG_ 1831 WINDSHIELD_FLUID_STAT 0;
BA_ "GenSigTimeoutTime_DTCM" SG_ 1831 WINDSHIELD_FLUID_STAT 0;
BA_ "GenSigTimeoutTime_ECM" SG_ 1831 WINDSHIELD_FLUID_STAT 0;
BA_ "GenSigTimeoutTime_EVCU2" SG_ 1831 WINDSHIELD_FLUID_STAT 0;
BA_ "GenSigTimeoutTime_GNMM" SG_ 1831 WINDSHIELD_FLUID_STAT 0;
BA_ "GenSigTimeoutTime_HCP" SG_ 1831 WINDSHIELD_FLUID_STAT 0;
BA_ "GenSigTimeoutTime_IPC" SG_ 1831 WINDSHIELD_FLUID_STAT 0;
BA_ "GenSigTimeoutTime_RFHM" SG_ 1831 WINDSHIELD_FLUID_STAT 0;
BA_ "GenSigTimeoutTime_TCM" SG_ 1831 WINDSHIELD_FLUID_STAT 0;
BA_ "GenSigTimeoutTime_AGSM" SG_ 600 AirBagLamp_FailSts 0;
BA_ "GenSigTimeoutTime_BSM" SG_ 600 AirBagLamp_FailSts 0;
BA_ "GenSigTimeoutTime_CADM" SG_ 600 AirBagLamp_FailSts 0;
BA_ "GenSigTimeoutTime_DMSM" SG_ 600 AirBagLamp_FailSts 0;
BA_ "GenSigTimeoutTime_DTCM" SG_ 600 AirBagLamp_FailSts 0;
BA_ "GenSigTimeoutTime_ECM" SG_ 600 AirBagLamp_FailSts 0;
BA_ "GenSigTimeoutTime_EVCU2" SG_ 600 AirBagLamp_FailSts 0;
BA_ "GenSigTimeoutTime_GNMM" SG_ 600 AirBagLamp_FailSts 0;
BA_ "GenSigTimeoutTime_HCP" SG_ 600 AirBagLamp_FailSts 0;
BA_ "GenSigTimeoutTime_IPC" SG_ 600 AirBagLamp_FailSts 0;
BA_ "GenSigTimeoutTime_RFHM" SG_ 600 AirBagLamp_FailSts 0;
BA_ "GenSigTimeoutTime_TCM" SG_ 600 AirBagLamp_FailSts 0;
BA_ "GenSigSendType" SG_ 600 DisplayedSpeedLimSts 3;
BA_ "GenSigTimeoutTime_AGSM" SG_ 600 DisplayedSpeedLimSts 0;
BA_ "GenSigTimeoutTime_BCM" SG_ 600 DisplayedSpeedLimSts 0;
BA_ "GenSigTimeoutTime_BSM" SG_ 600 DisplayedSpeedLimSts 0;
BA_ "GenSigTimeoutTime_CADM" SG_ 600 DisplayedSpeedLimSts 0;
BA_ "GenSigTimeoutTime_DMSM" SG_ 600 DisplayedSpeedLimSts 0;
BA_ "GenSigTimeoutTime_DTCM" SG_ 600 DisplayedSpeedLimSts 0;
BA_ "GenSigTimeoutTime_ECM" SG_ 600 DisplayedSpeedLimSts 0;
BA_ "GenSigTimeoutTime_GNMM" SG_ 600 DisplayedSpeedLimSts 0;
BA_ "GenSigTimeoutTime_HCP" SG_ 600 DisplayedSpeedLimSts 0;
BA_ "GenSigTimeoutTime_IPC" SG_ 600 DisplayedSpeedLimSts 0;
BA_ "GenSigTimeoutTime_RFHM" SG_ 600 DisplayedSpeedLimSts 0;
BA_ "GenSigTimeoutTime_TCM" SG_ 600 DisplayedSpeedLimSts 0;
BA_ "GenSigTimeoutTime_AGSM" SG_ 600 OilChgRst 0;
BA_ "GenSigTimeoutTime_BCM" SG_ 600 OilChgRst 0;
BA_ "GenSigTimeoutTime_BSM" SG_ 600 OilChgRst 0;
BA_ "GenSigTimeoutTime_CADM" SG_ 600 OilChgRst 0;
BA_ "GenSigTimeoutTime_DMSM" SG_ 600 OilChgRst 0;
BA_ "GenSigTimeoutTime_DTCM" SG_ 600 OilChgRst 0;
BA_ "GenSigTimeoutTime_EVCU2" SG_ 600 OilChgRst 0;
BA_ "GenSigTimeoutTime_GNMM" SG_ 600 OilChgRst 0;
BA_ "GenSigTimeoutTime_HCP" SG_ 600 OilChgRst 0;
BA_ "GenSigTimeoutTime_IPC" SG_ 600 OilChgRst 0;
BA_ "GenSigTimeoutTime_RFHM" SG_ 600 OilChgRst 0;
BA_ "GenSigTimeoutTime_SGW" SG_ 600 OilChgRst 0;
BA_ "GenSigTimeoutTime_TCM" SG_ 600 OilChgRst 0;
BA_ "GenSigTimeoutTime_AGSM" SG_ 1154 Est_Range_Disp 0;
BA_ "GenSigTimeoutTime_BCM" SG_ 1154 Est_Range_Disp 0;
BA_ "GenSigTimeoutTime_BSM" SG_ 1154 Est_Range_Disp 0;
BA_ "GenSigTimeoutTime_CADM" SG_ 1154 Est_Range_Disp 0;
BA_ "GenSigTimeoutTime_DMSM" SG_ 1154 Est_Range_Disp 0;
BA_ "GenSigTimeoutTime_DTCM" SG_ 1154 Est_Range_Disp 0;
BA_ "GenSigTimeoutTime_ECM" SG_ 1154 Est_Range_Disp 0;
BA_ "GenSigTimeoutTime_EVCU2" SG_ 1154 Est_Range_Disp 0;
BA_ "GenSigTimeoutTime_GNMM" SG_ 1154 Est_Range_Disp 0;
BA_ "GenSigTimeoutTime_HCP" SG_ 1154 Est_Range_Disp 0;
BA_ "GenSigTimeoutTime_IPC" SG_ 1154 Est_Range_Disp 0;
BA_ "GenSigTimeoutTime_RFHM" SG_ 1154 Est_Range_Disp 0;
BA_ "GenSigTimeoutTime_TCM" SG_ 1154 Est_Range_Disp 0;
BA_ "GenSigTimeoutTime_AGSM" SG_ 1154 Est_Range_Disp_Long 0;
BA_ "GenSigTimeoutTime_BCM" SG_ 1154 Est_Range_Disp_Long 0;
BA_ "GenSigTimeoutTime_BSM" SG_ 1154 Est_Range_Disp_Long 0;
BA_ "GenSigTimeoutTime_CADM" SG_ 1154 Est_Range_Disp_Long 0;
BA_ "GenSigTimeoutTime_DMSM" SG_ 1154 Est_Range_Disp_Long 0;
BA_ "GenSigTimeoutTime_DTCM" SG_ 1154 Est_Range_Disp_Long 0;
BA_ "GenSigTimeoutTime_ECM" SG_ 1154 Est_Range_Disp_Long 0;
BA_ "GenSigTimeoutTime_EVCU2" SG_ 1154 Est_Range_Disp_Long 0;
BA_ "GenSigTimeoutTime_GNMM" SG_ 1154 Est_Range_Disp_Long 0;
BA_ "GenSigTimeoutTime_HCP" SG_ 1154 Est_Range_Disp_Long 0;
BA_ "GenSigTimeoutTime_IPC" SG_ 1154 Est_Range_Disp_Long 0;
BA_ "GenSigTimeoutTime_RFHM" SG_ 1154 Est_Range_Disp_Long 0;
BA_ "GenSigTimeoutTime_TCM" SG_ 1154 Est_Range_Disp_Long 0;
BA_ "GenSigTimeoutTime_AGSM" SG_ 1154 VehSpd_MPH 0;
BA_ "GenSigTimeoutTime_BCM" SG_ 1154 VehSpd_MPH 0;
BA_ "GenSigTimeoutTime_BSM" SG_ 1154 VehSpd_MPH 0;
BA_ "GenSigTimeoutTime_CADM" SG_ 1154 VehSpd_MPH 0;
BA_ "GenSigTimeoutTime_DMSM" SG_ 1154 VehSpd_MPH 0;
BA_ "GenSigTimeoutTime_DTCM" SG_ 1154 VehSpd_MPH 0;
BA_ "GenSigTimeoutTime_ECM" SG_ 1154 VehSpd_MPH 0;
BA_ "GenSigTimeoutTime_EVCU2" SG_ 1154 VehSpd_MPH 0;
BA_ "GenSigTimeoutTime_GNMM" SG_ 1154 VehSpd_MPH 0;
BA_ "GenSigTimeoutTime_HCP" SG_ 1154 VehSpd_MPH 0;
BA_ "GenSigTimeoutTime_IPC" SG_ 1154 VehSpd_MPH 0;
BA_ "GenSigTimeoutTime_RFHM" SG_ 1154 VehSpd_MPH 0;
BA_ "GenSigTimeoutTime_TCM" SG_ 1154 VehSpd_MPH 0;
BA_ "GenSigStartValue" SG_ 1154 VehSpdDisp 65535;
BA_ "GenSigTimeoutTime_AGSM" SG_ 1154 VehSpdDisp 0;
BA_ "GenSigTimeoutTime_BCM" SG_ 1154 VehSpdDisp 0;
BA_ "GenSigTimeoutTime_BSM" SG_ 1154 VehSpdDisp 0;
BA_ "GenSigTimeoutTime_CADM" SG_ 1154 VehSpdDisp 0;
BA_ "GenSigTimeoutTime_DMSM" SG_ 1154 VehSpdDisp 0;
BA_ "GenSigTimeoutTime_DTCM" SG_ 1154 VehSpdDisp 0;
BA_ "GenSigTimeoutTime_ECM" SG_ 1154 VehSpdDisp 0;
BA_ "GenSigTimeoutTime_EVCU2" SG_ 1154 VehSpdDisp 0;
BA_ "GenSigTimeoutTime_GNMM" SG_ 1154 VehSpdDisp 0;
BA_ "GenSigTimeoutTime_HCP" SG_ 1154 VehSpdDisp 0;
BA_ "GenSigTimeoutTime_IPC" SG_ 1154 VehSpdDisp 0;
BA_ "GenSigTimeoutTime_RFHM" SG_ 1154 VehSpdDisp 0;
BA_ "GenSigTimeoutTime_TCM" SG_ 1154 VehSpdDisp 0;
BA_ "GenSigSendType" SG_ 1432 AverageFuelConsumptionAPlus 3;
BA_ "GenSigTimeoutTime_AGSM" SG_ 1432 AverageFuelConsumptionAPlus 0;
BA_ "GenSigTimeoutTime_BCM" SG_ 1432 AverageFuelConsumptionAPlus 0;
BA_ "GenSigTimeoutTime_BSM" SG_ 1432 AverageFuelConsumptionAPlus 0;
BA_ "GenSigTimeoutTime_CADM" SG_ 1432 AverageFuelConsumptionAPlus 0;
BA_ "GenSigTimeoutTime_DMSM" SG_ 1432 AverageFuelConsumptionAPlus 0;
BA_ "GenSigTimeoutTime_DTCM" SG_ 1432 AverageFuelConsumptionAPlus 0;
BA_ "GenSigTimeoutTime_ECM" SG_ 1432 AverageFuelConsumptionAPlus 0;
BA_ "GenSigTimeoutTime_EVCU2" SG_ 1432 AverageFuelConsumptionAPlus 0;
BA_ "GenSigTimeoutTime_GNMM" SG_ 1432 AverageFuelConsumptionAPlus 0;
BA_ "GenSigTimeoutTime_HCP" SG_ 1432 AverageFuelConsumptionAPlus 0;
BA_ "GenSigTimeoutTime_IPC" SG_ 1432 AverageFuelConsumptionAPlus 0;
BA_ "GenSigTimeoutTime_RFHM" SG_ 1432 AverageFuelConsumptionAPlus 0;
BA_ "GenSigTimeoutTime_TCM" SG_ 1432 AverageFuelConsumptionAPlus 0;
BA_ "GenSigSendType" SG_ 1432 AverageFuelConsumptionBPlus 3;
BA_ "GenSigTimeoutTime_AGSM" SG_ 1432 AverageFuelConsumptionBPlus 0;
BA_ "GenSigTimeoutTime_BCM" SG_ 1432 AverageFuelConsumptionBPlus 0;
BA_ "GenSigTimeoutTime_BSM" SG_ 1432 AverageFuelConsumptionBPlus 0;
BA_ "GenSigTimeoutTime_CADM" SG_ 1432 AverageFuelConsumptionBPlus 0;
BA_ "GenSigTimeoutTime_DMSM" SG_ 1432 AverageFuelConsumptionBPlus 0;
BA_ "GenSigTimeoutTime_DTCM" SG_ 1432 AverageFuelConsumptionBPlus 0;
BA_ "GenSigTimeoutTime_ECM" SG_ 1432 AverageFuelConsumptionBPlus 0;
BA_ "GenSigTimeoutTime_EVCU2" SG_ 1432 AverageFuelConsumptionBPlus 0;
BA_ "GenSigTimeoutTime_GNMM" SG_ 1432 AverageFuelConsumptionBPlus 0;
BA_ "GenSigTimeoutTime_HCP" SG_ 1432 AverageFuelConsumptionBPlus 0;
BA_ "GenSigTimeoutTime_IPC" SG_ 1432 AverageFuelConsumptionBPlus 0;
BA_ "GenSigTimeoutTime_RFHM" SG_ 1432 AverageFuelConsumptionBPlus 0;
BA_ "GenSigTimeoutTime_TCM" SG_ 1432 AverageFuelConsumptionBPlus 0;
BA_ "GenSigTimeoutTime_AGSM" SG_ 1432 CRC_IPC6 0;
BA_ "GenSigTimeoutTime_BSM" SG_ 1432 CRC_IPC6 0;
BA_ "GenSigTimeoutTime_DMSM" SG_ 1432 CRC_IPC6 0;
BA_ "GenSigTimeoutTime_DTCM" SG_ 1432 CRC_IPC6 0;
BA_ "GenSigTimeoutTime_ECM" SG_ 1432 CRC_IPC6 0;
BA_ "GenSigTimeoutTime_EVCU2" SG_ 1432 CRC_IPC6 0;
BA_ "GenSigTimeoutTime_GNMM" SG_ 1432 CRC_IPC6 0;
BA_ "GenSigTimeoutTime_HCP" SG_ 1432 CRC_IPC6 0;
BA_ "GenSigTimeoutTime_IPC" SG_ 1432 CRC_IPC6 0;
BA_ "GenSigTimeoutTime_RFHM" SG_ 1432 CRC_IPC6 0;
BA_ "GenSigTimeoutTime_SGW" SG_ 1432 CRC_IPC6 0;
BA_ "GenSigTimeoutTime_TCM" SG_ 1432 CRC_IPC6 0;
BA_ "GenSigSendType" SG_ 1432 HAS_SoH_IPC 3;
BA_ "GenSigTimeoutTime_AGSM" SG_ 1432 HAS_SoH_IPC 0;
BA_ "GenSigTimeoutTime_BSM" SG_ 1432 HAS_SoH_IPC 0;
BA_ "GenSigTimeoutTime_DMSM" SG_ 1432 HAS_SoH_IPC 0;
BA_ "GenSigTimeoutTime_DTCM" SG_ 1432 HAS_SoH_IPC 0;
BA_ "GenSigTimeoutTime_ECM" SG_ 1432 HAS_SoH_IPC 0;
BA_ "GenSigTimeoutTime_EVCU2" SG_ 1432 HAS_SoH_IPC 0;
BA_ "GenSigTimeoutTime_GNMM" SG_ 1432 HAS_SoH_IPC 0;
BA_ "GenSigTimeoutTime_HCP" SG_ 1432 HAS_SoH_IPC 0;
BA_ "GenSigTimeoutTime_IPC" SG_ 1432 HAS_SoH_IPC 0;
BA_ "GenSigTimeoutTime_RFHM" SG_ 1432 HAS_SoH_IPC 0;
BA_ "GenSigTimeoutTime_SGW" SG_ 1432 HAS_SoH_IPC 0;
BA_ "GenSigTimeoutTime_TCM" SG_ 1432 HAS_SoH_IPC 0;
BA_ "GenSigTimeoutTime_AGSM" SG_ 1432 MessageCounter_IPC6 0;
BA_ "GenSigTimeoutTime_BSM" SG_ 1432 MessageCounter_IPC6 0;
BA_ "GenSigTimeoutTime_DMSM" SG_ 1432 MessageCounter_IPC6 0;
BA_ "GenSigTimeoutTime_DTCM" SG_ 1432 MessageCounter_IPC6 0;
BA_ "GenSigTimeoutTime_ECM" SG_ 1432 MessageCounter_IPC6 0;
BA_ "GenSigTimeoutTime_EVCU2" SG_ 1432 MessageCounter_IPC6 0;
BA_ "GenSigTimeoutTime_GNMM" SG_ 1432 MessageCounter_IPC6 0;
BA_ "GenSigTimeoutTime_HCP" SG_ 1432 MessageCounter_IPC6 0;
BA_ "GenSigTimeoutTime_IPC" SG_ 1432 MessageCounter_IPC6 0;
BA_ "GenSigTimeoutTime_RFHM" SG_ 1432 MessageCounter_IPC6 0;
BA_ "GenSigTimeoutTime_SGW" SG_ 1432 MessageCounter_IPC6 0;
BA_ "GenSigTimeoutTime_TCM" SG_ 1432 MessageCounter_IPC6 0;
BA_ "GenSigSendType" SG_ 1432 PartialOdometerAPlus 3;
BA_ "GenSigTimeoutTime_AGSM" SG_ 1432 PartialOdometerAPlus 0;
BA_ "GenSigTimeoutTime_BCM" SG_ 1432 PartialOdometerAPlus 0;
BA_ "GenSigTimeoutTime_BSM" SG_ 1432 PartialOdometerAPlus 0;
BA_ "GenSigTimeoutTime_CADM" SG_ 1432 PartialOdometerAPlus 0;
BA_ "GenSigTimeoutTime_DMSM" SG_ 1432 PartialOdometerAPlus 0;
BA_ "GenSigTimeoutTime_DTCM" SG_ 1432 PartialOdometerAPlus 0;
BA_ "GenSigTimeoutTime_ECM" SG_ 1432 PartialOdometerAPlus 0;
BA_ "GenSigTimeoutTime_EVCU2" SG_ 1432 PartialOdometerAPlus 0;
BA_ "GenSigTimeoutTime_GNMM" SG_ 1432 PartialOdometerAPlus 0;
BA_ "GenSigTimeoutTime_HCP" SG_ 1432 PartialOdometerAPlus 0;
BA_ "GenSigTimeoutTime_IPC" SG_ 1432 PartialOdometerAPlus 0;
BA_ "GenSigTimeoutTime_RFHM" SG_ 1432 PartialOdometerAPlus 0;
BA_ "GenSigTimeoutTime_TCM" SG_ 1432 PartialOdometerAPlus 0;
BA_ "GenSigSendType" SG_ 1432 PartialOdometerBPlus 3;
BA_ "GenSigTimeoutTime_AGSM" SG_ 1432 PartialOdometerBPlus 0;
BA_ "GenSigTimeoutTime_BCM" SG_ 1432 PartialOdometerBPlus 0;
BA_ "GenSigTimeoutTime_BSM" SG_ 1432 PartialOdometerBPlus 0;
BA_ "GenSigTimeoutTime_CADM" SG_ 1432 PartialOdometerBPlus 0;
BA_ "GenSigTimeoutTime_DMSM" SG_ 1432 PartialOdometerBPlus 0;
BA_ "GenSigTimeoutTime_DTCM" SG_ 1432 PartialOdometerBPlus 0;
BA_ "GenSigTimeoutTime_ECM" SG_ 1432 PartialOdometerBPlus 0;
BA_ "GenSigTimeoutTime_EVCU2" SG_ 1432 PartialOdometerBPlus 0;
BA_ "GenSigTimeoutTime_GNMM" SG_ 1432 PartialOdometerBPlus 0;
BA_ "GenSigTimeoutTime_HCP" SG_ 1432 PartialOdometerBPlus 0;
BA_ "GenSigTimeoutTime_IPC" SG_ 1432 PartialOdometerBPlus 0;
BA_ "GenSigTimeoutTime_RFHM" SG_ 1432 PartialOdometerBPlus 0;
BA_ "GenSigTimeoutTime_TCM" SG_ 1432 PartialOdometerBPlus 0;
BA_ "GenSigSendType" SG_ 1432 PowerMode_RQ 3;
BA_ "GenSigTimeoutTime_AGSM" SG_ 1432 PowerMode_RQ 0;
BA_ "GenSigTimeoutTime_BSM" SG_ 1432 PowerMode_RQ 0;
BA_ "GenSigTimeoutTime_CADM" SG_ 1432 PowerMode_RQ 0;
BA_ "GenSigTimeoutTime_DMSM" SG_ 1432 PowerMode_RQ 0;
BA_ "GenSigTimeoutTime_DTCM" SG_ 1432 PowerMode_RQ 0;
BA_ "GenSigTimeoutTime_ECM" SG_ 1432 PowerMode_RQ 0;
BA_ "GenSigTimeoutTime_EVCU2" SG_ 1432 PowerMode_RQ 0;
BA_ "GenSigTimeoutTime_GNMM" SG_ 1432 PowerMode_RQ 0;
BA_ "GenSigTimeoutTime_HCP" SG_ 1432 PowerMode_RQ 0;
BA_ "GenSigTimeoutTime_IPC" SG_ 1432 PowerMode_RQ 0;
BA_ "GenSigTimeoutTime_RFHM" SG_ 1432 PowerMode_RQ 0;
BA_ "GenSigTimeoutTime_SGW" SG_ 1432 PowerMode_RQ 0;
BA_ "GenSigTimeoutTime_TCM" SG_ 1432 PowerMode_RQ 0;
BA_ "GenSigSendType" SG_ 1432 TravelingTimeAPlus_Hour 3;
BA_ "GenSigTimeoutTime_AGSM" SG_ 1432 TravelingTimeAPlus_Hour 0;
BA_ "GenSigTimeoutTime_BCM" SG_ 1432 TravelingTimeAPlus_Hour 0;
BA_ "GenSigTimeoutTime_BSM" SG_ 1432 TravelingTimeAPlus_Hour 0;
BA_ "GenSigTimeoutTime_CADM" SG_ 1432 TravelingTimeAPlus_Hour 0;
BA_ "GenSigTimeoutTime_DMSM" SG_ 1432 TravelingTimeAPlus_Hour 0;
BA_ "GenSigTimeoutTime_DTCM" SG_ 1432 TravelingTimeAPlus_Hour 0;
BA_ "GenSigTimeoutTime_ECM" SG_ 1432 TravelingTimeAPlus_Hour 0;
BA_ "GenSigTimeoutTime_EVCU2" SG_ 1432 TravelingTimeAPlus_Hour 0;
BA_ "GenSigTimeoutTime_GNMM" SG_ 1432 TravelingTimeAPlus_Hour 0;
BA_ "GenSigTimeoutTime_HCP" SG_ 1432 TravelingTimeAPlus_Hour 0;
BA_ "GenSigTimeoutTime_IPC" SG_ 1432 TravelingTimeAPlus_Hour 0;
BA_ "GenSigTimeoutTime_RFHM" SG_ 1432 TravelingTimeAPlus_Hour 0;
BA_ "GenSigTimeoutTime_TCM" SG_ 1432 TravelingTimeAPlus_Hour 0;
BA_ "GenSigSendType" SG_ 1432 TravelingTimeAPlus_Minute 3;
BA_ "GenSigTimeoutTime_AGSM" SG_ 1432 TravelingTimeAPlus_Minute 0;
BA_ "GenSigTimeoutTime_BCM" SG_ 1432 TravelingTimeAPlus_Minute 0;
BA_ "GenSigTimeoutTime_BSM" SG_ 1432 TravelingTimeAPlus_Minute 0;
BA_ "GenSigTimeoutTime_CADM" SG_ 1432 TravelingTimeAPlus_Minute 0;
BA_ "GenSigTimeoutTime_DMSM" SG_ 1432 TravelingTimeAPlus_Minute 0;
BA_ "GenSigTimeoutTime_DTCM" SG_ 1432 TravelingTimeAPlus_Minute 0;
BA_ "GenSigTimeoutTime_ECM" SG_ 1432 TravelingTimeAPlus_Minute 0;
BA_ "GenSigTimeoutTime_EVCU2" SG_ 1432 TravelingTimeAPlus_Minute 0;
BA_ "GenSigTimeoutTime_GNMM" SG_ 1432 TravelingTimeAPlus_Minute 0;
BA_ "GenSigTimeoutTime_HCP" SG_ 1432 TravelingTimeAPlus_Minute 0;
BA_ "GenSigTimeoutTime_IPC" SG_ 1432 TravelingTimeAPlus_Minute 0;
BA_ "GenSigTimeoutTime_RFHM" SG_ 1432 TravelingTimeAPlus_Minute 0;
BA_ "GenSigTimeoutTime_TCM" SG_ 1432 TravelingTimeAPlus_Minute 0;
BA_ "GenSigTimeoutTime_AGSM" SG_ 1432 TravelingTimeAPlus_Second 0;
BA_ "GenSigTimeoutTime_BCM" SG_ 1432 TravelingTimeAPlus_Second 0;
BA_ "GenSigTimeoutTime_BSM" SG_ 1432 TravelingTimeAPlus_Second 0;
BA_ "GenSigTimeoutTime_CADM" SG_ 1432 TravelingTimeAPlus_Second 0;
BA_ "GenSigTimeoutTime_DMSM" SG_ 1432 TravelingTimeAPlus_Second 0;
BA_ "GenSigTimeoutTime_DTCM" SG_ 1432 TravelingTimeAPlus_Second 0;
BA_ "GenSigTimeoutTime_ECM" SG_ 1432 TravelingTimeAPlus_Second 0;
BA_ "GenSigTimeoutTime_EVCU2" SG_ 1432 TravelingTimeAPlus_Second 0;
BA_ "GenSigTimeoutTime_GNMM" SG_ 1432 TravelingTimeAPlus_Second 0;
BA_ "GenSigTimeoutTime_HCP" SG_ 1432 TravelingTimeAPlus_Second 0;
BA_ "GenSigTimeoutTime_IPC" SG_ 1432 TravelingTimeAPlus_Second 0;
BA_ "GenSigTimeoutTime_RFHM" SG_ 1432 TravelingTimeAPlus_Second 0;
BA_ "GenSigTimeoutTime_TCM" SG_ 1432 TravelingTimeAPlus_Second 0;
BA_ "GenSigSendType" SG_ 1432 TravelingTimeBPlus_Hour 3;
BA_ "GenSigTimeoutTime_AGSM" SG_ 1432 TravelingTimeBPlus_Hour 0;
BA_ "GenSigTimeoutTime_BCM" SG_ 1432 TravelingTimeBPlus_Hour 0;
BA_ "GenSigTimeoutTime_BSM" SG_ 1432 TravelingTimeBPlus_Hour 0;
BA_ "GenSigTimeoutTime_CADM" SG_ 1432 TravelingTimeBPlus_Hour 0;
BA_ "GenSigTimeoutTime_DMSM" SG_ 1432 TravelingTimeBPlus_Hour 0;
BA_ "GenSigTimeoutTime_DTCM" SG_ 1432 TravelingTimeBPlus_Hour 0;
BA_ "GenSigTimeoutTime_ECM" SG_ 1432 TravelingTimeBPlus_Hour 0;
BA_ "GenSigTimeoutTime_EVCU2" SG_ 1432 TravelingTimeBPlus_Hour 0;
BA_ "GenSigTimeoutTime_GNMM" SG_ 1432 TravelingTimeBPlus_Hour 0;
BA_ "GenSigTimeoutTime_HCP" SG_ 1432 TravelingTimeBPlus_Hour 0;
BA_ "GenSigTimeoutTime_IPC" SG_ 1432 TravelingTimeBPlus_Hour 0;
BA_ "GenSigTimeoutTime_RFHM" SG_ 1432 TravelingTimeBPlus_Hour 0;
BA_ "GenSigTimeoutTime_TCM" SG_ 1432 TravelingTimeBPlus_Hour 0;
BA_ "GenSigSendType" SG_ 1432 TravelingTimeBPlus_Minute 3;
BA_ "GenSigTimeoutTime_AGSM" SG_ 1432 TravelingTimeBPlus_Minute 0;
BA_ "GenSigTimeoutTime_BCM" SG_ 1432 TravelingTimeBPlus_Minute 0;
BA_ "GenSigTimeoutTime_BSM" SG_ 1432 TravelingTimeBPlus_Minute 0;
BA_ "GenSigTimeoutTime_CADM" SG_ 1432 TravelingTimeBPlus_Minute 0;
BA_ "GenSigTimeoutTime_DMSM" SG_ 1432 TravelingTimeBPlus_Minute 0;
BA_ "GenSigTimeoutTime_DTCM" SG_ 1432 TravelingTimeBPlus_Minute 0;
BA_ "GenSigTimeoutTime_ECM" SG_ 1432 TravelingTimeBPlus_Minute 0;
BA_ "GenSigTimeoutTime_EVCU2" SG_ 1432 TravelingTimeBPlus_Minute 0;
BA_ "GenSigTimeoutTime_GNMM" SG_ 1432 TravelingTimeBPlus_Minute 0;
BA_ "GenSigTimeoutTime_HCP" SG_ 1432 TravelingTimeBPlus_Minute 0;
BA_ "GenSigTimeoutTime_IPC" SG_ 1432 TravelingTimeBPlus_Minute 0;
BA_ "GenSigTimeoutTime_RFHM" SG_ 1432 TravelingTimeBPlus_Minute 0;
BA_ "GenSigTimeoutTime_TCM" SG_ 1432 TravelingTimeBPlus_Minute 0;
BA_ "GenSigTimeoutTime_AGSM" SG_ 1432 TravelingTimeBPlus_Second 0;
BA_ "GenSigTimeoutTime_BCM" SG_ 1432 TravelingTimeBPlus_Second 0;
BA_ "GenSigTimeoutTime_BSM" SG_ 1432 TravelingTimeBPlus_Second 0;
BA_ "GenSigTimeoutTime_CADM" SG_ 1432 TravelingTimeBPlus_Second 0;
BA_ "GenSigTimeoutTime_DMSM" SG_ 1432 TravelingTimeBPlus_Second 0;
BA_ "GenSigTimeoutTime_DTCM" SG_ 1432 TravelingTimeBPlus_Second 0;
BA_ "GenSigTimeoutTime_ECM" SG_ 1432 TravelingTimeBPlus_Second 0;
BA_ "GenSigTimeoutTime_EVCU2" SG_ 1432 TravelingTimeBPlus_Second 0;
BA_ "GenSigTimeoutTime_GNMM" SG_ 1432 TravelingTimeBPlus_Second 0;
BA_ "GenSigTimeoutTime_HCP" SG_ 1432 TravelingTimeBPlus_Second 0;
BA_ "GenSigTimeoutTime_IPC" SG_ 1432 TravelingTimeBPlus_Second 0;
BA_ "GenSigTimeoutTime_RFHM" SG_ 1432 TravelingTimeBPlus_Second 0;
BA_ "GenSigTimeoutTime_TCM" SG_ 1432 TravelingTimeBPlus_Second 0;
BA_ "GenSigTimeoutTime_AGSM" SG_ 1897 VehPerfAccelPeak_X_Neg 0;
BA_ "GenSigTimeoutTime_BCM" SG_ 1897 VehPerfAccelPeak_X_Neg 0;
BA_ "GenSigTimeoutTime_BSM" SG_ 1897 VehPerfAccelPeak_X_Neg 0;
BA_ "GenSigTimeoutTime_CADM" SG_ 1897 VehPerfAccelPeak_X_Neg 0;
BA_ "GenSigTimeoutTime_DMSM" SG_ 1897 VehPerfAccelPeak_X_Neg 0;
BA_ "GenSigTimeoutTime_DTCM" SG_ 1897 VehPerfAccelPeak_X_Neg 0;
BA_ "GenSigTimeoutTime_ECM" SG_ 1897 VehPerfAccelPeak_X_Neg 0;
BA_ "GenSigTimeoutTime_EVCU2" SG_ 1897 VehPerfAccelPeak_X_Neg 0;
BA_ "GenSigTimeoutTime_GNMM" SG_ 1897 VehPerfAccelPeak_X_Neg 0;
BA_ "GenSigTimeoutTime_HCP" SG_ 1897 VehPerfAccelPeak_X_Neg 0;
BA_ "GenSigTimeoutTime_IPC" SG_ 1897 VehPerfAccelPeak_X_Neg 0;
BA_ "GenSigTimeoutTime_RFHM" SG_ 1897 VehPerfAccelPeak_X_Neg 0;
BA_ "GenSigTimeoutTime_TCM" SG_ 1897 VehPerfAccelPeak_X_Neg 0;
BA_ "GenSigTimeoutTime_AGSM" SG_ 1897 VehPerfAccelPeak_X_Pos 0;
BA_ "GenSigTimeoutTime_BCM" SG_ 1897 VehPerfAccelPeak_X_Pos 0;
BA_ "GenSigTimeoutTime_BSM" SG_ 1897 VehPerfAccelPeak_X_Pos 0;
BA_ "GenSigTimeoutTime_CADM" SG_ 1897 VehPerfAccelPeak_X_Pos 0;
BA_ "GenSigTimeoutTime_DMSM" SG_ 1897 VehPerfAccelPeak_X_Pos 0;
BA_ "GenSigTimeoutTime_DTCM" SG_ 1897 VehPerfAccelPeak_X_Pos 0;
BA_ "GenSigTimeoutTime_ECM" SG_ 1897 VehPerfAccelPeak_X_Pos 0;
BA_ "GenSigTimeoutTime_EVCU2" SG_ 1897 VehPerfAccelPeak_X_Pos 0;
BA_ "GenSigTimeoutTime_GNMM" SG_ 1897 VehPerfAccelPeak_X_Pos 0;
BA_ "GenSigTimeoutTime_HCP" SG_ 1897 VehPerfAccelPeak_X_Pos 0;
BA_ "GenSigTimeoutTime_IPC" SG_ 1897 VehPerfAccelPeak_X_Pos 0;
BA_ "GenSigTimeoutTime_RFHM" SG_ 1897 VehPerfAccelPeak_X_Pos 0;
BA_ "GenSigTimeoutTime_TCM" SG_ 1897 VehPerfAccelPeak_X_Pos 0;
BA_ "GenSigTimeoutTime_AGSM" SG_ 1897 VehPerfAccelPeak_Y_Neg 0;
BA_ "GenSigTimeoutTime_BCM" SG_ 1897 VehPerfAccelPeak_Y_Neg 0;
BA_ "GenSigTimeoutTime_BSM" SG_ 1897 VehPerfAccelPeak_Y_Neg 0;
BA_ "GenSigTimeoutTime_CADM" SG_ 1897 VehPerfAccelPeak_Y_Neg 0;
BA_ "GenSigTimeoutTime_DMSM" SG_ 1897 VehPerfAccelPeak_Y_Neg 0;
BA_ "GenSigTimeoutTime_DTCM" SG_ 1897 VehPerfAccelPeak_Y_Neg 0;
BA_ "GenSigTimeoutTime_ECM" SG_ 1897 VehPerfAccelPeak_Y_Neg 0;
BA_ "GenSigTimeoutTime_EVCU2" SG_ 1897 VehPerfAccelPeak_Y_Neg 0;
BA_ "GenSigTimeoutTime_GNMM" SG_ 1897 VehPerfAccelPeak_Y_Neg 0;
BA_ "GenSigTimeoutTime_HCP" SG_ 1897 VehPerfAccelPeak_Y_Neg 0;
BA_ "GenSigTimeoutTime_IPC" SG_ 1897 VehPerfAccelPeak_Y_Neg 0;
BA_ "GenSigTimeoutTime_RFHM" SG_ 1897 VehPerfAccelPeak_Y_Neg 0;
BA_ "GenSigTimeoutTime_TCM" SG_ 1897 VehPerfAccelPeak_Y_Neg 0;
BA_ "GenSigTimeoutTime_AGSM" SG_ 1897 VehPerfAccelPeak_Y_Pos 0;
BA_ "GenSigTimeoutTime_BCM" SG_ 1897 VehPerfAccelPeak_Y_Pos 0;
BA_ "GenSigTimeoutTime_BSM" SG_ 1897 VehPerfAccelPeak_Y_Pos 0;
BA_ "GenSigTimeoutTime_CADM" SG_ 1897 VehPerfAccelPeak_Y_Pos 0;
BA_ "GenSigTimeoutTime_DMSM" SG_ 1897 VehPerfAccelPeak_Y_Pos 0;
BA_ "GenSigTimeoutTime_DTCM" SG_ 1897 VehPerfAccelPeak_Y_Pos 0;
BA_ "GenSigTimeoutTime_ECM" SG_ 1897 VehPerfAccelPeak_Y_Pos 0;
BA_ "GenSigTimeoutTime_EVCU2" SG_ 1897 VehPerfAccelPeak_Y_Pos 0;
BA_ "GenSigTimeoutTime_GNMM" SG_ 1897 VehPerfAccelPeak_Y_Pos 0;
BA_ "GenSigTimeoutTime_HCP" SG_ 1897 VehPerfAccelPeak_Y_Pos 0;
BA_ "GenSigTimeoutTime_IPC" SG_ 1897 VehPerfAccelPeak_Y_Pos 0;
BA_ "GenSigTimeoutTime_RFHM" SG_ 1897 VehPerfAccelPeak_Y_Pos 0;
BA_ "GenSigTimeoutTime_TCM" SG_ 1897 VehPerfAccelPeak_Y_Pos 0;
BA_ "GenSigStartValue" SG_ 604 SRT_100mphTm_B 255;
BA_ "GenSigSendType" SG_ 604 SRT_100mphTm_B 3;
BA_ "GenSigTimeoutTime_AGSM" SG_ 604 SRT_100mphTm_B 0;
BA_ "GenSigTimeoutTime_BCM" SG_ 604 SRT_100mphTm_B 0;
BA_ "GenSigTimeoutTime_BSM" SG_ 604 SRT_100mphTm_B 0;
BA_ "GenSigTimeoutTime_CADM" SG_ 604 SRT_100mphTm_B 0;
BA_ "GenSigTimeoutTime_DMSM" SG_ 604 SRT_100mphTm_B 0;
BA_ "GenSigTimeoutTime_DTCM" SG_ 604 SRT_100mphTm_B 0;
BA_ "GenSigTimeoutTime_ECM" SG_ 604 SRT_100mphTm_B 0;
BA_ "GenSigTimeoutTime_EVCU2" SG_ 604 SRT_100mphTm_B 0;
BA_ "GenSigTimeoutTime_GNMM" SG_ 604 SRT_100mphTm_B 0;
BA_ "GenSigTimeoutTime_HCP" SG_ 604 SRT_100mphTm_B 0;
BA_ "GenSigTimeoutTime_IPC" SG_ 604 SRT_100mphTm_B 0;
BA_ "GenSigTimeoutTime_RFHM" SG_ 604 SRT_100mphTm_B 0;
BA_ "GenSigTimeoutTime_TCM" SG_ 604 SRT_100mphTm_B 0;
BA_ "GenSigStartValue" SG_ 604 SRT_100mphTm_C 255;
BA_ "GenSigSendType" SG_ 604 SRT_100mphTm_C 3;
BA_ "GenSigTimeoutTime_AGSM" SG_ 604 SRT_100mphTm_C 0;
BA_ "GenSigTimeoutTime_BCM" SG_ 604 SRT_100mphTm_C 0;
BA_ "GenSigTimeoutTime_BSM" SG_ 604 SRT_100mphTm_C 0;
BA_ "GenSigTimeoutTime_CADM" SG_ 604 SRT_100mphTm_C 0;
BA_ "GenSigTimeoutTime_DMSM" SG_ 604 SRT_100mphTm_C 0;
BA_ "GenSigTimeoutTime_DTCM" SG_ 604 SRT_100mphTm_C 0;
BA_ "GenSigTimeoutTime_ECM" SG_ 604 SRT_100mphTm_C 0;
BA_ "GenSigTimeoutTime_EVCU2" SG_ 604 SRT_100mphTm_C 0;
BA_ "GenSigTimeoutTime_GNMM" SG_ 604 SRT_100mphTm_C 0;
BA_ "GenSigTimeoutTime_HCP" SG_ 604 SRT_100mphTm_C 0;
BA_ "GenSigTimeoutTime_IPC" SG_ 604 SRT_100mphTm_C 0;
BA_ "GenSigTimeoutTime_RFHM" SG_ 604 SRT_100mphTm_C 0;
BA_ "GenSigTimeoutTime_TCM" SG_ 604 SRT_100mphTm_C 0;
BA_ "GenSigStartValue" SG_ 604 SRT_100mphTm_L 255;
BA_ "GenSigSendType" SG_ 604 SRT_100mphTm_L 3;
BA_ "GenSigTimeoutTime_AGSM" SG_ 604 SRT_100mphTm_L 0;
BA_ "GenSigTimeoutTime_BCM" SG_ 604 SRT_100mphTm_L 0;
BA_ "GenSigTimeoutTime_BSM" SG_ 604 SRT_100mphTm_L 0;
BA_ "GenSigTimeoutTime_CADM" SG_ 604 SRT_100mphTm_L 0;
BA_ "GenSigTimeoutTime_DMSM" SG_ 604 SRT_100mphTm_L 0;
BA_ "GenSigTimeoutTime_DTCM" SG_ 604 SRT_100mphTm_L 0;
BA_ "GenSigTimeoutTime_ECM" SG_ 604 SRT_100mphTm_L 0;
BA_ "GenSigTimeoutTime_EVCU2" SG_ 604 SRT_100mphTm_L 0;
BA_ "GenSigTimeoutTime_GNMM" SG_ 604 SRT_100mphTm_L 0;
BA_ "GenSigTimeoutTime_HCP" SG_ 604 SRT_100mphTm_L 0;
BA_ "GenSigTimeoutTime_IPC" SG_ 604 SRT_100mphTm_L 0;
BA_ "GenSigTimeoutTime_RFHM" SG_ 604 SRT_100mphTm_L 0;
BA_ "GenSigTimeoutTime_TCM" SG_ 604 SRT_100mphTm_L 0;
BA_ "GenSigStartValue" SG_ 604 SRT_100mphTmB 255;
BA_ "GenSigSendType" SG_ 604 SRT_100mphTmB 3;
BA_ "GenSigTimeoutTime_AGSM" SG_ 604 SRT_100mphTmB 0;
BA_ "GenSigTimeoutTime_BCM" SG_ 604 SRT_100mphTmB 0;
BA_ "GenSigTimeoutTime_BSM" SG_ 604 SRT_100mphTmB 0;
BA_ "GenSigTimeoutTime_CADM" SG_ 604 SRT_100mphTmB 0;
BA_ "GenSigTimeoutTime_DMSM" SG_ 604 SRT_100mphTmB 0;
BA_ "GenSigTimeoutTime_DTCM" SG_ 604 SRT_100mphTmB 0;
BA_ "GenSigTimeoutTime_ECM" SG_ 604 SRT_100mphTmB 0;
BA_ "GenSigTimeoutTime_EVCU2" SG_ 604 SRT_100mphTmB 0;
BA_ "GenSigTimeoutTime_GNMM" SG_ 604 SRT_100mphTmB 0;
BA_ "GenSigTimeoutTime_HCP" SG_ 604 SRT_100mphTmB 0;
BA_ "GenSigTimeoutTime_IPC" SG_ 604 SRT_100mphTmB 0;
BA_ "GenSigTimeoutTime_RFHM" SG_ 604 SRT_100mphTmB 0;
BA_ "GenSigTimeoutTime_TCM" SG_ 604 SRT_100mphTmB 0;
BA_ "GenSigStartValue" SG_ 604 SRT_100mphTmC 255;
BA_ "GenSigSendType" SG_ 604 SRT_100mphTmC 3;
BA_ "GenSigTimeoutTime_AGSM" SG_ 604 SRT_100mphTmC 0;
BA_ "GenSigTimeoutTime_BCM" SG_ 604 SRT_100mphTmC 0;
BA_ "GenSigTimeoutTime_BSM" SG_ 604 SRT_100mphTmC 0;
BA_ "GenSigTimeoutTime_CADM" SG_ 604 SRT_100mphTmC 0;
BA_ "GenSigTimeoutTime_DMSM" SG_ 604 SRT_100mphTmC 0;
BA_ "GenSigTimeoutTime_DTCM" SG_ 604 SRT_100mphTmC 0;
BA_ "GenSigTimeoutTime_ECM" SG_ 604 SRT_100mphTmC 0;
BA_ "GenSigTimeoutTime_EVCU2" SG_ 604 SRT_100mphTmC 0;
BA_ "GenSigTimeoutTime_GNMM" SG_ 604 SRT_100mphTmC 0;
BA_ "GenSigTimeoutTime_HCP" SG_ 604 SRT_100mphTmC 0;
BA_ "GenSigTimeoutTime_IPC" SG_ 604 SRT_100mphTmC 0;
BA_ "GenSigTimeoutTime_RFHM" SG_ 604 SRT_100mphTmC 0;
BA_ "GenSigTimeoutTime_TCM" SG_ 604 SRT_100mphTmC 0;
BA_ "GenSigStartValue" SG_ 604 SRT_100mphTmL 255;
BA_ "GenSigSendType" SG_ 604 SRT_100mphTmL 3;
BA_ "GenSigTimeoutTime_AGSM" SG_ 604 SRT_100mphTmL 0;
BA_ "GenSigTimeoutTime_BCM" SG_ 604 SRT_100mphTmL 0;
BA_ "GenSigTimeoutTime_BSM" SG_ 604 SRT_100mphTmL 0;
BA_ "GenSigTimeoutTime_CADM" SG_ 604 SRT_100mphTmL 0;
BA_ "GenSigTimeoutTime_DMSM" SG_ 604 SRT_100mphTmL 0;
BA_ "GenSigTimeoutTime_DTCM" SG_ 604 SRT_100mphTmL 0;
BA_ "GenSigTimeoutTime_ECM" SG_ 604 SRT_100mphTmL 0;
BA_ "GenSigTimeoutTime_EVCU2" SG_ 604 SRT_100mphTmL 0;
BA_ "GenSigTimeoutTime_GNMM" SG_ 604 SRT_100mphTmL 0;
BA_ "GenSigTimeoutTime_HCP" SG_ 604 SRT_100mphTmL 0;
BA_ "GenSigTimeoutTime_IPC" SG_ 604 SRT_100mphTmL 0;
BA_ "GenSigTimeoutTime_RFHM" SG_ 604 SRT_100mphTmL 0;
BA_ "GenSigTimeoutTime_TCM" SG_ 604 SRT_100mphTmL 0;
BA_ "GenSigStartValue" SG_ 604 SRT_60mphTm_B 255;
BA_ "GenSigSendType" SG_ 604 SRT_60mphTm_B 3;
BA_ "GenSigTimeoutTime_AGSM" SG_ 604 SRT_60mphTm_B 0;
BA_ "GenSigTimeoutTime_BCM" SG_ 604 SRT_60mphTm_B 0;
BA_ "GenSigTimeoutTime_BSM" SG_ 604 SRT_60mphTm_B 0;
BA_ "GenSigTimeoutTime_CADM" SG_ 604 SRT_60mphTm_B 0;
BA_ "GenSigTimeoutTime_DMSM" SG_ 604 SRT_60mphTm_B 0;
BA_ "GenSigTimeoutTime_DTCM" SG_ 604 SRT_60mphTm_B 0;
BA_ "GenSigTimeoutTime_ECM" SG_ 604 SRT_60mphTm_B 0;
BA_ "GenSigTimeoutTime_EVCU2" SG_ 604 SRT_60mphTm_B 0;
BA_ "GenSigTimeoutTime_GNMM" SG_ 604 SRT_60mphTm_B 0;
BA_ "GenSigTimeoutTime_HCP" SG_ 604 SRT_60mphTm_B 0;
BA_ "GenSigTimeoutTime_IPC" SG_ 604 SRT_60mphTm_B 0;
BA_ "GenSigTimeoutTime_RFHM" SG_ 604 SRT_60mphTm_B 0;
BA_ "GenSigTimeoutTime_TCM" SG_ 604 SRT_60mphTm_B 0;
BA_ "GenSigStartValue" SG_ 604 SRT_60mphTm_C 255;
BA_ "GenSigSendType" SG_ 604 SRT_60mphTm_C 3;
BA_ "GenSigTimeoutTime_AGSM" SG_ 604 SRT_60mphTm_C 0;
BA_ "GenSigTimeoutTime_BCM" SG_ 604 SRT_60mphTm_C 0;
BA_ "GenSigTimeoutTime_BSM" SG_ 604 SRT_60mphTm_C 0;
BA_ "GenSigTimeoutTime_CADM" SG_ 604 SRT_60mphTm_C 0;
BA_ "GenSigTimeoutTime_DMSM" SG_ 604 SRT_60mphTm_C 0;
BA_ "GenSigTimeoutTime_DTCM" SG_ 604 SRT_60mphTm_C 0;
BA_ "GenSigTimeoutTime_ECM" SG_ 604 SRT_60mphTm_C 0;
BA_ "GenSigTimeoutTime_EVCU2" SG_ 604 SRT_60mphTm_C 0;
BA_ "GenSigTimeoutTime_GNMM" SG_ 604 SRT_60mphTm_C 0;
BA_ "GenSigTimeoutTime_HCP" SG_ 604 SRT_60mphTm_C 0;
BA_ "GenSigTimeoutTime_IPC" SG_ 604 SRT_60mphTm_C 0;
BA_ "GenSigTimeoutTime_RFHM" SG_ 604 SRT_60mphTm_C 0;
BA_ "GenSigTimeoutTime_TCM" SG_ 604 SRT_60mphTm_C 0;
BA_ "GenSigStartValue" SG_ 604 SRT_60mphTm_L 255;
BA_ "GenSigSendType" SG_ 604 SRT_60mphTm_L 3;
BA_ "GenSigTimeoutTime_AGSM" SG_ 604 SRT_60mphTm_L 0;
BA_ "GenSigTimeoutTime_BCM" SG_ 604 SRT_60mphTm_L 0;
BA_ "GenSigTimeoutTime_BSM" SG_ 604 SRT_60mphTm_L 0;
BA_ "GenSigTimeoutTime_CADM" SG_ 604 SRT_60mphTm_L 0;
BA_ "GenSigTimeoutTime_DMSM" SG_ 604 SRT_60mphTm_L 0;
BA_ "GenSigTimeoutTime_DTCM" SG_ 604 SRT_60mphTm_L 0;
BA_ "GenSigTimeoutTime_ECM" SG_ 604 SRT_60mphTm_L 0;
BA_ "GenSigTimeoutTime_EVCU2" SG_ 604 SRT_60mphTm_L 0;
BA_ "GenSigTimeoutTime_GNMM" SG_ 604 SRT_60mphTm_L 0;
BA_ "GenSigTimeoutTime_HCP" SG_ 604 SRT_60mphTm_L 0;
BA_ "GenSigTimeoutTime_IPC" SG_ 604 SRT_60mphTm_L 0;
BA_ "GenSigTimeoutTime_RFHM" SG_ 604 SRT_60mphTm_L 0;
BA_ "GenSigTimeoutTime_TCM" SG_ 604 SRT_60mphTm_L 0;
BA_ "GenSigStartValue" SG_ 604 SRT_60mphTmB 255;
BA_ "GenSigSendType" SG_ 604 SRT_60mphTmB 3;
BA_ "GenSigTimeoutTime_AGSM" SG_ 604 SRT_60mphTmB 0;
BA_ "GenSigTimeoutTime_BCM" SG_ 604 SRT_60mphTmB 0;
BA_ "GenSigTimeoutTime_BSM" SG_ 604 SRT_60mphTmB 0;
BA_ "GenSigTimeoutTime_CADM" SG_ 604 SRT_60mphTmB 0;
BA_ "GenSigTimeoutTime_DMSM" SG_ 604 SRT_60mphTmB 0;
BA_ "GenSigTimeoutTime_DTCM" SG_ 604 SRT_60mphTmB 0;
BA_ "GenSigTimeoutTime_ECM" SG_ 604 SRT_60mphTmB 0;
BA_ "GenSigTimeoutTime_EVCU2" SG_ 604 SRT_60mphTmB 0;
BA_ "GenSigTimeoutTime_GNMM" SG_ 604 SRT_60mphTmB 0;
BA_ "GenSigTimeoutTime_HCP" SG_ 604 SRT_60mphTmB 0;
BA_ "GenSigTimeoutTime_IPC" SG_ 604 SRT_60mphTmB 0;
BA_ "GenSigTimeoutTime_RFHM" SG_ 604 SRT_60mphTmB 0;
BA_ "GenSigTimeoutTime_TCM" SG_ 604 SRT_60mphTmB 0;
BA_ "GenSigStartValue" SG_ 604 SRT_60mphTmC 255;
BA_ "GenSigSendType" SG_ 604 SRT_60mphTmC 3;
BA_ "GenSigTimeoutTime_AGSM" SG_ 604 SRT_60mphTmC 0;
BA_ "GenSigTimeoutTime_BCM" SG_ 604 SRT_60mphTmC 0;
BA_ "GenSigTimeoutTime_BSM" SG_ 604 SRT_60mphTmC 0;
BA_ "GenSigTimeoutTime_CADM" SG_ 604 SRT_60mphTmC 0;
BA_ "GenSigTimeoutTime_DMSM" SG_ 604 SRT_60mphTmC 0;
BA_ "GenSigTimeoutTime_DTCM" SG_ 604 SRT_60mphTmC 0;
BA_ "GenSigTimeoutTime_ECM" SG_ 604 SRT_60mphTmC 0;
BA_ "GenSigTimeoutTime_EVCU2" SG_ 604 SRT_60mphTmC 0;
BA_ "GenSigTimeoutTime_GNMM" SG_ 604 SRT_60mphTmC 0;
BA_ "GenSigTimeoutTime_HCP" SG_ 604 SRT_60mphTmC 0;
BA_ "GenSigTimeoutTime_IPC" SG_ 604 SRT_60mphTmC 0;
BA_ "GenSigTimeoutTime_RFHM" SG_ 604 SRT_60mphTmC 0;
BA_ "GenSigTimeoutTime_TCM" SG_ 604 SRT_60mphTmC 0;
BA_ "GenSigStartValue" SG_ 604 SRT_60mphTmL 255;
BA_ "GenSigSendType" SG_ 604 SRT_60mphTmL 3;
BA_ "GenSigTimeoutTime_AGSM" SG_ 604 SRT_60mphTmL 0;
BA_ "GenSigTimeoutTime_BCM" SG_ 604 SRT_60mphTmL 0;
BA_ "GenSigTimeoutTime_BSM" SG_ 604 SRT_60mphTmL 0;
BA_ "GenSigTimeoutTime_CADM" SG_ 604 SRT_60mphTmL 0;
BA_ "GenSigTimeoutTime_DMSM" SG_ 604 SRT_60mphTmL 0;
BA_ "GenSigTimeoutTime_DTCM" SG_ 604 SRT_60mphTmL 0;
BA_ "GenSigTimeoutTime_ECM" SG_ 604 SRT_60mphTmL 0;
BA_ "GenSigTimeoutTime_EVCU2" SG_ 604 SRT_60mphTmL 0;
BA_ "GenSigTimeoutTime_GNMM" SG_ 604 SRT_60mphTmL 0;
BA_ "GenSigTimeoutTime_HCP" SG_ 604 SRT_60mphTmL 0;
BA_ "GenSigTimeoutTime_IPC" SG_ 604 SRT_60mphTmL 0;
BA_ "GenSigTimeoutTime_RFHM" SG_ 604 SRT_60mphTmL 0;
BA_ "GenSigTimeoutTime_TCM" SG_ 604 SRT_60mphTmL 0;
BA_ "GenSigStartValue" SG_ 604 SRT_BrkTm_B 255;
BA_ "GenSigSendType" SG_ 604 SRT_BrkTm_B 3;
BA_ "GenSigTimeoutTime_AGSM" SG_ 604 SRT_BrkTm_B 0;
BA_ "GenSigTimeoutTime_BCM" SG_ 604 SRT_BrkTm_B 0;
BA_ "GenSigTimeoutTime_BSM" SG_ 604 SRT_BrkTm_B 0;
BA_ "GenSigTimeoutTime_CADM" SG_ 604 SRT_BrkTm_B 0;
BA_ "GenSigTimeoutTime_DMSM" SG_ 604 SRT_BrkTm_B 0;
BA_ "GenSigTimeoutTime_DTCM" SG_ 604 SRT_BrkTm_B 0;
BA_ "GenSigTimeoutTime_ECM" SG_ 604 SRT_BrkTm_B 0;
BA_ "GenSigTimeoutTime_EVCU2" SG_ 604 SRT_BrkTm_B 0;
BA_ "GenSigTimeoutTime_GNMM" SG_ 604 SRT_BrkTm_B 0;
BA_ "GenSigTimeoutTime_HCP" SG_ 604 SRT_BrkTm_B 0;
BA_ "GenSigTimeoutTime_IPC" SG_ 604 SRT_BrkTm_B 0;
BA_ "GenSigTimeoutTime_RFHM" SG_ 604 SRT_BrkTm_B 0;
BA_ "GenSigTimeoutTime_TCM" SG_ 604 SRT_BrkTm_B 0;
BA_ "GenSigStartValue" SG_ 604 SRT_BrkTm_C 255;
BA_ "GenSigSendType" SG_ 604 SRT_BrkTm_C 3;
BA_ "GenSigTimeoutTime_AGSM" SG_ 604 SRT_BrkTm_C 0;
BA_ "GenSigTimeoutTime_BCM" SG_ 604 SRT_BrkTm_C 0;
BA_ "GenSigTimeoutTime_BSM" SG_ 604 SRT_BrkTm_C 0;
BA_ "GenSigTimeoutTime_CADM" SG_ 604 SRT_BrkTm_C 0;
BA_ "GenSigTimeoutTime_DMSM" SG_ 604 SRT_BrkTm_C 0;
BA_ "GenSigTimeoutTime_DTCM" SG_ 604 SRT_BrkTm_C 0;
BA_ "GenSigTimeoutTime_ECM" SG_ 604 SRT_BrkTm_C 0;
BA_ "GenSigTimeoutTime_EVCU2" SG_ 604 SRT_BrkTm_C 0;
BA_ "GenSigTimeoutTime_GNMM" SG_ 604 SRT_BrkTm_C 0;
BA_ "GenSigTimeoutTime_HCP" SG_ 604 SRT_BrkTm_C 0;
BA_ "GenSigTimeoutTime_IPC" SG_ 604 SRT_BrkTm_C 0;
BA_ "GenSigTimeoutTime_RFHM" SG_ 604 SRT_BrkTm_C 0;
BA_ "GenSigTimeoutTime_TCM" SG_ 604 SRT_BrkTm_C 0;
BA_ "GenSigStartValue" SG_ 604 SRT_BrkTm_L 255;
BA_ "GenSigSendType" SG_ 604 SRT_BrkTm_L 3;
BA_ "GenSigTimeoutTime_AGSM" SG_ 604 SRT_BrkTm_L 0;
BA_ "GenSigTimeoutTime_BCM" SG_ 604 SRT_BrkTm_L 0;
BA_ "GenSigTimeoutTime_BSM" SG_ 604 SRT_BrkTm_L 0;
BA_ "GenSigTimeoutTime_CADM" SG_ 604 SRT_BrkTm_L 0;
BA_ "GenSigTimeoutTime_DMSM" SG_ 604 SRT_BrkTm_L 0;
BA_ "GenSigTimeoutTime_DTCM" SG_ 604 SRT_BrkTm_L 0;
BA_ "GenSigTimeoutTime_ECM" SG_ 604 SRT_BrkTm_L 0;
BA_ "GenSigTimeoutTime_EVCU2" SG_ 604 SRT_BrkTm_L 0;
BA_ "GenSigTimeoutTime_GNMM" SG_ 604 SRT_BrkTm_L 0;
BA_ "GenSigTimeoutTime_HCP" SG_ 604 SRT_BrkTm_L 0;
BA_ "GenSigTimeoutTime_IPC" SG_ 604 SRT_BrkTm_L 0;
BA_ "GenSigTimeoutTime_RFHM" SG_ 604 SRT_BrkTm_L 0;
BA_ "GenSigTimeoutTime_TCM" SG_ 604 SRT_BrkTm_L 0;
BA_ "GenSigStartValue" SG_ 604 SRT_BrkTmB 255;
BA_ "GenSigSendType" SG_ 604 SRT_BrkTmB 3;
BA_ "GenSigTimeoutTime_AGSM" SG_ 604 SRT_BrkTmB 0;
BA_ "GenSigTimeoutTime_BCM" SG_ 604 SRT_BrkTmB 0;
BA_ "GenSigTimeoutTime_BSM" SG_ 604 SRT_BrkTmB 0;
BA_ "GenSigTimeoutTime_CADM" SG_ 604 SRT_BrkTmB 0;
BA_ "GenSigTimeoutTime_DMSM" SG_ 604 SRT_BrkTmB 0;
BA_ "GenSigTimeoutTime_DTCM" SG_ 604 SRT_BrkTmB 0;
BA_ "GenSigTimeoutTime_ECM" SG_ 604 SRT_BrkTmB 0;
BA_ "GenSigTimeoutTime_EVCU2" SG_ 604 SRT_BrkTmB 0;
BA_ "GenSigTimeoutTime_GNMM" SG_ 604 SRT_BrkTmB 0;
BA_ "GenSigTimeoutTime_HCP" SG_ 604 SRT_BrkTmB 0;
BA_ "GenSigTimeoutTime_IPC" SG_ 604 SRT_BrkTmB 0;
BA_ "GenSigTimeoutTime_RFHM" SG_ 604 SRT_BrkTmB 0;
BA_ "GenSigTimeoutTime_TCM" SG_ 604 SRT_BrkTmB 0;
BA_ "GenSigStartValue" SG_ 604 SRT_BrkTmC 255;
BA_ "GenSigSendType" SG_ 604 SRT_BrkTmC 3;
BA_ "GenSigTimeoutTime_AGSM" SG_ 604 SRT_BrkTmC 0;
BA_ "GenSigTimeoutTime_BCM" SG_ 604 SRT_BrkTmC 0;
BA_ "GenSigTimeoutTime_BSM" SG_ 604 SRT_BrkTmC 0;
BA_ "GenSigTimeoutTime_CADM" SG_ 604 SRT_BrkTmC 0;
BA_ "GenSigTimeoutTime_DMSM" SG_ 604 SRT_BrkTmC 0;
BA_ "GenSigTimeoutTime_DTCM" SG_ 604 SRT_BrkTmC 0;
BA_ "GenSigTimeoutTime_ECM" SG_ 604 SRT_BrkTmC 0;
BA_ "GenSigTimeoutTime_EVCU2" SG_ 604 SRT_BrkTmC 0;
BA_ "GenSigTimeoutTime_GNMM" SG_ 604 SRT_BrkTmC 0;
BA_ "GenSigTimeoutTime_HCP" SG_ 604 SRT_BrkTmC 0;
BA_ "GenSigTimeoutTime_IPC" SG_ 604 SRT_BrkTmC 0;
BA_ "GenSigTimeoutTime_RFHM" SG_ 604 SRT_BrkTmC 0;
BA_ "GenSigTimeoutTime_TCM" SG_ 604 SRT_BrkTmC 0;
BA_ "GenSigStartValue" SG_ 604 SRT_BrkTmL 255;
BA_ "GenSigSendType" SG_ 604 SRT_BrkTmL 3;
BA_ "GenSigTimeoutTime_AGSM" SG_ 604 SRT_BrkTmL 0;
BA_ "GenSigTimeoutTime_BCM" SG_ 604 SRT_BrkTmL 0;
BA_ "GenSigTimeoutTime_BSM" SG_ 604 SRT_BrkTmL 0;
BA_ "GenSigTimeoutTime_CADM" SG_ 604 SRT_BrkTmL 0;
BA_ "GenSigTimeoutTime_DMSM" SG_ 604 SRT_BrkTmL 0;
BA_ "GenSigTimeoutTime_DTCM" SG_ 604 SRT_BrkTmL 0;
BA_ "GenSigTimeoutTime_ECM" SG_ 604 SRT_BrkTmL 0;
BA_ "GenSigTimeoutTime_EVCU2" SG_ 604 SRT_BrkTmL 0;
BA_ "GenSigTimeoutTime_GNMM" SG_ 604 SRT_BrkTmL 0;
BA_ "GenSigTimeoutTime_HCP" SG_ 604 SRT_BrkTmL 0;
BA_ "GenSigTimeoutTime_IPC" SG_ 604 SRT_BrkTmL 0;
BA_ "GenSigTimeoutTime_RFHM" SG_ 604 SRT_BrkTmL 0;
BA_ "GenSigTimeoutTime_TCM" SG_ 604 SRT_BrkTmL 0;
BA_ "GenSigStartValue" SG_ 604 SRT_eighthTm_B 255;
BA_ "GenSigSendType" SG_ 604 SRT_eighthTm_B 3;
BA_ "GenSigTimeoutTime_AGSM" SG_ 604 SRT_eighthTm_B 0;
BA_ "GenSigTimeoutTime_BCM" SG_ 604 SRT_eighthTm_B 0;
BA_ "GenSigTimeoutTime_BSM" SG_ 604 SRT_eighthTm_B 0;
BA_ "GenSigTimeoutTime_CADM" SG_ 604 SRT_eighthTm_B 0;
BA_ "GenSigTimeoutTime_DMSM" SG_ 604 SRT_eighthTm_B 0;
BA_ "GenSigTimeoutTime_DTCM" SG_ 604 SRT_eighthTm_B 0;
BA_ "GenSigTimeoutTime_ECM" SG_ 604 SRT_eighthTm_B 0;
BA_ "GenSigTimeoutTime_EVCU2" SG_ 604 SRT_eighthTm_B 0;
BA_ "GenSigTimeoutTime_GNMM" SG_ 604 SRT_eighthTm_B 0;
BA_ "GenSigTimeoutTime_HCP" SG_ 604 SRT_eighthTm_B 0;
BA_ "GenSigTimeoutTime_IPC" SG_ 604 SRT_eighthTm_B 0;
BA_ "GenSigTimeoutTime_RFHM" SG_ 604 SRT_eighthTm_B 0;
BA_ "GenSigTimeoutTime_TCM" SG_ 604 SRT_eighthTm_B 0;
BA_ "GenSigStartValue" SG_ 604 SRT_eighthTm_C 255;
BA_ "GenSigSendType" SG_ 604 SRT_eighthTm_C 3;
BA_ "GenSigTimeoutTime_AGSM" SG_ 604 SRT_eighthTm_C 0;
BA_ "GenSigTimeoutTime_BCM" SG_ 604 SRT_eighthTm_C 0;
BA_ "GenSigTimeoutTime_BSM" SG_ 604 SRT_eighthTm_C 0;
BA_ "GenSigTimeoutTime_CADM" SG_ 604 SRT_eighthTm_C 0;
BA_ "GenSigTimeoutTime_DMSM" SG_ 604 SRT_eighthTm_C 0;
BA_ "GenSigTimeoutTime_DTCM" SG_ 604 SRT_eighthTm_C 0;
BA_ "GenSigTimeoutTime_ECM" SG_ 604 SRT_eighthTm_C 0;
BA_ "GenSigTimeoutTime_EVCU2" SG_ 604 SRT_eighthTm_C 0;
BA_ "GenSigTimeoutTime_GNMM" SG_ 604 SRT_eighthTm_C 0;
BA_ "GenSigTimeoutTime_HCP" SG_ 604 SRT_eighthTm_C 0;
BA_ "GenSigTimeoutTime_IPC" SG_ 604 SRT_eighthTm_C 0;
BA_ "GenSigTimeoutTime_RFHM" SG_ 604 SRT_eighthTm_C 0;
BA_ "GenSigTimeoutTime_TCM" SG_ 604 SRT_eighthTm_C 0;
BA_ "GenSigStartValue" SG_ 604 SRT_eighthTm_L 255;
BA_ "GenSigSendType" SG_ 604 SRT_eighthTm_L 3;
BA_ "GenSigTimeoutTime_AGSM" SG_ 604 SRT_eighthTm_L 0;
BA_ "GenSigTimeoutTime_BCM" SG_ 604 SRT_eighthTm_L 0;
BA_ "GenSigTimeoutTime_BSM" SG_ 604 SRT_eighthTm_L 0;
BA_ "GenSigTimeoutTime_CADM" SG_ 604 SRT_eighthTm_L 0;
BA_ "GenSigTimeoutTime_DMSM" SG_ 604 SRT_eighthTm_L 0;
BA_ "GenSigTimeoutTime_DTCM" SG_ 604 SRT_eighthTm_L 0;
BA_ "GenSigTimeoutTime_ECM" SG_ 604 SRT_eighthTm_L 0;
BA_ "GenSigTimeoutTime_EVCU2" SG_ 604 SRT_eighthTm_L 0;
BA_ "GenSigTimeoutTime_GNMM" SG_ 604 SRT_eighthTm_L 0;
BA_ "GenSigTimeoutTime_HCP" SG_ 604 SRT_eighthTm_L 0;
BA_ "GenSigTimeoutTime_IPC" SG_ 604 SRT_eighthTm_L 0;
BA_ "GenSigTimeoutTime_RFHM" SG_ 604 SRT_eighthTm_L 0;
BA_ "GenSigTimeoutTime_TCM" SG_ 604 SRT_eighthTm_L 0;
BA_ "GenSigStartValue" SG_ 604 SRT_eighthTmB 255;
BA_ "GenSigSendType" SG_ 604 SRT_eighthTmB 3;
BA_ "GenSigTimeoutTime_AGSM" SG_ 604 SRT_eighthTmB 0;
BA_ "GenSigTimeoutTime_BCM" SG_ 604 SRT_eighthTmB 0;
BA_ "GenSigTimeoutTime_BSM" SG_ 604 SRT_eighthTmB 0;
BA_ "GenSigTimeoutTime_CADM" SG_ 604 SRT_eighthTmB 0;
BA_ "GenSigTimeoutTime_DMSM" SG_ 604 SRT_eighthTmB 0;
BA_ "GenSigTimeoutTime_DTCM" SG_ 604 SRT_eighthTmB 0;
BA_ "GenSigTimeoutTime_ECM" SG_ 604 SRT_eighthTmB 0;
BA_ "GenSigTimeoutTime_EVCU2" SG_ 604 SRT_eighthTmB 0;
BA_ "GenSigTimeoutTime_GNMM" SG_ 604 SRT_eighthTmB 0;
BA_ "GenSigTimeoutTime_HCP" SG_ 604 SRT_eighthTmB 0;
BA_ "GenSigTimeoutTime_IPC" SG_ 604 SRT_eighthTmB 0;
BA_ "GenSigTimeoutTime_RFHM" SG_ 604 SRT_eighthTmB 0;
BA_ "GenSigTimeoutTime_TCM" SG_ 604 SRT_eighthTmB 0;
BA_ "GenSigStartValue" SG_ 604 SRT_eighthTmC 255;
BA_ "GenSigSendType" SG_ 604 SRT_eighthTmC 3;
BA_ "GenSigTimeoutTime_AGSM" SG_ 604 SRT_eighthTmC 0;
BA_ "GenSigTimeoutTime_BCM" SG_ 604 SRT_eighthTmC 0;
BA_ "GenSigTimeoutTime_BSM" SG_ 604 SRT_eighthTmC 0;
BA_ "GenSigTimeoutTime_CADM" SG_ 604 SRT_eighthTmC 0;
BA_ "GenSigTimeoutTime_DMSM" SG_ 604 SRT_eighthTmC 0;
BA_ "GenSigTimeoutTime_DTCM" SG_ 604 SRT_eighthTmC 0;
BA_ "GenSigTimeoutTime_ECM" SG_ 604 SRT_eighthTmC 0;
BA_ "GenSigTimeoutTime_EVCU2" SG_ 604 SRT_eighthTmC 0;
BA_ "GenSigTimeoutTime_GNMM" SG_ 604 SRT_eighthTmC 0;
BA_ "GenSigTimeoutTime_HCP" SG_ 604 SRT_eighthTmC 0;
BA_ "GenSigTimeoutTime_IPC" SG_ 604 SRT_eighthTmC 0;
BA_ "GenSigTimeoutTime_RFHM" SG_ 604 SRT_eighthTmC 0;
BA_ "GenSigTimeoutTime_TCM" SG_ 604 SRT_eighthTmC 0;
BA_ "GenSigStartValue" SG_ 604 SRT_eighthTmL 255;
BA_ "GenSigSendType" SG_ 604 SRT_eighthTmL 3;
BA_ "GenSigTimeoutTime_AGSM" SG_ 604 SRT_eighthTmL 0;
BA_ "GenSigTimeoutTime_BCM" SG_ 604 SRT_eighthTmL 0;
BA_ "GenSigTimeoutTime_BSM" SG_ 604 SRT_eighthTmL 0;
BA_ "GenSigTimeoutTime_CADM" SG_ 604 SRT_eighthTmL 0;
BA_ "GenSigTimeoutTime_DMSM" SG_ 604 SRT_eighthTmL 0;
BA_ "GenSigTimeoutTime_DTCM" SG_ 604 SRT_eighthTmL 0;
BA_ "GenSigTimeoutTime_ECM" SG_ 604 SRT_eighthTmL 0;
BA_ "GenSigTimeoutTime_EVCU2" SG_ 604 SRT_eighthTmL 0;
BA_ "GenSigTimeoutTime_GNMM" SG_ 604 SRT_eighthTmL 0;
BA_ "GenSigTimeoutTime_HCP" SG_ 604 SRT_eighthTmL 0;
BA_ "GenSigTimeoutTime_IPC" SG_ 604 SRT_eighthTmL 0;
BA_ "GenSigTimeoutTime_RFHM" SG_ 604 SRT_eighthTmL 0;
BA_ "GenSigTimeoutTime_TCM" SG_ 604 SRT_eighthTmL 0;
BA_ "GenSigStartValue" SG_ 604 SRT_EthSpdB_M 255;
BA_ "GenSigSendType" SG_ 604 SRT_EthSpdB_M 3;
BA_ "GenSigTimeoutTime_AGSM" SG_ 604 SRT_EthSpdB_M 0;
BA_ "GenSigTimeoutTime_BCM" SG_ 604 SRT_EthSpdB_M 0;
BA_ "GenSigTimeoutTime_BSM" SG_ 604 SRT_EthSpdB_M 0;
BA_ "GenSigTimeoutTime_CADM" SG_ 604 SRT_EthSpdB_M 0;
BA_ "GenSigTimeoutTime_DMSM" SG_ 604 SRT_EthSpdB_M 0;
BA_ "GenSigTimeoutTime_DTCM" SG_ 604 SRT_EthSpdB_M 0;
BA_ "GenSigTimeoutTime_ECM" SG_ 604 SRT_EthSpdB_M 0;
BA_ "GenSigTimeoutTime_EVCU2" SG_ 604 SRT_EthSpdB_M 0;
BA_ "GenSigTimeoutTime_GNMM" SG_ 604 SRT_EthSpdB_M 0;
BA_ "GenSigTimeoutTime_HCP" SG_ 604 SRT_EthSpdB_M 0;
BA_ "GenSigTimeoutTime_IPC" SG_ 604 SRT_EthSpdB_M 0;
BA_ "GenSigTimeoutTime_RFHM" SG_ 604 SRT_EthSpdB_M 0;
BA_ "GenSigTimeoutTime_TCM" SG_ 604 SRT_EthSpdB_M 0;
BA_ "GenSigStartValue" SG_ 604 SRT_EthSpdB_US 255;
BA_ "GenSigSendType" SG_ 604 SRT_EthSpdB_US 3;
BA_ "GenSigTimeoutTime_AGSM" SG_ 604 SRT_EthSpdB_US 0;
BA_ "GenSigTimeoutTime_BCM" SG_ 604 SRT_EthSpdB_US 0;
BA_ "GenSigTimeoutTime_BSM" SG_ 604 SRT_EthSpdB_US 0;
BA_ "GenSigTimeoutTime_CADM" SG_ 604 SRT_EthSpdB_US 0;
BA_ "GenSigTimeoutTime_DMSM" SG_ 604 SRT_EthSpdB_US 0;
BA_ "GenSigTimeoutTime_DTCM" SG_ 604 SRT_EthSpdB_US 0;
BA_ "GenSigTimeoutTime_ECM" SG_ 604 SRT_EthSpdB_US 0;
BA_ "GenSigTimeoutTime_EVCU2" SG_ 604 SRT_EthSpdB_US 0;
BA_ "GenSigTimeoutTime_GNMM" SG_ 604 SRT_EthSpdB_US 0;
BA_ "GenSigTimeoutTime_HCP" SG_ 604 SRT_EthSpdB_US 0;
BA_ "GenSigTimeoutTime_IPC" SG_ 604 SRT_EthSpdB_US 0;
BA_ "GenSigTimeoutTime_RFHM" SG_ 604 SRT_EthSpdB_US 0;
BA_ "GenSigTimeoutTime_TCM" SG_ 604 SRT_EthSpdB_US 0;
BA_ "GenSigStartValue" SG_ 604 SRT_EthSpdC_M 255;
BA_ "GenSigSendType" SG_ 604 SRT_EthSpdC_M 3;
BA_ "GenSigTimeoutTime_AGSM" SG_ 604 SRT_EthSpdC_M 0;
BA_ "GenSigTimeoutTime_BCM" SG_ 604 SRT_EthSpdC_M 0;
BA_ "GenSigTimeoutTime_BSM" SG_ 604 SRT_EthSpdC_M 0;
BA_ "GenSigTimeoutTime_CADM" SG_ 604 SRT_EthSpdC_M 0;
BA_ "GenSigTimeoutTime_DMSM" SG_ 604 SRT_EthSpdC_M 0;
BA_ "GenSigTimeoutTime_DTCM" SG_ 604 SRT_EthSpdC_M 0;
BA_ "GenSigTimeoutTime_ECM" SG_ 604 SRT_EthSpdC_M 0;
BA_ "GenSigTimeoutTime_EVCU2" SG_ 604 SRT_EthSpdC_M 0;
BA_ "GenSigTimeoutTime_GNMM" SG_ 604 SRT_EthSpdC_M 0;
BA_ "GenSigTimeoutTime_HCP" SG_ 604 SRT_EthSpdC_M 0;
BA_ "GenSigTimeoutTime_IPC" SG_ 604 SRT_EthSpdC_M 0;
BA_ "GenSigTimeoutTime_RFHM" SG_ 604 SRT_EthSpdC_M 0;
BA_ "GenSigTimeoutTime_TCM" SG_ 604 SRT_EthSpdC_M 0;
BA_ "GenSigStartValue" SG_ 604 SRT_EthSpdC_US 255;
BA_ "GenSigSendType" SG_ 604 SRT_EthSpdC_US 3;
BA_ "GenSigTimeoutTime_AGSM" SG_ 604 SRT_EthSpdC_US 0;
BA_ "GenSigTimeoutTime_BCM" SG_ 604 SRT_EthSpdC_US 0;
BA_ "GenSigTimeoutTime_BSM" SG_ 604 SRT_EthSpdC_US 0;
BA_ "GenSigTimeoutTime_CADM" SG_ 604 SRT_EthSpdC_US 0;
BA_ "GenSigTimeoutTime_DMSM" SG_ 604 SRT_EthSpdC_US 0;
BA_ "GenSigTimeoutTime_DTCM" SG_ 604 SRT_EthSpdC_US 0;
BA_ "GenSigTimeoutTime_ECM" SG_ 604 SRT_EthSpdC_US 0;
BA_ "GenSigTimeoutTime_EVCU2" SG_ 604 SRT_EthSpdC_US 0;
BA_ "GenSigTimeoutTime_GNMM" SG_ 604 SRT_EthSpdC_US 0;
BA_ "GenSigTimeoutTime_HCP" SG_ 604 SRT_EthSpdC_US 0;
BA_ "GenSigTimeoutTime_IPC" SG_ 604 SRT_EthSpdC_US 0;
BA_ "GenSigTimeoutTime_RFHM" SG_ 604 SRT_EthSpdC_US 0;
BA_ "GenSigTimeoutTime_TCM" SG_ 604 SRT_EthSpdC_US 0;
BA_ "GenSigStartValue" SG_ 604 SRT_EthSpdL_M 255;
BA_ "GenSigSendType" SG_ 604 SRT_EthSpdL_M 3;
BA_ "GenSigTimeoutTime_AGSM" SG_ 604 SRT_EthSpdL_M 0;
BA_ "GenSigTimeoutTime_BCM" SG_ 604 SRT_EthSpdL_M 0;
BA_ "GenSigTimeoutTime_BSM" SG_ 604 SRT_EthSpdL_M 0;
BA_ "GenSigTimeoutTime_CADM" SG_ 604 SRT_EthSpdL_M 0;
BA_ "GenSigTimeoutTime_DMSM" SG_ 604 SRT_EthSpdL_M 0;
BA_ "GenSigTimeoutTime_DTCM" SG_ 604 SRT_EthSpdL_M 0;
BA_ "GenSigTimeoutTime_ECM" SG_ 604 SRT_EthSpdL_M 0;
BA_ "GenSigTimeoutTime_EVCU2" SG_ 604 SRT_EthSpdL_M 0;
BA_ "GenSigTimeoutTime_GNMM" SG_ 604 SRT_EthSpdL_M 0;
BA_ "GenSigTimeoutTime_HCP" SG_ 604 SRT_EthSpdL_M 0;
BA_ "GenSigTimeoutTime_IPC" SG_ 604 SRT_EthSpdL_M 0;
BA_ "GenSigTimeoutTime_RFHM" SG_ 604 SRT_EthSpdL_M 0;
BA_ "GenSigTimeoutTime_TCM" SG_ 604 SRT_EthSpdL_M 0;
BA_ "GenSigStartValue" SG_ 604 SRT_EthSpdL_US 255;
BA_ "GenSigSendType" SG_ 604 SRT_EthSpdL_US 3;
BA_ "GenSigTimeoutTime_AGSM" SG_ 604 SRT_EthSpdL_US 0;
BA_ "GenSigTimeoutTime_BCM" SG_ 604 SRT_EthSpdL_US 0;
BA_ "GenSigTimeoutTime_BSM" SG_ 604 SRT_EthSpdL_US 0;
BA_ "GenSigTimeoutTime_CADM" SG_ 604 SRT_EthSpdL_US 0;
BA_ "GenSigTimeoutTime_DMSM" SG_ 604 SRT_EthSpdL_US 0;
BA_ "GenSigTimeoutTime_DTCM" SG_ 604 SRT_EthSpdL_US 0;
BA_ "GenSigTimeoutTime_ECM" SG_ 604 SRT_EthSpdL_US 0;
BA_ "GenSigTimeoutTime_EVCU2" SG_ 604 SRT_EthSpdL_US 0;
BA_ "GenSigTimeoutTime_GNMM" SG_ 604 SRT_EthSpdL_US 0;
BA_ "GenSigTimeoutTime_HCP" SG_ 604 SRT_EthSpdL_US 0;
BA_ "GenSigTimeoutTime_IPC" SG_ 604 SRT_EthSpdL_US 0;
BA_ "GenSigTimeoutTime_RFHM" SG_ 604 SRT_EthSpdL_US 0;
BA_ "GenSigTimeoutTime_TCM" SG_ 604 SRT_EthSpdL_US 0;
BA_ "GenSigStartValue" SG_ 604 SRT_QrtSpdB_M 255;
BA_ "GenSigSendType" SG_ 604 SRT_QrtSpdB_M 3;
BA_ "GenSigTimeoutTime_AGSM" SG_ 604 SRT_QrtSpdB_M 0;
BA_ "GenSigTimeoutTime_BCM" SG_ 604 SRT_QrtSpdB_M 0;
BA_ "GenSigTimeoutTime_BSM" SG_ 604 SRT_QrtSpdB_M 0;
BA_ "GenSigTimeoutTime_CADM" SG_ 604 SRT_QrtSpdB_M 0;
BA_ "GenSigTimeoutTime_DMSM" SG_ 604 SRT_QrtSpdB_M 0;
BA_ "GenSigTimeoutTime_DTCM" SG_ 604 SRT_QrtSpdB_M 0;
BA_ "GenSigTimeoutTime_ECM" SG_ 604 SRT_QrtSpdB_M 0;
BA_ "GenSigTimeoutTime_EVCU2" SG_ 604 SRT_QrtSpdB_M 0;
BA_ "GenSigTimeoutTime_GNMM" SG_ 604 SRT_QrtSpdB_M 0;
BA_ "GenSigTimeoutTime_HCP" SG_ 604 SRT_QrtSpdB_M 0;
BA_ "GenSigTimeoutTime_IPC" SG_ 604 SRT_QrtSpdB_M 0;
BA_ "GenSigTimeoutTime_RFHM" SG_ 604 SRT_QrtSpdB_M 0;
BA_ "GenSigTimeoutTime_TCM" SG_ 604 SRT_QrtSpdB_M 0;
BA_ "GenSigStartValue" SG_ 604 SRT_QrtSpdB_US 255;
BA_ "GenSigSendType" SG_ 604 SRT_QrtSpdB_US 3;
BA_ "GenSigTimeoutTime_AGSM" SG_ 604 SRT_QrtSpdB_US 0;
BA_ "GenSigTimeoutTime_BCM" SG_ 604 SRT_QrtSpdB_US 0;
BA_ "GenSigTimeoutTime_BSM" SG_ 604 SRT_QrtSpdB_US 0;
BA_ "GenSigTimeoutTime_CADM" SG_ 604 SRT_QrtSpdB_US 0;
BA_ "GenSigTimeoutTime_DMSM" SG_ 604 SRT_QrtSpdB_US 0;
BA_ "GenSigTimeoutTime_DTCM" SG_ 604 SRT_QrtSpdB_US 0;
BA_ "GenSigTimeoutTime_ECM" SG_ 604 SRT_QrtSpdB_US 0;
BA_ "GenSigTimeoutTime_EVCU2" SG_ 604 SRT_QrtSpdB_US 0;
BA_ "GenSigTimeoutTime_GNMM" SG_ 604 SRT_QrtSpdB_US 0;
BA_ "GenSigTimeoutTime_HCP" SG_ 604 SRT_QrtSpdB_US 0;
BA_ "GenSigTimeoutTime_IPC" SG_ 604 SRT_QrtSpdB_US 0;
BA_ "GenSigTimeoutTime_RFHM" SG_ 604 SRT_QrtSpdB_US 0;
BA_ "GenSigTimeoutTime_TCM" SG_ 604 SRT_QrtSpdB_US 0;
BA_ "GenSigStartValue" SG_ 604 SRT_QrtSpdC_M 255;
BA_ "GenSigSendType" SG_ 604 SRT_QrtSpdC_M 3;
BA_ "GenSigTimeoutTime_AGSM" SG_ 604 SRT_QrtSpdC_M 0;
BA_ "GenSigTimeoutTime_BCM" SG_ 604 SRT_QrtSpdC_M 0;
BA_ "GenSigTimeoutTime_BSM" SG_ 604 SRT_QrtSpdC_M 0;
BA_ "GenSigTimeoutTime_CADM" SG_ 604 SRT_QrtSpdC_M 0;
BA_ "GenSigTimeoutTime_DMSM" SG_ 604 SRT_QrtSpdC_M 0;
BA_ "GenSigTimeoutTime_DTCM" SG_ 604 SRT_QrtSpdC_M 0;
BA_ "GenSigTimeoutTime_ECM" SG_ 604 SRT_QrtSpdC_M 0;
BA_ "GenSigTimeoutTime_EVCU2" SG_ 604 SRT_QrtSpdC_M 0;
BA_ "GenSigTimeoutTime_GNMM" SG_ 604 SRT_QrtSpdC_M 0;
BA_ "GenSigTimeoutTime_HCP" SG_ 604 SRT_QrtSpdC_M 0;
BA_ "GenSigTimeoutTime_IPC" SG_ 604 SRT_QrtSpdC_M 0;
BA_ "GenSigTimeoutTime_RFHM" SG_ 604 SRT_QrtSpdC_M 0;
BA_ "GenSigTimeoutTime_TCM" SG_ 604 SRT_QrtSpdC_M 0;
BA_ "GenSigStartValue" SG_ 604 SRT_QrtSpdC_US 255;
BA_ "GenSigSendType" SG_ 604 SRT_QrtSpdC_US 3;
BA_ "GenSigTimeoutTime_AGSM" SG_ 604 SRT_QrtSpdC_US 0;
BA_ "GenSigTimeoutTime_BCM" SG_ 604 SRT_QrtSpdC_US 0;
BA_ "GenSigTimeoutTime_BSM" SG_ 604 SRT_QrtSpdC_US 0;
BA_ "GenSigTimeoutTime_CADM" SG_ 604 SRT_QrtSpdC_US 0;
BA_ "GenSigTimeoutTime_DMSM" SG_ 604 SRT_QrtSpdC_US 0;
BA_ "GenSigTimeoutTime_DTCM" SG_ 604 SRT_QrtSpdC_US 0;
BA_ "GenSigTimeoutTime_ECM" SG_ 604 SRT_QrtSpdC_US 0;
BA_ "GenSigTimeoutTime_EVCU2" SG_ 604 SRT_QrtSpdC_US 0;
BA_ "GenSigTimeoutTime_GNMM" SG_ 604 SRT_QrtSpdC_US 0;
BA_ "GenSigTimeoutTime_HCP" SG_ 604 SRT_QrtSpdC_US 0;
BA_ "GenSigTimeoutTime_IPC" SG_ 604 SRT_QrtSpdC_US 0;
BA_ "GenSigTimeoutTime_RFHM" SG_ 604 SRT_QrtSpdC_US 0;
BA_ "GenSigTimeoutTime_TCM" SG_ 604 SRT_QrtSpdC_US 0;
BA_ "GenSigStartValue" SG_ 604 SRT_QrtSpdL_M 255;
BA_ "GenSigSendType" SG_ 604 SRT_QrtSpdL_M 3;
BA_ "GenSigTimeoutTime_AGSM" SG_ 604 SRT_QrtSpdL_M 0;
BA_ "GenSigTimeoutTime_BCM" SG_ 604 SRT_QrtSpdL_M 0;
BA_ "GenSigTimeoutTime_BSM" SG_ 604 SRT_QrtSpdL_M 0;
BA_ "GenSigTimeoutTime_CADM" SG_ 604 SRT_QrtSpdL_M 0;
BA_ "GenSigTimeoutTime_DMSM" SG_ 604 SRT_QrtSpdL_M 0;
BA_ "GenSigTimeoutTime_DTCM" SG_ 604 SRT_QrtSpdL_M 0;
BA_ "GenSigTimeoutTime_ECM" SG_ 604 SRT_QrtSpdL_M 0;
BA_ "GenSigTimeoutTime_EVCU2" SG_ 604 SRT_QrtSpdL_M 0;
BA_ "GenSigTimeoutTime_GNMM" SG_ 604 SRT_QrtSpdL_M 0;
BA_ "GenSigTimeoutTime_HCP" SG_ 604 SRT_QrtSpdL_M 0;
BA_ "GenSigTimeoutTime_IPC" SG_ 604 SRT_QrtSpdL_M 0;
BA_ "GenSigTimeoutTime_RFHM" SG_ 604 SRT_QrtSpdL_M 0;
BA_ "GenSigTimeoutTime_TCM" SG_ 604 SRT_QrtSpdL_M 0;
BA_ "GenSigStartValue" SG_ 604 SRT_QrtSpdL_US 255;
BA_ "GenSigSendType" SG_ 604 SRT_QrtSpdL_US 3;
BA_ "GenSigTimeoutTime_AGSM" SG_ 604 SRT_QrtSpdL_US 0;
BA_ "GenSigTimeoutTime_BCM" SG_ 604 SRT_QrtSpdL_US 0;
BA_ "GenSigTimeoutTime_BSM" SG_ 604 SRT_QrtSpdL_US 0;
BA_ "GenSigTimeoutTime_CADM" SG_ 604 SRT_QrtSpdL_US 0;
BA_ "GenSigTimeoutTime_DMSM" SG_ 604 SRT_QrtSpdL_US 0;
BA_ "GenSigTimeoutTime_DTCM" SG_ 604 SRT_QrtSpdL_US 0;
BA_ "GenSigTimeoutTime_ECM" SG_ 604 SRT_QrtSpdL_US 0;
BA_ "GenSigTimeoutTime_EVCU2" SG_ 604 SRT_QrtSpdL_US 0;
BA_ "GenSigTimeoutTime_GNMM" SG_ 604 SRT_QrtSpdL_US 0;
BA_ "GenSigTimeoutTime_HCP" SG_ 604 SRT_QrtSpdL_US 0;
BA_ "GenSigTimeoutTime_IPC" SG_ 604 SRT_QrtSpdL_US 0;
BA_ "GenSigTimeoutTime_RFHM" SG_ 604 SRT_QrtSpdL_US 0;
BA_ "GenSigTimeoutTime_TCM" SG_ 604 SRT_QrtSpdL_US 0;
BA_ "GenSigStartValue" SG_ 604 SRT_quarterTm_B 255;
BA_ "GenSigSendType" SG_ 604 SRT_quarterTm_B 3;
BA_ "GenSigTimeoutTime_AGSM" SG_ 604 SRT_quarterTm_B 0;
BA_ "GenSigTimeoutTime_BCM" SG_ 604 SRT_quarterTm_B 0;
BA_ "GenSigTimeoutTime_BSM" SG_ 604 SRT_quarterTm_B 0;
BA_ "GenSigTimeoutTime_CADM" SG_ 604 SRT_quarterTm_B 0;
BA_ "GenSigTimeoutTime_DMSM" SG_ 604 SRT_quarterTm_B 0;
BA_ "GenSigTimeoutTime_DTCM" SG_ 604 SRT_quarterTm_B 0;
BA_ "GenSigTimeoutTime_ECM" SG_ 604 SRT_quarterTm_B 0;
BA_ "GenSigTimeoutTime_EVCU2" SG_ 604 SRT_quarterTm_B 0;
BA_ "GenSigTimeoutTime_GNMM" SG_ 604 SRT_quarterTm_B 0;
BA_ "GenSigTimeoutTime_HCP" SG_ 604 SRT_quarterTm_B 0;
BA_ "GenSigTimeoutTime_IPC" SG_ 604 SRT_quarterTm_B 0;
BA_ "GenSigTimeoutTime_RFHM" SG_ 604 SRT_quarterTm_B 0;
BA_ "GenSigTimeoutTime_TCM" SG_ 604 SRT_quarterTm_B 0;
BA_ "GenSigStartValue" SG_ 604 SRT_quarterTm_C 255;
BA_ "GenSigSendType" SG_ 604 SRT_quarterTm_C 3;
BA_ "GenSigTimeoutTime_AGSM" SG_ 604 SRT_quarterTm_C 0;
BA_ "GenSigTimeoutTime_BCM" SG_ 604 SRT_quarterTm_C 0;
BA_ "GenSigTimeoutTime_BSM" SG_ 604 SRT_quarterTm_C 0;
BA_ "GenSigTimeoutTime_CADM" SG_ 604 SRT_quarterTm_C 0;
BA_ "GenSigTimeoutTime_DMSM" SG_ 604 SRT_quarterTm_C 0;
BA_ "GenSigTimeoutTime_DTCM" SG_ 604 SRT_quarterTm_C 0;
BA_ "GenSigTimeoutTime_ECM" SG_ 604 SRT_quarterTm_C 0;
BA_ "GenSigTimeoutTime_EVCU2" SG_ 604 SRT_quarterTm_C 0;
BA_ "GenSigTimeoutTime_GNMM" SG_ 604 SRT_quarterTm_C 0;
BA_ "GenSigTimeoutTime_HCP" SG_ 604 SRT_quarterTm_C 0;
BA_ "GenSigTimeoutTime_IPC" SG_ 604 SRT_quarterTm_C 0;
BA_ "GenSigTimeoutTime_RFHM" SG_ 604 SRT_quarterTm_C 0;
BA_ "GenSigTimeoutTime_TCM" SG_ 604 SRT_quarterTm_C 0;
BA_ "GenSigStartValue" SG_ 604 SRT_quarterTm_L 255;
BA_ "GenSigSendType" SG_ 604 SRT_quarterTm_L 3;
BA_ "GenSigTimeoutTime_AGSM" SG_ 604 SRT_quarterTm_L 0;
BA_ "GenSigTimeoutTime_BCM" SG_ 604 SRT_quarterTm_L 0;
BA_ "GenSigTimeoutTime_BSM" SG_ 604 SRT_quarterTm_L 0;
BA_ "GenSigTimeoutTime_CADM" SG_ 604 SRT_quarterTm_L 0;
BA_ "GenSigTimeoutTime_DMSM" SG_ 604 SRT_quarterTm_L 0;
BA_ "GenSigTimeoutTime_DTCM" SG_ 604 SRT_quarterTm_L 0;
BA_ "GenSigTimeoutTime_ECM" SG_ 604 SRT_quarterTm_L 0;
BA_ "GenSigTimeoutTime_EVCU2" SG_ 604 SRT_quarterTm_L 0;
BA_ "GenSigTimeoutTime_GNMM" SG_ 604 SRT_quarterTm_L 0;
BA_ "GenSigTimeoutTime_HCP" SG_ 604 SRT_quarterTm_L 0;
BA_ "GenSigTimeoutTime_IPC" SG_ 604 SRT_quarterTm_L 0;
BA_ "GenSigTimeoutTime_RFHM" SG_ 604 SRT_quarterTm_L 0;
BA_ "GenSigTimeoutTime_TCM" SG_ 604 SRT_quarterTm_L 0;
BA_ "GenSigStartValue" SG_ 604 SRT_quarterTmB 255;
BA_ "GenSigSendType" SG_ 604 SRT_quarterTmB 3;
BA_ "GenSigTimeoutTime_AGSM" SG_ 604 SRT_quarterTmB 0;
BA_ "GenSigTimeoutTime_BCM" SG_ 604 SRT_quarterTmB 0;
BA_ "GenSigTimeoutTime_BSM" SG_ 604 SRT_quarterTmB 0;
BA_ "GenSigTimeoutTime_CADM" SG_ 604 SRT_quarterTmB 0;
BA_ "GenSigTimeoutTime_DMSM" SG_ 604 SRT_quarterTmB 0;
BA_ "GenSigTimeoutTime_DTCM" SG_ 604 SRT_quarterTmB 0;
BA_ "GenSigTimeoutTime_ECM" SG_ 604 SRT_quarterTmB 0;
BA_ "GenSigTimeoutTime_EVCU2" SG_ 604 SRT_quarterTmB 0;
BA_ "GenSigTimeoutTime_GNMM" SG_ 604 SRT_quarterTmB 0;
BA_ "GenSigTimeoutTime_HCP" SG_ 604 SRT_quarterTmB 0;
BA_ "GenSigTimeoutTime_IPC" SG_ 604 SRT_quarterTmB 0;
BA_ "GenSigTimeoutTime_RFHM" SG_ 604 SRT_quarterTmB 0;
BA_ "GenSigTimeoutTime_TCM" SG_ 604 SRT_quarterTmB 0;
BA_ "GenSigStartValue" SG_ 604 SRT_quarterTmC 255;
BA_ "GenSigSendType" SG_ 604 SRT_quarterTmC 3;
BA_ "GenSigTimeoutTime_AGSM" SG_ 604 SRT_quarterTmC 0;
BA_ "GenSigTimeoutTime_BCM" SG_ 604 SRT_quarterTmC 0;
BA_ "GenSigTimeoutTime_BSM" SG_ 604 SRT_quarterTmC 0;
BA_ "GenSigTimeoutTime_CADM" SG_ 604 SRT_quarterTmC 0;
BA_ "GenSigTimeoutTime_DMSM" SG_ 604 SRT_quarterTmC 0;
BA_ "GenSigTimeoutTime_DTCM" SG_ 604 SRT_quarterTmC 0;
BA_ "GenSigTimeoutTime_ECM" SG_ 604 SRT_quarterTmC 0;
BA_ "GenSigTimeoutTime_EVCU2" SG_ 604 SRT_quarterTmC 0;
BA_ "GenSigTimeoutTime_GNMM" SG_ 604 SRT_quarterTmC 0;
BA_ "GenSigTimeoutTime_HCP" SG_ 604 SRT_quarterTmC 0;
BA_ "GenSigTimeoutTime_IPC" SG_ 604 SRT_quarterTmC 0;
BA_ "GenSigTimeoutTime_RFHM" SG_ 604 SRT_quarterTmC 0;
BA_ "GenSigTimeoutTime_TCM" SG_ 604 SRT_quarterTmC 0;
BA_ "GenSigStartValue" SG_ 604 SRT_quarterTmL 255;
BA_ "GenSigSendType" SG_ 604 SRT_quarterTmL 3;
BA_ "GenSigTimeoutTime_AGSM" SG_ 604 SRT_quarterTmL 0;
BA_ "GenSigTimeoutTime_BCM" SG_ 604 SRT_quarterTmL 0;
BA_ "GenSigTimeoutTime_BSM" SG_ 604 SRT_quarterTmL 0;
BA_ "GenSigTimeoutTime_CADM" SG_ 604 SRT_quarterTmL 0;
BA_ "GenSigTimeoutTime_DMSM" SG_ 604 SRT_quarterTmL 0;
BA_ "GenSigTimeoutTime_DTCM" SG_ 604 SRT_quarterTmL 0;
BA_ "GenSigTimeoutTime_ECM" SG_ 604 SRT_quarterTmL 0;
BA_ "GenSigTimeoutTime_EVCU2" SG_ 604 SRT_quarterTmL 0;
BA_ "GenSigTimeoutTime_GNMM" SG_ 604 SRT_quarterTmL 0;
BA_ "GenSigTimeoutTime_HCP" SG_ 604 SRT_quarterTmL 0;
BA_ "GenSigTimeoutTime_IPC" SG_ 604 SRT_quarterTmL 0;
BA_ "GenSigTimeoutTime_RFHM" SG_ 604 SRT_quarterTmL 0;
BA_ "GenSigTimeoutTime_TCM" SG_ 604 SRT_quarterTmL 0;
BA_ "GenSigStartValue" SG_ 604 SRT_ReactTm_B 255;
BA_ "GenSigSendType" SG_ 604 SRT_ReactTm_B 3;
BA_ "GenSigTimeoutTime_AGSM" SG_ 604 SRT_ReactTm_B 0;
BA_ "GenSigTimeoutTime_BCM" SG_ 604 SRT_ReactTm_B 0;
BA_ "GenSigTimeoutTime_BSM" SG_ 604 SRT_ReactTm_B 0;
BA_ "GenSigTimeoutTime_CADM" SG_ 604 SRT_ReactTm_B 0;
BA_ "GenSigTimeoutTime_DMSM" SG_ 604 SRT_ReactTm_B 0;
BA_ "GenSigTimeoutTime_DTCM" SG_ 604 SRT_ReactTm_B 0;
BA_ "GenSigTimeoutTime_ECM" SG_ 604 SRT_ReactTm_B 0;
BA_ "GenSigTimeoutTime_EVCU2" SG_ 604 SRT_ReactTm_B 0;
BA_ "GenSigTimeoutTime_GNMM" SG_ 604 SRT_ReactTm_B 0;
BA_ "GenSigTimeoutTime_HCP" SG_ 604 SRT_ReactTm_B 0;
BA_ "GenSigTimeoutTime_IPC" SG_ 604 SRT_ReactTm_B 0;
BA_ "GenSigTimeoutTime_RFHM" SG_ 604 SRT_ReactTm_B 0;
BA_ "GenSigTimeoutTime_TCM" SG_ 604 SRT_ReactTm_B 0;
BA_ "GenSigStartValue" SG_ 604 SRT_ReactTm_C 255;
BA_ "GenSigSendType" SG_ 604 SRT_ReactTm_C 3;
BA_ "GenSigTimeoutTime_AGSM" SG_ 604 SRT_ReactTm_C 0;
BA_ "GenSigTimeoutTime_BCM" SG_ 604 SRT_ReactTm_C 0;
BA_ "GenSigTimeoutTime_BSM" SG_ 604 SRT_ReactTm_C 0;
BA_ "GenSigTimeoutTime_CADM" SG_ 604 SRT_ReactTm_C 0;
BA_ "GenSigTimeoutTime_DMSM" SG_ 604 SRT_ReactTm_C 0;
BA_ "GenSigTimeoutTime_DTCM" SG_ 604 SRT_ReactTm_C 0;
BA_ "GenSigTimeoutTime_ECM" SG_ 604 SRT_ReactTm_C 0;
BA_ "GenSigTimeoutTime_EVCU2" SG_ 604 SRT_ReactTm_C 0;
BA_ "GenSigTimeoutTime_GNMM" SG_ 604 SRT_ReactTm_C 0;
BA_ "GenSigTimeoutTime_HCP" SG_ 604 SRT_ReactTm_C 0;
BA_ "GenSigTimeoutTime_IPC" SG_ 604 SRT_ReactTm_C 0;
BA_ "GenSigTimeoutTime_RFHM" SG_ 604 SRT_ReactTm_C 0;
BA_ "GenSigTimeoutTime_TCM" SG_ 604 SRT_ReactTm_C 0;
BA_ "GenSigStartValue" SG_ 604 SRT_ReactTm_L 255;
BA_ "GenSigSendType" SG_ 604 SRT_ReactTm_L 3;
BA_ "GenSigTimeoutTime_AGSM" SG_ 604 SRT_ReactTm_L 0;
BA_ "GenSigTimeoutTime_BCM" SG_ 604 SRT_ReactTm_L 0;
BA_ "GenSigTimeoutTime_BSM" SG_ 604 SRT_ReactTm_L 0;
BA_ "GenSigTimeoutTime_CADM" SG_ 604 SRT_ReactTm_L 0;
BA_ "GenSigTimeoutTime_DMSM" SG_ 604 SRT_ReactTm_L 0;
BA_ "GenSigTimeoutTime_DTCM" SG_ 604 SRT_ReactTm_L 0;
BA_ "GenSigTimeoutTime_ECM" SG_ 604 SRT_ReactTm_L 0;
BA_ "GenSigTimeoutTime_EVCU2" SG_ 604 SRT_ReactTm_L 0;
BA_ "GenSigTimeoutTime_GNMM" SG_ 604 SRT_ReactTm_L 0;
BA_ "GenSigTimeoutTime_HCP" SG_ 604 SRT_ReactTm_L 0;
BA_ "GenSigTimeoutTime_IPC" SG_ 604 SRT_ReactTm_L 0;
BA_ "GenSigTimeoutTime_RFHM" SG_ 604 SRT_ReactTm_L 0;
BA_ "GenSigTimeoutTime_TCM" SG_ 604 SRT_ReactTm_L 0;
BA_ "GenSigStartValue" SG_ 604 SRT_ReactTmB 255;
BA_ "GenSigSendType" SG_ 604 SRT_ReactTmB 3;
BA_ "GenSigTimeoutTime_AGSM" SG_ 604 SRT_ReactTmB 0;
BA_ "GenSigTimeoutTime_BCM" SG_ 604 SRT_ReactTmB 0;
BA_ "GenSigTimeoutTime_BSM" SG_ 604 SRT_ReactTmB 0;
BA_ "GenSigTimeoutTime_CADM" SG_ 604 SRT_ReactTmB 0;
BA_ "GenSigTimeoutTime_DMSM" SG_ 604 SRT_ReactTmB 0;
BA_ "GenSigTimeoutTime_DTCM" SG_ 604 SRT_ReactTmB 0;
BA_ "GenSigTimeoutTime_ECM" SG_ 604 SRT_ReactTmB 0;
BA_ "GenSigTimeoutTime_EVCU2" SG_ 604 SRT_ReactTmB 0;
BA_ "GenSigTimeoutTime_GNMM" SG_ 604 SRT_ReactTmB 0;
BA_ "GenSigTimeoutTime_HCP" SG_ 604 SRT_ReactTmB 0;
BA_ "GenSigTimeoutTime_IPC" SG_ 604 SRT_ReactTmB 0;
BA_ "GenSigTimeoutTime_RFHM" SG_ 604 SRT_ReactTmB 0;
BA_ "GenSigTimeoutTime_TCM" SG_ 604 SRT_ReactTmB 0;
BA_ "GenSigStartValue" SG_ 604 SRT_ReactTmC 255;
BA_ "GenSigSendType" SG_ 604 SRT_ReactTmC 3;
BA_ "GenSigTimeoutTime_AGSM" SG_ 604 SRT_ReactTmC 0;
BA_ "GenSigTimeoutTime_BCM" SG_ 604 SRT_ReactTmC 0;
BA_ "GenSigTimeoutTime_BSM" SG_ 604 SRT_ReactTmC 0;
BA_ "GenSigTimeoutTime_CADM" SG_ 604 SRT_ReactTmC 0;
BA_ "GenSigTimeoutTime_DMSM" SG_ 604 SRT_ReactTmC 0;
BA_ "GenSigTimeoutTime_DTCM" SG_ 604 SRT_ReactTmC 0;
BA_ "GenSigTimeoutTime_ECM" SG_ 604 SRT_ReactTmC 0;
BA_ "GenSigTimeoutTime_EVCU2" SG_ 604 SRT_ReactTmC 0;
BA_ "GenSigTimeoutTime_GNMM" SG_ 604 SRT_ReactTmC 0;
BA_ "GenSigTimeoutTime_HCP" SG_ 604 SRT_ReactTmC 0;
BA_ "GenSigTimeoutTime_IPC" SG_ 604 SRT_ReactTmC 0;
BA_ "GenSigTimeoutTime_RFHM" SG_ 604 SRT_ReactTmC 0;
BA_ "GenSigTimeoutTime_TCM" SG_ 604 SRT_ReactTmC 0;
BA_ "GenSigStartValue" SG_ 604 SRT_ReactTmL 255;
BA_ "GenSigSendType" SG_ 604 SRT_ReactTmL 3;
BA_ "GenSigTimeoutTime_AGSM" SG_ 604 SRT_ReactTmL 0;
BA_ "GenSigTimeoutTime_BCM" SG_ 604 SRT_ReactTmL 0;
BA_ "GenSigTimeoutTime_BSM" SG_ 604 SRT_ReactTmL 0;
BA_ "GenSigTimeoutTime_CADM" SG_ 604 SRT_ReactTmL 0;
BA_ "GenSigTimeoutTime_DMSM" SG_ 604 SRT_ReactTmL 0;
BA_ "GenSigTimeoutTime_DTCM" SG_ 604 SRT_ReactTmL 0;
BA_ "GenSigTimeoutTime_ECM" SG_ 604 SRT_ReactTmL 0;
BA_ "GenSigTimeoutTime_EVCU2" SG_ 604 SRT_ReactTmL 0;
BA_ "GenSigTimeoutTime_GNMM" SG_ 604 SRT_ReactTmL 0;
BA_ "GenSigTimeoutTime_HCP" SG_ 604 SRT_ReactTmL 0;
BA_ "GenSigTimeoutTime_IPC" SG_ 604 SRT_ReactTmL 0;
BA_ "GenSigTimeoutTime_RFHM" SG_ 604 SRT_ReactTmL 0;
BA_ "GenSigTimeoutTime_TCM" SG_ 604 SRT_ReactTmL 0;
BA_ "GenSigStartValue" SG_ 605 SRT_1000ftTm_B 255;
BA_ "GenSigSendType" SG_ 605 SRT_1000ftTm_B 3;
BA_ "GenSigTimeoutTime_AGSM" SG_ 605 SRT_1000ftTm_B 0;
BA_ "GenSigTimeoutTime_BCM" SG_ 605 SRT_1000ftTm_B 0;
BA_ "GenSigTimeoutTime_BSM" SG_ 605 SRT_1000ftTm_B 0;
BA_ "GenSigTimeoutTime_CADM" SG_ 605 SRT_1000ftTm_B 0;
BA_ "GenSigTimeoutTime_DMSM" SG_ 605 SRT_1000ftTm_B 0;
BA_ "GenSigTimeoutTime_DTCM" SG_ 605 SRT_1000ftTm_B 0;
BA_ "GenSigTimeoutTime_ECM" SG_ 605 SRT_1000ftTm_B 0;
BA_ "GenSigTimeoutTime_EVCU2" SG_ 605 SRT_1000ftTm_B 0;
BA_ "GenSigTimeoutTime_GNMM" SG_ 605 SRT_1000ftTm_B 0;
BA_ "GenSigTimeoutTime_HCP" SG_ 605 SRT_1000ftTm_B 0;
BA_ "GenSigTimeoutTime_IPC" SG_ 605 SRT_1000ftTm_B 0;
BA_ "GenSigTimeoutTime_RFHM" SG_ 605 SRT_1000ftTm_B 0;
BA_ "GenSigTimeoutTime_TCM" SG_ 605 SRT_1000ftTm_B 0;
BA_ "GenSigStartValue" SG_ 605 SRT_1000ftTm_C 255;
BA_ "GenSigSendType" SG_ 605 SRT_1000ftTm_C 3;
BA_ "GenSigTimeoutTime_AGSM" SG_ 605 SRT_1000ftTm_C 0;
BA_ "GenSigTimeoutTime_BCM" SG_ 605 SRT_1000ftTm_C 0;
BA_ "GenSigTimeoutTime_BSM" SG_ 605 SRT_1000ftTm_C 0;
BA_ "GenSigTimeoutTime_CADM" SG_ 605 SRT_1000ftTm_C 0;
BA_ "GenSigTimeoutTime_DMSM" SG_ 605 SRT_1000ftTm_C 0;
BA_ "GenSigTimeoutTime_DTCM" SG_ 605 SRT_1000ftTm_C 0;
BA_ "GenSigTimeoutTime_ECM" SG_ 605 SRT_1000ftTm_C 0;
BA_ "GenSigTimeoutTime_EVCU2" SG_ 605 SRT_1000ftTm_C 0;
BA_ "GenSigTimeoutTime_GNMM" SG_ 605 SRT_1000ftTm_C 0;
BA_ "GenSigTimeoutTime_HCP" SG_ 605 SRT_1000ftTm_C 0;
BA_ "GenSigTimeoutTime_IPC" SG_ 605 SRT_1000ftTm_C 0;
BA_ "GenSigTimeoutTime_RFHM" SG_ 605 SRT_1000ftTm_C 0;
BA_ "GenSigTimeoutTime_TCM" SG_ 605 SRT_1000ftTm_C 0;
BA_ "GenSigStartValue" SG_ 605 SRT_1000ftTm_L 255;
BA_ "GenSigSendType" SG_ 605 SRT_1000ftTm_L 3;
BA_ "GenSigTimeoutTime_AGSM" SG_ 605 SRT_1000ftTm_L 0;
BA_ "GenSigTimeoutTime_BCM" SG_ 605 SRT_1000ftTm_L 0;
BA_ "GenSigTimeoutTime_BSM" SG_ 605 SRT_1000ftTm_L 0;
BA_ "GenSigTimeoutTime_CADM" SG_ 605 SRT_1000ftTm_L 0;
BA_ "GenSigTimeoutTime_DMSM" SG_ 605 SRT_1000ftTm_L 0;
BA_ "GenSigTimeoutTime_DTCM" SG_ 605 SRT_1000ftTm_L 0;
BA_ "GenSigTimeoutTime_ECM" SG_ 605 SRT_1000ftTm_L 0;
BA_ "GenSigTimeoutTime_EVCU2" SG_ 605 SRT_1000ftTm_L 0;
BA_ "GenSigTimeoutTime_GNMM" SG_ 605 SRT_1000ftTm_L 0;
BA_ "GenSigTimeoutTime_HCP" SG_ 605 SRT_1000ftTm_L 0;
BA_ "GenSigTimeoutTime_IPC" SG_ 605 SRT_1000ftTm_L 0;
BA_ "GenSigTimeoutTime_RFHM" SG_ 605 SRT_1000ftTm_L 0;
BA_ "GenSigTimeoutTime_TCM" SG_ 605 SRT_1000ftTm_L 0;
BA_ "GenSigStartValue" SG_ 605 SRT_1000ftTmB 255;
BA_ "GenSigSendType" SG_ 605 SRT_1000ftTmB 3;
BA_ "GenSigTimeoutTime_AGSM" SG_ 605 SRT_1000ftTmB 0;
BA_ "GenSigTimeoutTime_BCM" SG_ 605 SRT_1000ftTmB 0;
BA_ "GenSigTimeoutTime_BSM" SG_ 605 SRT_1000ftTmB 0;
BA_ "GenSigTimeoutTime_CADM" SG_ 605 SRT_1000ftTmB 0;
BA_ "GenSigTimeoutTime_DMSM" SG_ 605 SRT_1000ftTmB 0;
BA_ "GenSigTimeoutTime_DTCM" SG_ 605 SRT_1000ftTmB 0;
BA_ "GenSigTimeoutTime_ECM" SG_ 605 SRT_1000ftTmB 0;
BA_ "GenSigTimeoutTime_EVCU2" SG_ 605 SRT_1000ftTmB 0;
BA_ "GenSigTimeoutTime_GNMM" SG_ 605 SRT_1000ftTmB 0;
BA_ "GenSigTimeoutTime_HCP" SG_ 605 SRT_1000ftTmB 0;
BA_ "GenSigTimeoutTime_IPC" SG_ 605 SRT_1000ftTmB 0;
BA_ "GenSigTimeoutTime_RFHM" SG_ 605 SRT_1000ftTmB 0;
BA_ "GenSigTimeoutTime_TCM" SG_ 605 SRT_1000ftTmB 0;
BA_ "GenSigStartValue" SG_ 605 SRT_1000ftTmC 255;
BA_ "GenSigSendType" SG_ 605 SRT_1000ftTmC 3;
BA_ "GenSigTimeoutTime_AGSM" SG_ 605 SRT_1000ftTmC 0;
BA_ "GenSigTimeoutTime_BCM" SG_ 605 SRT_1000ftTmC 0;
BA_ "GenSigTimeoutTime_BSM" SG_ 605 SRT_1000ftTmC 0;
BA_ "GenSigTimeoutTime_CADM" SG_ 605 SRT_1000ftTmC 0;
BA_ "GenSigTimeoutTime_DMSM" SG_ 605 SRT_1000ftTmC 0;
BA_ "GenSigTimeoutTime_DTCM" SG_ 605 SRT_1000ftTmC 0;
BA_ "GenSigTimeoutTime_ECM" SG_ 605 SRT_1000ftTmC 0;
BA_ "GenSigTimeoutTime_EVCU2" SG_ 605 SRT_1000ftTmC 0;
BA_ "GenSigTimeoutTime_GNMM" SG_ 605 SRT_1000ftTmC 0;
BA_ "GenSigTimeoutTime_HCP" SG_ 605 SRT_1000ftTmC 0;
BA_ "GenSigTimeoutTime_IPC" SG_ 605 SRT_1000ftTmC 0;
BA_ "GenSigTimeoutTime_RFHM" SG_ 605 SRT_1000ftTmC 0;
BA_ "GenSigTimeoutTime_TCM" SG_ 605 SRT_1000ftTmC 0;
BA_ "GenSigStartValue" SG_ 605 SRT_1000ftTmL 255;
BA_ "GenSigSendType" SG_ 605 SRT_1000ftTmL 3;
BA_ "GenSigTimeoutTime_AGSM" SG_ 605 SRT_1000ftTmL 0;
BA_ "GenSigTimeoutTime_BCM" SG_ 605 SRT_1000ftTmL 0;
BA_ "GenSigTimeoutTime_BSM" SG_ 605 SRT_1000ftTmL 0;
BA_ "GenSigTimeoutTime_CADM" SG_ 605 SRT_1000ftTmL 0;
BA_ "GenSigTimeoutTime_DMSM" SG_ 605 SRT_1000ftTmL 0;
BA_ "GenSigTimeoutTime_DTCM" SG_ 605 SRT_1000ftTmL 0;
BA_ "GenSigTimeoutTime_ECM" SG_ 605 SRT_1000ftTmL 0;
BA_ "GenSigTimeoutTime_EVCU2" SG_ 605 SRT_1000ftTmL 0;
BA_ "GenSigTimeoutTime_GNMM" SG_ 605 SRT_1000ftTmL 0;
BA_ "GenSigTimeoutTime_HCP" SG_ 605 SRT_1000ftTmL 0;
BA_ "GenSigTimeoutTime_IPC" SG_ 605 SRT_1000ftTmL 0;
BA_ "GenSigTimeoutTime_RFHM" SG_ 605 SRT_1000ftTmL 0;
BA_ "GenSigTimeoutTime_TCM" SG_ 605 SRT_1000ftTmL 0;
BA_ "GenSigStartValue" SG_ 605 SRT_330ftTm_B 255;
BA_ "GenSigSendType" SG_ 605 SRT_330ftTm_B 3;
BA_ "GenSigTimeoutTime_AGSM" SG_ 605 SRT_330ftTm_B 0;
BA_ "GenSigTimeoutTime_BCM" SG_ 605 SRT_330ftTm_B 0;
BA_ "GenSigTimeoutTime_BSM" SG_ 605 SRT_330ftTm_B 0;
BA_ "GenSigTimeoutTime_CADM" SG_ 605 SRT_330ftTm_B 0;
BA_ "GenSigTimeoutTime_DMSM" SG_ 605 SRT_330ftTm_B 0;
BA_ "GenSigTimeoutTime_DTCM" SG_ 605 SRT_330ftTm_B 0;
BA_ "GenSigTimeoutTime_ECM" SG_ 605 SRT_330ftTm_B 0;
BA_ "GenSigTimeoutTime_EVCU2" SG_ 605 SRT_330ftTm_B 0;
BA_ "GenSigTimeoutTime_GNMM" SG_ 605 SRT_330ftTm_B 0;
BA_ "GenSigTimeoutTime_HCP" SG_ 605 SRT_330ftTm_B 0;
BA_ "GenSigTimeoutTime_IPC" SG_ 605 SRT_330ftTm_B 0;
BA_ "GenSigTimeoutTime_RFHM" SG_ 605 SRT_330ftTm_B 0;
BA_ "GenSigTimeoutTime_TCM" SG_ 605 SRT_330ftTm_B 0;
BA_ "GenSigStartValue" SG_ 605 SRT_330ftTm_C 255;
BA_ "GenSigSendType" SG_ 605 SRT_330ftTm_C 3;
BA_ "GenSigTimeoutTime_AGSM" SG_ 605 SRT_330ftTm_C 0;
BA_ "GenSigTimeoutTime_BCM" SG_ 605 SRT_330ftTm_C 0;
BA_ "GenSigTimeoutTime_BSM" SG_ 605 SRT_330ftTm_C 0;
BA_ "GenSigTimeoutTime_CADM" SG_ 605 SRT_330ftTm_C 0;
BA_ "GenSigTimeoutTime_DMSM" SG_ 605 SRT_330ftTm_C 0;
BA_ "GenSigTimeoutTime_DTCM" SG_ 605 SRT_330ftTm_C 0;
BA_ "GenSigTimeoutTime_ECM" SG_ 605 SRT_330ftTm_C 0;
BA_ "GenSigTimeoutTime_EVCU2" SG_ 605 SRT_330ftTm_C 0;
BA_ "GenSigTimeoutTime_GNMM" SG_ 605 SRT_330ftTm_C 0;
BA_ "GenSigTimeoutTime_HCP" SG_ 605 SRT_330ftTm_C 0;
BA_ "GenSigTimeoutTime_IPC" SG_ 605 SRT_330ftTm_C 0;
BA_ "GenSigTimeoutTime_RFHM" SG_ 605 SRT_330ftTm_C 0;
BA_ "GenSigTimeoutTime_TCM" SG_ 605 SRT_330ftTm_C 0;
BA_ "GenSigStartValue" SG_ 605 SRT_330ftTm_L 255;
BA_ "GenSigSendType" SG_ 605 SRT_330ftTm_L 3;
BA_ "GenSigTimeoutTime_AGSM" SG_ 605 SRT_330ftTm_L 0;
BA_ "GenSigTimeoutTime_BCM" SG_ 605 SRT_330ftTm_L 0;
BA_ "GenSigTimeoutTime_BSM" SG_ 605 SRT_330ftTm_L 0;
BA_ "GenSigTimeoutTime_CADM" SG_ 605 SRT_330ftTm_L 0;
BA_ "GenSigTimeoutTime_DMSM" SG_ 605 SRT_330ftTm_L 0;
BA_ "GenSigTimeoutTime_DTCM" SG_ 605 SRT_330ftTm_L 0;
BA_ "GenSigTimeoutTime_ECM" SG_ 605 SRT_330ftTm_L 0;
BA_ "GenSigTimeoutTime_EVCU2" SG_ 605 SRT_330ftTm_L 0;
BA_ "GenSigTimeoutTime_GNMM" SG_ 605 SRT_330ftTm_L 0;
BA_ "GenSigTimeoutTime_HCP" SG_ 605 SRT_330ftTm_L 0;
BA_ "GenSigTimeoutTime_IPC" SG_ 605 SRT_330ftTm_L 0;
BA_ "GenSigTimeoutTime_RFHM" SG_ 605 SRT_330ftTm_L 0;
BA_ "GenSigTimeoutTime_TCM" SG_ 605 SRT_330ftTm_L 0;
BA_ "GenSigStartValue" SG_ 605 SRT_330ftTmB 255;
BA_ "GenSigSendType" SG_ 605 SRT_330ftTmB 3;
BA_ "GenSigTimeoutTime_AGSM" SG_ 605 SRT_330ftTmB 0;
BA_ "GenSigTimeoutTime_BCM" SG_ 605 SRT_330ftTmB 0;
BA_ "GenSigTimeoutTime_BSM" SG_ 605 SRT_330ftTmB 0;
BA_ "GenSigTimeoutTime_CADM" SG_ 605 SRT_330ftTmB 0;
BA_ "GenSigTimeoutTime_DMSM" SG_ 605 SRT_330ftTmB 0;
BA_ "GenSigTimeoutTime_DTCM" SG_ 605 SRT_330ftTmB 0;
BA_ "GenSigTimeoutTime_ECM" SG_ 605 SRT_330ftTmB 0;
BA_ "GenSigTimeoutTime_EVCU2" SG_ 605 SRT_330ftTmB 0;
BA_ "GenSigTimeoutTime_GNMM" SG_ 605 SRT_330ftTmB 0;
BA_ "GenSigTimeoutTime_HCP" SG_ 605 SRT_330ftTmB 0;
BA_ "GenSigTimeoutTime_IPC" SG_ 605 SRT_330ftTmB 0;
BA_ "GenSigTimeoutTime_RFHM" SG_ 605 SRT_330ftTmB 0;
BA_ "GenSigTimeoutTime_TCM" SG_ 605 SRT_330ftTmB 0;
BA_ "GenSigStartValue" SG_ 605 SRT_330ftTmC 255;
BA_ "GenSigSendType" SG_ 605 SRT_330ftTmC 3;
BA_ "GenSigTimeoutTime_AGSM" SG_ 605 SRT_330ftTmC 0;
BA_ "GenSigTimeoutTime_BCM" SG_ 605 SRT_330ftTmC 0;
BA_ "GenSigTimeoutTime_BSM" SG_ 605 SRT_330ftTmC 0;
BA_ "GenSigTimeoutTime_CADM" SG_ 605 SRT_330ftTmC 0;
BA_ "GenSigTimeoutTime_DMSM" SG_ 605 SRT_330ftTmC 0;
BA_ "GenSigTimeoutTime_DTCM" SG_ 605 SRT_330ftTmC 0;
BA_ "GenSigTimeoutTime_ECM" SG_ 605 SRT_330ftTmC 0;
BA_ "GenSigTimeoutTime_EVCU2" SG_ 605 SRT_330ftTmC 0;
BA_ "GenSigTimeoutTime_GNMM" SG_ 605 SRT_330ftTmC 0;
BA_ "GenSigTimeoutTime_HCP" SG_ 605 SRT_330ftTmC 0;
BA_ "GenSigTimeoutTime_IPC" SG_ 605 SRT_330ftTmC 0;
BA_ "GenSigTimeoutTime_RFHM" SG_ 605 SRT_330ftTmC 0;
BA_ "GenSigTimeoutTime_TCM" SG_ 605 SRT_330ftTmC 0;
BA_ "GenSigStartValue" SG_ 605 SRT_330ftTmL 255;
BA_ "GenSigSendType" SG_ 605 SRT_330ftTmL 3;
BA_ "GenSigTimeoutTime_AGSM" SG_ 605 SRT_330ftTmL 0;
BA_ "GenSigTimeoutTime_BCM" SG_ 605 SRT_330ftTmL 0;
BA_ "GenSigTimeoutTime_BSM" SG_ 605 SRT_330ftTmL 0;
BA_ "GenSigTimeoutTime_CADM" SG_ 605 SRT_330ftTmL 0;
BA_ "GenSigTimeoutTime_DMSM" SG_ 605 SRT_330ftTmL 0;
BA_ "GenSigTimeoutTime_DTCM" SG_ 605 SRT_330ftTmL 0;
BA_ "GenSigTimeoutTime_ECM" SG_ 605 SRT_330ftTmL 0;
BA_ "GenSigTimeoutTime_EVCU2" SG_ 605 SRT_330ftTmL 0;
BA_ "GenSigTimeoutTime_GNMM" SG_ 605 SRT_330ftTmL 0;
BA_ "GenSigTimeoutTime_HCP" SG_ 605 SRT_330ftTmL 0;
BA_ "GenSigTimeoutTime_IPC" SG_ 605 SRT_330ftTmL 0;
BA_ "GenSigTimeoutTime_RFHM" SG_ 605 SRT_330ftTmL 0;
BA_ "GenSigTimeoutTime_TCM" SG_ 605 SRT_330ftTmL 0;
BA_ "GenSigStartValue" SG_ 605 SRT_60ftTm_B 511;
BA_ "GenSigSendType" SG_ 605 SRT_60ftTm_B 3;
BA_ "GenSigTimeoutTime_AGSM" SG_ 605 SRT_60ftTm_B 0;
BA_ "GenSigTimeoutTime_BCM" SG_ 605 SRT_60ftTm_B 0;
BA_ "GenSigTimeoutTime_BSM" SG_ 605 SRT_60ftTm_B 0;
BA_ "GenSigTimeoutTime_CADM" SG_ 605 SRT_60ftTm_B 0;
BA_ "GenSigTimeoutTime_DMSM" SG_ 605 SRT_60ftTm_B 0;
BA_ "GenSigTimeoutTime_DTCM" SG_ 605 SRT_60ftTm_B 0;
BA_ "GenSigTimeoutTime_ECM" SG_ 605 SRT_60ftTm_B 0;
BA_ "GenSigTimeoutTime_EVCU2" SG_ 605 SRT_60ftTm_B 0;
BA_ "GenSigTimeoutTime_GNMM" SG_ 605 SRT_60ftTm_B 0;
BA_ "GenSigTimeoutTime_HCP" SG_ 605 SRT_60ftTm_B 0;
BA_ "GenSigTimeoutTime_IPC" SG_ 605 SRT_60ftTm_B 0;
BA_ "GenSigTimeoutTime_RFHM" SG_ 605 SRT_60ftTm_B 0;
BA_ "GenSigTimeoutTime_TCM" SG_ 605 SRT_60ftTm_B 0;
BA_ "GenSigStartValue" SG_ 605 SRT_60ftTm_C 511;
BA_ "GenSigSendType" SG_ 605 SRT_60ftTm_C 3;
BA_ "GenSigTimeoutTime_AGSM" SG_ 605 SRT_60ftTm_C 0;
BA_ "GenSigTimeoutTime_BCM" SG_ 605 SRT_60ftTm_C 0;
BA_ "GenSigTimeoutTime_BSM" SG_ 605 SRT_60ftTm_C 0;
BA_ "GenSigTimeoutTime_CADM" SG_ 605 SRT_60ftTm_C 0;
BA_ "GenSigTimeoutTime_DMSM" SG_ 605 SRT_60ftTm_C 0;
BA_ "GenSigTimeoutTime_DTCM" SG_ 605 SRT_60ftTm_C 0;
BA_ "GenSigTimeoutTime_ECM" SG_ 605 SRT_60ftTm_C 0;
BA_ "GenSigTimeoutTime_EVCU2" SG_ 605 SRT_60ftTm_C 0;
BA_ "GenSigTimeoutTime_GNMM" SG_ 605 SRT_60ftTm_C 0;
BA_ "GenSigTimeoutTime_HCP" SG_ 605 SRT_60ftTm_C 0;
BA_ "GenSigTimeoutTime_IPC" SG_ 605 SRT_60ftTm_C 0;
BA_ "GenSigTimeoutTime_RFHM" SG_ 605 SRT_60ftTm_C 0;
BA_ "GenSigTimeoutTime_TCM" SG_ 605 SRT_60ftTm_C 0;
BA_ "GenSigStartValue" SG_ 605 SRT_60ftTm_L 511;
BA_ "GenSigSendType" SG_ 605 SRT_60ftTm_L 3;
BA_ "GenSigTimeoutTime_AGSM" SG_ 605 SRT_60ftTm_L 0;
BA_ "GenSigTimeoutTime_BCM" SG_ 605 SRT_60ftTm_L 0;
BA_ "GenSigTimeoutTime_BSM" SG_ 605 SRT_60ftTm_L 0;
BA_ "GenSigTimeoutTime_CADM" SG_ 605 SRT_60ftTm_L 0;
BA_ "GenSigTimeoutTime_DMSM" SG_ 605 SRT_60ftTm_L 0;
BA_ "GenSigTimeoutTime_DTCM" SG_ 605 SRT_60ftTm_L 0;
BA_ "GenSigTimeoutTime_ECM" SG_ 605 SRT_60ftTm_L 0;
BA_ "GenSigTimeoutTime_EVCU2" SG_ 605 SRT_60ftTm_L 0;
BA_ "GenSigTimeoutTime_GNMM" SG_ 605 SRT_60ftTm_L 0;
BA_ "GenSigTimeoutTime_HCP" SG_ 605 SRT_60ftTm_L 0;
BA_ "GenSigTimeoutTime_IPC" SG_ 605 SRT_60ftTm_L 0;
BA_ "GenSigTimeoutTime_RFHM" SG_ 605 SRT_60ftTm_L 0;
BA_ "GenSigTimeoutTime_TCM" SG_ 605 SRT_60ftTm_L 0;
BA_ "GenSigStartValue" SG_ 605 SRT_60ftTmB 511;
BA_ "GenSigSendType" SG_ 605 SRT_60ftTmB 4;
BA_ "GenSigTimeoutTime_AGSM" SG_ 605 SRT_60ftTmB 0;
BA_ "GenSigTimeoutTime_BCM" SG_ 605 SRT_60ftTmB 0;
BA_ "GenSigTimeoutTime_BSM" SG_ 605 SRT_60ftTmB 0;
BA_ "GenSigTimeoutTime_CADM" SG_ 605 SRT_60ftTmB 0;
BA_ "GenSigTimeoutTime_DMSM" SG_ 605 SRT_60ftTmB 0;
BA_ "GenSigTimeoutTime_DTCM" SG_ 605 SRT_60ftTmB 0;
BA_ "GenSigTimeoutTime_ECM" SG_ 605 SRT_60ftTmB 0;
BA_ "GenSigTimeoutTime_EVCU2" SG_ 605 SRT_60ftTmB 0;
BA_ "GenSigTimeoutTime_GNMM" SG_ 605 SRT_60ftTmB 0;
BA_ "GenSigTimeoutTime_HCP" SG_ 605 SRT_60ftTmB 0;
BA_ "GenSigTimeoutTime_IPC" SG_ 605 SRT_60ftTmB 0;
BA_ "GenSigTimeoutTime_RFHM" SG_ 605 SRT_60ftTmB 0;
BA_ "GenSigTimeoutTime_TCM" SG_ 605 SRT_60ftTmB 0;
BA_ "GenSigStartValue" SG_ 605 SRT_60ftTmC 511;
BA_ "GenSigSendType" SG_ 605 SRT_60ftTmC 3;
BA_ "GenSigTimeoutTime_AGSM" SG_ 605 SRT_60ftTmC 0;
BA_ "GenSigTimeoutTime_BCM" SG_ 605 SRT_60ftTmC 0;
BA_ "GenSigTimeoutTime_BSM" SG_ 605 SRT_60ftTmC 0;
BA_ "GenSigTimeoutTime_CADM" SG_ 605 SRT_60ftTmC 0;
BA_ "GenSigTimeoutTime_DMSM" SG_ 605 SRT_60ftTmC 0;
BA_ "GenSigTimeoutTime_DTCM" SG_ 605 SRT_60ftTmC 0;
BA_ "GenSigTimeoutTime_ECM" SG_ 605 SRT_60ftTmC 0;
BA_ "GenSigTimeoutTime_EVCU2" SG_ 605 SRT_60ftTmC 0;
BA_ "GenSigTimeoutTime_GNMM" SG_ 605 SRT_60ftTmC 0;
BA_ "GenSigTimeoutTime_HCP" SG_ 605 SRT_60ftTmC 0;
BA_ "GenSigTimeoutTime_IPC" SG_ 605 SRT_60ftTmC 0;
BA_ "GenSigTimeoutTime_RFHM" SG_ 605 SRT_60ftTmC 0;
BA_ "GenSigTimeoutTime_TCM" SG_ 605 SRT_60ftTmC 0;
BA_ "GenSigStartValue" SG_ 605 SRT_60ftTmL 511;
BA_ "GenSigSendType" SG_ 605 SRT_60ftTmL 3;
BA_ "GenSigTimeoutTime_AGSM" SG_ 605 SRT_60ftTmL 0;
BA_ "GenSigTimeoutTime_BCM" SG_ 605 SRT_60ftTmL 0;
BA_ "GenSigTimeoutTime_BSM" SG_ 605 SRT_60ftTmL 0;
BA_ "GenSigTimeoutTime_CADM" SG_ 605 SRT_60ftTmL 0;
BA_ "GenSigTimeoutTime_DMSM" SG_ 605 SRT_60ftTmL 0;
BA_ "GenSigTimeoutTime_DTCM" SG_ 605 SRT_60ftTmL 0;
BA_ "GenSigTimeoutTime_ECM" SG_ 605 SRT_60ftTmL 0;
BA_ "GenSigTimeoutTime_EVCU2" SG_ 605 SRT_60ftTmL 0;
BA_ "GenSigTimeoutTime_GNMM" SG_ 605 SRT_60ftTmL 0;
BA_ "GenSigTimeoutTime_HCP" SG_ 605 SRT_60ftTmL 0;
BA_ "GenSigTimeoutTime_IPC" SG_ 605 SRT_60ftTmL 0;
BA_ "GenSigTimeoutTime_RFHM" SG_ 605 SRT_60ftTmL 0;
BA_ "GenSigTimeoutTime_TCM" SG_ 605 SRT_60ftTmL 0;
BA_ "GenSigStartValue" SG_ 605 SRT_BrkDistB_M 255;
BA_ "GenSigSendType" SG_ 605 SRT_BrkDistB_M 3;
BA_ "GenSigTimeoutTime_AGSM" SG_ 605 SRT_BrkDistB_M 0;
BA_ "GenSigTimeoutTime_BCM" SG_ 605 SRT_BrkDistB_M 0;
BA_ "GenSigTimeoutTime_BSM" SG_ 605 SRT_BrkDistB_M 0;
BA_ "GenSigTimeoutTime_CADM" SG_ 605 SRT_BrkDistB_M 0;
BA_ "GenSigTimeoutTime_DMSM" SG_ 605 SRT_BrkDistB_M 0;
BA_ "GenSigTimeoutTime_DTCM" SG_ 605 SRT_BrkDistB_M 0;
BA_ "GenSigTimeoutTime_ECM" SG_ 605 SRT_BrkDistB_M 0;
BA_ "GenSigTimeoutTime_EVCU2" SG_ 605 SRT_BrkDistB_M 0;
BA_ "GenSigTimeoutTime_GNMM" SG_ 605 SRT_BrkDistB_M 0;
BA_ "GenSigTimeoutTime_HCP" SG_ 605 SRT_BrkDistB_M 0;
BA_ "GenSigTimeoutTime_IPC" SG_ 605 SRT_BrkDistB_M 0;
BA_ "GenSigTimeoutTime_RFHM" SG_ 605 SRT_BrkDistB_M 0;
BA_ "GenSigTimeoutTime_TCM" SG_ 605 SRT_BrkDistB_M 0;
BA_ "GenSigStartValue" SG_ 605 SRT_BrkDistB_US 255;
BA_ "GenSigSendType" SG_ 605 SRT_BrkDistB_US 3;
BA_ "GenSigTimeoutTime_AGSM" SG_ 605 SRT_BrkDistB_US 0;
BA_ "GenSigTimeoutTime_BCM" SG_ 605 SRT_BrkDistB_US 0;
BA_ "GenSigTimeoutTime_BSM" SG_ 605 SRT_BrkDistB_US 0;
BA_ "GenSigTimeoutTime_CADM" SG_ 605 SRT_BrkDistB_US 0;
BA_ "GenSigTimeoutTime_DMSM" SG_ 605 SRT_BrkDistB_US 0;
BA_ "GenSigTimeoutTime_DTCM" SG_ 605 SRT_BrkDistB_US 0;
BA_ "GenSigTimeoutTime_ECM" SG_ 605 SRT_BrkDistB_US 0;
BA_ "GenSigTimeoutTime_EVCU2" SG_ 605 SRT_BrkDistB_US 0;
BA_ "GenSigTimeoutTime_GNMM" SG_ 605 SRT_BrkDistB_US 0;
BA_ "GenSigTimeoutTime_HCP" SG_ 605 SRT_BrkDistB_US 0;
BA_ "GenSigTimeoutTime_IPC" SG_ 605 SRT_BrkDistB_US 0;
BA_ "GenSigTimeoutTime_RFHM" SG_ 605 SRT_BrkDistB_US 0;
BA_ "GenSigTimeoutTime_TCM" SG_ 605 SRT_BrkDistB_US 0;
BA_ "GenSigStartValue" SG_ 605 SRT_BrkDistC_M 255;
BA_ "GenSigSendType" SG_ 605 SRT_BrkDistC_M 3;
BA_ "GenSigTimeoutTime_AGSM" SG_ 605 SRT_BrkDistC_M 0;
BA_ "GenSigTimeoutTime_BCM" SG_ 605 SRT_BrkDistC_M 0;
BA_ "GenSigTimeoutTime_BSM" SG_ 605 SRT_BrkDistC_M 0;
BA_ "GenSigTimeoutTime_CADM" SG_ 605 SRT_BrkDistC_M 0;
BA_ "GenSigTimeoutTime_DMSM" SG_ 605 SRT_BrkDistC_M 0;
BA_ "GenSigTimeoutTime_DTCM" SG_ 605 SRT_BrkDistC_M 0;
BA_ "GenSigTimeoutTime_ECM" SG_ 605 SRT_BrkDistC_M 0;
BA_ "GenSigTimeoutTime_EVCU2" SG_ 605 SRT_BrkDistC_M 0;
BA_ "GenSigTimeoutTime_GNMM" SG_ 605 SRT_BrkDistC_M 0;
BA_ "GenSigTimeoutTime_HCP" SG_ 605 SRT_BrkDistC_M 0;
BA_ "GenSigTimeoutTime_IPC" SG_ 605 SRT_BrkDistC_M 0;
BA_ "GenSigTimeoutTime_RFHM" SG_ 605 SRT_BrkDistC_M 0;
BA_ "GenSigTimeoutTime_TCM" SG_ 605 SRT_BrkDistC_M 0;
BA_ "GenSigStartValue" SG_ 605 SRT_BrkDistC_US 255;
BA_ "GenSigSendType" SG_ 605 SRT_BrkDistC_US 3;
BA_ "GenSigTimeoutTime_AGSM" SG_ 605 SRT_BrkDistC_US 0;
BA_ "GenSigTimeoutTime_BCM" SG_ 605 SRT_BrkDistC_US 0;
BA_ "GenSigTimeoutTime_BSM" SG_ 605 SRT_BrkDistC_US 0;
BA_ "GenSigTimeoutTime_CADM" SG_ 605 SRT_BrkDistC_US 0;
BA_ "GenSigTimeoutTime_DMSM" SG_ 605 SRT_BrkDistC_US 0;
BA_ "GenSigTimeoutTime_DTCM" SG_ 605 SRT_BrkDistC_US 0;
BA_ "GenSigTimeoutTime_ECM" SG_ 605 SRT_BrkDistC_US 0;
BA_ "GenSigTimeoutTime_EVCU2" SG_ 605 SRT_BrkDistC_US 0;
BA_ "GenSigTimeoutTime_GNMM" SG_ 605 SRT_BrkDistC_US 0;
BA_ "GenSigTimeoutTime_HCP" SG_ 605 SRT_BrkDistC_US 0;
BA_ "GenSigTimeoutTime_IPC" SG_ 605 SRT_BrkDistC_US 0;
BA_ "GenSigTimeoutTime_RFHM" SG_ 605 SRT_BrkDistC_US 0;
BA_ "GenSigTimeoutTime_TCM" SG_ 605 SRT_BrkDistC_US 0;
BA_ "GenSigStartValue" SG_ 605 SRT_BrkDistL_M 255;
BA_ "GenSigSendType" SG_ 605 SRT_BrkDistL_M 3;
BA_ "GenSigTimeoutTime_AGSM" SG_ 605 SRT_BrkDistL_M 0;
BA_ "GenSigTimeoutTime_BCM" SG_ 605 SRT_BrkDistL_M 0;
BA_ "GenSigTimeoutTime_BSM" SG_ 605 SRT_BrkDistL_M 0;
BA_ "GenSigTimeoutTime_CADM" SG_ 605 SRT_BrkDistL_M 0;
BA_ "GenSigTimeoutTime_DMSM" SG_ 605 SRT_BrkDistL_M 0;
BA_ "GenSigTimeoutTime_DTCM" SG_ 605 SRT_BrkDistL_M 0;
BA_ "GenSigTimeoutTime_ECM" SG_ 605 SRT_BrkDistL_M 0;
BA_ "GenSigTimeoutTime_EVCU2" SG_ 605 SRT_BrkDistL_M 0;
BA_ "GenSigTimeoutTime_GNMM" SG_ 605 SRT_BrkDistL_M 0;
BA_ "GenSigTimeoutTime_HCP" SG_ 605 SRT_BrkDistL_M 0;
BA_ "GenSigTimeoutTime_IPC" SG_ 605 SRT_BrkDistL_M 0;
BA_ "GenSigTimeoutTime_RFHM" SG_ 605 SRT_BrkDistL_M 0;
BA_ "GenSigTimeoutTime_TCM" SG_ 605 SRT_BrkDistL_M 0;
BA_ "GenSigStartValue" SG_ 605 SRT_BrkDistL_US 255;
BA_ "GenSigSendType" SG_ 605 SRT_BrkDistL_US 3;
BA_ "GenSigTimeoutTime_AGSM" SG_ 605 SRT_BrkDistL_US 0;
BA_ "GenSigTimeoutTime_BCM" SG_ 605 SRT_BrkDistL_US 0;
BA_ "GenSigTimeoutTime_BSM" SG_ 605 SRT_BrkDistL_US 0;
BA_ "GenSigTimeoutTime_CADM" SG_ 605 SRT_BrkDistL_US 0;
BA_ "GenSigTimeoutTime_DMSM" SG_ 605 SRT_BrkDistL_US 0;
BA_ "GenSigTimeoutTime_DTCM" SG_ 605 SRT_BrkDistL_US 0;
BA_ "GenSigTimeoutTime_ECM" SG_ 605 SRT_BrkDistL_US 0;
BA_ "GenSigTimeoutTime_EVCU2" SG_ 605 SRT_BrkDistL_US 0;
BA_ "GenSigTimeoutTime_GNMM" SG_ 605 SRT_BrkDistL_US 0;
BA_ "GenSigTimeoutTime_HCP" SG_ 605 SRT_BrkDistL_US 0;
BA_ "GenSigTimeoutTime_IPC" SG_ 605 SRT_BrkDistL_US 0;
BA_ "GenSigTimeoutTime_RFHM" SG_ 605 SRT_BrkDistL_US 0;
BA_ "GenSigTimeoutTime_TCM" SG_ 605 SRT_BrkDistL_US 0;
BA_ "GenSigStartValue" SG_ 605 SRT_BrkSpdB_M 255;
BA_ "GenSigSendType" SG_ 605 SRT_BrkSpdB_M 3;
BA_ "GenSigTimeoutTime_AGSM" SG_ 605 SRT_BrkSpdB_M 0;
BA_ "GenSigTimeoutTime_BCM" SG_ 605 SRT_BrkSpdB_M 0;
BA_ "GenSigTimeoutTime_BSM" SG_ 605 SRT_BrkSpdB_M 0;
BA_ "GenSigTimeoutTime_CADM" SG_ 605 SRT_BrkSpdB_M 0;
BA_ "GenSigTimeoutTime_DMSM" SG_ 605 SRT_BrkSpdB_M 0;
BA_ "GenSigTimeoutTime_DTCM" SG_ 605 SRT_BrkSpdB_M 0;
BA_ "GenSigTimeoutTime_ECM" SG_ 605 SRT_BrkSpdB_M 0;
BA_ "GenSigTimeoutTime_EVCU2" SG_ 605 SRT_BrkSpdB_M 0;
BA_ "GenSigTimeoutTime_GNMM" SG_ 605 SRT_BrkSpdB_M 0;
BA_ "GenSigTimeoutTime_HCP" SG_ 605 SRT_BrkSpdB_M 0;
BA_ "GenSigTimeoutTime_IPC" SG_ 605 SRT_BrkSpdB_M 0;
BA_ "GenSigTimeoutTime_RFHM" SG_ 605 SRT_BrkSpdB_M 0;
BA_ "GenSigTimeoutTime_TCM" SG_ 605 SRT_BrkSpdB_M 0;
BA_ "GenSigStartValue" SG_ 605 SRT_BrkSpdB_US 255;
BA_ "GenSigSendType" SG_ 605 SRT_BrkSpdB_US 3;
BA_ "GenSigTimeoutTime_AGSM" SG_ 605 SRT_BrkSpdB_US 0;
BA_ "GenSigTimeoutTime_BCM" SG_ 605 SRT_BrkSpdB_US 0;
BA_ "GenSigTimeoutTime_BSM" SG_ 605 SRT_BrkSpdB_US 0;
BA_ "GenSigTimeoutTime_CADM" SG_ 605 SRT_BrkSpdB_US 0;
BA_ "GenSigTimeoutTime_DMSM" SG_ 605 SRT_BrkSpdB_US 0;
BA_ "GenSigTimeoutTime_DTCM" SG_ 605 SRT_BrkSpdB_US 0;
BA_ "GenSigTimeoutTime_ECM" SG_ 605 SRT_BrkSpdB_US 0;
BA_ "GenSigTimeoutTime_EVCU2" SG_ 605 SRT_BrkSpdB_US 0;
BA_ "GenSigTimeoutTime_GNMM" SG_ 605 SRT_BrkSpdB_US 0;
BA_ "GenSigTimeoutTime_HCP" SG_ 605 SRT_BrkSpdB_US 0;
BA_ "GenSigTimeoutTime_IPC" SG_ 605 SRT_BrkSpdB_US 0;
BA_ "GenSigTimeoutTime_RFHM" SG_ 605 SRT_BrkSpdB_US 0;
BA_ "GenSigTimeoutTime_TCM" SG_ 605 SRT_BrkSpdB_US 0;
BA_ "GenSigStartValue" SG_ 605 SRT_BrkSpdC_M 255;
BA_ "GenSigSendType" SG_ 605 SRT_BrkSpdC_M 3;
BA_ "GenSigTimeoutTime_AGSM" SG_ 605 SRT_BrkSpdC_M 0;
BA_ "GenSigTimeoutTime_BCM" SG_ 605 SRT_BrkSpdC_M 0;
BA_ "GenSigTimeoutTime_BSM" SG_ 605 SRT_BrkSpdC_M 0;
BA_ "GenSigTimeoutTime_CADM" SG_ 605 SRT_BrkSpdC_M 0;
BA_ "GenSigTimeoutTime_DMSM" SG_ 605 SRT_BrkSpdC_M 0;
BA_ "GenSigTimeoutTime_DTCM" SG_ 605 SRT_BrkSpdC_M 0;
BA_ "GenSigTimeoutTime_ECM" SG_ 605 SRT_BrkSpdC_M 0;
BA_ "GenSigTimeoutTime_EVCU2" SG_ 605 SRT_BrkSpdC_M 0;
BA_ "GenSigTimeoutTime_GNMM" SG_ 605 SRT_BrkSpdC_M 0;
BA_ "GenSigTimeoutTime_HCP" SG_ 605 SRT_BrkSpdC_M 0;
BA_ "GenSigTimeoutTime_IPC" SG_ 605 SRT_BrkSpdC_M 0;
BA_ "GenSigTimeoutTime_RFHM" SG_ 605 SRT_BrkSpdC_M 0;
BA_ "GenSigTimeoutTime_TCM" SG_ 605 SRT_BrkSpdC_M 0;
BA_ "GenSigStartValue" SG_ 605 SRT_BrkSpdC_US 255;
BA_ "GenSigSendType" SG_ 605 SRT_BrkSpdC_US 3;
BA_ "GenSigTimeoutTime_AGSM" SG_ 605 SRT_BrkSpdC_US 0;
BA_ "GenSigTimeoutTime_BCM" SG_ 605 SRT_BrkSpdC_US 0;
BA_ "GenSigTimeoutTime_BSM" SG_ 605 SRT_BrkSpdC_US 0;
BA_ "GenSigTimeoutTime_CADM" SG_ 605 SRT_BrkSpdC_US 0;
BA_ "GenSigTimeoutTime_DMSM" SG_ 605 SRT_BrkSpdC_US 0;
BA_ "GenSigTimeoutTime_DTCM" SG_ 605 SRT_BrkSpdC_US 0;
BA_ "GenSigTimeoutTime_ECM" SG_ 605 SRT_BrkSpdC_US 0;
BA_ "GenSigTimeoutTime_EVCU2" SG_ 605 SRT_BrkSpdC_US 0;
BA_ "GenSigTimeoutTime_GNMM" SG_ 605 SRT_BrkSpdC_US 0;
BA_ "GenSigTimeoutTime_HCP" SG_ 605 SRT_BrkSpdC_US 0;
BA_ "GenSigTimeoutTime_IPC" SG_ 605 SRT_BrkSpdC_US 0;
BA_ "GenSigTimeoutTime_RFHM" SG_ 605 SRT_BrkSpdC_US 0;
BA_ "GenSigTimeoutTime_TCM" SG_ 605 SRT_BrkSpdC_US 0;
BA_ "GenSigStartValue" SG_ 605 SRT_BrkSpdL_M 255;
BA_ "GenSigSendType" SG_ 605 SRT_BrkSpdL_M 3;
BA_ "GenSigTimeoutTime_AGSM" SG_ 605 SRT_BrkSpdL_M 0;
BA_ "GenSigTimeoutTime_BCM" SG_ 605 SRT_BrkSpdL_M 0;
BA_ "GenSigTimeoutTime_BSM" SG_ 605 SRT_BrkSpdL_M 0;
BA_ "GenSigTimeoutTime_CADM" SG_ 605 SRT_BrkSpdL_M 0;
BA_ "GenSigTimeoutTime_DMSM" SG_ 605 SRT_BrkSpdL_M 0;
BA_ "GenSigTimeoutTime_DTCM" SG_ 605 SRT_BrkSpdL_M 0;
BA_ "GenSigTimeoutTime_ECM" SG_ 605 SRT_BrkSpdL_M 0;
BA_ "GenSigTimeoutTime_EVCU2" SG_ 605 SRT_BrkSpdL_M 0;
BA_ "GenSigTimeoutTime_GNMM" SG_ 605 SRT_BrkSpdL_M 0;
BA_ "GenSigTimeoutTime_HCP" SG_ 605 SRT_BrkSpdL_M 0;
BA_ "GenSigTimeoutTime_IPC" SG_ 605 SRT_BrkSpdL_M 0;
BA_ "GenSigTimeoutTime_RFHM" SG_ 605 SRT_BrkSpdL_M 0;
BA_ "GenSigTimeoutTime_TCM" SG_ 605 SRT_BrkSpdL_M 0;
BA_ "GenSigStartValue" SG_ 605 SRT_BrkSpdL_US 255;
BA_ "GenSigSendType" SG_ 605 SRT_BrkSpdL_US 3;
BA_ "GenSigTimeoutTime_AGSM" SG_ 605 SRT_BrkSpdL_US 0;
BA_ "GenSigTimeoutTime_BCM" SG_ 605 SRT_BrkSpdL_US 0;
BA_ "GenSigTimeoutTime_BSM" SG_ 605 SRT_BrkSpdL_US 0;
BA_ "GenSigTimeoutTime_CADM" SG_ 605 SRT_BrkSpdL_US 0;
BA_ "GenSigTimeoutTime_DMSM" SG_ 605 SRT_BrkSpdL_US 0;
BA_ "GenSigTimeoutTime_DTCM" SG_ 605 SRT_BrkSpdL_US 0;
BA_ "GenSigTimeoutTime_ECM" SG_ 605 SRT_BrkSpdL_US 0;
BA_ "GenSigTimeoutTime_EVCU2" SG_ 605 SRT_BrkSpdL_US 0;
BA_ "GenSigTimeoutTime_GNMM" SG_ 605 SRT_BrkSpdL_US 0;
BA_ "GenSigTimeoutTime_HCP" SG_ 605 SRT_BrkSpdL_US 0;
BA_ "GenSigTimeoutTime_IPC" SG_ 605 SRT_BrkSpdL_US 0;
BA_ "GenSigTimeoutTime_RFHM" SG_ 605 SRT_BrkSpdL_US 0;
BA_ "GenSigTimeoutTime_TCM" SG_ 605 SRT_BrkSpdL_US 0;
VAL_ 1831 ABS_IND_STAT 0 "Off" 1 "On" 2 "Blinking" 3 "SNA";
VAL_ 1831 ACC_WARN_STAT 0 "Off" 1 "On" 2 "Blinking" 3 "SNA";
VAL_ 1831 AIR_BAG_STAT 0 "Off" 1 "On" 2 "Blinking" 3 "SNA";
VAL_ 1831 AWD_IND_STAT 0 "Off" 1 "On" 2 "Blinking" 3 "SNA";
VAL_ 1831 AWD_SERVICE_STAT 0 "Off" 1 "On" 2 "Blinking" 3 "SNA";
VAL_ 1831 BATTERY_CHARGE_STAT 0 "Off" 1 "On" 2 "Blinking" 3 "SNA";
VAL_ 1831 BRAKE_PAD_STAT 0 "Off" 1 "On" 2 "Blinking" 3 "SNA";
VAL_ 1831 BRK_IND_STAT 0 "Off" 1 "On" 2 "Blinking" 3 "SNA";
VAL_ 1831 CARGO_LT_STAT 0 "Off" 1 "On" 2 "Blinking" 3 "SNA";
VAL_ 1831 CATALYST_TEMP_STAT 0 "Off" 1 "On" 2 "Blinking" 3 "SNA";
VAL_ 1831 COOLENT_LEVEL_STAT 0 "Off" 1 "On" 2 "Blinking" 3 "SNA";
VAL_ 1831 CRUISE_SET_STAT 0 "Off" 1 "On" 2 "Blinking" 3 "SNA";
VAL_ 1831 DAMPING_SYSTEM_STAT 0 "Off" 1 "On" 2 "Blinking" 3 "SNA";
VAL_ 1831 DEF_STAT 0 "Off" 1 "On" 2 "Blinking" 3 "SNA";
VAL_ 1831 DOORS_STAT 0 "Off" 1 "On" 2 "Blinking" 3 "SNA";
VAL_ 1831 ECO_MODE_STAT 0 "Off" 1 "On" 2 "Blinking" 3 "SNA";
VAL_ 1831 ELEC_STAB_STAT 0 "Off" 1 "On" 2 "Blinking" 3 "SNA";
VAL_ 1831 ELECTRIC_WRENCH_STAT 0 "Off" 1 "On" 2 "Blinking" 3 "SNA";
VAL_ 1831 ENGINE_MIL_STAT 0 "Off" 1 "On" 2 "Blinking" 3 "SNA";
VAL_ 1831 ENGINE_TEMP_STAT 0 "Off" 1 "On" 2 "Blinking" 3 "SNA";
VAL_ 1831 EPB_WARN_STAT 0 "Off" 1 "On" 2 "Blinking" 3 "SNA";
VAL_ 1831 EPS_STAT 0 "Off" 1 "On" 2 "Blinking" 3 "SNA";
VAL_ 1831 ESC_OFF_STAT 0 "Off" 1 "On" 2 "Blinking" 3 "SNA";
VAL_ 1831 ETC_CONTROL_STAT 0 "Off" 1 "On" 2 "Blinking" 3 "SNA";
VAL_ 1831 EXH_BRK_STAT 0 "Off" 1 "On" 2 "Blinking" 3 "SNA";
VAL_ 1831 FCW_SYSTEM_STAT 0 "Off" 1 "On" 2 "Blinking" 3 "SNA";
VAL_ 1831 FOUR_WD_SERVICE_STAT 0 "Off" 1 "On" 2 "Blinking" 3 "SNA";
VAL_ 1831 FT_FOG_STAT 0 "Off" 1 "On" 2 "Blinking" 3 "SNA";
VAL_ 1831 FUEL_CAP_STAT 0 "Off" 1 "On" 2 "Blinking" 3 "SNA";
VAL_ 1831 FUEL_CUT_OFF_STAT 0 "Off" 1 "On" 2 "Blinking" 3 "SNA";
VAL_ 1831 HDLT_LVL_STAT 0 "Off" 1 "On" 2 "Blinking" 3 "SNA";
VAL_ 1831 HI_BEAM_STAT 0 "Off" 1 "On" 2 "Blinking" 3 "SNA";
VAL_ 1831 HILL_DESCENT_STAT 0 "Off" 1 "On" 2 "Blinking" 3 "SNA";
VAL_ 1831 HVY_EXH_STAT 0 "Off" 1 "On" 2 "Blinking" 3 "SNA";
VAL_ 1831 LANE_DEPART_FAIL_STAT 0 "Off" 1 "On" 2 "Blinking" 3 "SNA";
VAL_ 1831 LANE_DEPART_STAT 0 "Off" 1 "On" 2 "Blinking" 3 "SNA";
VAL_ 1831 LANE_SENSE_STAT 0 "Off" 1 "On" 2 "Blinking" 3 "SNA";
VAL_ 1831 LIFT_GATE_STAT 0 "Off" 1 "On" 2 "Blinking" 3 "SNA";
VAL_ 1831 LT_EXH_STAT 0 "Off" 1 "On" 2 "Blinking" 3 "SNA";
VAL_ 1831 NAT_GAS_STAT 0 "Off" 1 "On" 2 "Blinking" 3 "SNA";
VAL_ 1831 OIL_LEVEL_STAT 0 "Off" 1 "On" 2 "Blinking" 3 "SNA";
VAL_ 1831 OIL_PRESSURE_STAT 0 "Off" 1 "On" 2 "Blinking" 3 "SNA";
VAL_ 1831 OIL_TEMP_STAT 0 "Off" 1 "On" 2 "Blinking" 3 "SNA";
VAL_ 1831 OVER_TEMP_STAT 0 "Off" 1 "On" 2 "Blinking" 3 "SNA";
VAL_ 1831 PARK_BRAKE_STAT 0 "Off" 1 "On" 2 "Blinking" 3 "SNA";
VAL_ 1831 POS_LIGHT_STAT 0 "Off" 1 "On" 2 "Blinking" 3 "SNA";
VAL_ 1831 SEAT_BELT_STAT 0 "Off" 1 "On" 2 "Blinking" 3 "SNA";
VAL_ 1831 SERVICE_ACC_STAT 0 "Off" 1 "On" 2 "Blinking" 3 "SNA";
VAL_ 1831 SERVICE_STAT 0 "Off" 1 "On" 2 "Blinking" 3 "SNA";
VAL_ 1831 SPEED_CTRL_STAT 0 "Off" 1 "On" 2 "Blinking" 3 "SNA";
VAL_ 1831 SPEED_LMT_STAT 0 "Off" 1 "On" 2 "Blinking" 3 "SNA";
VAL_ 1831 STOP_START_STAT 0 "Off" 1 "On" 2 "Blinking" 3 "SNA";
VAL_ 1831 STR_DIR_LT_STAT 0 "Off" 1 "On" 2 "Blinking" 3 "SNA";
VAL_ 1831 THEFT_ALARM_STAT 0 "Off" 1 "On" 2 "Blinking" 3 "SNA";
VAL_ 1831 TIRE_PRESSURE_STAT 0 "Off" 1 "On" 2 "Blinking" 3 "SNA";
VAL_ 1831 TORQUE_STAT 0 "Off" 1 "On" 2 "Blinking" 3 "SNA";
VAL_ 1831 TOW_HAUL_STAT 0 "Off" 1 "On" 2 "Blinking" 3 "SNA";
VAL_ 1831 TRK_OPN_STAT 0 "Off" 1 "On" 2 "Blinking" 3 "SNA";
VAL_ 1831 WATER_IN_FUEL_STAT 0 "Off" 1 "On" 2 "Blinking" 3 "SNA";
VAL_ 1831 WINDSHIELD_FLUID_STAT 0 "Off" 1 "On" 2 "Blinking" 3 "SNA";
VAL_ 600 AirBagLamp_FailSts 0 "OFF_Fail_not_present" 1 "OFF_Fail_present" 2 "ON_Fail_not_present" 3 "BLINKING_Fail_not_present";
VAL_ 600 DisplayedSpeedLimSts 0 "Sign_Not_Detected" 1 "Speed_Limit_0" 2 "Speed_Limit_1" 3 "Speed_Limit_2" 4 "Speed_Limit_3" 5 "Speed_Limit_4" 6 "Speed_Limit_5" 7 "Speed_Limit_6" 8 "Speed_Limit_7" 9 "Speed_Limit_8" 10 "Speed_Limit_9" 11 "Speed_Limit_10" 12 "Speed_Limit_11" 13 "Speed_Limit_12" 14 "Speed_Limit_13" 15 "Speed_Limit_14" 16 "Speed_Limit_15" 17 "Speed_Limit_16" 18 "Speed_Limit_17" 19 "Speed_Limit_18" 20 "Speed_Limit_19" 21 "Speed_Limit_20" 22 "Speed_Limit_21" 23 "Speed_Limit_22" 24 "Speed_Limit_23" 25 "Speed_Limit_24" 26 "Speed_Limit_25" 27 "Speed_Limit_26" 28 "Speed_Limit_27" 29 "Speed_Limit_28" 30 "Speed_Limit_29" 31 "Speed_Limit_30" 32 "Speed_Limit_31" 33 "Speed_Limit_32" 34 "Speed_Limit_33" 35 "Speed_Limit_34" 36 "Speed_Limit_35" 37 "Speed_Limit_36" 38 "Speed_Limit_37" 39 "Speed_Limit_38" 40 "Speed_Limit_39" 41 "Speed_Limit_40" 42 "Speed_Limit_41" 43 "Speed_Limit_42" 44 "Speed_Limit_43" 45 "Speed_Limit_44" 46 "Speed_Limit_45" 47 "Speed_Limit_46" 48 "Speed_Limit_47" 49 "Speed_Limit_48" 50 "Speed_Limit_49" 51 "Speed_Limit_50" 52 "Speed_Limit_51" 53 "Speed_Limit_52" 54 "Speed_Limit_53" 55 "Speed_Limit_54" 56 "Speed_Limit_55" 57 "Speed_Limit_56" 58 "Speed_Limit_57" 59 "Speed_Limit_58" 60 "Speed_Limit_59" 61 "Speed_Limit_60" 62 "Speed_Limit_61" 63 "Speed_Limit_62" 64 "Speed_Limit_63" 65 "Speed_Limit_64" 66 "Speed_Limit_65" 67 "Speed_Limit_66" 68 "Speed_Limit_67" 69 "Speed_Limit_68" 70 "Speed_Limit_69" 71 "Speed_Limit_70" 72 "Speed_Limit_71" 73 "Speed_Limit_72" 74 "Speed_Limit_73" 75 "Speed_Limit_74" 76 "Speed_Limit_75" 77 "Speed_Limit_76" 78 "Speed_Limit_77" 79 "Speed_Limit_78" 80 "Speed_Limit_79" 81 "Speed_Limit_80" 82 "Speed_Limit_81" 83 "Speed_Limit_82" 84 "Speed_Limit_83" 85 "Speed_Limit_84" 86 "Speed_Limit_85" 87 "Speed_Limit_86" 88 "Speed_Limit_87" 89 "Speed_Limit_88" 90 "Speed_Limit_89" 91 "Speed_Limit_90" 92 "Speed_Limit_91" 93 "Speed_Limit_92" 94 "Speed_Limit_93" 95 "Speed_Limit_94" 96 "Speed_Limit_95" 97 "Speed_Limit_96" 98 "Speed_Limit_97" 99 "Speed_Limit_98" 100 "Speed_Limit_99" 101 "Speed_Limit_100" 102 "Speed_Limit_101" 103 "Speed_Limit_102" 104 "Speed_Limit_103" 105 "Speed_Limit_104" 106 "Speed_Limit_105" 107 "Speed_Limit_106" 108 "Speed_Limit_107" 109 "Speed_Limit_108" 110 "Speed_Limit_109" 111 "Speed_Limit_110" 112 "Speed_Limit_111" 113 "Speed_Limit_112" 114 "Speed_Limit_113" 115 "Speed_Limit_114" 116 "Speed_Limit_115" 117 "Speed_Limit_116" 118 "Speed_Limit_117" 119 "Speed_Limit_118" 120 "Speed_Limit_119" 121 "Speed_Limit_120" 122 "Speed_Limit_121" 123 "Speed_Limit_122" 124 "Speed_Limit_123" 125 "Speed_Limit_124" 126 "Speed_Limit_125" 127 "Speed_Limit_126" 128 "Speed_Limit_127" 129 "Speed_Limit_128" 130 "Speed_Limit_129" 131 "Speed_Limit_130" 132 "Speed_Limit_131" 133 "Speed_Limit_132" 134 "Speed_Limit_133" 135 "Speed_Limit_134" 136 "Speed_Limit_135" 137 "Speed_Limit_136" 138 "Speed_Limit_137" 139 "Speed_Limit_138" 140 "Speed_Limit_139" 141 "Speed_Limit_140" 142 "Speed_Limit_141" 143 "Speed_Limit_142" 144 "Speed_Limit_143" 145 "Speed_Limit_144" 146 "Speed_Limit_145" 147 "Speed_Limit_146" 148 "Speed_Limit_147" 149 "Speed_Limit_148" 150 "Speed_Limit_149" 151 "Speed_Limit_150" 152 "Speed_Limit_151" 153 "Speed_Limit_152" 154 "Speed_Limit_153" 155 "Speed_Limit_154" 156 "Speed_Limit_155" 157 "Speed_Limit_156" 158 "Speed_Limit_157" 159 "Speed_Limit_158" 160 "Speed_Limit_159" 161 "Speed_Limit_160" 162 "Speed_Limit_161" 163 "Speed_Limit_162" 164 "Speed_Limit_163" 165 "Speed_Limit_164" 166 "Speed_Limit_165" 167 "Speed_Limit_166" 168 "Speed_Limit_167" 169 "Speed_Limit_168" 170 "Speed_Limit_169" 171 "Speed_Limit_170" 172 "Speed_Limit_171" 173 "Speed_Limit_172" 174 "Speed_Limit_173" 175 "Speed_Limit_174" 176 "Speed_Limit_175" 177 "Speed_Limit_176" 178 "Speed_Limit_177" 179 "Speed_Limit_178" 180 "Speed_Limit_179" 181 "Speed_Limit_180" 182 "Speed_Limit_181" 183 "Speed_Limit_182" 184 "Speed_Limit_183" 185 "Speed_Limit_184" 186 "Speed_Limit_185" 187 "Speed_Limit_186" 188 "Speed_Limit_187" 189 "Speed_Limit_188" 190 "Speed_Limit_189" 191 "Speed_Limit_190" 192 "Speed_Limit_191" 193 "Speed_Limit_192" 194 "Speed_Limit_193" 195 "Speed_Limit_194" 196 "Speed_Limit_195" 197 "Speed_Limit_196" 198 "Speed_Limit_197" 199 "Speed_Limit_198" 200 "Speed_Limit_199" 201 "Speed_Limit_200" 202 "Speed_Limit_201" 203 "Speed_Limit_202" 204 "Speed_Limit_203" 205 "Speed_Limit_204" 206 "Speed_Limit_205" 207 "Speed_Limit_206" 208 "Speed_Limit_207" 209 "Speed_Limit_208" 210 "Speed_Limit_209" 211 "Speed_Limit_210" 212 "Speed_Limit_211" 213 "Speed_Limit_212" 214 "Speed_Limit_213" 215 "Speed_Limit_214" 216 "Speed_Limit_215" 217 "Speed_Limit_216" 218 "Speed_Limit_217" 219 "Speed_Limit_218" 220 "Speed_Limit_219" 221 "Speed_Limit_220" 222 "Speed_Limit_221" 223 "Speed_Limit_222" 224 "Speed_Limit_223" 225 "Speed_Limit_224" 226 "Speed_Limit_225" 227 "Speed_Limit_226" 228 "Speed_Limit_227" 229 "Speed_Limit_228" 230 "Speed_Limit_229" 231 "Speed_Limit_230" 232 "Speed_Limit_231" 233 "Speed_Limit_232" 234 "Speed_Limit_233" 254 "Speed_Limit_Unlimited" 255 "End_Speed_Limit";
VAL_ 600 OilChgRst 0 "Not_Active" 1 "Active";
VAL_ 1154 Est_Range_Disp 255 "SNA";
VAL_ 1154 Est_Range_Disp_Long 2047 "SNA";
VAL_ 1154 VehSpd_MPH 0 "kph" 1 "mph";
VAL_ 1154 VehSpdDisp 65535 "SNA";
VAL_ 1432 AverageFuelConsumptionAPlus 1023 "SNA";
VAL_ 1432 AverageFuelConsumptionBPlus 1023 "SNA";
VAL_ 1432 HAS_SoH_IPC 0 "No Fault" 1 "Fault";
VAL_ 1432 PartialOdometerAPlus 1048575 "SNA";
VAL_ 1432 PartialOdometerBPlus 1048575 "SNA";
VAL_ 1432 PowerMode_RQ 0 "CUSTOMER" 1 "STORAGE" 2 "SHIP" 3 "ABBR" 7 "SNA";
VAL_ 1897 VehPerfAccelPeak_X_Neg 511 "SNA";
VAL_ 1897 VehPerfAccelPeak_X_Pos 511 "SNA";
VAL_ 1897 VehPerfAccelPeak_Y_Neg 511 "SNA";
VAL_ 1897 VehPerfAccelPeak_Y_Pos 511 "SNA";
VAL_ 604 SRT_100mphTm_B 252 "TMR_ACTIVE" 253 "TMR_CANCEL" 254 "TMR_READY" 255 "SNA";
VAL_ 604 SRT_100mphTm_C 252 "TMR_ACTIVE" 253 "TMR_CANCEL" 254 "TMR_READY" 255 "SNA";
VAL_ 604 SRT_100mphTm_L 252 "TMR_ACTIVE" 253 "TMR_CANCEL" 254 "TMR_READY" 255 "SNA";
VAL_ 604 SRT_100mphTmB 252 "TMR_ACTIVE" 253 "TMR_CANCEL" 254 "TMR_READY" 255 "SNA";
VAL_ 604 SRT_100mphTmC 252 "TMR_ACTIVE" 253 "TMR_CANCEL" 254 "TMR_READY" 255 "SNA";
VAL_ 604 SRT_100mphTmL 252 "TMR_ACTIVE" 253 "TMR_CANCEL" 254 "TMR_READY" 255 "SNA";
VAL_ 604 SRT_60mphTm_B 252 "TMR_ACTIVE" 253 "TMR_CANCEL" 254 "TMR_READY" 255 "SNA";
VAL_ 604 SRT_60mphTm_C 252 "TMR_ACTIVE" 253 "TMR_CANCEL" 254 "TMR_READY" 255 "SNA";
VAL_ 604 SRT_60mphTm_L 252 "TMR_ACTIVE" 253 "TMR_CANCEL" 254 "TMR_READY" 255 "SNA";
VAL_ 604 SRT_60mphTmB 252 "TMR_ACTIVE" 253 "TMR_CANCEL" 254 "TMR_READY" 255 "SNA";
VAL_ 604 SRT_60mphTmC 252 "TMR_ACTIVE" 253 "TMR_CANCEL" 254 "TMR_READY" 255 "SNA";
VAL_ 604 SRT_60mphTmL 252 "TMR_ACTIVE" 253 "TMR_CANCEL" 254 "TMR_READY" 255 "SNA";
VAL_ 604 SRT_BrkTm_B 252 "TMR_ACTIVE" 253 "TMR_CANCEL" 254 "TMR_READY" 255 "SNA";
VAL_ 604 SRT_BrkTm_C 252 "TMR_ACTIVE" 253 "TMR_CANCEL" 254 "TMR_READY" 255 "SNA";
VAL_ 604 SRT_BrkTm_L 252 "TMR_ACTIVE" 253 "TMR_CANCEL" 254 "TMR_READY" 255 "SNA";
VAL_ 604 SRT_BrkTmB 252 "TMR_ACTIVE" 253 "TMR_CANCEL" 254 "TMR_READY" 255 "SNA";
VAL_ 604 SRT_BrkTmC 252 "TMR_ACTIVE" 253 "TMR_CANCEL" 254 "TMR_READY" 255 "SNA";
VAL_ 604 SRT_BrkTmL 252 "TMR_ACTIVE" 253 "TMR_CANCEL" 254 "TMR_READY" 255 "SNA";
VAL_ 604 SRT_eighthTm_B 252 "TMR_ACTIVE" 253 "TMR_CANCEL" 254 "TMR_READY" 255 "SNA";
VAL_ 604 SRT_eighthTm_C 252 "TMR_ACTIVE" 253 "TMR_CANCEL" 254 "TMR_READY" 255 "SNA";
VAL_ 604 SRT_eighthTm_L 252 "TMR_ACTIVE" 253 "TMR_CANCEL" 254 "TMR_READY" 255 "SNA";
VAL_ 604 SRT_eighthTmB 252 "TMR_ACTIVE" 253 "TMR_CANCEL" 254 "TMR_READY" 255 "SNA";
VAL_ 604 SRT_eighthTmC 252 "TMR_ACTIVE" 253 "TMR_CANCEL" 254 "TMR_READY" 255 "SNA";
VAL_ 604 SRT_eighthTmL 252 "TMR_ACTIVE" 253 "TMR_CANCEL" 254 "TMR_READY" 255 "SNA";
VAL_ 604 SRT_EthSpdB_M 255 "SNA";
VAL_ 604 SRT_EthSpdB_US 255 "SNA";
VAL_ 604 SRT_EthSpdC_M 255 "SNA";
VAL_ 604 SRT_EthSpdC_US 255 "SNA";
VAL_ 604 SRT_EthSpdL_M 255 "SNA";
VAL_ 604 SRT_EthSpdL_US 255 "SNA";
VAL_ 604 SRT_QrtSpdB_M 255 "SNA";
VAL_ 604 SRT_QrtSpdB_US 255 "SNA";
VAL_ 604 SRT_QrtSpdC_M 255 "SNA";
VAL_ 604 SRT_QrtSpdC_US 255 "SNA";
VAL_ 604 SRT_QrtSpdL_M 255 "SNA";
VAL_ 604 SRT_QrtSpdL_US 255 "SNA";
VAL_ 604 SRT_quarterTm_B 252 "TMR_ACTIVE" 253 "TMR_CANCEL" 254 "TMR_READY" 255 "SNA";
VAL_ 604 SRT_quarterTm_C 252 "TMR_ACTIVE" 253 "TMR_CANCEL" 254 "TMR_READY" 255 "SNA";
VAL_ 604 SRT_quarterTm_L 252 "TMR_ACTIVE" 253 "TMR_CANCEL" 254 "TMR_READY" 255 "SNA";
VAL_ 604 SRT_quarterTmB 252 "TMR_ACTIVE" 253 "TMR_CANCEL" 254 "TMR_READY" 255 "SNA";
VAL_ 604 SRT_quarterTmC 252 "TMR_ACTIVE" 253 "TMR_CANCEL" 254 "TMR_READY" 255 "SNA";
VAL_ 604 SRT_quarterTmL 252 "TMR_ACTIVE" 253 "TMR_CANCEL" 254 "TMR_READY" 255 "SNA";
VAL_ 604 SRT_ReactTm_B 252 "TMR_READY" 253 "OOR" 254 "TMR_NU" 255 "SNA";
VAL_ 604 SRT_ReactTm_C 252 "TMR_READY" 253 "OOR" 254 "TMR_NU" 255 "SNA";
VAL_ 604 SRT_ReactTm_L 252 "TMR_READY" 253 "OOR" 254 "TMR_NU" 255 "SNA";
VAL_ 604 SRT_ReactTmB 252 "TMR_READY" 253 "OOR" 254 "TMR_NU" 255 "SNA";
VAL_ 604 SRT_ReactTmC 252 "TMR_READY" 253 "OOR" 254 "TMR_NU" 255 "SNA";
VAL_ 604 SRT_ReactTmL 252 "TMR_READY" 253 "OOR" 254 "TMR_NU" 255 "SNA";
VAL_ 605 SRT_1000ftTm_B 252 "TMR_ACTIVE" 253 "TMR_CANCEL" 254 "TMR_READY" 255 "SNA";
VAL_ 605 SRT_1000ftTm_C 252 "TMR_ACTIVE" 253 "TMR_CANCEL" 254 "TMR_READY" 255 "SNA";
VAL_ 605 SRT_1000ftTm_L 252 "TMR_ACTIVE" 253 "TMR_CANCEL" 254 "TMR_READY" 255 "SNA";
VAL_ 605 SRT_1000ftTmB 252 "TMR_ACTIVE" 253 "TMR_CANCEL" 254 "TMR_READY" 255 "SNA";
VAL_ 605 SRT_1000ftTmC 252 "TMR_ACTIVE" 253 "TMR_CANCEL" 254 "TMR_READY" 255 "SNA";
VAL_ 605 SRT_1000ftTmL 252 "TMR_ACTIVE" 253 "TMR_CANCEL" 254 "TMR_READY" 255 "SNA";
VAL_ 605 SRT_330ftTm_B 252 "TMR_ACTIVE" 253 "TMR_CANCEL" 254 "TMR_READY" 255 "SNA";
VAL_ 605 SRT_330ftTm_C 252 "TMR_ACTIVE" 253 "TMR_CANCEL" 254 "TMR_READY" 255 "SNA";
VAL_ 605 SRT_330ftTm_L 252 "TMR_ACTIVE" 253 "TMR_CANCEL" 254 "TMR_READY" 255 "SNA";
VAL_ 605 SRT_330ftTmB 252 "TMR_ACTIVE" 253 "TMR_CANCEL" 254 "TMR_READY" 255 "SNA";
VAL_ 605 SRT_330ftTmC 252 "TMR_ACTIVE" 253 "TMR_CANCEL" 254 "TMR_READY" 255 "SNA";
VAL_ 605 SRT_330ftTmL 252 "TMR_ACTIVE" 253 "TMR_CANCEL" 254 "TMR_READY" 255 "SNA";
VAL_ 605 SRT_60ftTm_B 511 "SNA";
VAL_ 605 SRT_60ftTm_C 511 "SNA";
VAL_ 605 SRT_60ftTm_L 511 "SNA";
VAL_ 605 SRT_60ftTmB 511 "SNA";
VAL_ 605 SRT_60ftTmC 511 "SNA";
VAL_ 605 SRT_60ftTmL 511 "SNA";
VAL_ 605 SRT_BrkDistB_M 252 "TMR_ACTIVE" 253 "T_CANCEL" 254 "T_READY" 255 "SNA";
VAL_ 605 SRT_BrkDistB_US 252 "TMR_ACTIVE" 253 "T_CANCEL" 254 "T_READY" 255 "SNA";
VAL_ 605 SRT_BrkDistC_M 252 "TMR_ACTIVE" 253 "T_CANCEL" 254 "T_READY" 255 "SNA";
VAL_ 605 SRT_BrkDistC_US 252 "TMR_ACTIVE" 253 "T_CANCEL" 254 "T_READY" 255 "SNA";
VAL_ 605 SRT_BrkDistL_M 252 "TMR_ACTIVE" 253 "T_CANCEL" 254 "T_READY" 255 "SNA";
VAL_ 605 SRT_BrkDistL_US 252 "TMR_ACTIVE" 253 "T_CANCEL" 254 "T_READY" 255 "SNA";
VAL_ 605 SRT_BrkSpdB_M 255 "SNA";
VAL_ 605 SRT_BrkSpdB_US 255 "SNA";
VAL_ 605 SRT_BrkSpdC_M 255 "SNA";
VAL_ 605 SRT_BrkSpdC_US 255 "SNA";
VAL_ 605 SRT_BrkSpdL_M 255 "SNA";
VAL_ 605 SRT_BrkSpdL_US 255 "SNA";
