VERSION ""

NS_ :

BS_:

BU_: AGSM BCM BSM CADM DMSM DTCM ECM EVCU2 GNMM HCP IPC RFHM SGW TCM
BO_ 2654339161 PDC_INFO_FD_MCPB: 32 EVCU2
 SG_ CurrentCanNMState_FD05_MCPB : 15|4@0+ (1,0) [0|15] "" SGW
 SG_ CurrentCanNMState_FD16_MCPB : 99|4@0+ (1,0) [0|15] "" SGW
 SG_ CurrentFailSts_FD05_MCPB : 6|1@0+ (1,0) [0|1] "" BCM,SGW
 SG_ CurrentFailSts_FD16_MCPB : 173|1@0+ (1,0) [0|1] "" SGW
 SG_ DES_FD05_MCPB : 4|2@0+ (1,0) [0|3] "" SGW
 SG_ DES_FD16_MCPB : 175|2@0+ (1,0) [0|3] "" SGW
 SG_ EOL_FD05_MCPB : 7|1@0+ (1,0) [0|1] "-" BCM,SGW
 SG_ EOL_FD16_MCPB : 2|1@0+ (1,0) [0|1] "-" SGW
 SG_ GenericFailSts_FD05_MCPB : 5|1@0+ (1,0) [0|1] "" BCM,SGW
 SG_ GenericFailSts_FD16_MCPB : 172|1@0+ (1,0) [0|1] "" SGW
 SG_ PreviousCanNMState_FD05_MCPB : 11|4@0+ (1,0) [0|15] "" SGW
 SG_ PreviousCanNMState_FD16_MCPB : 103|4@0+ (1,0) [0|15] "" SGW
 SG_ StayActiveSource_FD05_MCPB : 31|64@0+ (1,0) [0|0] "" SGW
 SG_ StayActiveSource_FD16_MCPB : 111|64@0+ (1,0) [0|0] "" SGW
 SG_ WakeupSource_FD05_MCPB : 23|8@0+ (1,0) [0|255] "" SGW
 SG_ WakeupSource_FD16_MCPB : 95|8@0+ (1,0) [0|255] "" SGW

BO_ 2654339286 PDC_INFO_FD_PPIM: 32 EVCU2
 SG_ CurrentCanNMState_FD05_PPIM : 15|4@0+ (1,0) [0|15] "" Vector__XXX
 SG_ CurrentCanNMState_FD11_PPIM : 99|4@0+ (1,0) [0|15] "" Vector__XXX
 SG_ CurrentFailSts_FD05_PPIM : 6|1@0+ (1,0) [0|1] "" Vector__XXX
 SG_ CurrentFailSts_FD11_PPIM : 181|1@0+ (1,0) [0|1] "" BCM
 SG_ DES_FD05_PPIM : 4|2@0+ (1,0) [0|3] "" Vector__XXX
 SG_ DES_FD11_PPIM : 183|2@0+ (1,0) [0|3] "" Vector__XXX
 SG_ EOL_FD05_PPIM : 2|1@0+ (1,0) [0|1] "-" Vector__XXX
 SG_ EOL_FD11_PPIM : 7|1@0+ (1,0) [0|1] "-" BCM
 SG_ GenericFailSts_FD05_PPIM : 5|1@0+ (1,0) [0|1] "" Vector__XXX
 SG_ GenericFailSts_FD11_PPIM : 180|1@0+ (1,0) [0|1] "" BCM
 SG_ PreviousCanNMState_FD05_PPIM : 11|4@0+ (1,0) [0|15] "" Vector__XXX
 SG_ PreviousCanNMState_FD11_PPIM : 103|4@0+ (1,0) [0|15] "" Vector__XXX
 SG_ StayActiveSource_FD05_PPIM : 31|64@0+ (1,0) [0|0] "" Vector__XXX
 SG_ StayActiveSource_FD11_PPIM : 111|64@0+ (1,0) [0|0] "" Vector__XXX
 SG_ WakeupSource_FD05_PPIM : 23|8@0+ (1,0) [0|255] "" Vector__XXX
 SG_ WakeupSource_FD11_PPIM : 95|8@0+ (1,0) [0|255] "" Vector__XXX

BO_ 2654339137 PDC_INFO_FD_RFHM: 32 RFHM
 SG_ CurrentCanNMState_FD03_RFHM : 15|4@0+ (1,0) [0|15] "" SGW
 SG_ CurrentCanNMState_FD09_RFHM : 103|4@0+ (1,0) [0|15] "" SGW
 SG_ CurrentFailSts_FD03_RFHM : 6|1@0+ (1,0) [0|1] "" BCM,SGW
 SG_ CurrentFailSts_FD09_RFHM : 94|1@0+ (1,0) [0|1] "" SGW
 SG_ DES_FD03_RFHM : 4|2@0+ (1,0) [0|3] "" SGW
 SG_ DES_FD09_RFHM : 92|2@0+ (1,0) [0|3] "" SGW
 SG_ EOL_FD03_RFHM : 7|1@0+ (1,0) [0|1] "-" BCM,SGW
 SG_ EOL_FD09_RFHM : 95|1@0+ (1,0) [0|1] "-" SGW
 SG_ GenericFailSts_FD03_RFHM : 5|1@0+ (1,0) [0|1] "" BCM,SGW
 SG_ GenericFailSts_FD09_RFHM : 93|1@0+ (1,0) [0|1] "" SGW
 SG_ PreviousCanNMState_FD03_RFHM : 11|4@0+ (1,0) [0|15] "" SGW
 SG_ PreviousCanNMState_FD09_RFHM : 99|4@0+ (1,0) [0|15] "" SGW
 SG_ StayActiveSource_FD03_RFHM : 31|64@0+ (1,0) [0|18446744073709551615] "" SGW
 SG_ StayActiveSource_FD09_RFHM : 119|64@0+ (1,0) [0|18446744073709551615] "" SGW
 SG_ WakeupSource_FD03_RFHM : 23|8@0+ (1,0) [0|255] "" SGW
 SG_ WakeupSource_FD09_RFHM : 111|8@0+ (1,0) [0|255] "" SGW

BO_ 2654339273 PDC_INFO_FD_SGCP: 32 EVCU2
 SG_ CurrentCanNMState_FD05_SGCP : 15|4@0+ (1,0) [0|15] "" SGW
 SG_ CurrentCanNMState_FD16_SGCP : 99|4@0+ (1,0) [0|15] "" SGW
 SG_ CurrentFailSts_FD05_SGCP : 6|1@0+ (1,0) [0|1] "" SGW
 SG_ CurrentFailSts_FD16_SGCP : 181|1@0+ (1,0) [0|1] "" SGW
 SG_ DES_FD05_SGCP : 4|2@0+ (1,0) [0|3] "" SGW
 SG_ DES_FD16_SGCP : 183|2@0+ (1,0) [0|3] "" SGW
 SG_ EOL_FD05_SGCP : 7|1@0+ (1,0) [0|1] "-" SGW
 SG_ EOL_FD16_SGCP : 2|1@0+ (1,0) [0|1] "-" SGW
 SG_ GenericFailSts_FD05_SGCP : 5|1@0+ (1,0) [0|1] "" SGW
 SG_ GenericFailSts_FD16_SGCP : 180|1@0+ (1,0) [0|1] "" SGW
 SG_ PreviousCanNMState_FD05_SGCP : 11|4@0+ (1,0) [0|15] "" SGW
 SG_ PreviousCanNMState_FD16_SGCP : 103|4@0+ (1,0) [0|15] "" SGW
 SG_ StayActiveSource_FD05_SGCP : 31|64@0+ (1,0) [0|0] "" SGW
 SG_ StayActiveSource_FD16_SGCP : 111|64@0+ (1,0) [0|0] "" SGW
 SG_ WakeupSource_FD05_SGCP : 23|8@0+ (1,0) [0|255] "" SGW
 SG_ WakeupSource_FD16_SGCP : 95|8@0+ (1,0) [0|255] "" SGW

BO_ 2654339184 PDC_INFO_FD_SGW: 64 SGW
 SG_ CurrentCanNMState_FD01_SGW : 15|4@0+ (1,0) [0|15] "" Vector__XXX
 SG_ CurrentCanNMState_FD02_SGW : 103|4@0+ (1,0) [0|15] "" Vector__XXX
 SG_ CurrentCanNMState_FD03_SGW : 191|4@0+ (1,0) [0|15] "" Vector__XXX
 SG_ CurrentCanNMState_FD08_SGW : 367|4@0+ (1,0) [0|15] "" Vector__XXX
 SG_ CurrentCanNMState_FD11_SGW : 279|4@0+ (1,0) [0|15] "" Vector__XXX
 SG_ CurrentFailSts_FD01_SGW : 6|1@0+ (1,0) [0|1] "" Vector__XXX
 SG_ CurrentFailSts_FD02_SGW : 94|1@0+ (1,0) [0|1] "" Vector__XXX
 SG_ CurrentFailSts_FD03_SGW : 182|1@0+ (1,0) [0|1] "" BCM
 SG_ CurrentFailSts_FD08_SGW : 358|1@0+ (1,0) [0|1] "" Vector__XXX
 SG_ CurrentFailSts_FD11_SGW : 270|1@0+ (1,0) [0|1] "" Vector__XXX
 SG_ DES_FD01_SGW : 4|2@0+ (1,0) [0|3] "" Vector__XXX
 SG_ DES_FD02_SGW : 92|2@0+ (1,0) [0|3] "" Vector__XXX
 SG_ DES_FD03_SGW : 180|2@0+ (1,0) [0|3] "" Vector__XXX
 SG_ DES_FD08_SGW : 356|2@0+ (1,0) [0|3] "" Vector__XXX
 SG_ DES_FD11_SGW : 268|2@0+ (1,0) [0|3] "" Vector__XXX
 SG_ EOL_FD01_SGW : 7|1@0+ (1,0) [0|1] "-" Vector__XXX
 SG_ EOL_FD02_SGW : 95|1@0+ (1,0) [0|1] "-" Vector__XXX
 SG_ EOL_FD03_SGW : 183|1@0+ (1,0) [0|1] "-" BCM
 SG_ EOL_FD08_SGW : 359|1@0+ (1,0) [0|1] "-" Vector__XXX
 SG_ EOL_FD11_SGW : 271|1@0+ (1,0) [0|1] "-" Vector__XXX
 SG_ GenericFailSts_FD01_SGW : 5|1@0+ (1,0) [0|1] "" Vector__XXX
 SG_ GenericFailSts_FD02_SGW : 93|1@0+ (1,0) [0|1] "" Vector__XXX
 SG_ GenericFailSts_FD03_SGW : 181|1@0+ (1,0) [0|1] "" BCM
 SG_ GenericFailSts_FD08_SGW : 357|1@0+ (1,0) [0|1] "" Vector__XXX
 SG_ GenericFailSts_FD11_SGW : 269|1@0+ (1,0) [0|1] "" Vector__XXX
 SG_ PreviousCanNMState_FD01_SGW : 11|4@0+ (1,0) [0|15] "" Vector__XXX
 SG_ PreviousCanNMState_FD02_SGW : 99|4@0+ (1,0) [0|15] "" Vector__XXX
 SG_ PreviousCanNMState_FD03_SGW : 187|4@0+ (1,0) [0|15] "" Vector__XXX
 SG_ PreviousCanNMState_FD08_SGW : 363|4@0+ (1,0) [0|15] "" Vector__XXX
 SG_ PreviousCanNMState_FD11_SGW : 275|4@0+ (1,0) [0|15] "" Vector__XXX
 SG_ StayActiveSource_FD01_SGW : 31|64@0+ (1,0) [0|18446744073709551615] "" Vector__XXX
 SG_ StayActiveSource_FD02_SGW : 119|64@0+ (1,0) [0|18446744073709551615] "" Vector__XXX
 SG_ StayActiveSource_FD03_SGW : 207|64@0+ (1,0) [0|18446744073709551615] "" Vector__XXX
 SG_ StayActiveSource_FD08_SGW : 383|64@0+ (1,0) [0|18446744073709551615] "" Vector__XXX
 SG_ StayActiveSource_FD11_SGW : 295|64@0+ (1,0) [0|18446744073709551615] "" Vector__XXX
 SG_ WakeupSource_FD01_SGW : 23|8@0+ (1,0) [0|255] "" Vector__XXX
 SG_ WakeupSource_FD02_SGW : 111|8@0+ (1,0) [0|255] "" Vector__XXX
 SG_ WakeupSource_FD03_SGW : 199|8@0+ (1,0) [0|255] "" Vector__XXX
 SG_ WakeupSource_FD08_SGW : 375|8@0+ (1,0) [0|255] "" Vector__XXX
 SG_ WakeupSource_FD11_SGW : 287|8@0+ (1,0) [0|255] "" Vector__XXX

BO_ 2654339107 PDC_INFO_FD_TBM: 12 SGW
 SG_ CurrentCanNMState_FD08_TBM : 15|4@0+ (1,0) [0|15] "" Vector__XXX
 SG_ CurrentFailSts_FD08_TBM : 6|1@0+ (1,0) [0|1] "" BCM
 SG_ DES_FD08_TBM : 4|2@0+ (1,0) [0|3] "" Vector__XXX
 SG_ EOL_FD08_TBM : 7|1@0+ (1,0) [0|1] "-" BCM
 SG_ GenericFailSts_FD08_TBM : 5|1@0+ (1,0) [0|1] "" BCM
 SG_ PreviousCanNMState_FD08_TBM : 11|4@0+ (1,0) [0|15] "" Vector__XXX
 SG_ StayActiveSource_FD08_TBM : 31|64@0+ (1,0) [0|18446744073709551615] "" Vector__XXX
 SG_ WakeupSource_FD08_TBM : 23|8@0+ (1,0) [0|255] "" Vector__XXX

BO_ 2654339083 PDC_INFO_FD_TCM: 12 TCM
 SG_ CurrentCanNMState_FD03_TCM : 15|4@0+ (1,0) [0|15] "" SGW
 SG_ CurrentFailSts_FD03_TCM : 6|1@0+ (1,0) [0|1] "" BCM,SGW
 SG_ DES_FD03_TCM : 4|2@0+ (1,0) [0|3] "" SGW
 SG_ EOL_FD03_TCM : 7|1@0+ (1,0) [0|1] "-" BCM,SGW
 SG_ GenericFailSts_FD03_TCM : 5|1@0+ (1,0) [0|1] "" BCM,SGW
 SG_ PreviousCanNMState_FD03_TCM : 11|4@0+ (1,0) [0|15] "" SGW
 SG_ StayActiveSource_FD03_TCM : 31|64@0+ (1,0) [0|18446744073709600000] "" SGW
 SG_ WakeupSource_FD03_TCM : 23|8@0+ (1,0) [0|255] "" SGW

BO_ 263 PT_SYSTEM_FD_1: 64 ECM
 SG_ AlternatorFail_PT : 159|1@0+ (1,0) [0|1] "" IPC
 SG_ APCM_Rq_PT : 137|2@0+ (1,0) [0|3] "" AGSM,SGW
 SG_ AtmosphericPressure_PT : 47|8@0+ (3.6,300) [300|1218] "mbar" BCM,BSM,RFHM,SGW
 SG_ AWD_Status_PT : 114|3@0+ (1,0) [0|6] "" Vector__XXX
 SG_ CrankEnable_PT : 167|1@0+ (1,0) [0|1] "" SGW
 SG_ CRC_PT_SYSTEM_FD_1 : 447|8@0+ (1,0) [0|255] "-" AGSM,BCM,BSM,CADM,ECM,GNMM,IPC
 SG_ DriveReady_PT : 166|1@0+ (1,0) [0|1] "" BCM,BSM,IPC,SGW
 SG_ DriverPowerReq_PT : 127|11@0+ (1,0) [0|2047] "kW" Vector__XXX
 SG_ DrvAway_Alert_PT : 156|1@0+ (1,0) [0|1] "" IPC
 SG_ DrvAway_Inhibit_PT : 157|1@0+ (1,0) [0|1] "" IPC
 SG_ ESS_RqShftPark_PT : 144|1@0+ (1,0) [0|1] "" Vector__XXX
 SG_ EVCU2_THA_Resp : 220|2@0+ (1,0) [0|3] "" BCM
 SG_ GasPedalPosition_PT : 31|8@0+ (0.392,0) [0|99.96] "%" BCM,BSM,ECM,EVCU2,SGW,TCM
 SG_ GasPedalPositionFailSts_PT : 145|1@0+ (1,0) [0|1] "" BCM,BSM,SGW
 SG_ GearEngaged_PT : 132|4@0+ (1,0) [0|15] "" BCM,BSM,CADM,ECM,EVCU2,IPC,RFHM,SGW
 SG_ GearEngagedForDisplay_PT : 12|5@0+ (1,0) [0|31] "" AGSM,BCM,BSM,CADM,ECM,EVCU2,GNMM,IPC,RFHM,SGW,TCM
 SG_ GearIndicationSts_PT : 153|1@0+ (1,0) [0|1] "" AGSM,IPC
 SG_ HAS_SoH_PT : 128|1@0+ (1,0) [0|1] "" BCM,CADM
 SG_ MessageCounter_PT_SYSTEM_FD_1 : 435|4@0+ (1,0) [0|15] "-" AGSM,BCM,BSM,CADM,ECM,GNMM,IPC
 SG_ ParkingFailSts_PT : 165|1@0+ (1,0) [0|1] "" Vector__XXX
 SG_ ParkingSts_PT : 164|1@0+ (1,0) [0|1] "" Vector__XXX
 SG_ PdlPosActual_PT : 39|8@0+ (0.4,0) [0|102] "%" BCM,BSM,CADM,SGW
 SG_ PowertrainPrplsnActv_PT : 146|1@0+ (1,0) [0|1] "" BCM,BSM,CADM,ECM,EVCU2,IPC,RFHM,SGW,TCM
 SG_ R_SHFT_LOCK_PT : 154|1@0+ (1,0) [0|1] "" Vector__XXX
 SG_ RawPVS1_PT : 295|8@0+ (0.019607843,0) [0|4.999999965] "V" Vector__XXX
 SG_ RawPVS2_PT : 303|8@0+ (0.019607843,0) [0|4.999999965] "V" Vector__XXX
 SG_ ShiftLeverLockReq_PT : 155|1@0+ (1,0) [0|1] "" Vector__XXX
 SG_ ShiftLeverPosition_PT : 51|4@0+ (1,0) [0|15] "" AGSM,BCM,BSM,CADM,IPC,SGW
 SG_ TargetGear_PT : 55|4@0+ (1,0) [0|15] "" BCM,BSM,CADM,IPC,SGW
 SG_ TerrainModeStat_PT : 119|5@0+ (1,0) [0|31] "" BCM,BSM,CADM,IPC,SGW
 SG_ TransmissionFailSts_PT : 152|1@0+ (1,0) [0|1] "" AGSM,BCM,ECM,SGW
 SG_ TransmissionWarnings_PT : 111|6@0+ (1,0) [0|53] "" BCM,IPC,SGW
 SG_ TurtleModeSts_PT : 98|3@0+ (1,0) [0|7] "" IPC
 SG_ VehSpd_Overridden_PT : 84|3@0+ (1,0) [0|7] "" IPC
 SG_ Warn_BTO_PT : 247|1@0+ (1,0) [0|1] "" IPC

BO_TX_BU_ 263 : ECM,EVCU2;
CM_ SG_ 2654339161 CurrentCanNMState_FD05_MCPB "Indicates that CanNM state the ECU is currently executing";
CM_ SG_ 2654339161 CurrentCanNMState_FD16_MCPB "Indicates that CanNM state the ECU is currently executing";
CM_ SG_ 2654339161 CurrentFailSts_FD05_MCPB "Indicates the presence/absence of at least one DTC with DTCStatus = present in the System Memory";
CM_ SG_ 2654339161 CurrentFailSts_FD16_MCPB "Indicates the presence/absence of at least one DTC with DTCStatus = present in the System Memory";
CM_ SG_ 2654339161 DES_FD05_MCPB "Indicates whether the ECU?s CAN cell is in either ErrorActive, or ErrorPassive state OR has just now recovered from a BusOff condition";
CM_ SG_ 2654339161 DES_FD16_MCPB "Indicates whether the ECU?s CAN cell is in either ErrorActive, or ErrorPassive state OR has just now recovered from a BusOff condition";
CM_ SG_ 2654339161 EOL_FD05_MCPB "Indicates if the ECU requires configuration data at the assembly plant End Of Line";
CM_ SG_ 2654339161 EOL_FD16_MCPB "Indicates if the ECU requires configuration data at the assembly plant End Of Line";
CM_ SG_ 2654339161 GenericFailSts_FD05_MCPB "Indicates the presence/absent of at least one DTC in the System Memory";
CM_ SG_ 2654339161 GenericFailSts_FD16_MCPB "Indicates the presence/absent of at least one DTC in the System Memory";
CM_ SG_ 2654339161 PreviousCanNMState_FD05_MCPB "Indicates the last CanNM state that the ECU existed in";
CM_ SG_ 2654339161 PreviousCanNMState_FD16_MCPB "Indicates the last CanNM state that the ECU existed in";
CM_ SG_ 2654339161 StayActiveSource_FD05_MCPB "Indicates the source that requests the ECU to stay active";
CM_ SG_ 2654339161 StayActiveSource_FD16_MCPB "Indicates the source that requests the ECU to stay active";
CM_ SG_ 2654339161 WakeupSource_FD05_MCPB "Indicates the reason the ECU was most recently awakened";
CM_ SG_ 2654339161 WakeupSource_FD16_MCPB "Indicates the reason the ECU was most recently awakened";
CM_ SG_ 2654339286 CurrentCanNMState_FD05_PPIM "Indicates that CanNM state the ECU is currently executing";
CM_ SG_ 2654339286 CurrentCanNMState_FD11_PPIM "Indicates that CanNM state the ECU is currently executing";
CM_ SG_ 2654339286 CurrentFailSts_FD05_PPIM "Indicates the presence/absence of at least one DTC with DTCStatus = present in the System Memory";
CM_ SG_ 2654339286 CurrentFailSts_FD11_PPIM "Indicates the presence/absence of at least one DTC with DTCStatus = present in the System Memory";
CM_ SG_ 2654339286 DES_FD05_PPIM "Indicates whether the ECU?s CAN cell is in either ErrorActive, or ErrorPassive state OR has just now recovered from a BusOff condition";
CM_ SG_ 2654339286 DES_FD11_PPIM "Indicates whether the ECU?s CAN cell is in either ErrorActive, or ErrorPassive state OR has just now recovered from a BusOff condition";
CM_ SG_ 2654339286 EOL_FD05_PPIM "Indicates if the ECU requires configuration data at the assembly plant End Of Line";
CM_ SG_ 2654339286 EOL_FD11_PPIM "Indicates if the ECU requires configuration data at the assembly plant End Of Line";
CM_ SG_ 2654339286 GenericFailSts_FD05_PPIM "Indicates the presence/absent of at least one DTC in the System Memory";
CM_ SG_ 2654339286 GenericFailSts_FD11_PPIM "Indicates the presence/absent of at least one DTC in the System Memory";
CM_ SG_ 2654339286 PreviousCanNMState_FD05_PPIM "Indicates the last CanNM state that the ECU existed in";
CM_ SG_ 2654339286 PreviousCanNMState_FD11_PPIM "Indicates the last CanNM state that the ECU existed in";
CM_ SG_ 2654339286 StayActiveSource_FD05_PPIM "Indicates the source that requests the ECU to stay active";
CM_ SG_ 2654339286 StayActiveSource_FD11_PPIM "Indicates the source that requests the ECU to stay active";
CM_ SG_ 2654339286 WakeupSource_FD05_PPIM "Indicates the reason the ECU was most recently awakened";
CM_ SG_ 2654339286 WakeupSource_FD11_PPIM "Indicates the reason the ECU was most recently awakened";
CM_ SG_ 2654339137 CurrentCanNMState_FD03_RFHM "Indicates that CanNM state the ECU is currently executing";
CM_ SG_ 2654339137 CurrentCanNMState_FD09_RFHM "Indicates that CanNM state the ECU is currently executing";
CM_ SG_ 2654339137 CurrentFailSts_FD03_RFHM "Indicates the presence/absence of at least one DTC with DTCStatus = present in the System Memory";
CM_ SG_ 2654339137 CurrentFailSts_FD09_RFHM "Indicates the presence/absence of at least one DTC with DTCStatus = present in the System Memory";
CM_ SG_ 2654339137 DES_FD03_RFHM "Indicates whether the ECU?s CAN cell is in either ErrorActive, or ErrorPassive state OR has just now recovered from a BusOff condition";
CM_ SG_ 2654339137 DES_FD09_RFHM "Indicates whether the ECU?s CAN cell is in either ErrorActive, or ErrorPassive state OR has just now recovered from a BusOff condition";
CM_ SG_ 2654339137 EOL_FD03_RFHM "Indicates if the ECU requires configuration data at the assembly plant End Of Line";
CM_ SG_ 2654339137 EOL_FD09_RFHM "Indicates if the ECU requires configuration data at the assembly plant End Of Line";
CM_ SG_ 2654339137 GenericFailSts_FD03_RFHM "Indicates the presence/absent of at least one DTC in the System Memory";
CM_ SG_ 2654339137 GenericFailSts_FD09_RFHM "Indicates the presence/absent of at least one DTC in the System Memory";
CM_ SG_ 2654339137 PreviousCanNMState_FD03_RFHM "Indicates the last CanNM state that the ECU existed in";
CM_ SG_ 2654339137 PreviousCanNMState_FD09_RFHM "Indicates the last CanNM state that the ECU existed in";
CM_ SG_ 2654339137 StayActiveSource_FD03_RFHM "Indicates the source that requests the ECU to stay active";
CM_ SG_ 2654339137 StayActiveSource_FD09_RFHM "Indicates the source that requests the ECU to stay active";
CM_ SG_ 2654339137 WakeupSource_FD03_RFHM "Indicates the reason the ECU was most recently awakened";
CM_ SG_ 2654339137 WakeupSource_FD09_RFHM "Indicates the reason the ECU was most recently awakened";
CM_ SG_ 2654339273 CurrentCanNMState_FD05_SGCP "Indicates that CanNM state the ECU is currently executing";
CM_ SG_ 2654339273 CurrentCanNMState_FD16_SGCP "Indicates that CanNM state the ECU is currently executing";
CM_ SG_ 2654339273 CurrentFailSts_FD05_SGCP "Indicates the presence/absence of at least one DTC with DTCStatus = present in the System Memory";
CM_ SG_ 2654339273 CurrentFailSts_FD16_SGCP "Indicates the presence/absence of at least one DTC with DTCStatus = present in the System Memory";
CM_ SG_ 2654339273 DES_FD05_SGCP "Indicates whether the ECU?s CAN cell is in either ErrorActive, or ErrorPassive state OR has just now recovered from a BusOff condition";
CM_ SG_ 2654339273 DES_FD16_SGCP "Indicates whether the ECU?s CAN cell is in either ErrorActive, or ErrorPassive state OR has just now recovered from a BusOff condition";
CM_ SG_ 2654339273 EOL_FD05_SGCP "Indicates if the ECU requires configuration data at the assembly plant End Of Line";
CM_ SG_ 2654339273 EOL_FD16_SGCP "Indicates if the ECU requires configuration data at the assembly plant End Of Line";
CM_ SG_ 2654339273 GenericFailSts_FD05_SGCP "Indicates the presence/absent of at least one DTC in the System Memory";
CM_ SG_ 2654339273 GenericFailSts_FD16_SGCP "Indicates the presence/absent of at least one DTC in the System Memory";
CM_ SG_ 2654339273 PreviousCanNMState_FD05_SGCP "Indicates the last CanNM state that the ECU existed in";
CM_ SG_ 2654339273 PreviousCanNMState_FD16_SGCP "Indicates the last CanNM state that the ECU existed in";
CM_ SG_ 2654339273 StayActiveSource_FD05_SGCP "Indicates the source that requests the ECU to stay active";
CM_ SG_ 2654339273 StayActiveSource_FD16_SGCP "Indicates the source that requests the ECU to stay active";
CM_ SG_ 2654339273 WakeupSource_FD05_SGCP "Indicates the reason the ECU was most recently awakened";
CM_ SG_ 2654339273 WakeupSource_FD16_SGCP "Indicates the reason the ECU was most recently awakened";
CM_ SG_ 2654339184 CurrentCanNMState_FD01_SGW "Indicates that CanNM state the ECU is currently executing";
CM_ SG_ 2654339184 CurrentCanNMState_FD02_SGW "Indicates that CanNM state the ECU is currently executing";
CM_ SG_ 2654339184 CurrentCanNMState_FD03_SGW "Indicates that CanNM state the ECU is currently executing";
CM_ SG_ 2654339184 CurrentCanNMState_FD08_SGW "Indicates that CanNM state the ECU is currently executing";
CM_ SG_ 2654339184 CurrentCanNMState_FD11_SGW "Indicates that CanNM state the ECU is currently executing";
CM_ SG_ 2654339184 CurrentFailSts_FD01_SGW "Indicates the presence/absence of at least one DTC with DTCStatus = present in the System Memory";
CM_ SG_ 2654339184 CurrentFailSts_FD02_SGW "Indicates the presence/absence of at least one DTC with DTCStatus = present in the System Memory";
CM_ SG_ 2654339184 CurrentFailSts_FD03_SGW "Indicates the presence/absence of at least one DTC with DTCStatus = present in the System Memory";
CM_ SG_ 2654339184 CurrentFailSts_FD08_SGW "Indicates the presence/absence of at least one DTC with DTCStatus = present in the System Memory";
CM_ SG_ 2654339184 CurrentFailSts_FD11_SGW "Indicates the presence/absence of at least one DTC with DTCStatus = present in the System Memory";
CM_ SG_ 2654339184 DES_FD01_SGW "Indicates whether the ECU?s CAN cell is in either ErrorActive, or ErrorPassive state OR has just now recovered from a BusOff condition";
CM_ SG_ 2654339184 DES_FD02_SGW "Indicates whether the ECU?s CAN cell is in either ErrorActive, or ErrorPassive state OR has just now recovered from a BusOff condition";
CM_ SG_ 2654339184 DES_FD03_SGW "Indicates whether the ECU?s CAN cell is in either ErrorActive, or ErrorPassive state OR has just now recovered from a BusOff condition";
CM_ SG_ 2654339184 DES_FD08_SGW "Indicates whether the ECU?s CAN cell is in either ErrorActive, or ErrorPassive state OR has just now recovered from a BusOff condition";
CM_ SG_ 2654339184 DES_FD11_SGW "Indicates whether the ECU?s CAN cell is in either ErrorActive, or ErrorPassive state OR has just now recovered from a BusOff condition";
CM_ SG_ 2654339184 EOL_FD01_SGW "Indicates if the ECU requires configuration data at the assembly plant End Of Line";
CM_ SG_ 2654339184 EOL_FD02_SGW "Indicates if the ECU requires configuration data at the assembly plant End Of Line";
CM_ SG_ 2654339184 EOL_FD03_SGW "Indicates if the ECU requires configuration data at the assembly plant End Of Line";
CM_ SG_ 2654339184 EOL_FD08_SGW "Indicates if the ECU requires configuration data at the assembly plant End Of Line";
CM_ SG_ 2654339184 EOL_FD11_SGW "Indicates if the ECU requires configuration data at the assembly plant End Of Line";
CM_ SG_ 2654339184 GenericFailSts_FD01_SGW "Indicates the presence/absent of at least one DTC in the System Memory";
CM_ SG_ 2654339184 GenericFailSts_FD02_SGW "Indicates the presence/absent of at least one DTC in the System Memory";
CM_ SG_ 2654339184 GenericFailSts_FD03_SGW "Indicates the presence/absent of at least one DTC in the System Memory";
CM_ SG_ 2654339184 GenericFailSts_FD08_SGW "Indicates the presence/absent of at least one DTC in the System Memory";
CM_ SG_ 2654339184 GenericFailSts_FD11_SGW "Indicates the presence/absent of at least one DTC in the System Memory";
CM_ SG_ 2654339184 PreviousCanNMState_FD01_SGW "Indicates the last CanNM state that the ECU existed in";
CM_ SG_ 2654339184 PreviousCanNMState_FD02_SGW "Indicates the last CanNM state that the ECU existed in";
CM_ SG_ 2654339184 PreviousCanNMState_FD03_SGW "Indicates the last CanNM state that the ECU existed in";
CM_ SG_ 2654339184 PreviousCanNMState_FD08_SGW "Indicates the last CanNM state that the ECU existed in";
CM_ SG_ 2654339184 PreviousCanNMState_FD11_SGW "Indicates the last CanNM state that the ECU existed in";
CM_ SG_ 2654339184 StayActiveSource_FD01_SGW "Indicates the source that requests the ECU to stay active";
CM_ SG_ 2654339184 StayActiveSource_FD02_SGW "Indicates the source that requests the ECU to stay active";
CM_ SG_ 2654339184 StayActiveSource_FD03_SGW "Indicates the source that requests the ECU to stay active";
CM_ SG_ 2654339184 StayActiveSource_FD08_SGW "Indicates the source that requests the ECU to stay active";
CM_ SG_ 2654339184 StayActiveSource_FD11_SGW "Indicates the source that requests the ECU to stay active";
CM_ SG_ 2654339184 WakeupSource_FD01_SGW "Indicates the reason the ECU was most recently awakened";
CM_ SG_ 2654339184 WakeupSource_FD02_SGW "Indicates the reason the ECU was most recently awakened";
CM_ SG_ 2654339184 WakeupSource_FD03_SGW "Indicates the reason the ECU was most recently awakened";
CM_ SG_ 2654339184 WakeupSource_FD08_SGW "Indicates the reason the ECU was most recently awakened";
CM_ SG_ 2654339184 WakeupSource_FD11_SGW "Indicates the reason the ECU was most recently awakened";
CM_ SG_ 2654339107 CurrentCanNMState_FD08_TBM "Indicates that CanNM state the ECU is currently executing";
CM_ SG_ 2654339107 CurrentFailSts_FD08_TBM "Indicates the presence/absence of at least one DTC with DTCStatus = present in the System Memory";
CM_ SG_ 2654339107 DES_FD08_TBM "Indicates whether the ECU?s CAN cell is in either ErrorActive, or ErrorPassive state OR has just now recovered from a BusOff condition";
CM_ SG_ 2654339107 EOL_FD08_TBM "Indicates if the ECU requires configuration data at the assembly plant End Of Line";
CM_ SG_ 2654339107 GenericFailSts_FD08_TBM "Indicates the presence/absent of at least one DTC in the System Memory";
CM_ SG_ 2654339107 PreviousCanNMState_FD08_TBM "Indicates the last CanNM state that the ECU existed in";
CM_ SG_ 2654339107 StayActiveSource_FD08_TBM "Indicates the source that requests the ECU to stay active";
CM_ SG_ 2654339107 WakeupSource_FD08_TBM "Indicates the reason the ECU was most recently awakened";
CM_ SG_ 2654339083 CurrentCanNMState_FD03_TCM "Indicates that CanNM state the ECU is currently executing";
CM_ SG_ 2654339083 CurrentFailSts_FD03_TCM "Indicates the presence/absence of at least one DTC with DTCStatus = present in the System Memory";
CM_ SG_ 2654339083 DES_FD03_TCM "Indicates whether the ECU?s CAN cell is in either ErrorActive, or ErrorPassive state OR has just now recovered from a BusOff condition";
CM_ SG_ 2654339083 EOL_FD03_TCM "Indicates if the ECU requires configuration data at the assembly plant End Of Line";
CM_ SG_ 2654339083 GenericFailSts_FD03_TCM "Indicates the presence/absent of at least one DTC in the System Memory";
CM_ SG_ 2654339083 PreviousCanNMState_FD03_TCM "Indicates the last CanNM state that the ECU existed in";
CM_ SG_ 2654339083 StayActiveSource_FD03_TCM "Indicates the source that requests the ECU to stay active";
CM_ SG_ 2654339083 WakeupSource_FD03_TCM "Indicates the reason the ECU was most recently awakened";
CM_ SG_ 263 AlternatorFail_PT "Alternator Fail Status";
CM_ SG_ 263 APCM_Rq_PT "Auto position correction mode request";
CM_ SG_ 263 AtmosphericPressure_PT "Atmoshperic pressure";
CM_ SG_ 263 AWD_Status_PT "AWD Status";
CM_ SG_ 263 CrankEnable_PT "This signal is used to enable the cranking in safety conditions";
CM_ SG_ 263 CRC_PT_SYSTEM_FD_1 "CRC according to SAE J1850 standard at each frame transmission.";
CM_ SG_ 263 DriveReady_PT "Drive Ready allowed status";
CM_ SG_ 263 DriverPowerReq_PT "Current delivered power";
CM_ SG_ 263 DrvAway_Alert_PT "Drive Away Alert";
CM_ SG_ 263 DrvAway_Inhibit_PT "Drive Away Inhibit";
CM_ SG_ 263 ESS_RqShftPark_PT "ESS Request Shift to Park";
CM_ SG_ 263 EVCU2_THA_Resp "EVCU2 speed limiting availability response for trailer hitch assist";
CM_ SG_ 263 GasPedalPosition_PT "Gas Pedal Position in percentage";
CM_ SG_ 263 GasPedalPositionFailSts_PT "Gas Pedal Position Failure Status";
CM_ SG_ 263 GearEngaged_PT "Current engaged gear";
CM_ SG_ 263 GearEngagedForDisplay_PT "Transmission Gear Engaged signal for the instrument cluster display";
CM_ SG_ 263 GearIndicationSts_PT "Gear Indication Status";
CM_ SG_ 263 HAS_SoH_PT "HAS SoH";
CM_ SG_ 263 MessageCounter_PT_SYSTEM_FD_1 "This signal is a counter used for safety checks strategies. This counter is incremented of 1 (one) unit at each frame transmission.";
CM_ SG_ 263 ParkingFailSts_PT "Parking Fail Sts";
CM_ SG_ 263 ParkingSts_PT "Parking Status";
CM_ SG_ 263 PdlPosActual_PT "Actual Pedal Position";
CM_ SG_ 263 PowertrainPrplsnActv_PT "Powertrain Propulsion System Status";
CM_ SG_ 263 R_SHFT_LOCK_PT "Shift lock for reverse";
CM_ SG_ 263 RawPVS1_PT "Raw Pedal Voltage - Sensor 1";
CM_ SG_ 263 RawPVS2_PT "Raw Pedal Voltage - Sensor 2";
CM_ SG_ 263 ShiftLeverLockReq_PT "Shift Lever Lock Request";
CM_ SG_ 263 ShiftLeverPosition_PT "Shift Lever Position";
CM_ SG_ 263 TargetGear_PT "Intended Gear that the transmission will shift to.";
CM_ SG_ 263 TerrainModeStat_PT "Terrain Mode";
CM_ SG_ 263 TransmissionFailSts_PT "Transmission Failure Status";
CM_ SG_ 263 TransmissionWarnings_PT "Transmission Warnings";
CM_ SG_ 263 TurtleModeSts_PT "Turtle Mode State";
CM_ SG_ 263 VehSpd_Overridden_PT "Vehicle Speed Override Indication";
CM_ SG_ 263 Warn_BTO_PT "Brake Throttle Override status";

BA_DEF_ SG_ "GenSigStartValue" INT 0 2147483647;
BA_DEF_ SG_ "GenSigInactiveValue" INT 0 2147483647;
BA_DEF_ SG_ "GenSigSendType" ENUM "NotUsed","OnWrite","OnWriteWithRepetition","OnChange","OnChangeWithRepetition","IfActive","IfActiveWithRepetition","NoSigSendType";
BA_DEF_ SG_ "SystemSignalLongSymbol" STRING ;
BA_DEF_ SG_ "GenSigTimeoutTime_AGSM" INT 0 65535;
BA_DEF_ SG_ "GenSigTimeoutTime_BCM" INT 0 65535;
BA_DEF_ SG_ "GenSigTimeoutTime_BSM" INT 0 65535;
BA_DEF_ SG_ "GenSigTimeoutTime_CADM" INT 0 65535;
BA_DEF_ SG_ "GenSigTimeoutTime_DMSM" INT 0 65535;
BA_DEF_ SG_ "GenSigTimeoutTime_DTCM" INT 0 65535;
BA_DEF_ SG_ "GenSigTimeoutTime_ECM" INT 0 65535;
BA_DEF_ SG_ "GenSigTimeoutTime_EVCU2" INT 0 65535;
BA_DEF_ SG_ "GenSigTimeoutTime_GNMM" INT 0 65535;
BA_DEF_ SG_ "GenSigTimeoutTime_HCP" INT 0 65535;
BA_DEF_ SG_ "GenSigTimeoutTime_IPC" INT 0 65535;
BA_DEF_ SG_ "GenSigTimeoutTime_RFHM" INT 0 65535;
BA_DEF_ SG_ "GenSigTimeoutTime_SGW" INT 0 65535;
BA_DEF_ SG_ "GenSigTimeoutTime_TCM" INT 0 65535;
BA_DEF_ BO_ "DiagRequest" ENUM "No","Yes";
BA_DEF_ BO_ "Type" ENUM "P","C","PE","COC","PE_Cntrl","E","E_Cntrl","OC","S","BAF","DC","EM","MM","ISO-TP","-";
BA_DEF_ BO_ "DiagResponse" ENUM "No","Yes";
BA_DEF_ BO_ "NmMessage" ENUM "No","Yes";
BA_DEF_ BO_ "GenMsgSendType" ENUM "Cyclic","NotUsed","NotUsed","NotUsed","NotUsed","NotUsed","NotUsed","NotUsed","NoMsgSendType";
BA_DEF_ BO_ "GenMsgNrOfRepetition" INT 0 255;
BA_DEF_ BO_ "GenMsgILSupport" ENUM "No","Yes";
BA_DEF_ BO_ "GenMsgStartDelayTime" INT 0 65535;
BA_DEF_ BO_ "GenMsgCycleTimeFast" INT 0 65535;
BA_DEF_ BO_ "GenMsgCycleTime" INT 0 65535;
BA_DEF_ BO_ "GenMsgDelayTime" INT 0 65535;
BA_DEF_ BO_ "NmAsrMessage" ENUM "No","Yes";
BA_DEF_ BO_ "DiagState" ENUM "No","Yes";
BA_DEF_ BO_ "DiagConnection" HEX 0 65535;
BA_DEF_ BO_ "VFrameFormat" ENUM "StandardCAN","ExtendedCAN","reserved","reserved","reserved","reserved","reserved","reserved","reserved","reserved","reserved","reserved","reserved","reserved","StandardCAN_FD","ExtendedCAN_FD";
BA_DEF_ BO_ "CANFD_BRS" ENUM "No","Yes";
BA_DEF_DEF_ "DiagRequest" "No";
BA_DEF_DEF_ "Type" "-";
BA_DEF_DEF_ "DiagResponse" "No";
BA_DEF_DEF_ "NmMessage" "No";
BA_DEF_DEF_ "GenMsgSendType" "NoMsgSendType";
BA_DEF_DEF_ "GenMsgNrOfRepetition" 0;
BA_DEF_DEF_ "GenMsgILSupport" "No";
BA_DEF_DEF_ "GenMsgStartDelayTime" 0;
BA_DEF_DEF_ "GenMsgCycleTimeFast" 0;
BA_DEF_DEF_ "GenMsgCycleTime" 0;
BA_DEF_DEF_ "GenMsgDelayTime" 0;
BA_DEF_DEF_ "NmAsrMessage" "No";
BA_DEF_DEF_ "DiagState" "No";
BA_DEF_DEF_ "DiagConnection" 0;
BA_DEF_DEF_ "VFrameFormat" "StandardCAN_FD";
BA_DEF_DEF_ "CANFD_BRS" "No";
BA_DEF_DEF_ "GenSigStartValue" 0;
BA_DEF_DEF_ "GenSigInactiveValue" 0;
BA_DEF_DEF_ "GenSigSendType" "NoSigSendType";
BA_DEF_DEF_ "SystemSignalLongSymbol" "";
BA_DEF_DEF_ "GenSigTimeoutTime_AGSM" 2500;
BA_DEF_DEF_ "GenSigTimeoutTime_BCM" 2500;
BA_DEF_DEF_ "GenSigTimeoutTime_BSM" 2500;
BA_DEF_DEF_ "GenSigTimeoutTime_CADM" 2500;
BA_DEF_DEF_ "GenSigTimeoutTime_DMSM" 2500;
BA_DEF_DEF_ "GenSigTimeoutTime_DTCM" 2500;
BA_DEF_DEF_ "GenSigTimeoutTime_ECM" 2500;
BA_DEF_DEF_ "GenSigTimeoutTime_EVCU2" 2500;
BA_DEF_DEF_ "GenSigTimeoutTime_GNMM" 2500;
BA_DEF_DEF_ "GenSigTimeoutTime_HCP" 2500;
BA_DEF_DEF_ "GenSigTimeoutTime_IPC" 2500;
BA_DEF_DEF_ "GenSigTimeoutTime_RFHM" 2500;
BA_DEF_DEF_ "GenSigTimeoutTime_SGW" 2500;
BA_DEF_DEF_ "GenSigTimeoutTime_TCM" 2500;
BA_ "Type" BO_ 2654339161 1;
BA_ "GenMsgSendType" BO_ 2654339161 0;
BA_ "GenMsgILSupport" BO_ 2654339161 1;
BA_ "GenMsgCycleTime" BO_ 2654339161 1000;
BA_ "VFrameFormat" BO_ 2654339161 15;
BA_ "CANFD_BRS" BO_ 2654339161 1;
BA_ "Type" BO_ 2654339286 1;
BA_ "GenMsgSendType" BO_ 2654339286 0;
BA_ "GenMsgILSupport" BO_ 2654339286 1;
BA_ "GenMsgCycleTime" BO_ 2654339286 1000;
BA_ "VFrameFormat" BO_ 2654339286 15;
BA_ "CANFD_BRS" BO_ 2654339286 1;
BA_ "Type" BO_ 2654339137 1;
BA_ "GenMsgSendType" BO_ 2654339137 0;
BA_ "GenMsgILSupport" BO_ 2654339137 1;
BA_ "GenMsgCycleTime" BO_ 2654339137 1000;
BA_ "VFrameFormat" BO_ 2654339137 15;
BA_ "CANFD_BRS" BO_ 2654339137 1;
BA_ "Type" BO_ 2654339273 1;
BA_ "GenMsgSendType" BO_ 2654339273 0;
BA_ "GenMsgILSupport" BO_ 2654339273 1;
BA_ "GenMsgCycleTime" BO_ 2654339273 1000;
BA_ "VFrameFormat" BO_ 2654339273 15;
BA_ "CANFD_BRS" BO_ 2654339273 1;
BA_ "Type" BO_ 2654339184 1;
BA_ "GenMsgSendType" BO_ 2654339184 0;
BA_ "GenMsgILSupport" BO_ 2654339184 1;
BA_ "GenMsgCycleTime" BO_ 2654339184 1000;
BA_ "VFrameFormat" BO_ 2654339184 15;
BA_ "CANFD_BRS" BO_ 2654339184 1;
BA_ "Type" BO_ 2654339107 1;
BA_ "GenMsgSendType" BO_ 2654339107 0;
BA_ "GenMsgILSupport" BO_ 2654339107 1;
BA_ "GenMsgCycleTime" BO_ 2654339107 1000;
BA_ "VFrameFormat" BO_ 2654339107 15;
BA_ "CANFD_BRS" BO_ 2654339107 1;
BA_ "Type" BO_ 2654339083 1;
BA_ "GenMsgSendType" BO_ 2654339083 0;
BA_ "GenMsgILSupport" BO_ 2654339083 1;
BA_ "GenMsgCycleTime" BO_ 2654339083 1000;
BA_ "VFrameFormat" BO_ 2654339083 15;
BA_ "CANFD_BRS" BO_ 2654339083 1;
BA_ "Type" BO_ 263 1;
BA_ "GenMsgSendType" BO_ 263 0;
BA_ "GenMsgILSupport" BO_ 263 1;
BA_ "GenMsgCycleTime" BO_ 263 10;
BA_ "CANFD_BRS" BO_ 263 1;
BA_ "GenSigTimeoutTime_AGSM" SG_ 2654339161 CurrentCanNMState_FD05_MCPB 0;
BA_ "GenSigTimeoutTime_BCM" SG_ 2654339161 CurrentCanNMState_FD05_MCPB 0;
BA_ "GenSigTimeoutTime_BSM" SG_ 2654339161 CurrentCanNMState_FD05_MCPB 0;
BA_ "GenSigTimeoutTime_CADM" SG_ 2654339161 CurrentCanNMState_FD05_MCPB 0;
BA_ "GenSigTimeoutTime_DMSM" SG_ 2654339161 CurrentCanNMState_FD05_MCPB 0;
BA_ "GenSigTimeoutTime_DTCM" SG_ 2654339161 CurrentCanNMState_FD05_MCPB 0;
BA_ "GenSigTimeoutTime_ECM" SG_ 2654339161 CurrentCanNMState_FD05_MCPB 0;
BA_ "GenSigTimeoutTime_EVCU2" SG_ 2654339161 CurrentCanNMState_FD05_MCPB 0;
BA_ "GenSigTimeoutTime_GNMM" SG_ 2654339161 CurrentCanNMState_FD05_MCPB 0;
BA_ "GenSigTimeoutTime_HCP" SG_ 2654339161 CurrentCanNMState_FD05_MCPB 0;
BA_ "GenSigTimeoutTime_IPC" SG_ 2654339161 CurrentCanNMState_FD05_MCPB 0;
BA_ "GenSigTimeoutTime_RFHM" SG_ 2654339161 CurrentCanNMState_FD05_MCPB 0;
BA_ "GenSigTimeoutTime_TCM" SG_ 2654339161 CurrentCanNMState_FD05_MCPB 0;
BA_ "GenSigTimeoutTime_AGSM" SG_ 2654339161 CurrentCanNMState_FD16_MCPB 0;
BA_ "GenSigTimeoutTime_BCM" SG_ 2654339161 CurrentCanNMState_FD16_MCPB 0;
BA_ "GenSigTimeoutTime_BSM" SG_ 2654339161 CurrentCanNMState_FD16_MCPB 0;
BA_ "GenSigTimeoutTime_CADM" SG_ 2654339161 CurrentCanNMState_FD16_MCPB 0;
BA_ "GenSigTimeoutTime_DMSM" SG_ 2654339161 CurrentCanNMState_FD16_MCPB 0;
BA_ "GenSigTimeoutTime_DTCM" SG_ 2654339161 CurrentCanNMState_FD16_MCPB 0;
BA_ "GenSigTimeoutTime_ECM" SG_ 2654339161 CurrentCanNMState_FD16_MCPB 0;
BA_ "GenSigTimeoutTime_EVCU2" SG_ 2654339161 CurrentCanNMState_FD16_MCPB 0;
BA_ "GenSigTimeoutTime_GNMM" SG_ 2654339161 CurrentCanNMState_FD16_MCPB 0;
BA_ "GenSigTimeoutTime_HCP" SG_ 2654339161 CurrentCanNMState_FD16_MCPB 0;
BA_ "GenSigTimeoutTime_IPC" SG_ 2654339161 CurrentCanNMState_FD16_MCPB 0;
BA_ "GenSigTimeoutTime_RFHM" SG_ 2654339161 CurrentCanNMState_FD16_MCPB 0;
BA_ "GenSigTimeoutTime_TCM" SG_ 2654339161 CurrentCanNMState_FD16_MCPB 0;
BA_ "GenSigTimeoutTime_AGSM" SG_ 2654339161 CurrentFailSts_FD05_MCPB 0;
BA_ "GenSigTimeoutTime_BSM" SG_ 2654339161 CurrentFailSts_FD05_MCPB 0;
BA_ "GenSigTimeoutTime_CADM" SG_ 2654339161 CurrentFailSts_FD05_MCPB 0;
BA_ "GenSigTimeoutTime_DMSM" SG_ 2654339161 CurrentFailSts_FD05_MCPB 0;
BA_ "GenSigTimeoutTime_DTCM" SG_ 2654339161 CurrentFailSts_FD05_MCPB 0;
BA_ "GenSigTimeoutTime_ECM" SG_ 2654339161 CurrentFailSts_FD05_MCPB 0;
BA_ "GenSigTimeoutTime_EVCU2" SG_ 2654339161 CurrentFailSts_FD05_MCPB 0;
BA_ "GenSigTimeoutTime_GNMM" SG_ 2654339161 CurrentFailSts_FD05_MCPB 0;
BA_ "GenSigTimeoutTime_HCP" SG_ 2654339161 CurrentFailSts_FD05_MCPB 0;
BA_ "GenSigTimeoutTime_IPC" SG_ 2654339161 CurrentFailSts_FD05_MCPB 0;
BA_ "GenSigTimeoutTime_RFHM" SG_ 2654339161 CurrentFailSts_FD05_MCPB 0;
BA_ "GenSigTimeoutTime_TCM" SG_ 2654339161 CurrentFailSts_FD05_MCPB 0;
BA_ "GenSigTimeoutTime_AGSM" SG_ 2654339161 CurrentFailSts_FD16_MCPB 0;
BA_ "GenSigTimeoutTime_BCM" SG_ 2654339161 CurrentFailSts_FD16_MCPB 0;
BA_ "GenSigTimeoutTime_BSM" SG_ 2654339161 CurrentFailSts_FD16_MCPB 0;
BA_ "GenSigTimeoutTime_CADM" SG_ 2654339161 CurrentFailSts_FD16_MCPB 0;
BA_ "GenSigTimeoutTime_DMSM" SG_ 2654339161 CurrentFailSts_FD16_MCPB 0;
BA_ "GenSigTimeoutTime_DTCM" SG_ 2654339161 CurrentFailSts_FD16_MCPB 0;
BA_ "GenSigTimeoutTime_ECM" SG_ 2654339161 CurrentFailSts_FD16_MCPB 0;
BA_ "GenSigTimeoutTime_EVCU2" SG_ 2654339161 CurrentFailSts_FD16_MCPB 0;
BA_ "GenSigTimeoutTime_GNMM" SG_ 2654339161 CurrentFailSts_FD16_MCPB 0;
BA_ "GenSigTimeoutTime_HCP" SG_ 2654339161 CurrentFailSts_FD16_MCPB 0;
BA_ "GenSigTimeoutTime_IPC" SG_ 2654339161 CurrentFailSts_FD16_MCPB 0;
BA_ "GenSigTimeoutTime_RFHM" SG_ 2654339161 CurrentFailSts_FD16_MCPB 0;
BA_ "GenSigTimeoutTime_TCM" SG_ 2654339161 CurrentFailSts_FD16_MCPB 0;
BA_ "GenSigTimeoutTime_AGSM" SG_ 2654339161 DES_FD05_MCPB 0;
BA_ "GenSigTimeoutTime_BCM" SG_ 2654339161 DES_FD05_MCPB 0;
BA_ "GenSigTimeoutTime_BSM" SG_ 2654339161 DES_FD05_MCPB 0;
BA_ "GenSigTimeoutTime_CADM" SG_ 2654339161 DES_FD05_MCPB 0;
BA_ "GenSigTimeoutTime_DMSM" SG_ 2654339161 DES_FD05_MCPB 0;
BA_ "GenSigTimeoutTime_DTCM" SG_ 2654339161 DES_FD05_MCPB 0;
BA_ "GenSigTimeoutTime_ECM" SG_ 2654339161 DES_FD05_MCPB 0;
BA_ "GenSigTimeoutTime_EVCU2" SG_ 2654339161 DES_FD05_MCPB 0;
BA_ "GenSigTimeoutTime_GNMM" SG_ 2654339161 DES_FD05_MCPB 0;
BA_ "GenSigTimeoutTime_HCP" SG_ 2654339161 DES_FD05_MCPB 0;
BA_ "GenSigTimeoutTime_IPC" SG_ 2654339161 DES_FD05_MCPB 0;
BA_ "GenSigTimeoutTime_RFHM" SG_ 2654339161 DES_FD05_MCPB 0;
BA_ "GenSigTimeoutTime_TCM" SG_ 2654339161 DES_FD05_MCPB 0;
BA_ "GenSigTimeoutTime_AGSM" SG_ 2654339161 DES_FD16_MCPB 0;
BA_ "GenSigTimeoutTime_BCM" SG_ 2654339161 DES_FD16_MCPB 0;
BA_ "GenSigTimeoutTime_BSM" SG_ 2654339161 DES_FD16_MCPB 0;
BA_ "GenSigTimeoutTime_CADM" SG_ 2654339161 DES_FD16_MCPB 0;
BA_ "GenSigTimeoutTime_DMSM" SG_ 2654339161 DES_FD16_MCPB 0;
BA_ "GenSigTimeoutTime_DTCM" SG_ 2654339161 DES_FD16_MCPB 0;
BA_ "GenSigTimeoutTime_ECM" SG_ 2654339161 DES_FD16_MCPB 0;
BA_ "GenSigTimeoutTime_EVCU2" SG_ 2654339161 DES_FD16_MCPB 0;
BA_ "GenSigTimeoutTime_GNMM" SG_ 2654339161 DES_FD16_MCPB 0;
BA_ "GenSigTimeoutTime_HCP" SG_ 2654339161 DES_FD16_MCPB 0;
BA_ "GenSigTimeoutTime_IPC" SG_ 2654339161 DES_FD16_MCPB 0;
BA_ "GenSigTimeoutTime_RFHM" SG_ 2654339161 DES_FD16_MCPB 0;
BA_ "GenSigTimeoutTime_TCM" SG_ 2654339161 DES_FD16_MCPB 0;
BA_ "GenSigTimeoutTime_AGSM" SG_ 2654339161 EOL_FD05_MCPB 0;
BA_ "GenSigTimeoutTime_BSM" SG_ 2654339161 EOL_FD05_MCPB 0;
BA_ "GenSigTimeoutTime_CADM" SG_ 2654339161 EOL_FD05_MCPB 0;
BA_ "GenSigTimeoutTime_DMSM" SG_ 2654339161 EOL_FD05_MCPB 0;
BA_ "GenSigTimeoutTime_DTCM" SG_ 2654339161 EOL_FD05_MCPB 0;
BA_ "GenSigTimeoutTime_ECM" SG_ 2654339161 EOL_FD05_MCPB 0;
BA_ "GenSigTimeoutTime_EVCU2" SG_ 2654339161 EOL_FD05_MCPB 0;
BA_ "GenSigTimeoutTime_GNMM" SG_ 2654339161 EOL_FD05_MCPB 0;
BA_ "GenSigTimeoutTime_HCP" SG_ 2654339161 EOL_FD05_MCPB 0;
BA_ "GenSigTimeoutTime_IPC" SG_ 2654339161 EOL_FD05_MCPB 0;
BA_ "GenSigTimeoutTime_RFHM" SG_ 2654339161 EOL_FD05_MCPB 0;
BA_ "GenSigTimeoutTime_TCM" SG_ 2654339161 EOL_FD05_MCPB 0;
BA_ "GenSigTimeoutTime_AGSM" SG_ 2654339161 EOL_FD16_MCPB 0;
BA_ "GenSigTimeoutTime_BCM" SG_ 2654339161 EOL_FD16_MCPB 0;
BA_ "GenSigTimeoutTime_BSM" SG_ 2654339161 EOL_FD16_MCPB 0;
BA_ "GenSigTimeoutTime_CADM" SG_ 2654339161 EOL_FD16_MCPB 0;
BA_ "GenSigTimeoutTime_DMSM" SG_ 2654339161 EOL_FD16_MCPB 0;
BA_ "GenSigTimeoutTime_DTCM" SG_ 2654339161 EOL_FD16_MCPB 0;
BA_ "GenSigTimeoutTime_ECM" SG_ 2654339161 EOL_FD16_MCPB 0;
BA_ "GenSigTimeoutTime_EVCU2" SG_ 2654339161 EOL_FD16_MCPB 0;
BA_ "GenSigTimeoutTime_GNMM" SG_ 2654339161 EOL_FD16_MCPB 0;
BA_ "GenSigTimeoutTime_HCP" SG_ 2654339161 EOL_FD16_MCPB 0;
BA_ "GenSigTimeoutTime_IPC" SG_ 2654339161 EOL_FD16_MCPB 0;
BA_ "GenSigTimeoutTime_RFHM" SG_ 2654339161 EOL_FD16_MCPB 0;
BA_ "GenSigTimeoutTime_TCM" SG_ 2654339161 EOL_FD16_MCPB 0;
BA_ "GenSigTimeoutTime_AGSM" SG_ 2654339161 GenericFailSts_FD05_MCPB 0;
BA_ "GenSigTimeoutTime_BSM" SG_ 2654339161 GenericFailSts_FD05_MCPB 0;
BA_ "GenSigTimeoutTime_CADM" SG_ 2654339161 GenericFailSts_FD05_MCPB 0;
BA_ "GenSigTimeoutTime_DMSM" SG_ 2654339161 GenericFailSts_FD05_MCPB 0;
BA_ "GenSigTimeoutTime_DTCM" SG_ 2654339161 GenericFailSts_FD05_MCPB 0;
BA_ "GenSigTimeoutTime_ECM" SG_ 2654339161 GenericFailSts_FD05_MCPB 0;
BA_ "GenSigTimeoutTime_EVCU2" SG_ 2654339161 GenericFailSts_FD05_MCPB 0;
BA_ "GenSigTimeoutTime_GNMM" SG_ 2654339161 GenericFailSts_FD05_MCPB 0;
BA_ "GenSigTimeoutTime_HCP" SG_ 2654339161 GenericFailSts_FD05_MCPB 0;
BA_ "GenSigTimeoutTime_IPC" SG_ 2654339161 GenericFailSts_FD05_MCPB 0;
BA_ "GenSigTimeoutTime_RFHM" SG_ 2654339161 GenericFailSts_FD05_MCPB 0;
BA_ "GenSigTimeoutTime_TCM" SG_ 2654339161 GenericFailSts_FD05_MCPB 0;
BA_ "GenSigTimeoutTime_AGSM" SG_ 2654339161 GenericFailSts_FD16_MCPB 0;
BA_ "GenSigTimeoutTime_BCM" SG_ 2654339161 GenericFailSts_FD16_MCPB 0;
BA_ "GenSigTimeoutTime_BSM" SG_ 2654339161 GenericFailSts_FD16_MCPB 0;
BA_ "GenSigTimeoutTime_CADM" SG_ 2654339161 GenericFailSts_FD16_MCPB 0;
BA_ "GenSigTimeoutTime_DMSM" SG_ 2654339161 GenericFailSts_FD16_MCPB 0;
BA_ "GenSigTimeoutTime_DTCM" SG_ 2654339161 GenericFailSts_FD16_MCPB 0;
BA_ "GenSigTimeoutTime_ECM" SG_ 2654339161 GenericFailSts_FD16_MCPB 0;
BA_ "GenSigTimeoutTime_EVCU2" SG_ 2654339161 GenericFailSts_FD16_MCPB 0;
BA_ "GenSigTimeoutTime_GNMM" SG_ 2654339161 GenericFailSts_FD16_MCPB 0;
BA_ "GenSigTimeoutTime_HCP" SG_ 2654339161 GenericFailSts_FD16_MCPB 0;
BA_ "GenSigTimeoutTime_IPC" SG_ 2654339161 GenericFailSts_FD16_MCPB 0;
BA_ "GenSigTimeoutTime_RFHM" SG_ 2654339161 GenericFailSts_FD16_MCPB 0;
BA_ "GenSigTimeoutTime_TCM" SG_ 2654339161 GenericFailSts_FD16_MCPB 0;
BA_ "GenSigTimeoutTime_AGSM" SG_ 2654339161 PreviousCanNMState_FD05_MCPB 0;
BA_ "GenSigTimeoutTime_BCM" SG_ 2654339161 PreviousCanNMState_FD05_MCPB 0;
BA_ "GenSigTimeoutTime_BSM" SG_ 2654339161 PreviousCanNMState_FD05_MCPB 0;
BA_ "GenSigTimeoutTime_CADM" SG_ 2654339161 PreviousCanNMState_FD05_MCPB 0;
BA_ "GenSigTimeoutTime_DMSM" SG_ 2654339161 PreviousCanNMState_FD05_MCPB 0;
BA_ "GenSigTimeoutTime_DTCM" SG_ 2654339161 PreviousCanNMState_FD05_MCPB 0;
BA_ "GenSigTimeoutTime_ECM" SG_ 2654339161 PreviousCanNMState_FD05_MCPB 0;
BA_ "GenSigTimeoutTime_EVCU2" SG_ 2654339161 PreviousCanNMState_FD05_MCPB 0;
BA_ "GenSigTimeoutTime_GNMM" SG_ 2654339161 PreviousCanNMState_FD05_MCPB 0;
BA_ "GenSigTimeoutTime_HCP" SG_ 2654339161 PreviousCanNMState_FD05_MCPB 0;
BA_ "GenSigTimeoutTime_IPC" SG_ 2654339161 PreviousCanNMState_FD05_MCPB 0;
BA_ "GenSigTimeoutTime_RFHM" SG_ 2654339161 PreviousCanNMState_FD05_MCPB 0;
BA_ "GenSigTimeoutTime_TCM" SG_ 2654339161 PreviousCanNMState_FD05_MCPB 0;
BA_ "GenSigTimeoutTime_AGSM" SG_ 2654339161 PreviousCanNMState_FD16_MCPB 0;
BA_ "GenSigTimeoutTime_BCM" SG_ 2654339161 PreviousCanNMState_FD16_MCPB 0;
BA_ "GenSigTimeoutTime_BSM" SG_ 2654339161 PreviousCanNMState_FD16_MCPB 0;
BA_ "GenSigTimeoutTime_CADM" SG_ 2654339161 PreviousCanNMState_FD16_MCPB 0;
BA_ "GenSigTimeoutTime_DMSM" SG_ 2654339161 PreviousCanNMState_FD16_MCPB 0;
BA_ "GenSigTimeoutTime_DTCM" SG_ 2654339161 PreviousCanNMState_FD16_MCPB 0;
BA_ "GenSigTimeoutTime_ECM" SG_ 2654339161 PreviousCanNMState_FD16_MCPB 0;
BA_ "GenSigTimeoutTime_EVCU2" SG_ 2654339161 PreviousCanNMState_FD16_MCPB 0;
BA_ "GenSigTimeoutTime_GNMM" SG_ 2654339161 PreviousCanNMState_FD16_MCPB 0;
BA_ "GenSigTimeoutTime_HCP" SG_ 2654339161 PreviousCanNMState_FD16_MCPB 0;
BA_ "GenSigTimeoutTime_IPC" SG_ 2654339161 PreviousCanNMState_FD16_MCPB 0;
BA_ "GenSigTimeoutTime_RFHM" SG_ 2654339161 PreviousCanNMState_FD16_MCPB 0;
BA_ "GenSigTimeoutTime_TCM" SG_ 2654339161 PreviousCanNMState_FD16_MCPB 0;
BA_ "GenSigTimeoutTime_AGSM" SG_ 2654339161 StayActiveSource_FD05_MCPB 0;
BA_ "GenSigTimeoutTime_BCM" SG_ 2654339161 StayActiveSource_FD05_MCPB 0;
BA_ "GenSigTimeoutTime_BSM" SG_ 2654339161 StayActiveSource_FD05_MCPB 0;
BA_ "GenSigTimeoutTime_CADM" SG_ 2654339161 StayActiveSource_FD05_MCPB 0;
BA_ "GenSigTimeoutTime_DMSM" SG_ 2654339161 StayActiveSource_FD05_MCPB 0;
BA_ "GenSigTimeoutTime_DTCM" SG_ 2654339161 StayActiveSource_FD05_MCPB 0;
BA_ "GenSigTimeoutTime_ECM" SG_ 2654339161 StayActiveSource_FD05_MCPB 0;
BA_ "GenSigTimeoutTime_EVCU2" SG_ 2654339161 StayActiveSource_FD05_MCPB 0;
BA_ "GenSigTimeoutTime_GNMM" SG_ 2654339161 StayActiveSource_FD05_MCPB 0;
BA_ "GenSigTimeoutTime_HCP" SG_ 2654339161 StayActiveSource_FD05_MCPB 0;
BA_ "GenSigTimeoutTime_IPC" SG_ 2654339161 StayActiveSource_FD05_MCPB 0;
BA_ "GenSigTimeoutTime_RFHM" SG_ 2654339161 StayActiveSource_FD05_MCPB 0;
BA_ "GenSigTimeoutTime_TCM" SG_ 2654339161 StayActiveSource_FD05_MCPB 0;
BA_ "GenSigTimeoutTime_AGSM" SG_ 2654339161 StayActiveSource_FD16_MCPB 0;
BA_ "GenSigTimeoutTime_BCM" SG_ 2654339161 StayActiveSource_FD16_MCPB 0;
BA_ "GenSigTimeoutTime_BSM" SG_ 2654339161 StayActiveSource_FD16_MCPB 0;
BA_ "GenSigTimeoutTime_CADM" SG_ 2654339161 StayActiveSource_FD16_MCPB 0;
BA_ "GenSigTimeoutTime_DMSM" SG_ 2654339161 StayActiveSource_FD16_MCPB 0;
BA_ "GenSigTimeoutTime_DTCM" SG_ 2654339161 StayActiveSource_FD16_MCPB 0;
BA_ "GenSigTimeoutTime_ECM" SG_ 2654339161 StayActiveSource_FD16_MCPB 0;
BA_ "GenSigTimeoutTime_EVCU2" SG_ 2654339161 StayActiveSource_FD16_MCPB 0;
BA_ "GenSigTimeoutTime_GNMM" SG_ 2654339161 StayActiveSource_FD16_MCPB 0;
BA_ "GenSigTimeoutTime_HCP" SG_ 2654339161 StayActiveSource_FD16_MCPB 0;
BA_ "GenSigTimeoutTime_IPC" SG_ 2654339161 StayActiveSource_FD16_MCPB 0;
BA_ "GenSigTimeoutTime_RFHM" SG_ 2654339161 StayActiveSource_FD16_MCPB 0;
BA_ "GenSigTimeoutTime_TCM" SG_ 2654339161 StayActiveSource_FD16_MCPB 0;
BA_ "GenSigTimeoutTime_AGSM" SG_ 2654339161 WakeupSource_FD05_MCPB 0;
BA_ "GenSigTimeoutTime_BCM" SG_ 2654339161 WakeupSource_FD05_MCPB 0;
BA_ "GenSigTimeoutTime_BSM" SG_ 2654339161 WakeupSource_FD05_MCPB 0;
BA_ "GenSigTimeoutTime_CADM" SG_ 2654339161 WakeupSource_FD05_MCPB 0;
BA_ "GenSigTimeoutTime_DMSM" SG_ 2654339161 WakeupSource_FD05_MCPB 0;
BA_ "GenSigTimeoutTime_DTCM" SG_ 2654339161 WakeupSource_FD05_MCPB 0;
BA_ "GenSigTimeoutTime_ECM" SG_ 2654339161 WakeupSource_FD05_MCPB 0;
BA_ "GenSigTimeoutTime_EVCU2" SG_ 2654339161 WakeupSource_FD05_MCPB 0;
BA_ "GenSigTimeoutTime_GNMM" SG_ 2654339161 WakeupSource_FD05_MCPB 0;
BA_ "GenSigTimeoutTime_HCP" SG_ 2654339161 WakeupSource_FD05_MCPB 0;
BA_ "GenSigTimeoutTime_IPC" SG_ 2654339161 WakeupSource_FD05_MCPB 0;
BA_ "GenSigTimeoutTime_RFHM" SG_ 2654339161 WakeupSource_FD05_MCPB 0;
BA_ "GenSigTimeoutTime_TCM" SG_ 2654339161 WakeupSource_FD05_MCPB 0;
BA_ "GenSigTimeoutTime_AGSM" SG_ 2654339161 WakeupSource_FD16_MCPB 0;
BA_ "GenSigTimeoutTime_BCM" SG_ 2654339161 WakeupSource_FD16_MCPB 0;
BA_ "GenSigTimeoutTime_BSM" SG_ 2654339161 WakeupSource_FD16_MCPB 0;
BA_ "GenSigTimeoutTime_CADM" SG_ 2654339161 WakeupSource_FD16_MCPB 0;
BA_ "GenSigTimeoutTime_DMSM" SG_ 2654339161 WakeupSource_FD16_MCPB 0;
BA_ "GenSigTimeoutTime_DTCM" SG_ 2654339161 WakeupSource_FD16_MCPB 0;
BA_ "GenSigTimeoutTime_ECM" SG_ 2654339161 WakeupSource_FD16_MCPB 0;
BA_ "GenSigTimeoutTime_EVCU2" SG_ 2654339161 WakeupSource_FD16_MCPB 0;
BA_ "GenSigTimeoutTime_GNMM" SG_ 2654339161 WakeupSource_FD16_MCPB 0;
BA_ "GenSigTimeoutTime_HCP" SG_ 2654339161 WakeupSource_FD16_MCPB 0;
BA_ "GenSigTimeoutTime_IPC" SG_ 2654339161 WakeupSource_FD16_MCPB 0;
BA_ "GenSigTimeoutTime_RFHM" SG_ 2654339161 WakeupSource_FD16_MCPB 0;
BA_ "GenSigTimeoutTime_TCM" SG_ 2654339161 WakeupSource_FD16_MCPB 0;
BA_ "GenSigTimeoutTime_AGSM" SG_ 2654339286 CurrentCanNMState_FD05_PPIM 0;
BA_ "GenSigTimeoutTime_BCM" SG_ 2654339286 CurrentCanNMState_FD05_PPIM 0;
BA_ "GenSigTimeoutTime_BSM" SG_ 2654339286 CurrentCanNMState_FD05_PPIM 0;
BA_ "GenSigTimeoutTime_CADM" SG_ 2654339286 CurrentCanNMState_FD05_PPIM 0;
BA_ "GenSigTimeoutTime_DMSM" SG_ 2654339286 CurrentCanNMState_FD05_PPIM 0;
BA_ "GenSigTimeoutTime_DTCM" SG_ 2654339286 CurrentCanNMState_FD05_PPIM 0;
BA_ "GenSigTimeoutTime_ECM" SG_ 2654339286 CurrentCanNMState_FD05_PPIM 0;
BA_ "GenSigTimeoutTime_EVCU2" SG_ 2654339286 CurrentCanNMState_FD05_PPIM 0;
BA_ "GenSigTimeoutTime_GNMM" SG_ 2654339286 CurrentCanNMState_FD05_PPIM 0;
BA_ "GenSigTimeoutTime_HCP" SG_ 2654339286 CurrentCanNMState_FD05_PPIM 0;
BA_ "GenSigTimeoutTime_IPC" SG_ 2654339286 CurrentCanNMState_FD05_PPIM 0;
BA_ "GenSigTimeoutTime_RFHM" SG_ 2654339286 CurrentCanNMState_FD05_PPIM 0;
BA_ "GenSigTimeoutTime_SGW" SG_ 2654339286 CurrentCanNMState_FD05_PPIM 0;
BA_ "GenSigTimeoutTime_TCM" SG_ 2654339286 CurrentCanNMState_FD05_PPIM 0;
BA_ "GenSigTimeoutTime_AGSM" SG_ 2654339286 CurrentCanNMState_FD11_PPIM 0;
BA_ "GenSigTimeoutTime_BCM" SG_ 2654339286 CurrentCanNMState_FD11_PPIM 0;
BA_ "GenSigTimeoutTime_BSM" SG_ 2654339286 CurrentCanNMState_FD11_PPIM 0;
BA_ "GenSigTimeoutTime_CADM" SG_ 2654339286 CurrentCanNMState_FD11_PPIM 0;
BA_ "GenSigTimeoutTime_DMSM" SG_ 2654339286 CurrentCanNMState_FD11_PPIM 0;
BA_ "GenSigTimeoutTime_DTCM" SG_ 2654339286 CurrentCanNMState_FD11_PPIM 0;
BA_ "GenSigTimeoutTime_ECM" SG_ 2654339286 CurrentCanNMState_FD11_PPIM 0;
BA_ "GenSigTimeoutTime_EVCU2" SG_ 2654339286 CurrentCanNMState_FD11_PPIM 0;
BA_ "GenSigTimeoutTime_GNMM" SG_ 2654339286 CurrentCanNMState_FD11_PPIM 0;
BA_ "GenSigTimeoutTime_HCP" SG_ 2654339286 CurrentCanNMState_FD11_PPIM 0;
BA_ "GenSigTimeoutTime_IPC" SG_ 2654339286 CurrentCanNMState_FD11_PPIM 0;
BA_ "GenSigTimeoutTime_RFHM" SG_ 2654339286 CurrentCanNMState_FD11_PPIM 0;
BA_ "GenSigTimeoutTime_SGW" SG_ 2654339286 CurrentCanNMState_FD11_PPIM 0;
BA_ "GenSigTimeoutTime_TCM" SG_ 2654339286 CurrentCanNMState_FD11_PPIM 0;
BA_ "GenSigTimeoutTime_AGSM" SG_ 2654339286 CurrentFailSts_FD05_PPIM 0;
BA_ "GenSigTimeoutTime_BCM" SG_ 2654339286 CurrentFailSts_FD05_PPIM 0;
BA_ "GenSigTimeoutTime_BSM" SG_ 2654339286 CurrentFailSts_FD05_PPIM 0;
BA_ "GenSigTimeoutTime_CADM" SG_ 2654339286 CurrentFailSts_FD05_PPIM 0;
BA_ "GenSigTimeoutTime_DMSM" SG_ 2654339286 CurrentFailSts_FD05_PPIM 0;
BA_ "GenSigTimeoutTime_DTCM" SG_ 2654339286 CurrentFailSts_FD05_PPIM 0;
BA_ "GenSigTimeoutTime_ECM" SG_ 2654339286 CurrentFailSts_FD05_PPIM 0;
BA_ "GenSigTimeoutTime_EVCU2" SG_ 2654339286 CurrentFailSts_FD05_PPIM 0;
BA_ "GenSigTimeoutTime_GNMM" SG_ 2654339286 CurrentFailSts_FD05_PPIM 0;
BA_ "GenSigTimeoutTime_HCP" SG_ 2654339286 CurrentFailSts_FD05_PPIM 0;
BA_ "GenSigTimeoutTime_IPC" SG_ 2654339286 CurrentFailSts_FD05_PPIM 0;
BA_ "GenSigTimeoutTime_RFHM" SG_ 2654339286 CurrentFailSts_FD05_PPIM 0;
BA_ "GenSigTimeoutTime_SGW" SG_ 2654339286 CurrentFailSts_FD05_PPIM 0;
BA_ "GenSigTimeoutTime_TCM" SG_ 2654339286 CurrentFailSts_FD05_PPIM 0;
BA_ "GenSigTimeoutTime_AGSM" SG_ 2654339286 CurrentFailSts_FD11_PPIM 0;
BA_ "GenSigTimeoutTime_BSM" SG_ 2654339286 CurrentFailSts_FD11_PPIM 0;
BA_ "GenSigTimeoutTime_CADM" SG_ 2654339286 CurrentFailSts_FD11_PPIM 0;
BA_ "GenSigTimeoutTime_DMSM" SG_ 2654339286 CurrentFailSts_FD11_PPIM 0;
BA_ "GenSigTimeoutTime_DTCM" SG_ 2654339286 CurrentFailSts_FD11_PPIM 0;
BA_ "GenSigTimeoutTime_ECM" SG_ 2654339286 CurrentFailSts_FD11_PPIM 0;
BA_ "GenSigTimeoutTime_EVCU2" SG_ 2654339286 CurrentFailSts_FD11_PPIM 0;
BA_ "GenSigTimeoutTime_GNMM" SG_ 2654339286 CurrentFailSts_FD11_PPIM 0;
BA_ "GenSigTimeoutTime_HCP" SG_ 2654339286 CurrentFailSts_FD11_PPIM 0;
BA_ "GenSigTimeoutTime_IPC" SG_ 2654339286 CurrentFailSts_FD11_PPIM 0;
BA_ "GenSigTimeoutTime_RFHM" SG_ 2654339286 CurrentFailSts_FD11_PPIM 0;
BA_ "GenSigTimeoutTime_SGW" SG_ 2654339286 CurrentFailSts_FD11_PPIM 0;
BA_ "GenSigTimeoutTime_TCM" SG_ 2654339286 CurrentFailSts_FD11_PPIM 0;
BA_ "GenSigTimeoutTime_AGSM" SG_ 2654339286 DES_FD05_PPIM 0;
BA_ "GenSigTimeoutTime_BCM" SG_ 2654339286 DES_FD05_PPIM 0;
BA_ "GenSigTimeoutTime_BSM" SG_ 2654339286 DES_FD05_PPIM 0;
BA_ "GenSigTimeoutTime_CADM" SG_ 2654339286 DES_FD05_PPIM 0;
BA_ "GenSigTimeoutTime_DMSM" SG_ 2654339286 DES_FD05_PPIM 0;
BA_ "GenSigTimeoutTime_DTCM" SG_ 2654339286 DES_FD05_PPIM 0;
BA_ "GenSigTimeoutTime_ECM" SG_ 2654339286 DES_FD05_PPIM 0;
BA_ "GenSigTimeoutTime_EVCU2" SG_ 2654339286 DES_FD05_PPIM 0;
BA_ "GenSigTimeoutTime_GNMM" SG_ 2654339286 DES_FD05_PPIM 0;
BA_ "GenSigTimeoutTime_HCP" SG_ 2654339286 DES_FD05_PPIM 0;
BA_ "GenSigTimeoutTime_IPC" SG_ 2654339286 DES_FD05_PPIM 0;
BA_ "GenSigTimeoutTime_RFHM" SG_ 2654339286 DES_FD05_PPIM 0;
BA_ "GenSigTimeoutTime_SGW" SG_ 2654339286 DES_FD05_PPIM 0;
BA_ "GenSigTimeoutTime_TCM" SG_ 2654339286 DES_FD05_PPIM 0;
BA_ "GenSigTimeoutTime_AGSM" SG_ 2654339286 DES_FD11_PPIM 0;
BA_ "GenSigTimeoutTime_BCM" SG_ 2654339286 DES_FD11_PPIM 0;
BA_ "GenSigTimeoutTime_BSM" SG_ 2654339286 DES_FD11_PPIM 0;
BA_ "GenSigTimeoutTime_CADM" SG_ 2654339286 DES_FD11_PPIM 0;
BA_ "GenSigTimeoutTime_DMSM" SG_ 2654339286 DES_FD11_PPIM 0;
BA_ "GenSigTimeoutTime_DTCM" SG_ 2654339286 DES_FD11_PPIM 0;
BA_ "GenSigTimeoutTime_ECM" SG_ 2654339286 DES_FD11_PPIM 0;
BA_ "GenSigTimeoutTime_EVCU2" SG_ 2654339286 DES_FD11_PPIM 0;
BA_ "GenSigTimeoutTime_GNMM" SG_ 2654339286 DES_FD11_PPIM 0;
BA_ "GenSigTimeoutTime_HCP" SG_ 2654339286 DES_FD11_PPIM 0;
BA_ "GenSigTimeoutTime_IPC" SG_ 2654339286 DES_FD11_PPIM 0;
BA_ "GenSigTimeoutTime_RFHM" SG_ 2654339286 DES_FD11_PPIM 0;
BA_ "GenSigTimeoutTime_SGW" SG_ 2654339286 DES_FD11_PPIM 0;
BA_ "GenSigTimeoutTime_TCM" SG_ 2654339286 DES_FD11_PPIM 0;
BA_ "GenSigTimeoutTime_AGSM" SG_ 2654339286 EOL_FD05_PPIM 0;
BA_ "GenSigTimeoutTime_BCM" SG_ 2654339286 EOL_FD05_PPIM 0;
BA_ "GenSigTimeoutTime_BSM" SG_ 2654339286 EOL_FD05_PPIM 0;
BA_ "GenSigTimeoutTime_CADM" SG_ 2654339286 EOL_FD05_PPIM 0;
BA_ "GenSigTimeoutTime_DMSM" SG_ 2654339286 EOL_FD05_PPIM 0;
BA_ "GenSigTimeoutTime_DTCM" SG_ 2654339286 EOL_FD05_PPIM 0;
BA_ "GenSigTimeoutTime_ECM" SG_ 2654339286 EOL_FD05_PPIM 0;
BA_ "GenSigTimeoutTime_EVCU2" SG_ 2654339286 EOL_FD05_PPIM 0;
BA_ "GenSigTimeoutTime_GNMM" SG_ 2654339286 EOL_FD05_PPIM 0;
BA_ "GenSigTimeoutTime_HCP" SG_ 2654339286 EOL_FD05_PPIM 0;
BA_ "GenSigTimeoutTime_IPC" SG_ 2654339286 EOL_FD05_PPIM 0;
BA_ "GenSigTimeoutTime_RFHM" SG_ 2654339286 EOL_FD05_PPIM 0;
BA_ "GenSigTimeoutTime_SGW" SG_ 2654339286 EOL_FD05_PPIM 0;
BA_ "GenSigTimeoutTime_TCM" SG_ 2654339286 EOL_FD05_PPIM 0;
BA_ "GenSigTimeoutTime_AGSM" SG_ 2654339286 EOL_FD11_PPIM 0;
BA_ "GenSigTimeoutTime_BSM" SG_ 2654339286 EOL_FD11_PPIM 0;
BA_ "GenSigTimeoutTime_CADM" SG_ 2654339286 EOL_FD11_PPIM 0;
BA_ "GenSigTimeoutTime_DMSM" SG_ 2654339286 EOL_FD11_PPIM 0;
BA_ "GenSigTimeoutTime_DTCM" SG_ 2654339286 EOL_FD11_PPIM 0;
BA_ "GenSigTimeoutTime_ECM" SG_ 2654339286 EOL_FD11_PPIM 0;
BA_ "GenSigTimeoutTime_EVCU2" SG_ 2654339286 EOL_FD11_PPIM 0;
BA_ "GenSigTimeoutTime_GNMM" SG_ 2654339286 EOL_FD11_PPIM 0;
BA_ "GenSigTimeoutTime_HCP" SG_ 2654339286 EOL_FD11_PPIM 0;
BA_ "GenSigTimeoutTime_IPC" SG_ 2654339286 EOL_FD11_PPIM 0;
BA_ "GenSigTimeoutTime_RFHM" SG_ 2654339286 EOL_FD11_PPIM 0;
BA_ "GenSigTimeoutTime_SGW" SG_ 2654339286 EOL_FD11_PPIM 0;
BA_ "GenSigTimeoutTime_TCM" SG_ 2654339286 EOL_FD11_PPIM 0;
BA_ "GenSigTimeoutTime_AGSM" SG_ 2654339286 GenericFailSts_FD05_PPIM 0;
BA_ "GenSigTimeoutTime_BCM" SG_ 2654339286 GenericFailSts_FD05_PPIM 0;
BA_ "GenSigTimeoutTime_BSM" SG_ 2654339286 GenericFailSts_FD05_PPIM 0;
BA_ "GenSigTimeoutTime_CADM" SG_ 2654339286 GenericFailSts_FD05_PPIM 0;
BA_ "GenSigTimeoutTime_DMSM" SG_ 2654339286 GenericFailSts_FD05_PPIM 0;
BA_ "GenSigTimeoutTime_DTCM" SG_ 2654339286 GenericFailSts_FD05_PPIM 0;
BA_ "GenSigTimeoutTime_ECM" SG_ 2654339286 GenericFailSts_FD05_PPIM 0;
BA_ "GenSigTimeoutTime_EVCU2" SG_ 2654339286 GenericFailSts_FD05_PPIM 0;
BA_ "GenSigTimeoutTime_GNMM" SG_ 2654339286 GenericFailSts_FD05_PPIM 0;
BA_ "GenSigTimeoutTime_HCP" SG_ 2654339286 GenericFailSts_FD05_PPIM 0;
BA_ "GenSigTimeoutTime_IPC" SG_ 2654339286 GenericFailSts_FD05_PPIM 0;
BA_ "GenSigTimeoutTime_RFHM" SG_ 2654339286 GenericFailSts_FD05_PPIM 0;
BA_ "GenSigTimeoutTime_SGW" SG_ 2654339286 GenericFailSts_FD05_PPIM 0;
BA_ "GenSigTimeoutTime_TCM" SG_ 2654339286 GenericFailSts_FD05_PPIM 0;
BA_ "GenSigTimeoutTime_AGSM" SG_ 2654339286 GenericFailSts_FD11_PPIM 0;
BA_ "GenSigTimeoutTime_BSM" SG_ 2654339286 GenericFailSts_FD11_PPIM 0;
BA_ "GenSigTimeoutTime_CADM" SG_ 2654339286 GenericFailSts_FD11_PPIM 0;
BA_ "GenSigTimeoutTime_DMSM" SG_ 2654339286 GenericFailSts_FD11_PPIM 0;
BA_ "GenSigTimeoutTime_DTCM" SG_ 2654339286 GenericFailSts_FD11_PPIM 0;
BA_ "GenSigTimeoutTime_ECM" SG_ 2654339286 GenericFailSts_FD11_PPIM 0;
BA_ "GenSigTimeoutTime_EVCU2" SG_ 2654339286 GenericFailSts_FD11_PPIM 0;
BA_ "GenSigTimeoutTime_GNMM" SG_ 2654339286 GenericFailSts_FD11_PPIM 0;
BA_ "GenSigTimeoutTime_HCP" SG_ 2654339286 GenericFailSts_FD11_PPIM 0;
BA_ "GenSigTimeoutTime_IPC" SG_ 2654339286 GenericFailSts_FD11_PPIM 0;
BA_ "GenSigTimeoutTime_RFHM" SG_ 2654339286 GenericFailSts_FD11_PPIM 0;
BA_ "GenSigTimeoutTime_SGW" SG_ 2654339286 GenericFailSts_FD11_PPIM 0;
BA_ "GenSigTimeoutTime_TCM" SG_ 2654339286 GenericFailSts_FD11_PPIM 0;
BA_ "GenSigTimeoutTime_AGSM" SG_ 2654339286 PreviousCanNMState_FD05_PPIM 0;
BA_ "GenSigTimeoutTime_BCM" SG_ 2654339286 PreviousCanNMState_FD05_PPIM 0;
BA_ "GenSigTimeoutTime_BSM" SG_ 2654339286 PreviousCanNMState_FD05_PPIM 0;
BA_ "GenSigTimeoutTime_CADM" SG_ 2654339286 PreviousCanNMState_FD05_PPIM 0;
BA_ "GenSigTimeoutTime_DMSM" SG_ 2654339286 PreviousCanNMState_FD05_PPIM 0;
BA_ "GenSigTimeoutTime_DTCM" SG_ 2654339286 PreviousCanNMState_FD05_PPIM 0;
BA_ "GenSigTimeoutTime_ECM" SG_ 2654339286 PreviousCanNMState_FD05_PPIM 0;
BA_ "GenSigTimeoutTime_EVCU2" SG_ 2654339286 PreviousCanNMState_FD05_PPIM 0;
BA_ "GenSigTimeoutTime_GNMM" SG_ 2654339286 PreviousCanNMState_FD05_PPIM 0;
BA_ "GenSigTimeoutTime_HCP" SG_ 2654339286 PreviousCanNMState_FD05_PPIM 0;
BA_ "GenSigTimeoutTime_IPC" SG_ 2654339286 PreviousCanNMState_FD05_PPIM 0;
BA_ "GenSigTimeoutTime_RFHM" SG_ 2654339286 PreviousCanNMState_FD05_PPIM 0;
BA_ "GenSigTimeoutTime_SGW" SG_ 2654339286 PreviousCanNMState_FD05_PPIM 0;
BA_ "GenSigTimeoutTime_TCM" SG_ 2654339286 PreviousCanNMState_FD05_PPIM 0;
BA_ "GenSigTimeoutTime_AGSM" SG_ 2654339286 PreviousCanNMState_FD11_PPIM 0;
BA_ "GenSigTimeoutTime_BCM" SG_ 2654339286 PreviousCanNMState_FD11_PPIM 0;
BA_ "GenSigTimeoutTime_BSM" SG_ 2654339286 PreviousCanNMState_FD11_PPIM 0;
BA_ "GenSigTimeoutTime_CADM" SG_ 2654339286 PreviousCanNMState_FD11_PPIM 0;
BA_ "GenSigTimeoutTime_DMSM" SG_ 2654339286 PreviousCanNMState_FD11_PPIM 0;
BA_ "GenSigTimeoutTime_DTCM" SG_ 2654339286 PreviousCanNMState_FD11_PPIM 0;
BA_ "GenSigTimeoutTime_ECM" SG_ 2654339286 PreviousCanNMState_FD11_PPIM 0;
BA_ "GenSigTimeoutTime_EVCU2" SG_ 2654339286 PreviousCanNMState_FD11_PPIM 0;
BA_ "GenSigTimeoutTime_GNMM" SG_ 2654339286 PreviousCanNMState_FD11_PPIM 0;
BA_ "GenSigTimeoutTime_HCP" SG_ 2654339286 PreviousCanNMState_FD11_PPIM 0;
BA_ "GenSigTimeoutTime_IPC" SG_ 2654339286 PreviousCanNMState_FD11_PPIM 0;
BA_ "GenSigTimeoutTime_RFHM" SG_ 2654339286 PreviousCanNMState_FD11_PPIM 0;
BA_ "GenSigTimeoutTime_SGW" SG_ 2654339286 PreviousCanNMState_FD11_PPIM 0;
BA_ "GenSigTimeoutTime_TCM" SG_ 2654339286 PreviousCanNMState_FD11_PPIM 0;
BA_ "GenSigTimeoutTime_AGSM" SG_ 2654339286 StayActiveSource_FD05_PPIM 0;
BA_ "GenSigTimeoutTime_BCM" SG_ 2654339286 StayActiveSource_FD05_PPIM 0;
BA_ "GenSigTimeoutTime_BSM" SG_ 2654339286 StayActiveSource_FD05_PPIM 0;
BA_ "GenSigTimeoutTime_CADM" SG_ 2654339286 StayActiveSource_FD05_PPIM 0;
BA_ "GenSigTimeoutTime_DMSM" SG_ 2654339286 StayActiveSource_FD05_PPIM 0;
BA_ "GenSigTimeoutTime_DTCM" SG_ 2654339286 StayActiveSource_FD05_PPIM 0;
BA_ "GenSigTimeoutTime_ECM" SG_ 2654339286 StayActiveSource_FD05_PPIM 0;
BA_ "GenSigTimeoutTime_EVCU2" SG_ 2654339286 StayActiveSource_FD05_PPIM 0;
BA_ "GenSigTimeoutTime_GNMM" SG_ 2654339286 StayActiveSource_FD05_PPIM 0;
BA_ "GenSigTimeoutTime_HCP" SG_ 2654339286 StayActiveSource_FD05_PPIM 0;
BA_ "GenSigTimeoutTime_IPC" SG_ 2654339286 StayActiveSource_FD05_PPIM 0;
BA_ "GenSigTimeoutTime_RFHM" SG_ 2654339286 StayActiveSource_FD05_PPIM 0;
BA_ "GenSigTimeoutTime_SGW" SG_ 2654339286 StayActiveSource_FD05_PPIM 0;
BA_ "GenSigTimeoutTime_TCM" SG_ 2654339286 StayActiveSource_FD05_PPIM 0;
BA_ "GenSigTimeoutTime_AGSM" SG_ 2654339286 StayActiveSource_FD11_PPIM 0;
BA_ "GenSigTimeoutTime_BCM" SG_ 2654339286 StayActiveSource_FD11_PPIM 0;
BA_ "GenSigTimeoutTime_BSM" SG_ 2654339286 StayActiveSource_FD11_PPIM 0;
BA_ "GenSigTimeoutTime_CADM" SG_ 2654339286 StayActiveSource_FD11_PPIM 0;
BA_ "GenSigTimeoutTime_DMSM" SG_ 2654339286 StayActiveSource_FD11_PPIM 0;
BA_ "GenSigTimeoutTime_DTCM" SG_ 2654339286 StayActiveSource_FD11_PPIM 0;
BA_ "GenSigTimeoutTime_ECM" SG_ 2654339286 StayActiveSource_FD11_PPIM 0;
BA_ "GenSigTimeoutTime_EVCU2" SG_ 2654339286 StayActiveSource_FD11_PPIM 0;
BA_ "GenSigTimeoutTime_GNMM" SG_ 2654339286 StayActiveSource_FD11_PPIM 0;
BA_ "GenSigTimeoutTime_HCP" SG_ 2654339286 StayActiveSource_FD11_PPIM 0;
BA_ "GenSigTimeoutTime_IPC" SG_ 2654339286 StayActiveSource_FD11_PPIM 0;
BA_ "GenSigTimeoutTime_RFHM" SG_ 2654339286 StayActiveSource_FD11_PPIM 0;
BA_ "GenSigTimeoutTime_SGW" SG_ 2654339286 StayActiveSource_FD11_PPIM 0;
BA_ "GenSigTimeoutTime_TCM" SG_ 2654339286 StayActiveSource_FD11_PPIM 0;
BA_ "GenSigTimeoutTime_AGSM" SG_ 2654339286 WakeupSource_FD05_PPIM 0;
BA_ "GenSigTimeoutTime_BCM" SG_ 2654339286 WakeupSource_FD05_PPIM 0;
BA_ "GenSigTimeoutTime_BSM" SG_ 2654339286 WakeupSource_FD05_PPIM 0;
BA_ "GenSigTimeoutTime_CADM" SG_ 2654339286 WakeupSource_FD05_PPIM 0;
BA_ "GenSigTimeoutTime_DMSM" SG_ 2654339286 WakeupSource_FD05_PPIM 0;
BA_ "GenSigTimeoutTime_DTCM" SG_ 2654339286 WakeupSource_FD05_PPIM 0;
BA_ "GenSigTimeoutTime_ECM" SG_ 2654339286 WakeupSource_FD05_PPIM 0;
BA_ "GenSigTimeoutTime_EVCU2" SG_ 2654339286 WakeupSource_FD05_PPIM 0;
BA_ "GenSigTimeoutTime_GNMM" SG_ 2654339286 WakeupSource_FD05_PPIM 0;
BA_ "GenSigTimeoutTime_HCP" SG_ 2654339286 WakeupSource_FD05_PPIM 0;
BA_ "GenSigTimeoutTime_IPC" SG_ 2654339286 WakeupSource_FD05_PPIM 0;
BA_ "GenSigTimeoutTime_RFHM" SG_ 2654339286 WakeupSource_FD05_PPIM 0;
BA_ "GenSigTimeoutTime_SGW" SG_ 2654339286 WakeupSource_FD05_PPIM 0;
BA_ "GenSigTimeoutTime_TCM" SG_ 2654339286 WakeupSource_FD05_PPIM 0;
BA_ "GenSigTimeoutTime_AGSM" SG_ 2654339286 WakeupSource_FD11_PPIM 0;
BA_ "GenSigTimeoutTime_BCM" SG_ 2654339286 WakeupSource_FD11_PPIM 0;
BA_ "GenSigTimeoutTime_BSM" SG_ 2654339286 WakeupSource_FD11_PPIM 0;
BA_ "GenSigTimeoutTime_CADM" SG_ 2654339286 WakeupSource_FD11_PPIM 0;
BA_ "GenSigTimeoutTime_DMSM" SG_ 2654339286 WakeupSource_FD11_PPIM 0;
BA_ "GenSigTimeoutTime_DTCM" SG_ 2654339286 WakeupSource_FD11_PPIM 0;
BA_ "GenSigTimeoutTime_ECM" SG_ 2654339286 WakeupSource_FD11_PPIM 0;
BA_ "GenSigTimeoutTime_EVCU2" SG_ 2654339286 WakeupSource_FD11_PPIM 0;
BA_ "GenSigTimeoutTime_GNMM" SG_ 2654339286 WakeupSource_FD11_PPIM 0;
BA_ "GenSigTimeoutTime_HCP" SG_ 2654339286 WakeupSource_FD11_PPIM 0;
BA_ "GenSigTimeoutTime_IPC" SG_ 2654339286 WakeupSource_FD11_PPIM 0;
BA_ "GenSigTimeoutTime_RFHM" SG_ 2654339286 WakeupSource_FD11_PPIM 0;
BA_ "GenSigTimeoutTime_SGW" SG_ 2654339286 WakeupSource_FD11_PPIM 0;
BA_ "GenSigTimeoutTime_TCM" SG_ 2654339286 WakeupSource_FD11_PPIM 0;
BA_ "GenSigTimeoutTime_AGSM" SG_ 2654339137 CurrentCanNMState_FD03_RFHM 0;
BA_ "GenSigTimeoutTime_BCM" SG_ 2654339137 CurrentCanNMState_FD03_RFHM 0;
BA_ "GenSigTimeoutTime_BSM" SG_ 2654339137 CurrentCanNMState_FD03_RFHM 0;
BA_ "GenSigTimeoutTime_CADM" SG_ 2654339137 CurrentCanNMState_FD03_RFHM 0;
BA_ "GenSigTimeoutTime_DMSM" SG_ 2654339137 CurrentCanNMState_FD03_RFHM 0;
BA_ "GenSigTimeoutTime_DTCM" SG_ 2654339137 CurrentCanNMState_FD03_RFHM 0;
BA_ "GenSigTimeoutTime_ECM" SG_ 2654339137 CurrentCanNMState_FD03_RFHM 0;
BA_ "GenSigTimeoutTime_EVCU2" SG_ 2654339137 CurrentCanNMState_FD03_RFHM 0;
BA_ "GenSigTimeoutTime_GNMM" SG_ 2654339137 CurrentCanNMState_FD03_RFHM 0;
BA_ "GenSigTimeoutTime_HCP" SG_ 2654339137 CurrentCanNMState_FD03_RFHM 0;
BA_ "GenSigTimeoutTime_IPC" SG_ 2654339137 CurrentCanNMState_FD03_RFHM 0;
BA_ "GenSigTimeoutTime_RFHM" SG_ 2654339137 CurrentCanNMState_FD03_RFHM 0;
BA_ "GenSigTimeoutTime_TCM" SG_ 2654339137 CurrentCanNMState_FD03_RFHM 0;
BA_ "GenSigTimeoutTime_AGSM" SG_ 2654339137 CurrentCanNMState_FD09_RFHM 0;
BA_ "GenSigTimeoutTime_BCM" SG_ 2654339137 CurrentCanNMState_FD09_RFHM 0;
BA_ "GenSigTimeoutTime_BSM" SG_ 2654339137 CurrentCanNMState_FD09_RFHM 0;
BA_ "GenSigTimeoutTime_CADM" SG_ 2654339137 CurrentCanNMState_FD09_RFHM 0;
BA_ "GenSigTimeoutTime_DMSM" SG_ 2654339137 CurrentCanNMState_FD09_RFHM 0;
BA_ "GenSigTimeoutTime_DTCM" SG_ 2654339137 CurrentCanNMState_FD09_RFHM 0;
BA_ "GenSigTimeoutTime_ECM" SG_ 2654339137 CurrentCanNMState_FD09_RFHM 0;
BA_ "GenSigTimeoutTime_EVCU2" SG_ 2654339137 CurrentCanNMState_FD09_RFHM 0;
BA_ "GenSigTimeoutTime_GNMM" SG_ 2654339137 CurrentCanNMState_FD09_RFHM 0;
BA_ "GenSigTimeoutTime_HCP" SG_ 2654339137 CurrentCanNMState_FD09_RFHM 0;
BA_ "GenSigTimeoutTime_IPC" SG_ 2654339137 CurrentCanNMState_FD09_RFHM 0;
BA_ "GenSigTimeoutTime_RFHM" SG_ 2654339137 CurrentCanNMState_FD09_RFHM 0;
BA_ "GenSigTimeoutTime_TCM" SG_ 2654339137 CurrentCanNMState_FD09_RFHM 0;
BA_ "GenSigTimeoutTime_AGSM" SG_ 2654339137 CurrentFailSts_FD03_RFHM 0;
BA_ "GenSigTimeoutTime_BSM" SG_ 2654339137 CurrentFailSts_FD03_RFHM 0;
BA_ "GenSigTimeoutTime_CADM" SG_ 2654339137 CurrentFailSts_FD03_RFHM 0;
BA_ "GenSigTimeoutTime_DMSM" SG_ 2654339137 CurrentFailSts_FD03_RFHM 0;
BA_ "GenSigTimeoutTime_DTCM" SG_ 2654339137 CurrentFailSts_FD03_RFHM 0;
BA_ "GenSigTimeoutTime_ECM" SG_ 2654339137 CurrentFailSts_FD03_RFHM 0;
BA_ "GenSigTimeoutTime_EVCU2" SG_ 2654339137 CurrentFailSts_FD03_RFHM 0;
BA_ "GenSigTimeoutTime_GNMM" SG_ 2654339137 CurrentFailSts_FD03_RFHM 0;
BA_ "GenSigTimeoutTime_HCP" SG_ 2654339137 CurrentFailSts_FD03_RFHM 0;
BA_ "GenSigTimeoutTime_IPC" SG_ 2654339137 CurrentFailSts_FD03_RFHM 0;
BA_ "GenSigTimeoutTime_RFHM" SG_ 2654339137 CurrentFailSts_FD03_RFHM 0;
BA_ "GenSigTimeoutTime_TCM" SG_ 2654339137 CurrentFailSts_FD03_RFHM 0;
BA_ "GenSigTimeoutTime_AGSM" SG_ 2654339137 CurrentFailSts_FD09_RFHM 0;
BA_ "GenSigTimeoutTime_BCM" SG_ 2654339137 CurrentFailSts_FD09_RFHM 0;
BA_ "GenSigTimeoutTime_BSM" SG_ 2654339137 CurrentFailSts_FD09_RFHM 0;
BA_ "GenSigTimeoutTime_CADM" SG_ 2654339137 CurrentFailSts_FD09_RFHM 0;
BA_ "GenSigTimeoutTime_DMSM" SG_ 2654339137 CurrentFailSts_FD09_RFHM 0;
BA_ "GenSigTimeoutTime_DTCM" SG_ 2654339137 CurrentFailSts_FD09_RFHM 0;
BA_ "GenSigTimeoutTime_ECM" SG_ 2654339137 CurrentFailSts_FD09_RFHM 0;
BA_ "GenSigTimeoutTime_EVCU2" SG_ 2654339137 CurrentFailSts_FD09_RFHM 0;
BA_ "GenSigTimeoutTime_GNMM" SG_ 2654339137 CurrentFailSts_FD09_RFHM 0;
BA_ "GenSigTimeoutTime_HCP" SG_ 2654339137 CurrentFailSts_FD09_RFHM 0;
BA_ "GenSigTimeoutTime_IPC" SG_ 2654339137 CurrentFailSts_FD09_RFHM 0;
BA_ "GenSigTimeoutTime_RFHM" SG_ 2654339137 CurrentFailSts_FD09_RFHM 0;
BA_ "GenSigTimeoutTime_TCM" SG_ 2654339137 CurrentFailSts_FD09_RFHM 0;
BA_ "GenSigTimeoutTime_AGSM" SG_ 2654339137 DES_FD03_RFHM 0;
BA_ "GenSigTimeoutTime_BCM" SG_ 2654339137 DES_FD03_RFHM 0;
BA_ "GenSigTimeoutTime_BSM" SG_ 2654339137 DES_FD03_RFHM 0;
BA_ "GenSigTimeoutTime_CADM" SG_ 2654339137 DES_FD03_RFHM 0;
BA_ "GenSigTimeoutTime_DMSM" SG_ 2654339137 DES_FD03_RFHM 0;
BA_ "GenSigTimeoutTime_DTCM" SG_ 2654339137 DES_FD03_RFHM 0;
BA_ "GenSigTimeoutTime_ECM" SG_ 2654339137 DES_FD03_RFHM 0;
BA_ "GenSigTimeoutTime_EVCU2" SG_ 2654339137 DES_FD03_RFHM 0;
BA_ "GenSigTimeoutTime_GNMM" SG_ 2654339137 DES_FD03_RFHM 0;
BA_ "GenSigTimeoutTime_HCP" SG_ 2654339137 DES_FD03_RFHM 0;
BA_ "GenSigTimeoutTime_IPC" SG_ 2654339137 DES_FD03_RFHM 0;
BA_ "GenSigTimeoutTime_RFHM" SG_ 2654339137 DES_FD03_RFHM 0;
BA_ "GenSigTimeoutTime_TCM" SG_ 2654339137 DES_FD03_RFHM 0;
BA_ "GenSigTimeoutTime_AGSM" SG_ 2654339137 DES_FD09_RFHM 0;
BA_ "GenSigTimeoutTime_BCM" SG_ 2654339137 DES_FD09_RFHM 0;
BA_ "GenSigTimeoutTime_BSM" SG_ 2654339137 DES_FD09_RFHM 0;
BA_ "GenSigTimeoutTime_CADM" SG_ 2654339137 DES_FD09_RFHM 0;
BA_ "GenSigTimeoutTime_DMSM" SG_ 2654339137 DES_FD09_RFHM 0;
BA_ "GenSigTimeoutTime_DTCM" SG_ 2654339137 DES_FD09_RFHM 0;
BA_ "GenSigTimeoutTime_ECM" SG_ 2654339137 DES_FD09_RFHM 0;
BA_ "GenSigTimeoutTime_EVCU2" SG_ 2654339137 DES_FD09_RFHM 0;
BA_ "GenSigTimeoutTime_GNMM" SG_ 2654339137 DES_FD09_RFHM 0;
BA_ "GenSigTimeoutTime_HCP" SG_ 2654339137 DES_FD09_RFHM 0;
BA_ "GenSigTimeoutTime_IPC" SG_ 2654339137 DES_FD09_RFHM 0;
BA_ "GenSigTimeoutTime_RFHM" SG_ 2654339137 DES_FD09_RFHM 0;
BA_ "GenSigTimeoutTime_TCM" SG_ 2654339137 DES_FD09_RFHM 0;
BA_ "GenSigTimeoutTime_AGSM" SG_ 2654339137 EOL_FD03_RFHM 0;
BA_ "GenSigTimeoutTime_BSM" SG_ 2654339137 EOL_FD03_RFHM 0;
BA_ "GenSigTimeoutTime_CADM" SG_ 2654339137 EOL_FD03_RFHM 0;
BA_ "GenSigTimeoutTime_DMSM" SG_ 2654339137 EOL_FD03_RFHM 0;
BA_ "GenSigTimeoutTime_DTCM" SG_ 2654339137 EOL_FD03_RFHM 0;
BA_ "GenSigTimeoutTime_ECM" SG_ 2654339137 EOL_FD03_RFHM 0;
BA_ "GenSigTimeoutTime_EVCU2" SG_ 2654339137 EOL_FD03_RFHM 0;
BA_ "GenSigTimeoutTime_GNMM" SG_ 2654339137 EOL_FD03_RFHM 0;
BA_ "GenSigTimeoutTime_HCP" SG_ 2654339137 EOL_FD03_RFHM 0;
BA_ "GenSigTimeoutTime_IPC" SG_ 2654339137 EOL_FD03_RFHM 0;
BA_ "GenSigTimeoutTime_RFHM" SG_ 2654339137 EOL_FD03_RFHM 0;
BA_ "GenSigTimeoutTime_TCM" SG_ 2654339137 EOL_FD03_RFHM 0;
BA_ "GenSigTimeoutTime_AGSM" SG_ 2654339137 EOL_FD09_RFHM 0;
BA_ "GenSigTimeoutTime_BCM" SG_ 2654339137 EOL_FD09_RFHM 0;
BA_ "GenSigTimeoutTime_BSM" SG_ 2654339137 EOL_FD09_RFHM 0;
BA_ "GenSigTimeoutTime_CADM" SG_ 2654339137 EOL_FD09_RFHM 0;
BA_ "GenSigTimeoutTime_DMSM" SG_ 2654339137 EOL_FD09_RFHM 0;
BA_ "GenSigTimeoutTime_DTCM" SG_ 2654339137 EOL_FD09_RFHM 0;
BA_ "GenSigTimeoutTime_ECM" SG_ 2654339137 EOL_FD09_RFHM 0;
BA_ "GenSigTimeoutTime_EVCU2" SG_ 2654339137 EOL_FD09_RFHM 0;
BA_ "GenSigTimeoutTime_GNMM" SG_ 2654339137 EOL_FD09_RFHM 0;
BA_ "GenSigTimeoutTime_HCP" SG_ 2654339137 EOL_FD09_RFHM 0;
BA_ "GenSigTimeoutTime_IPC" SG_ 2654339137 EOL_FD09_RFHM 0;
BA_ "GenSigTimeoutTime_RFHM" SG_ 2654339137 EOL_FD09_RFHM 0;
BA_ "GenSigTimeoutTime_TCM" SG_ 2654339137 EOL_FD09_RFHM 0;
BA_ "GenSigTimeoutTime_AGSM" SG_ 2654339137 GenericFailSts_FD03_RFHM 0;
BA_ "GenSigTimeoutTime_BSM" SG_ 2654339137 GenericFailSts_FD03_RFHM 0;
BA_ "GenSigTimeoutTime_CADM" SG_ 2654339137 GenericFailSts_FD03_RFHM 0;
BA_ "GenSigTimeoutTime_DMSM" SG_ 2654339137 GenericFailSts_FD03_RFHM 0;
BA_ "GenSigTimeoutTime_DTCM" SG_ 2654339137 GenericFailSts_FD03_RFHM 0;
BA_ "GenSigTimeoutTime_ECM" SG_ 2654339137 GenericFailSts_FD03_RFHM 0;
BA_ "GenSigTimeoutTime_EVCU2" SG_ 2654339137 GenericFailSts_FD03_RFHM 0;
BA_ "GenSigTimeoutTime_GNMM" SG_ 2654339137 GenericFailSts_FD03_RFHM 0;
BA_ "GenSigTimeoutTime_HCP" SG_ 2654339137 GenericFailSts_FD03_RFHM 0;
BA_ "GenSigTimeoutTime_IPC" SG_ 2654339137 GenericFailSts_FD03_RFHM 0;
BA_ "GenSigTimeoutTime_RFHM" SG_ 2654339137 GenericFailSts_FD03_RFHM 0;
BA_ "GenSigTimeoutTime_TCM" SG_ 2654339137 GenericFailSts_FD03_RFHM 0;
BA_ "GenSigTimeoutTime_AGSM" SG_ 2654339137 GenericFailSts_FD09_RFHM 0;
BA_ "GenSigTimeoutTime_BCM" SG_ 2654339137 GenericFailSts_FD09_RFHM 0;
BA_ "GenSigTimeoutTime_BSM" SG_ 2654339137 GenericFailSts_FD09_RFHM 0;
BA_ "GenSigTimeoutTime_CADM" SG_ 2654339137 GenericFailSts_FD09_RFHM 0;
BA_ "GenSigTimeoutTime_DMSM" SG_ 2654339137 GenericFailSts_FD09_RFHM 0;
BA_ "GenSigTimeoutTime_DTCM" SG_ 2654339137 GenericFailSts_FD09_RFHM 0;
BA_ "GenSigTimeoutTime_ECM" SG_ 2654339137 GenericFailSts_FD09_RFHM 0;
BA_ "GenSigTimeoutTime_EVCU2" SG_ 2654339137 GenericFailSts_FD09_RFHM 0;
BA_ "GenSigTimeoutTime_GNMM" SG_ 2654339137 GenericFailSts_FD09_RFHM 0;
BA_ "GenSigTimeoutTime_HCP" SG_ 2654339137 GenericFailSts_FD09_RFHM 0;
BA_ "GenSigTimeoutTime_IPC" SG_ 2654339137 GenericFailSts_FD09_RFHM 0;
BA_ "GenSigTimeoutTime_RFHM" SG_ 2654339137 GenericFailSts_FD09_RFHM 0;
BA_ "GenSigTimeoutTime_TCM" SG_ 2654339137 GenericFailSts_FD09_RFHM 0;
BA_ "GenSigTimeoutTime_AGSM" SG_ 2654339137 PreviousCanNMState_FD03_RFHM 0;
BA_ "GenSigTimeoutTime_BCM" SG_ 2654339137 PreviousCanNMState_FD03_RFHM 0;
BA_ "GenSigTimeoutTime_BSM" SG_ 2654339137 PreviousCanNMState_FD03_RFHM 0;
BA_ "GenSigTimeoutTime_CADM" SG_ 2654339137 PreviousCanNMState_FD03_RFHM 0;
BA_ "GenSigTimeoutTime_DMSM" SG_ 2654339137 PreviousCanNMState_FD03_RFHM 0;
BA_ "GenSigTimeoutTime_DTCM" SG_ 2654339137 PreviousCanNMState_FD03_RFHM 0;
BA_ "GenSigTimeoutTime_ECM" SG_ 2654339137 PreviousCanNMState_FD03_RFHM 0;
BA_ "GenSigTimeoutTime_EVCU2" SG_ 2654339137 PreviousCanNMState_FD03_RFHM 0;
BA_ "GenSigTimeoutTime_GNMM" SG_ 2654339137 PreviousCanNMState_FD03_RFHM 0;
BA_ "GenSigTimeoutTime_HCP" SG_ 2654339137 PreviousCanNMState_FD03_RFHM 0;
BA_ "GenSigTimeoutTime_IPC" SG_ 2654339137 PreviousCanNMState_FD03_RFHM 0;
BA_ "GenSigTimeoutTime_RFHM" SG_ 2654339137 PreviousCanNMState_FD03_RFHM 0;
BA_ "GenSigTimeoutTime_TCM" SG_ 2654339137 PreviousCanNMState_FD03_RFHM 0;
BA_ "GenSigTimeoutTime_AGSM" SG_ 2654339137 PreviousCanNMState_FD09_RFHM 0;
BA_ "GenSigTimeoutTime_BCM" SG_ 2654339137 PreviousCanNMState_FD09_RFHM 0;
BA_ "GenSigTimeoutTime_BSM" SG_ 2654339137 PreviousCanNMState_FD09_RFHM 0;
BA_ "GenSigTimeoutTime_CADM" SG_ 2654339137 PreviousCanNMState_FD09_RFHM 0;
BA_ "GenSigTimeoutTime_DMSM" SG_ 2654339137 PreviousCanNMState_FD09_RFHM 0;
BA_ "GenSigTimeoutTime_DTCM" SG_ 2654339137 PreviousCanNMState_FD09_RFHM 0;
BA_ "GenSigTimeoutTime_ECM" SG_ 2654339137 PreviousCanNMState_FD09_RFHM 0;
BA_ "GenSigTimeoutTime_EVCU2" SG_ 2654339137 PreviousCanNMState_FD09_RFHM 0;
BA_ "GenSigTimeoutTime_GNMM" SG_ 2654339137 PreviousCanNMState_FD09_RFHM 0;
BA_ "GenSigTimeoutTime_HCP" SG_ 2654339137 PreviousCanNMState_FD09_RFHM 0;
BA_ "GenSigTimeoutTime_IPC" SG_ 2654339137 PreviousCanNMState_FD09_RFHM 0;
BA_ "GenSigTimeoutTime_RFHM" SG_ 2654339137 PreviousCanNMState_FD09_RFHM 0;
BA_ "GenSigTimeoutTime_TCM" SG_ 2654339137 PreviousCanNMState_FD09_RFHM 0;
BA_ "GenSigTimeoutTime_AGSM" SG_ 2654339137 StayActiveSource_FD03_RFHM 0;
BA_ "GenSigTimeoutTime_BCM" SG_ 2654339137 StayActiveSource_FD03_RFHM 0;
BA_ "GenSigTimeoutTime_BSM" SG_ 2654339137 StayActiveSource_FD03_RFHM 0;
BA_ "GenSigTimeoutTime_CADM" SG_ 2654339137 StayActiveSource_FD03_RFHM 0;
BA_ "GenSigTimeoutTime_DMSM" SG_ 2654339137 StayActiveSource_FD03_RFHM 0;
BA_ "GenSigTimeoutTime_DTCM" SG_ 2654339137 StayActiveSource_FD03_RFHM 0;
BA_ "GenSigTimeoutTime_ECM" SG_ 2654339137 StayActiveSource_FD03_RFHM 0;
BA_ "GenSigTimeoutTime_EVCU2" SG_ 2654339137 StayActiveSource_FD03_RFHM 0;
BA_ "GenSigTimeoutTime_GNMM" SG_ 2654339137 StayActiveSource_FD03_RFHM 0;
BA_ "GenSigTimeoutTime_HCP" SG_ 2654339137 StayActiveSource_FD03_RFHM 0;
BA_ "GenSigTimeoutTime_IPC" SG_ 2654339137 StayActiveSource_FD03_RFHM 0;
BA_ "GenSigTimeoutTime_RFHM" SG_ 2654339137 StayActiveSource_FD03_RFHM 0;
BA_ "GenSigTimeoutTime_TCM" SG_ 2654339137 StayActiveSource_FD03_RFHM 0;
BA_ "GenSigTimeoutTime_AGSM" SG_ 2654339137 StayActiveSource_FD09_RFHM 0;
BA_ "GenSigTimeoutTime_BCM" SG_ 2654339137 StayActiveSource_FD09_RFHM 0;
BA_ "GenSigTimeoutTime_BSM" SG_ 2654339137 StayActiveSource_FD09_RFHM 0;
BA_ "GenSigTimeoutTime_CADM" SG_ 2654339137 StayActiveSource_FD09_RFHM 0;
BA_ "GenSigTimeoutTime_DMSM" SG_ 2654339137 StayActiveSource_FD09_RFHM 0;
BA_ "GenSigTimeoutTime_DTCM" SG_ 2654339137 StayActiveSource_FD09_RFHM 0;
BA_ "GenSigTimeoutTime_ECM" SG_ 2654339137 StayActiveSource_FD09_RFHM 0;
BA_ "GenSigTimeoutTime_EVCU2" SG_ 2654339137 StayActiveSource_FD09_RFHM 0;
BA_ "GenSigTimeoutTime_GNMM" SG_ 2654339137 StayActiveSource_FD09_RFHM 0;
BA_ "GenSigTimeoutTime_HCP" SG_ 2654339137 StayActiveSource_FD09_RFHM 0;
BA_ "GenSigTimeoutTime_IPC" SG_ 2654339137 StayActiveSource_FD09_RFHM 0;
BA_ "GenSigTimeoutTime_RFHM" SG_ 2654339137 StayActiveSource_FD09_RFHM 0;
BA_ "GenSigTimeoutTime_TCM" SG_ 2654339137 StayActiveSource_FD09_RFHM 0;
BA_ "GenSigTimeoutTime_AGSM" SG_ 2654339137 WakeupSource_FD03_RFHM 0;
BA_ "GenSigTimeoutTime_BCM" SG_ 2654339137 WakeupSource_FD03_RFHM 0;
BA_ "GenSigTimeoutTime_BSM" SG_ 2654339137 WakeupSource_FD03_RFHM 0;
BA_ "GenSigTimeoutTime_CADM" SG_ 2654339137 WakeupSource_FD03_RFHM 0;
BA_ "GenSigTimeoutTime_DMSM" SG_ 2654339137 WakeupSource_FD03_RFHM 0;
BA_ "GenSigTimeoutTime_DTCM" SG_ 2654339137 WakeupSource_FD03_RFHM 0;
BA_ "GenSigTimeoutTime_ECM" SG_ 2654339137 WakeupSource_FD03_RFHM 0;
BA_ "GenSigTimeoutTime_EVCU2" SG_ 2654339137 WakeupSource_FD03_RFHM 0;
BA_ "GenSigTimeoutTime_GNMM" SG_ 2654339137 WakeupSource_FD03_RFHM 0;
BA_ "GenSigTimeoutTime_HCP" SG_ 2654339137 WakeupSource_FD03_RFHM 0;
BA_ "GenSigTimeoutTime_IPC" SG_ 2654339137 WakeupSource_FD03_RFHM 0;
BA_ "GenSigTimeoutTime_RFHM" SG_ 2654339137 WakeupSource_FD03_RFHM 0;
BA_ "GenSigTimeoutTime_TCM" SG_ 2654339137 WakeupSource_FD03_RFHM 0;
BA_ "GenSigTimeoutTime_AGSM" SG_ 2654339137 WakeupSource_FD09_RFHM 0;
BA_ "GenSigTimeoutTime_BCM" SG_ 2654339137 WakeupSource_FD09_RFHM 0;
BA_ "GenSigTimeoutTime_BSM" SG_ 2654339137 WakeupSource_FD09_RFHM 0;
BA_ "GenSigTimeoutTime_CADM" SG_ 2654339137 WakeupSource_FD09_RFHM 0;
BA_ "GenSigTimeoutTime_DMSM" SG_ 2654339137 WakeupSource_FD09_RFHM 0;
BA_ "GenSigTimeoutTime_DTCM" SG_ 2654339137 WakeupSource_FD09_RFHM 0;
BA_ "GenSigTimeoutTime_ECM" SG_ 2654339137 WakeupSource_FD09_RFHM 0;
BA_ "GenSigTimeoutTime_EVCU2" SG_ 2654339137 WakeupSource_FD09_RFHM 0;
BA_ "GenSigTimeoutTime_GNMM" SG_ 2654339137 WakeupSource_FD09_RFHM 0;
BA_ "GenSigTimeoutTime_HCP" SG_ 2654339137 WakeupSource_FD09_RFHM 0;
BA_ "GenSigTimeoutTime_IPC" SG_ 2654339137 WakeupSource_FD09_RFHM 0;
BA_ "GenSigTimeoutTime_RFHM" SG_ 2654339137 WakeupSource_FD09_RFHM 0;
BA_ "GenSigTimeoutTime_TCM" SG_ 2654339137 WakeupSource_FD09_RFHM 0;
BA_ "GenSigTimeoutTime_AGSM" SG_ 2654339273 CurrentCanNMState_FD05_SGCP 0;
BA_ "GenSigTimeoutTime_BCM" SG_ 2654339273 CurrentCanNMState_FD05_SGCP 0;
BA_ "GenSigTimeoutTime_BSM" SG_ 2654339273 CurrentCanNMState_FD05_SGCP 0;
BA_ "GenSigTimeoutTime_CADM" SG_ 2654339273 CurrentCanNMState_FD05_SGCP 0;
BA_ "GenSigTimeoutTime_DMSM" SG_ 2654339273 CurrentCanNMState_FD05_SGCP 0;
BA_ "GenSigTimeoutTime_DTCM" SG_ 2654339273 CurrentCanNMState_FD05_SGCP 0;
BA_ "GenSigTimeoutTime_ECM" SG_ 2654339273 CurrentCanNMState_FD05_SGCP 0;
BA_ "GenSigTimeoutTime_EVCU2" SG_ 2654339273 CurrentCanNMState_FD05_SGCP 0;
BA_ "GenSigTimeoutTime_GNMM" SG_ 2654339273 CurrentCanNMState_FD05_SGCP 0;
BA_ "GenSigTimeoutTime_HCP" SG_ 2654339273 CurrentCanNMState_FD05_SGCP 0;
BA_ "GenSigTimeoutTime_IPC" SG_ 2654339273 CurrentCanNMState_FD05_SGCP 0;
BA_ "GenSigTimeoutTime_RFHM" SG_ 2654339273 CurrentCanNMState_FD05_SGCP 0;
BA_ "GenSigTimeoutTime_TCM" SG_ 2654339273 CurrentCanNMState_FD05_SGCP 0;
BA_ "GenSigTimeoutTime_AGSM" SG_ 2654339273 CurrentCanNMState_FD16_SGCP 0;
BA_ "GenSigTimeoutTime_BCM" SG_ 2654339273 CurrentCanNMState_FD16_SGCP 0;
BA_ "GenSigTimeoutTime_BSM" SG_ 2654339273 CurrentCanNMState_FD16_SGCP 0;
BA_ "GenSigTimeoutTime_CADM" SG_ 2654339273 CurrentCanNMState_FD16_SGCP 0;
BA_ "GenSigTimeoutTime_DMSM" SG_ 2654339273 CurrentCanNMState_FD16_SGCP 0;
BA_ "GenSigTimeoutTime_DTCM" SG_ 2654339273 CurrentCanNMState_FD16_SGCP 0;
BA_ "GenSigTimeoutTime_ECM" SG_ 2654339273 CurrentCanNMState_FD16_SGCP 0;
BA_ "GenSigTimeoutTime_EVCU2" SG_ 2654339273 CurrentCanNMState_FD16_SGCP 0;
BA_ "GenSigTimeoutTime_GNMM" SG_ 2654339273 CurrentCanNMState_FD16_SGCP 0;
BA_ "GenSigTimeoutTime_HCP" SG_ 2654339273 CurrentCanNMState_FD16_SGCP 0;
BA_ "GenSigTimeoutTime_IPC" SG_ 2654339273 CurrentCanNMState_FD16_SGCP 0;
BA_ "GenSigTimeoutTime_RFHM" SG_ 2654339273 CurrentCanNMState_FD16_SGCP 0;
BA_ "GenSigTimeoutTime_TCM" SG_ 2654339273 CurrentCanNMState_FD16_SGCP 0;
BA_ "GenSigTimeoutTime_AGSM" SG_ 2654339273 CurrentFailSts_FD05_SGCP 0;
BA_ "GenSigTimeoutTime_BCM" SG_ 2654339273 CurrentFailSts_FD05_SGCP 0;
BA_ "GenSigTimeoutTime_BSM" SG_ 2654339273 CurrentFailSts_FD05_SGCP 0;
BA_ "GenSigTimeoutTime_CADM" SG_ 2654339273 CurrentFailSts_FD05_SGCP 0;
BA_ "GenSigTimeoutTime_DMSM" SG_ 2654339273 CurrentFailSts_FD05_SGCP 0;
BA_ "GenSigTimeoutTime_DTCM" SG_ 2654339273 CurrentFailSts_FD05_SGCP 0;
BA_ "GenSigTimeoutTime_ECM" SG_ 2654339273 CurrentFailSts_FD05_SGCP 0;
BA_ "GenSigTimeoutTime_EVCU2" SG_ 2654339273 CurrentFailSts_FD05_SGCP 0;
BA_ "GenSigTimeoutTime_GNMM" SG_ 2654339273 CurrentFailSts_FD05_SGCP 0;
BA_ "GenSigTimeoutTime_HCP" SG_ 2654339273 CurrentFailSts_FD05_SGCP 0;
BA_ "GenSigTimeoutTime_IPC" SG_ 2654339273 CurrentFailSts_FD05_SGCP 0;
BA_ "GenSigTimeoutTime_RFHM" SG_ 2654339273 CurrentFailSts_FD05_SGCP 0;
BA_ "GenSigTimeoutTime_TCM" SG_ 2654339273 CurrentFailSts_FD05_SGCP 0;
BA_ "GenSigTimeoutTime_AGSM" SG_ 2654339273 CurrentFailSts_FD16_SGCP 0;
BA_ "GenSigTimeoutTime_BCM" SG_ 2654339273 CurrentFailSts_FD16_SGCP 0;
BA_ "GenSigTimeoutTime_BSM" SG_ 2654339273 CurrentFailSts_FD16_SGCP 0;
BA_ "GenSigTimeoutTime_CADM" SG_ 2654339273 CurrentFailSts_FD16_SGCP 0;
BA_ "GenSigTimeoutTime_DMSM" SG_ 2654339273 CurrentFailSts_FD16_SGCP 0;
BA_ "GenSigTimeoutTime_DTCM" SG_ 2654339273 CurrentFailSts_FD16_SGCP 0;
BA_ "GenSigTimeoutTime_ECM" SG_ 2654339273 CurrentFailSts_FD16_SGCP 0;
BA_ "GenSigTimeoutTime_EVCU2" SG_ 2654339273 CurrentFailSts_FD16_SGCP 0;
BA_ "GenSigTimeoutTime_GNMM" SG_ 2654339273 CurrentFailSts_FD16_SGCP 0;
BA_ "GenSigTimeoutTime_HCP" SG_ 2654339273 CurrentFailSts_FD16_SGCP 0;
BA_ "GenSigTimeoutTime_IPC" SG_ 2654339273 CurrentFailSts_FD16_SGCP 0;
BA_ "GenSigTimeoutTime_RFHM" SG_ 2654339273 CurrentFailSts_FD16_SGCP 0;
BA_ "GenSigTimeoutTime_TCM" SG_ 2654339273 CurrentFailSts_FD16_SGCP 0;
BA_ "GenSigTimeoutTime_AGSM" SG_ 2654339273 DES_FD05_SGCP 0;
BA_ "GenSigTimeoutTime_BCM" SG_ 2654339273 DES_FD05_SGCP 0;
BA_ "GenSigTimeoutTime_BSM" SG_ 2654339273 DES_FD05_SGCP 0;
BA_ "GenSigTimeoutTime_CADM" SG_ 2654339273 DES_FD05_SGCP 0;
BA_ "GenSigTimeoutTime_DMSM" SG_ 2654339273 DES_FD05_SGCP 0;
BA_ "GenSigTimeoutTime_DTCM" SG_ 2654339273 DES_FD05_SGCP 0;
BA_ "GenSigTimeoutTime_ECM" SG_ 2654339273 DES_FD05_SGCP 0;
BA_ "GenSigTimeoutTime_EVCU2" SG_ 2654339273 DES_FD05_SGCP 0;
BA_ "GenSigTimeoutTime_GNMM" SG_ 2654339273 DES_FD05_SGCP 0;
BA_ "GenSigTimeoutTime_HCP" SG_ 2654339273 DES_FD05_SGCP 0;
BA_ "GenSigTimeoutTime_IPC" SG_ 2654339273 DES_FD05_SGCP 0;
BA_ "GenSigTimeoutTime_RFHM" SG_ 2654339273 DES_FD05_SGCP 0;
BA_ "GenSigTimeoutTime_TCM" SG_ 2654339273 DES_FD05_SGCP 0;
BA_ "GenSigTimeoutTime_AGSM" SG_ 2654339273 DES_FD16_SGCP 0;
BA_ "GenSigTimeoutTime_BCM" SG_ 2654339273 DES_FD16_SGCP 0;
BA_ "GenSigTimeoutTime_BSM" SG_ 2654339273 DES_FD16_SGCP 0;
BA_ "GenSigTimeoutTime_CADM" SG_ 2654339273 DES_FD16_SGCP 0;
BA_ "GenSigTimeoutTime_DMSM" SG_ 2654339273 DES_FD16_SGCP 0;
BA_ "GenSigTimeoutTime_DTCM" SG_ 2654339273 DES_FD16_SGCP 0;
BA_ "GenSigTimeoutTime_ECM" SG_ 2654339273 DES_FD16_SGCP 0;
BA_ "GenSigTimeoutTime_EVCU2" SG_ 2654339273 DES_FD16_SGCP 0;
BA_ "GenSigTimeoutTime_GNMM" SG_ 2654339273 DES_FD16_SGCP 0;
BA_ "GenSigTimeoutTime_HCP" SG_ 2654339273 DES_FD16_SGCP 0;
BA_ "GenSigTimeoutTime_IPC" SG_ 2654339273 DES_FD16_SGCP 0;
BA_ "GenSigTimeoutTime_RFHM" SG_ 2654339273 DES_FD16_SGCP 0;
BA_ "GenSigTimeoutTime_TCM" SG_ 2654339273 DES_FD16_SGCP 0;
BA_ "GenSigTimeoutTime_AGSM" SG_ 2654339273 EOL_FD05_SGCP 0;
BA_ "GenSigTimeoutTime_BCM" SG_ 2654339273 EOL_FD05_SGCP 0;
BA_ "GenSigTimeoutTime_BSM" SG_ 2654339273 EOL_FD05_SGCP 0;
BA_ "GenSigTimeoutTime_CADM" SG_ 2654339273 EOL_FD05_SGCP 0;
BA_ "GenSigTimeoutTime_DMSM" SG_ 2654339273 EOL_FD05_SGCP 0;
BA_ "GenSigTimeoutTime_DTCM" SG_ 2654339273 EOL_FD05_SGCP 0;
BA_ "GenSigTimeoutTime_ECM" SG_ 2654339273 EOL_FD05_SGCP 0;
BA_ "GenSigTimeoutTime_EVCU2" SG_ 2654339273 EOL_FD05_SGCP 0;
BA_ "GenSigTimeoutTime_GNMM" SG_ 2654339273 EOL_FD05_SGCP 0;
BA_ "GenSigTimeoutTime_HCP" SG_ 2654339273 EOL_FD05_SGCP 0;
BA_ "GenSigTimeoutTime_IPC" SG_ 2654339273 EOL_FD05_SGCP 0;
BA_ "GenSigTimeoutTime_RFHM" SG_ 2654339273 EOL_FD05_SGCP 0;
BA_ "GenSigTimeoutTime_TCM" SG_ 2654339273 EOL_FD05_SGCP 0;
BA_ "GenSigTimeoutTime_AGSM" SG_ 2654339273 EOL_FD16_SGCP 0;
BA_ "GenSigTimeoutTime_BCM" SG_ 2654339273 EOL_FD16_SGCP 0;
BA_ "GenSigTimeoutTime_BSM" SG_ 2654339273 EOL_FD16_SGCP 0;
BA_ "GenSigTimeoutTime_CADM" SG_ 2654339273 EOL_FD16_SGCP 0;
BA_ "GenSigTimeoutTime_DMSM" SG_ 2654339273 EOL_FD16_SGCP 0;
BA_ "GenSigTimeoutTime_DTCM" SG_ 2654339273 EOL_FD16_SGCP 0;
BA_ "GenSigTimeoutTime_ECM" SG_ 2654339273 EOL_FD16_SGCP 0;
BA_ "GenSigTimeoutTime_EVCU2" SG_ 2654339273 EOL_FD16_SGCP 0;
BA_ "GenSigTimeoutTime_GNMM" SG_ 2654339273 EOL_FD16_SGCP 0;
BA_ "GenSigTimeoutTime_HCP" SG_ 2654339273 EOL_FD16_SGCP 0;
BA_ "GenSigTimeoutTime_IPC" SG_ 2654339273 EOL_FD16_SGCP 0;
BA_ "GenSigTimeoutTime_RFHM" SG_ 2654339273 EOL_FD16_SGCP 0;
BA_ "GenSigTimeoutTime_TCM" SG_ 2654339273 EOL_FD16_SGCP 0;
BA_ "GenSigTimeoutTime_AGSM" SG_ 2654339273 GenericFailSts_FD05_SGCP 0;
BA_ "GenSigTimeoutTime_BCM" SG_ 2654339273 GenericFailSts_FD05_SGCP 0;
BA_ "GenSigTimeoutTime_BSM" SG_ 2654339273 GenericFailSts_FD05_SGCP 0;
BA_ "GenSigTimeoutTime_CADM" SG_ 2654339273 GenericFailSts_FD05_SGCP 0;
BA_ "GenSigTimeoutTime_DMSM" SG_ 2654339273 GenericFailSts_FD05_SGCP 0;
BA_ "GenSigTimeoutTime_DTCM" SG_ 2654339273 GenericFailSts_FD05_SGCP 0;
BA_ "GenSigTimeoutTime_ECM" SG_ 2654339273 GenericFailSts_FD05_SGCP 0;
BA_ "GenSigTimeoutTime_EVCU2" SG_ 2654339273 GenericFailSts_FD05_SGCP 0;
BA_ "GenSigTimeoutTime_GNMM" SG_ 2654339273 GenericFailSts_FD05_SGCP 0;
BA_ "GenSigTimeoutTime_HCP" SG_ 2654339273 GenericFailSts_FD05_SGCP 0;
BA_ "GenSigTimeoutTime_IPC" SG_ 2654339273 GenericFailSts_FD05_SGCP 0;
BA_ "GenSigTimeoutTime_RFHM" SG_ 2654339273 GenericFailSts_FD05_SGCP 0;
BA_ "GenSigTimeoutTime_TCM" SG_ 2654339273 GenericFailSts_FD05_SGCP 0;
BA_ "GenSigTimeoutTime_AGSM" SG_ 2654339273 GenericFailSts_FD16_SGCP 0;
BA_ "GenSigTimeoutTime_BCM" SG_ 2654339273 GenericFailSts_FD16_SGCP 0;
BA_ "GenSigTimeoutTime_BSM" SG_ 2654339273 GenericFailSts_FD16_SGCP 0;
BA_ "GenSigTimeoutTime_CADM" SG_ 2654339273 GenericFailSts_FD16_SGCP 0;
BA_ "GenSigTimeoutTime_DMSM" SG_ 2654339273 GenericFailSts_FD16_SGCP 0;
BA_ "GenSigTimeoutTime_DTCM" SG_ 2654339273 GenericFailSts_FD16_SGCP 0;
BA_ "GenSigTimeoutTime_ECM" SG_ 2654339273 GenericFailSts_FD16_SGCP 0;
BA_ "GenSigTimeoutTime_EVCU2" SG_ 2654339273 GenericFailSts_FD16_SGCP 0;
BA_ "GenSigTimeoutTime_GNMM" SG_ 2654339273 GenericFailSts_FD16_SGCP 0;
BA_ "GenSigTimeoutTime_HCP" SG_ 2654339273 GenericFailSts_FD16_SGCP 0;
BA_ "GenSigTimeoutTime_IPC" SG_ 2654339273 GenericFailSts_FD16_SGCP 0;
BA_ "GenSigTimeoutTime_RFHM" SG_ 2654339273 GenericFailSts_FD16_SGCP 0;
BA_ "GenSigTimeoutTime_TCM" SG_ 2654339273 GenericFailSts_FD16_SGCP 0;
BA_ "GenSigTimeoutTime_AGSM" SG_ 2654339273 PreviousCanNMState_FD05_SGCP 0;
BA_ "GenSigTimeoutTime_BCM" SG_ 2654339273 PreviousCanNMState_FD05_SGCP 0;
BA_ "GenSigTimeoutTime_BSM" SG_ 2654339273 PreviousCanNMState_FD05_SGCP 0;
BA_ "GenSigTimeoutTime_CADM" SG_ 2654339273 PreviousCanNMState_FD05_SGCP 0;
BA_ "GenSigTimeoutTime_DMSM" SG_ 2654339273 PreviousCanNMState_FD05_SGCP 0;
BA_ "GenSigTimeoutTime_DTCM" SG_ 2654339273 PreviousCanNMState_FD05_SGCP 0;
BA_ "GenSigTimeoutTime_ECM" SG_ 2654339273 PreviousCanNMState_FD05_SGCP 0;
BA_ "GenSigTimeoutTime_EVCU2" SG_ 2654339273 PreviousCanNMState_FD05_SGCP 0;
BA_ "GenSigTimeoutTime_GNMM" SG_ 2654339273 PreviousCanNMState_FD05_SGCP 0;
BA_ "GenSigTimeoutTime_HCP" SG_ 2654339273 PreviousCanNMState_FD05_SGCP 0;
BA_ "GenSigTimeoutTime_IPC" SG_ 2654339273 PreviousCanNMState_FD05_SGCP 0;
BA_ "GenSigTimeoutTime_RFHM" SG_ 2654339273 PreviousCanNMState_FD05_SGCP 0;
BA_ "GenSigTimeoutTime_TCM" SG_ 2654339273 PreviousCanNMState_FD05_SGCP 0;
BA_ "GenSigTimeoutTime_AGSM" SG_ 2654339273 PreviousCanNMState_FD16_SGCP 0;
BA_ "GenSigTimeoutTime_BCM" SG_ 2654339273 PreviousCanNMState_FD16_SGCP 0;
BA_ "GenSigTimeoutTime_BSM" SG_ 2654339273 PreviousCanNMState_FD16_SGCP 0;
BA_ "GenSigTimeoutTime_CADM" SG_ 2654339273 PreviousCanNMState_FD16_SGCP 0;
BA_ "GenSigTimeoutTime_DMSM" SG_ 2654339273 PreviousCanNMState_FD16_SGCP 0;
BA_ "GenSigTimeoutTime_DTCM" SG_ 2654339273 PreviousCanNMState_FD16_SGCP 0;
BA_ "GenSigTimeoutTime_ECM" SG_ 2654339273 PreviousCanNMState_FD16_SGCP 0;
BA_ "GenSigTimeoutTime_EVCU2" SG_ 2654339273 PreviousCanNMState_FD16_SGCP 0;
BA_ "GenSigTimeoutTime_GNMM" SG_ 2654339273 PreviousCanNMState_FD16_SGCP 0;
BA_ "GenSigTimeoutTime_HCP" SG_ 2654339273 PreviousCanNMState_FD16_SGCP 0;
BA_ "GenSigTimeoutTime_IPC" SG_ 2654339273 PreviousCanNMState_FD16_SGCP 0;
BA_ "GenSigTimeoutTime_RFHM" SG_ 2654339273 PreviousCanNMState_FD16_SGCP 0;
BA_ "GenSigTimeoutTime_TCM" SG_ 2654339273 PreviousCanNMState_FD16_SGCP 0;
BA_ "GenSigTimeoutTime_AGSM" SG_ 2654339273 StayActiveSource_FD05_SGCP 0;
BA_ "GenSigTimeoutTime_BCM" SG_ 2654339273 StayActiveSource_FD05_SGCP 0;
BA_ "GenSigTimeoutTime_BSM" SG_ 2654339273 StayActiveSource_FD05_SGCP 0;
BA_ "GenSigTimeoutTime_CADM" SG_ 2654339273 StayActiveSource_FD05_SGCP 0;
BA_ "GenSigTimeoutTime_DMSM" SG_ 2654339273 StayActiveSource_FD05_SGCP 0;
BA_ "GenSigTimeoutTime_DTCM" SG_ 2654339273 StayActiveSource_FD05_SGCP 0;
BA_ "GenSigTimeoutTime_ECM" SG_ 2654339273 StayActiveSource_FD05_SGCP 0;
BA_ "GenSigTimeoutTime_EVCU2" SG_ 2654339273 StayActiveSource_FD05_SGCP 0;
BA_ "GenSigTimeoutTime_GNMM" SG_ 2654339273 StayActiveSource_FD05_SGCP 0;
BA_ "GenSigTimeoutTime_HCP" SG_ 2654339273 StayActiveSource_FD05_SGCP 0;
BA_ "GenSigTimeoutTime_IPC" SG_ 2654339273 StayActiveSource_FD05_SGCP 0;
BA_ "GenSigTimeoutTime_RFHM" SG_ 2654339273 StayActiveSource_FD05_SGCP 0;
BA_ "GenSigTimeoutTime_TCM" SG_ 2654339273 StayActiveSource_FD05_SGCP 0;
BA_ "GenSigTimeoutTime_AGSM" SG_ 2654339273 StayActiveSource_FD16_SGCP 0;
BA_ "GenSigTimeoutTime_BCM" SG_ 2654339273 StayActiveSource_FD16_SGCP 0;
BA_ "GenSigTimeoutTime_BSM" SG_ 2654339273 StayActiveSource_FD16_SGCP 0;
BA_ "GenSigTimeoutTime_CADM" SG_ 2654339273 StayActiveSource_FD16_SGCP 0;
BA_ "GenSigTimeoutTime_DMSM" SG_ 2654339273 StayActiveSource_FD16_SGCP 0;
BA_ "GenSigTimeoutTime_DTCM" SG_ 2654339273 StayActiveSource_FD16_SGCP 0;
BA_ "GenSigTimeoutTime_ECM" SG_ 2654339273 StayActiveSource_FD16_SGCP 0;
BA_ "GenSigTimeoutTime_EVCU2" SG_ 2654339273 StayActiveSource_FD16_SGCP 0;
BA_ "GenSigTimeoutTime_GNMM" SG_ 2654339273 StayActiveSource_FD16_SGCP 0;
BA_ "GenSigTimeoutTime_HCP" SG_ 2654339273 StayActiveSource_FD16_SGCP 0;
BA_ "GenSigTimeoutTime_IPC" SG_ 2654339273 StayActiveSource_FD16_SGCP 0;
BA_ "GenSigTimeoutTime_RFHM" SG_ 2654339273 StayActiveSource_FD16_SGCP 0;
BA_ "GenSigTimeoutTime_TCM" SG_ 2654339273 StayActiveSource_FD16_SGCP 0;
BA_ "GenSigTimeoutTime_AGSM" SG_ 2654339273 WakeupSource_FD05_SGCP 0;
BA_ "GenSigTimeoutTime_BCM" SG_ 2654339273 WakeupSource_FD05_SGCP 0;
BA_ "GenSigTimeoutTime_BSM" SG_ 2654339273 WakeupSource_FD05_SGCP 0;
BA_ "GenSigTimeoutTime_CADM" SG_ 2654339273 WakeupSource_FD05_SGCP 0;
BA_ "GenSigTimeoutTime_DMSM" SG_ 2654339273 WakeupSource_FD05_SGCP 0;
BA_ "GenSigTimeoutTime_DTCM" SG_ 2654339273 WakeupSource_FD05_SGCP 0;
BA_ "GenSigTimeoutTime_ECM" SG_ 2654339273 WakeupSource_FD05_SGCP 0;
BA_ "GenSigTimeoutTime_EVCU2" SG_ 2654339273 WakeupSource_FD05_SGCP 0;
BA_ "GenSigTimeoutTime_GNMM" SG_ 2654339273 WakeupSource_FD05_SGCP 0;
BA_ "GenSigTimeoutTime_HCP" SG_ 2654339273 WakeupSource_FD05_SGCP 0;
BA_ "GenSigTimeoutTime_IPC" SG_ 2654339273 WakeupSource_FD05_SGCP 0;
BA_ "GenSigTimeoutTime_RFHM" SG_ 2654339273 WakeupSource_FD05_SGCP 0;
BA_ "GenSigTimeoutTime_TCM" SG_ 2654339273 WakeupSource_FD05_SGCP 0;
BA_ "GenSigTimeoutTime_AGSM" SG_ 2654339273 WakeupSource_FD16_SGCP 0;
BA_ "GenSigTimeoutTime_BCM" SG_ 2654339273 WakeupSource_FD16_SGCP 0;
BA_ "GenSigTimeoutTime_BSM" SG_ 2654339273 WakeupSource_FD16_SGCP 0;
BA_ "GenSigTimeoutTime_CADM" SG_ 2654339273 WakeupSource_FD16_SGCP 0;
BA_ "GenSigTimeoutTime_DMSM" SG_ 2654339273 WakeupSource_FD16_SGCP 0;
BA_ "GenSigTimeoutTime_DTCM" SG_ 2654339273 WakeupSource_FD16_SGCP 0;
BA_ "GenSigTimeoutTime_ECM" SG_ 2654339273 WakeupSource_FD16_SGCP 0;
BA_ "GenSigTimeoutTime_EVCU2" SG_ 2654339273 WakeupSource_FD16_SGCP 0;
BA_ "GenSigTimeoutTime_GNMM" SG_ 2654339273 WakeupSource_FD16_SGCP 0;
BA_ "GenSigTimeoutTime_HCP" SG_ 2654339273 WakeupSource_FD16_SGCP 0;
BA_ "GenSigTimeoutTime_IPC" SG_ 2654339273 WakeupSource_FD16_SGCP 0;
BA_ "GenSigTimeoutTime_RFHM" SG_ 2654339273 WakeupSource_FD16_SGCP 0;
BA_ "GenSigTimeoutTime_TCM" SG_ 2654339273 WakeupSource_FD16_SGCP 0;
BA_ "GenSigTimeoutTime_AGSM" SG_ 2654339184 CurrentCanNMState_FD01_SGW 0;
BA_ "GenSigTimeoutTime_BCM" SG_ 2654339184 CurrentCanNMState_FD01_SGW 0;
BA_ "GenSigTimeoutTime_BSM" SG_ 2654339184 CurrentCanNMState_FD01_SGW 0;
BA_ "GenSigTimeoutTime_CADM" SG_ 2654339184 CurrentCanNMState_FD01_SGW 0;
BA_ "GenSigTimeoutTime_DMSM" SG_ 2654339184 CurrentCanNMState_FD01_SGW 0;
BA_ "GenSigTimeoutTime_DTCM" SG_ 2654339184 CurrentCanNMState_FD01_SGW 0;
BA_ "GenSigTimeoutTime_ECM" SG_ 2654339184 CurrentCanNMState_FD01_SGW 0;
BA_ "GenSigTimeoutTime_EVCU2" SG_ 2654339184 CurrentCanNMState_FD01_SGW 0;
BA_ "GenSigTimeoutTime_GNMM" SG_ 2654339184 CurrentCanNMState_FD01_SGW 0;
BA_ "GenSigTimeoutTime_HCP" SG_ 2654339184 CurrentCanNMState_FD01_SGW 0;
BA_ "GenSigTimeoutTime_IPC" SG_ 2654339184 CurrentCanNMState_FD01_SGW 0;
BA_ "GenSigTimeoutTime_RFHM" SG_ 2654339184 CurrentCanNMState_FD01_SGW 0;
BA_ "GenSigTimeoutTime_SGW" SG_ 2654339184 CurrentCanNMState_FD01_SGW 0;
BA_ "GenSigTimeoutTime_TCM" SG_ 2654339184 CurrentCanNMState_FD01_SGW 0;
BA_ "GenSigTimeoutTime_AGSM" SG_ 2654339184 CurrentCanNMState_FD02_SGW 0;
BA_ "GenSigTimeoutTime_BCM" SG_ 2654339184 CurrentCanNMState_FD02_SGW 0;
BA_ "GenSigTimeoutTime_BSM" SG_ 2654339184 CurrentCanNMState_FD02_SGW 0;
BA_ "GenSigTimeoutTime_CADM" SG_ 2654339184 CurrentCanNMState_FD02_SGW 0;
BA_ "GenSigTimeoutTime_DMSM" SG_ 2654339184 CurrentCanNMState_FD02_SGW 0;
BA_ "GenSigTimeoutTime_DTCM" SG_ 2654339184 CurrentCanNMState_FD02_SGW 0;
BA_ "GenSigTimeoutTime_ECM" SG_ 2654339184 CurrentCanNMState_FD02_SGW 0;
BA_ "GenSigTimeoutTime_EVCU2" SG_ 2654339184 CurrentCanNMState_FD02_SGW 0;
BA_ "GenSigTimeoutTime_GNMM" SG_ 2654339184 CurrentCanNMState_FD02_SGW 0;
BA_ "GenSigTimeoutTime_HCP" SG_ 2654339184 CurrentCanNMState_FD02_SGW 0;
BA_ "GenSigTimeoutTime_IPC" SG_ 2654339184 CurrentCanNMState_FD02_SGW 0;
BA_ "GenSigTimeoutTime_RFHM" SG_ 2654339184 CurrentCanNMState_FD02_SGW 0;
BA_ "GenSigTimeoutTime_SGW" SG_ 2654339184 CurrentCanNMState_FD02_SGW 0;
BA_ "GenSigTimeoutTime_TCM" SG_ 2654339184 CurrentCanNMState_FD02_SGW 0;
BA_ "GenSigTimeoutTime_AGSM" SG_ 2654339184 CurrentCanNMState_FD03_SGW 0;
BA_ "GenSigTimeoutTime_BCM" SG_ 2654339184 CurrentCanNMState_FD03_SGW 0;
BA_ "GenSigTimeoutTime_BSM" SG_ 2654339184 CurrentCanNMState_FD03_SGW 0;
BA_ "GenSigTimeoutTime_CADM" SG_ 2654339184 CurrentCanNMState_FD03_SGW 0;
BA_ "GenSigTimeoutTime_DMSM" SG_ 2654339184 CurrentCanNMState_FD03_SGW 0;
BA_ "GenSigTimeoutTime_DTCM" SG_ 2654339184 CurrentCanNMState_FD03_SGW 0;
BA_ "GenSigTimeoutTime_ECM" SG_ 2654339184 CurrentCanNMState_FD03_SGW 0;
BA_ "GenSigTimeoutTime_EVCU2" SG_ 2654339184 CurrentCanNMState_FD03_SGW 0;
BA_ "GenSigTimeoutTime_GNMM" SG_ 2654339184 CurrentCanNMState_FD03_SGW 0;
BA_ "GenSigTimeoutTime_HCP" SG_ 2654339184 CurrentCanNMState_FD03_SGW 0;
BA_ "GenSigTimeoutTime_IPC" SG_ 2654339184 CurrentCanNMState_FD03_SGW 0;
BA_ "GenSigTimeoutTime_RFHM" SG_ 2654339184 CurrentCanNMState_FD03_SGW 0;
BA_ "GenSigTimeoutTime_SGW" SG_ 2654339184 CurrentCanNMState_FD03_SGW 0;
BA_ "GenSigTimeoutTime_TCM" SG_ 2654339184 CurrentCanNMState_FD03_SGW 0;
BA_ "GenSigTimeoutTime_AGSM" SG_ 2654339184 CurrentCanNMState_FD08_SGW 0;
BA_ "GenSigTimeoutTime_BCM" SG_ 2654339184 CurrentCanNMState_FD08_SGW 0;
BA_ "GenSigTimeoutTime_BSM" SG_ 2654339184 CurrentCanNMState_FD08_SGW 0;
BA_ "GenSigTimeoutTime_CADM" SG_ 2654339184 CurrentCanNMState_FD08_SGW 0;
BA_ "GenSigTimeoutTime_DMSM" SG_ 2654339184 CurrentCanNMState_FD08_SGW 0;
BA_ "GenSigTimeoutTime_DTCM" SG_ 2654339184 CurrentCanNMState_FD08_SGW 0;
BA_ "GenSigTimeoutTime_ECM" SG_ 2654339184 CurrentCanNMState_FD08_SGW 0;
BA_ "GenSigTimeoutTime_EVCU2" SG_ 2654339184 CurrentCanNMState_FD08_SGW 0;
BA_ "GenSigTimeoutTime_GNMM" SG_ 2654339184 CurrentCanNMState_FD08_SGW 0;
BA_ "GenSigTimeoutTime_HCP" SG_ 2654339184 CurrentCanNMState_FD08_SGW 0;
BA_ "GenSigTimeoutTime_IPC" SG_ 2654339184 CurrentCanNMState_FD08_SGW 0;
BA_ "GenSigTimeoutTime_RFHM" SG_ 2654339184 CurrentCanNMState_FD08_SGW 0;
BA_ "GenSigTimeoutTime_SGW" SG_ 2654339184 CurrentCanNMState_FD08_SGW 0;
BA_ "GenSigTimeoutTime_TCM" SG_ 2654339184 CurrentCanNMState_FD08_SGW 0;
BA_ "GenSigTimeoutTime_AGSM" SG_ 2654339184 CurrentCanNMState_FD11_SGW 0;
BA_ "GenSigTimeoutTime_BCM" SG_ 2654339184 CurrentCanNMState_FD11_SGW 0;
BA_ "GenSigTimeoutTime_BSM" SG_ 2654339184 CurrentCanNMState_FD11_SGW 0;
BA_ "GenSigTimeoutTime_CADM" SG_ 2654339184 CurrentCanNMState_FD11_SGW 0;
BA_ "GenSigTimeoutTime_DMSM" SG_ 2654339184 CurrentCanNMState_FD11_SGW 0;
BA_ "GenSigTimeoutTime_DTCM" SG_ 2654339184 CurrentCanNMState_FD11_SGW 0;
BA_ "GenSigTimeoutTime_ECM" SG_ 2654339184 CurrentCanNMState_FD11_SGW 0;
BA_ "GenSigTimeoutTime_EVCU2" SG_ 2654339184 CurrentCanNMState_FD11_SGW 0;
BA_ "GenSigTimeoutTime_GNMM" SG_ 2654339184 CurrentCanNMState_FD11_SGW 0;
BA_ "GenSigTimeoutTime_HCP" SG_ 2654339184 CurrentCanNMState_FD11_SGW 0;
BA_ "GenSigTimeoutTime_IPC" SG_ 2654339184 CurrentCanNMState_FD11_SGW 0;
BA_ "GenSigTimeoutTime_RFHM" SG_ 2654339184 CurrentCanNMState_FD11_SGW 0;
BA_ "GenSigTimeoutTime_SGW" SG_ 2654339184 CurrentCanNMState_FD11_SGW 0;
BA_ "GenSigTimeoutTime_TCM" SG_ 2654339184 CurrentCanNMState_FD11_SGW 0;
BA_ "GenSigTimeoutTime_AGSM" SG_ 2654339184 CurrentFailSts_FD01_SGW 0;
BA_ "GenSigTimeoutTime_BCM" SG_ 2654339184 CurrentFailSts_FD01_SGW 0;
BA_ "GenSigTimeoutTime_BSM" SG_ 2654339184 CurrentFailSts_FD01_SGW 0;
BA_ "GenSigTimeoutTime_CADM" SG_ 2654339184 CurrentFailSts_FD01_SGW 0;
BA_ "GenSigTimeoutTime_DMSM" SG_ 2654339184 CurrentFailSts_FD01_SGW 0;
BA_ "GenSigTimeoutTime_DTCM" SG_ 2654339184 CurrentFailSts_FD01_SGW 0;
BA_ "GenSigTimeoutTime_ECM" SG_ 2654339184 CurrentFailSts_FD01_SGW 0;
BA_ "GenSigTimeoutTime_EVCU2" SG_ 2654339184 CurrentFailSts_FD01_SGW 0;
BA_ "GenSigTimeoutTime_GNMM" SG_ 2654339184 CurrentFailSts_FD01_SGW 0;
BA_ "GenSigTimeoutTime_HCP" SG_ 2654339184 CurrentFailSts_FD01_SGW 0;
BA_ "GenSigTimeoutTime_IPC" SG_ 2654339184 CurrentFailSts_FD01_SGW 0;
BA_ "GenSigTimeoutTime_RFHM" SG_ 2654339184 CurrentFailSts_FD01_SGW 0;
BA_ "GenSigTimeoutTime_SGW" SG_ 2654339184 CurrentFailSts_FD01_SGW 0;
BA_ "GenSigTimeoutTime_TCM" SG_ 2654339184 CurrentFailSts_FD01_SGW 0;
BA_ "GenSigTimeoutTime_AGSM" SG_ 2654339184 CurrentFailSts_FD02_SGW 0;
BA_ "GenSigTimeoutTime_BCM" SG_ 2654339184 CurrentFailSts_FD02_SGW 0;
BA_ "GenSigTimeoutTime_BSM" SG_ 2654339184 CurrentFailSts_FD02_SGW 0;
BA_ "GenSigTimeoutTime_CADM" SG_ 2654339184 CurrentFailSts_FD02_SGW 0;
BA_ "GenSigTimeoutTime_DMSM" SG_ 2654339184 CurrentFailSts_FD02_SGW 0;
BA_ "GenSigTimeoutTime_DTCM" SG_ 2654339184 CurrentFailSts_FD02_SGW 0;
BA_ "GenSigTimeoutTime_ECM" SG_ 2654339184 CurrentFailSts_FD02_SGW 0;
BA_ "GenSigTimeoutTime_EVCU2" SG_ 2654339184 CurrentFailSts_FD02_SGW 0;
BA_ "GenSigTimeoutTime_GNMM" SG_ 2654339184 CurrentFailSts_FD02_SGW 0;
BA_ "GenSigTimeoutTime_HCP" SG_ 2654339184 CurrentFailSts_FD02_SGW 0;
BA_ "GenSigTimeoutTime_IPC" SG_ 2654339184 CurrentFailSts_FD02_SGW 0;
BA_ "GenSigTimeoutTime_RFHM" SG_ 2654339184 CurrentFailSts_FD02_SGW 0;
BA_ "GenSigTimeoutTime_SGW" SG_ 2654339184 CurrentFailSts_FD02_SGW 0;
BA_ "GenSigTimeoutTime_TCM" SG_ 2654339184 CurrentFailSts_FD02_SGW 0;
BA_ "GenSigTimeoutTime_AGSM" SG_ 2654339184 CurrentFailSts_FD03_SGW 0;
BA_ "GenSigTimeoutTime_BSM" SG_ 2654339184 CurrentFailSts_FD03_SGW 0;
BA_ "GenSigTimeoutTime_CADM" SG_ 2654339184 CurrentFailSts_FD03_SGW 0;
BA_ "GenSigTimeoutTime_DMSM" SG_ 2654339184 CurrentFailSts_FD03_SGW 0;
BA_ "GenSigTimeoutTime_DTCM" SG_ 2654339184 CurrentFailSts_FD03_SGW 0;
BA_ "GenSigTimeoutTime_ECM" SG_ 2654339184 CurrentFailSts_FD03_SGW 0;
BA_ "GenSigTimeoutTime_EVCU2" SG_ 2654339184 CurrentFailSts_FD03_SGW 0;
BA_ "GenSigTimeoutTime_GNMM" SG_ 2654339184 CurrentFailSts_FD03_SGW 0;
BA_ "GenSigTimeoutTime_HCP" SG_ 2654339184 CurrentFailSts_FD03_SGW 0;
BA_ "GenSigTimeoutTime_IPC" SG_ 2654339184 CurrentFailSts_FD03_SGW 0;
BA_ "GenSigTimeoutTime_RFHM" SG_ 2654339184 CurrentFailSts_FD03_SGW 0;
BA_ "GenSigTimeoutTime_SGW" SG_ 2654339184 CurrentFailSts_FD03_SGW 0;
BA_ "GenSigTimeoutTime_TCM" SG_ 2654339184 CurrentFailSts_FD03_SGW 0;
BA_ "GenSigTimeoutTime_AGSM" SG_ 2654339184 CurrentFailSts_FD08_SGW 0;
BA_ "GenSigTimeoutTime_BCM" SG_ 2654339184 CurrentFailSts_FD08_SGW 0;
BA_ "GenSigTimeoutTime_BSM" SG_ 2654339184 CurrentFailSts_FD08_SGW 0;
BA_ "GenSigTimeoutTime_CADM" SG_ 2654339184 CurrentFailSts_FD08_SGW 0;
BA_ "GenSigTimeoutTime_DMSM" SG_ 2654339184 CurrentFailSts_FD08_SGW 0;
BA_ "GenSigTimeoutTime_DTCM" SG_ 2654339184 CurrentFailSts_FD08_SGW 0;
BA_ "GenSigTimeoutTime_ECM" SG_ 2654339184 CurrentFailSts_FD08_SGW 0;
BA_ "GenSigTimeoutTime_EVCU2" SG_ 2654339184 CurrentFailSts_FD08_SGW 0;
BA_ "GenSigTimeoutTime_GNMM" SG_ 2654339184 CurrentFailSts_FD08_SGW 0;
BA_ "GenSigTimeoutTime_HCP" SG_ 2654339184 CurrentFailSts_FD08_SGW 0;
BA_ "GenSigTimeoutTime_IPC" SG_ 2654339184 CurrentFailSts_FD08_SGW 0;
BA_ "GenSigTimeoutTime_RFHM" SG_ 2654339184 CurrentFailSts_FD08_SGW 0;
BA_ "GenSigTimeoutTime_SGW" SG_ 2654339184 CurrentFailSts_FD08_SGW 0;
BA_ "GenSigTimeoutTime_TCM" SG_ 2654339184 CurrentFailSts_FD08_SGW 0;
BA_ "GenSigTimeoutTime_AGSM" SG_ 2654339184 CurrentFailSts_FD11_SGW 0;
BA_ "GenSigTimeoutTime_BCM" SG_ 2654339184 CurrentFailSts_FD11_SGW 0;
BA_ "GenSigTimeoutTime_BSM" SG_ 2654339184 CurrentFailSts_FD11_SGW 0;
BA_ "GenSigTimeoutTime_CADM" SG_ 2654339184 CurrentFailSts_FD11_SGW 0;
BA_ "GenSigTimeoutTime_DMSM" SG_ 2654339184 CurrentFailSts_FD11_SGW 0;
BA_ "GenSigTimeoutTime_DTCM" SG_ 2654339184 CurrentFailSts_FD11_SGW 0;
BA_ "GenSigTimeoutTime_ECM" SG_ 2654339184 CurrentFailSts_FD11_SGW 0;
BA_ "GenSigTimeoutTime_EVCU2" SG_ 2654339184 CurrentFailSts_FD11_SGW 0;
BA_ "GenSigTimeoutTime_GNMM" SG_ 2654339184 CurrentFailSts_FD11_SGW 0;
BA_ "GenSigTimeoutTime_HCP" SG_ 2654339184 CurrentFailSts_FD11_SGW 0;
BA_ "GenSigTimeoutTime_IPC" SG_ 2654339184 CurrentFailSts_FD11_SGW 0;
BA_ "GenSigTimeoutTime_RFHM" SG_ 2654339184 CurrentFailSts_FD11_SGW 0;
BA_ "GenSigTimeoutTime_SGW" SG_ 2654339184 CurrentFailSts_FD11_SGW 0;
BA_ "GenSigTimeoutTime_TCM" SG_ 2654339184 CurrentFailSts_FD11_SGW 0;
BA_ "GenSigTimeoutTime_AGSM" SG_ 2654339184 DES_FD01_SGW 0;
BA_ "GenSigTimeoutTime_BCM" SG_ 2654339184 DES_FD01_SGW 0;
BA_ "GenSigTimeoutTime_BSM" SG_ 2654339184 DES_FD01_SGW 0;
BA_ "GenSigTimeoutTime_CADM" SG_ 2654339184 DES_FD01_SGW 0;
BA_ "GenSigTimeoutTime_DMSM" SG_ 2654339184 DES_FD01_SGW 0;
BA_ "GenSigTimeoutTime_DTCM" SG_ 2654339184 DES_FD01_SGW 0;
BA_ "GenSigTimeoutTime_ECM" SG_ 2654339184 DES_FD01_SGW 0;
BA_ "GenSigTimeoutTime_EVCU2" SG_ 2654339184 DES_FD01_SGW 0;
BA_ "GenSigTimeoutTime_GNMM" SG_ 2654339184 DES_FD01_SGW 0;
BA_ "GenSigTimeoutTime_HCP" SG_ 2654339184 DES_FD01_SGW 0;
BA_ "GenSigTimeoutTime_IPC" SG_ 2654339184 DES_FD01_SGW 0;
BA_ "GenSigTimeoutTime_RFHM" SG_ 2654339184 DES_FD01_SGW 0;
BA_ "GenSigTimeoutTime_SGW" SG_ 2654339184 DES_FD01_SGW 0;
BA_ "GenSigTimeoutTime_TCM" SG_ 2654339184 DES_FD01_SGW 0;
BA_ "GenSigTimeoutTime_AGSM" SG_ 2654339184 DES_FD02_SGW 0;
BA_ "GenSigTimeoutTime_BCM" SG_ 2654339184 DES_FD02_SGW 0;
BA_ "GenSigTimeoutTime_BSM" SG_ 2654339184 DES_FD02_SGW 0;
BA_ "GenSigTimeoutTime_CADM" SG_ 2654339184 DES_FD02_SGW 0;
BA_ "GenSigTimeoutTime_DMSM" SG_ 2654339184 DES_FD02_SGW 0;
BA_ "GenSigTimeoutTime_DTCM" SG_ 2654339184 DES_FD02_SGW 0;
BA_ "GenSigTimeoutTime_ECM" SG_ 2654339184 DES_FD02_SGW 0;
BA_ "GenSigTimeoutTime_EVCU2" SG_ 2654339184 DES_FD02_SGW 0;
BA_ "GenSigTimeoutTime_GNMM" SG_ 2654339184 DES_FD02_SGW 0;
BA_ "GenSigTimeoutTime_HCP" SG_ 2654339184 DES_FD02_SGW 0;
BA_ "GenSigTimeoutTime_IPC" SG_ 2654339184 DES_FD02_SGW 0;
BA_ "GenSigTimeoutTime_RFHM" SG_ 2654339184 DES_FD02_SGW 0;
BA_ "GenSigTimeoutTime_SGW" SG_ 2654339184 DES_FD02_SGW 0;
BA_ "GenSigTimeoutTime_TCM" SG_ 2654339184 DES_FD02_SGW 0;
BA_ "GenSigTimeoutTime_AGSM" SG_ 2654339184 DES_FD03_SGW 0;
BA_ "GenSigTimeoutTime_BCM" SG_ 2654339184 DES_FD03_SGW 0;
BA_ "GenSigTimeoutTime_BSM" SG_ 2654339184 DES_FD03_SGW 0;
BA_ "GenSigTimeoutTime_CADM" SG_ 2654339184 DES_FD03_SGW 0;
BA_ "GenSigTimeoutTime_DMSM" SG_ 2654339184 DES_FD03_SGW 0;
BA_ "GenSigTimeoutTime_DTCM" SG_ 2654339184 DES_FD03_SGW 0;
BA_ "GenSigTimeoutTime_ECM" SG_ 2654339184 DES_FD03_SGW 0;
BA_ "GenSigTimeoutTime_EVCU2" SG_ 2654339184 DES_FD03_SGW 0;
BA_ "GenSigTimeoutTime_GNMM" SG_ 2654339184 DES_FD03_SGW 0;
BA_ "GenSigTimeoutTime_HCP" SG_ 2654339184 DES_FD03_SGW 0;
BA_ "GenSigTimeoutTime_IPC" SG_ 2654339184 DES_FD03_SGW 0;
BA_ "GenSigTimeoutTime_RFHM" SG_ 2654339184 DES_FD03_SGW 0;
BA_ "GenSigTimeoutTime_SGW" SG_ 2654339184 DES_FD03_SGW 0;
BA_ "GenSigTimeoutTime_TCM" SG_ 2654339184 DES_FD03_SGW 0;
BA_ "GenSigTimeoutTime_AGSM" SG_ 2654339184 DES_FD08_SGW 0;
BA_ "GenSigTimeoutTime_BCM" SG_ 2654339184 DES_FD08_SGW 0;
BA_ "GenSigTimeoutTime_BSM" SG_ 2654339184 DES_FD08_SGW 0;
BA_ "GenSigTimeoutTime_CADM" SG_ 2654339184 DES_FD08_SGW 0;
BA_ "GenSigTimeoutTime_DMSM" SG_ 2654339184 DES_FD08_SGW 0;
BA_ "GenSigTimeoutTime_DTCM" SG_ 2654339184 DES_FD08_SGW 0;
BA_ "GenSigTimeoutTime_ECM" SG_ 2654339184 DES_FD08_SGW 0;
BA_ "GenSigTimeoutTime_EVCU2" SG_ 2654339184 DES_FD08_SGW 0;
BA_ "GenSigTimeoutTime_GNMM" SG_ 2654339184 DES_FD08_SGW 0;
BA_ "GenSigTimeoutTime_HCP" SG_ 2654339184 DES_FD08_SGW 0;
BA_ "GenSigTimeoutTime_IPC" SG_ 2654339184 DES_FD08_SGW 0;
BA_ "GenSigTimeoutTime_RFHM" SG_ 2654339184 DES_FD08_SGW 0;
BA_ "GenSigTimeoutTime_SGW" SG_ 2654339184 DES_FD08_SGW 0;
BA_ "GenSigTimeoutTime_TCM" SG_ 2654339184 DES_FD08_SGW 0;
BA_ "GenSigTimeoutTime_AGSM" SG_ 2654339184 DES_FD11_SGW 0;
BA_ "GenSigTimeoutTime_BCM" SG_ 2654339184 DES_FD11_SGW 0;
BA_ "GenSigTimeoutTime_BSM" SG_ 2654339184 DES_FD11_SGW 0;
BA_ "GenSigTimeoutTime_CADM" SG_ 2654339184 DES_FD11_SGW 0;
BA_ "GenSigTimeoutTime_DMSM" SG_ 2654339184 DES_FD11_SGW 0;
BA_ "GenSigTimeoutTime_DTCM" SG_ 2654339184 DES_FD11_SGW 0;
BA_ "GenSigTimeoutTime_ECM" SG_ 2654339184 DES_FD11_SGW 0;
BA_ "GenSigTimeoutTime_EVCU2" SG_ 2654339184 DES_FD11_SGW 0;
BA_ "GenSigTimeoutTime_GNMM" SG_ 2654339184 DES_FD11_SGW 0;
BA_ "GenSigTimeoutTime_HCP" SG_ 2654339184 DES_FD11_SGW 0;
BA_ "GenSigTimeoutTime_IPC" SG_ 2654339184 DES_FD11_SGW 0;
BA_ "GenSigTimeoutTime_RFHM" SG_ 2654339184 DES_FD11_SGW 0;
BA_ "GenSigTimeoutTime_SGW" SG_ 2654339184 DES_FD11_SGW 0;
BA_ "GenSigTimeoutTime_TCM" SG_ 2654339184 DES_FD11_SGW 0;
BA_ "GenSigTimeoutTime_AGSM" SG_ 2654339184 EOL_FD01_SGW 0;
BA_ "GenSigTimeoutTime_BCM" SG_ 2654339184 EOL_FD01_SGW 0;
BA_ "GenSigTimeoutTime_BSM" SG_ 2654339184 EOL_FD01_SGW 0;
BA_ "GenSigTimeoutTime_CADM" SG_ 2654339184 EOL_FD01_SGW 0;
BA_ "GenSigTimeoutTime_DMSM" SG_ 2654339184 EOL_FD01_SGW 0;
BA_ "GenSigTimeoutTime_DTCM" SG_ 2654339184 EOL_FD01_SGW 0;
BA_ "GenSigTimeoutTime_ECM" SG_ 2654339184 EOL_FD01_SGW 0;
BA_ "GenSigTimeoutTime_EVCU2" SG_ 2654339184 EOL_FD01_SGW 0;
BA_ "GenSigTimeoutTime_GNMM" SG_ 2654339184 EOL_FD01_SGW 0;
BA_ "GenSigTimeoutTime_HCP" SG_ 2654339184 EOL_FD01_SGW 0;
BA_ "GenSigTimeoutTime_IPC" SG_ 2654339184 EOL_FD01_SGW 0;
BA_ "GenSigTimeoutTime_RFHM" SG_ 2654339184 EOL_FD01_SGW 0;
BA_ "GenSigTimeoutTime_SGW" SG_ 2654339184 EOL_FD01_SGW 0;
BA_ "GenSigTimeoutTime_TCM" SG_ 2654339184 EOL_FD01_SGW 0;
BA_ "GenSigTimeoutTime_AGSM" SG_ 2654339184 EOL_FD02_SGW 0;
BA_ "GenSigTimeoutTime_BCM" SG_ 2654339184 EOL_FD02_SGW 0;
BA_ "GenSigTimeoutTime_BSM" SG_ 2654339184 EOL_FD02_SGW 0;
BA_ "GenSigTimeoutTime_CADM" SG_ 2654339184 EOL_FD02_SGW 0;
BA_ "GenSigTimeoutTime_DMSM" SG_ 2654339184 EOL_FD02_SGW 0;
BA_ "GenSigTimeoutTime_DTCM" SG_ 2654339184 EOL_FD02_SGW 0;
BA_ "GenSigTimeoutTime_ECM" SG_ 2654339184 EOL_FD02_SGW 0;
BA_ "GenSigTimeoutTime_EVCU2" SG_ 2654339184 EOL_FD02_SGW 0;
BA_ "GenSigTimeoutTime_GNMM" SG_ 2654339184 EOL_FD02_SGW 0;
BA_ "GenSigTimeoutTime_HCP" SG_ 2654339184 EOL_FD02_SGW 0;
BA_ "GenSigTimeoutTime_IPC" SG_ 2654339184 EOL_FD02_SGW 0;
BA_ "GenSigTimeoutTime_RFHM" SG_ 2654339184 EOL_FD02_SGW 0;
BA_ "GenSigTimeoutTime_SGW" SG_ 2654339184 EOL_FD02_SGW 0;
BA_ "GenSigTimeoutTime_TCM" SG_ 2654339184 EOL_FD02_SGW 0;
BA_ "GenSigTimeoutTime_AGSM" SG_ 2654339184 EOL_FD03_SGW 0;
BA_ "GenSigTimeoutTime_BSM" SG_ 2654339184 EOL_FD03_SGW 0;
BA_ "GenSigTimeoutTime_CADM" SG_ 2654339184 EOL_FD03_SGW 0;
BA_ "GenSigTimeoutTime_DMSM" SG_ 2654339184 EOL_FD03_SGW 0;
BA_ "GenSigTimeoutTime_DTCM" SG_ 2654339184 EOL_FD03_SGW 0;
BA_ "GenSigTimeoutTime_ECM" SG_ 2654339184 EOL_FD03_SGW 0;
BA_ "GenSigTimeoutTime_EVCU2" SG_ 2654339184 EOL_FD03_SGW 0;
BA_ "GenSigTimeoutTime_GNMM" SG_ 2654339184 EOL_FD03_SGW 0;
BA_ "GenSigTimeoutTime_HCP" SG_ 2654339184 EOL_FD03_SGW 0;
BA_ "GenSigTimeoutTime_IPC" SG_ 2654339184 EOL_FD03_SGW 0;
BA_ "GenSigTimeoutTime_RFHM" SG_ 2654339184 EOL_FD03_SGW 0;
BA_ "GenSigTimeoutTime_SGW" SG_ 2654339184 EOL_FD03_SGW 0;
BA_ "GenSigTimeoutTime_TCM" SG_ 2654339184 EOL_FD03_SGW 0;
BA_ "GenSigTimeoutTime_AGSM" SG_ 2654339184 EOL_FD08_SGW 0;
BA_ "GenSigTimeoutTime_BCM" SG_ 2654339184 EOL_FD08_SGW 0;
BA_ "GenSigTimeoutTime_BSM" SG_ 2654339184 EOL_FD08_SGW 0;
BA_ "GenSigTimeoutTime_CADM" SG_ 2654339184 EOL_FD08_SGW 0;
BA_ "GenSigTimeoutTime_DMSM" SG_ 2654339184 EOL_FD08_SGW 0;
BA_ "GenSigTimeoutTime_DTCM" SG_ 2654339184 EOL_FD08_SGW 0;
BA_ "GenSigTimeoutTime_ECM" SG_ 2654339184 EOL_FD08_SGW 0;
BA_ "GenSigTimeoutTime_EVCU2" SG_ 2654339184 EOL_FD08_SGW 0;
BA_ "GenSigTimeoutTime_GNMM" SG_ 2654339184 EOL_FD08_SGW 0;
BA_ "GenSigTimeoutTime_HCP" SG_ 2654339184 EOL_FD08_SGW 0;
BA_ "GenSigTimeoutTime_IPC" SG_ 2654339184 EOL_FD08_SGW 0;
BA_ "GenSigTimeoutTime_RFHM" SG_ 2654339184 EOL_FD08_SGW 0;
BA_ "GenSigTimeoutTime_SGW" SG_ 2654339184 EOL_FD08_SGW 0;
BA_ "GenSigTimeoutTime_TCM" SG_ 2654339184 EOL_FD08_SGW 0;
BA_ "GenSigTimeoutTime_AGSM" SG_ 2654339184 EOL_FD11_SGW 0;
BA_ "GenSigTimeoutTime_BCM" SG_ 2654339184 EOL_FD11_SGW 0;
BA_ "GenSigTimeoutTime_BSM" SG_ 2654339184 EOL_FD11_SGW 0;
BA_ "GenSigTimeoutTime_CADM" SG_ 2654339184 EOL_FD11_SGW 0;
BA_ "GenSigTimeoutTime_DMSM" SG_ 2654339184 EOL_FD11_SGW 0;
BA_ "GenSigTimeoutTime_DTCM" SG_ 2654339184 EOL_FD11_SGW 0;
BA_ "GenSigTimeoutTime_ECM" SG_ 2654339184 EOL_FD11_SGW 0;
BA_ "GenSigTimeoutTime_EVCU2" SG_ 2654339184 EOL_FD11_SGW 0;
BA_ "GenSigTimeoutTime_GNMM" SG_ 2654339184 EOL_FD11_SGW 0;
BA_ "GenSigTimeoutTime_HCP" SG_ 2654339184 EOL_FD11_SGW 0;
BA_ "GenSigTimeoutTime_IPC" SG_ 2654339184 EOL_FD11_SGW 0;
BA_ "GenSigTimeoutTime_RFHM" SG_ 2654339184 EOL_FD11_SGW 0;
BA_ "GenSigTimeoutTime_SGW" SG_ 2654339184 EOL_FD11_SGW 0;
BA_ "GenSigTimeoutTime_TCM" SG_ 2654339184 EOL_FD11_SGW 0;
BA_ "GenSigTimeoutTime_AGSM" SG_ 2654339184 GenericFailSts_FD01_SGW 0;
BA_ "GenSigTimeoutTime_BCM" SG_ 2654339184 GenericFailSts_FD01_SGW 0;
BA_ "GenSigTimeoutTime_BSM" SG_ 2654339184 GenericFailSts_FD01_SGW 0;
BA_ "GenSigTimeoutTime_CADM" SG_ 2654339184 GenericFailSts_FD01_SGW 0;
BA_ "GenSigTimeoutTime_DMSM" SG_ 2654339184 GenericFailSts_FD01_SGW 0;
BA_ "GenSigTimeoutTime_DTCM" SG_ 2654339184 GenericFailSts_FD01_SGW 0;
BA_ "GenSigTimeoutTime_ECM" SG_ 2654339184 GenericFailSts_FD01_SGW 0;
BA_ "GenSigTimeoutTime_EVCU2" SG_ 2654339184 GenericFailSts_FD01_SGW 0;
BA_ "GenSigTimeoutTime_GNMM" SG_ 2654339184 GenericFailSts_FD01_SGW 0;
BA_ "GenSigTimeoutTime_HCP" SG_ 2654339184 GenericFailSts_FD01_SGW 0;
BA_ "GenSigTimeoutTime_IPC" SG_ 2654339184 GenericFailSts_FD01_SGW 0;
BA_ "GenSigTimeoutTime_RFHM" SG_ 2654339184 GenericFailSts_FD01_SGW 0;
BA_ "GenSigTimeoutTime_SGW" SG_ 2654339184 GenericFailSts_FD01_SGW 0;
BA_ "GenSigTimeoutTime_TCM" SG_ 2654339184 GenericFailSts_FD01_SGW 0;
BA_ "GenSigTimeoutTime_AGSM" SG_ 2654339184 GenericFailSts_FD02_SGW 0;
BA_ "GenSigTimeoutTime_BCM" SG_ 2654339184 GenericFailSts_FD02_SGW 0;
BA_ "GenSigTimeoutTime_BSM" SG_ 2654339184 GenericFailSts_FD02_SGW 0;
BA_ "GenSigTimeoutTime_CADM" SG_ 2654339184 GenericFailSts_FD02_SGW 0;
BA_ "GenSigTimeoutTime_DMSM" SG_ 2654339184 GenericFailSts_FD02_SGW 0;
BA_ "GenSigTimeoutTime_DTCM" SG_ 2654339184 GenericFailSts_FD02_SGW 0;
BA_ "GenSigTimeoutTime_ECM" SG_ 2654339184 GenericFailSts_FD02_SGW 0;
BA_ "GenSigTimeoutTime_EVCU2" SG_ 2654339184 GenericFailSts_FD02_SGW 0;
BA_ "GenSigTimeoutTime_GNMM" SG_ 2654339184 GenericFailSts_FD02_SGW 0;
BA_ "GenSigTimeoutTime_HCP" SG_ 2654339184 GenericFailSts_FD02_SGW 0;
BA_ "GenSigTimeoutTime_IPC" SG_ 2654339184 GenericFailSts_FD02_SGW 0;
BA_ "GenSigTimeoutTime_RFHM" SG_ 2654339184 GenericFailSts_FD02_SGW 0;
BA_ "GenSigTimeoutTime_SGW" SG_ 2654339184 GenericFailSts_FD02_SGW 0;
BA_ "GenSigTimeoutTime_TCM" SG_ 2654339184 GenericFailSts_FD02_SGW 0;
BA_ "GenSigTimeoutTime_AGSM" SG_ 2654339184 GenericFailSts_FD03_SGW 0;
BA_ "GenSigTimeoutTime_BSM" SG_ 2654339184 GenericFailSts_FD03_SGW 0;
BA_ "GenSigTimeoutTime_CADM" SG_ 2654339184 GenericFailSts_FD03_SGW 0;
BA_ "GenSigTimeoutTime_DMSM" SG_ 2654339184 GenericFailSts_FD03_SGW 0;
BA_ "GenSigTimeoutTime_DTCM" SG_ 2654339184 GenericFailSts_FD03_SGW 0;
BA_ "GenSigTimeoutTime_ECM" SG_ 2654339184 GenericFailSts_FD03_SGW 0;
BA_ "GenSigTimeoutTime_EVCU2" SG_ 2654339184 GenericFailSts_FD03_SGW 0;
BA_ "GenSigTimeoutTime_GNMM" SG_ 2654339184 GenericFailSts_FD03_SGW 0;
BA_ "GenSigTimeoutTime_HCP" SG_ 2654339184 GenericFailSts_FD03_SGW 0;
BA_ "GenSigTimeoutTime_IPC" SG_ 2654339184 GenericFailSts_FD03_SGW 0;
BA_ "GenSigTimeoutTime_RFHM" SG_ 2654339184 GenericFailSts_FD03_SGW 0;
BA_ "GenSigTimeoutTime_SGW" SG_ 2654339184 GenericFailSts_FD03_SGW 0;
BA_ "GenSigTimeoutTime_TCM" SG_ 2654339184 GenericFailSts_FD03_SGW 0;
BA_ "GenSigTimeoutTime_AGSM" SG_ 2654339184 GenericFailSts_FD08_SGW 0;
BA_ "GenSigTimeoutTime_BCM" SG_ 2654339184 GenericFailSts_FD08_SGW 0;
BA_ "GenSigTimeoutTime_BSM" SG_ 2654339184 GenericFailSts_FD08_SGW 0;
BA_ "GenSigTimeoutTime_CADM" SG_ 2654339184 GenericFailSts_FD08_SGW 0;
BA_ "GenSigTimeoutTime_DMSM" SG_ 2654339184 GenericFailSts_FD08_SGW 0;
BA_ "GenSigTimeoutTime_DTCM" SG_ 2654339184 GenericFailSts_FD08_SGW 0;
BA_ "GenSigTimeoutTime_ECM" SG_ 2654339184 GenericFailSts_FD08_SGW 0;
BA_ "GenSigTimeoutTime_EVCU2" SG_ 2654339184 GenericFailSts_FD08_SGW 0;
BA_ "GenSigTimeoutTime_GNMM" SG_ 2654339184 GenericFailSts_FD08_SGW 0;
BA_ "GenSigTimeoutTime_HCP" SG_ 2654339184 GenericFailSts_FD08_SGW 0;
BA_ "GenSigTimeoutTime_IPC" SG_ 2654339184 GenericFailSts_FD08_SGW 0;
BA_ "GenSigTimeoutTime_RFHM" SG_ 2654339184 GenericFailSts_FD08_SGW 0;
BA_ "GenSigTimeoutTime_SGW" SG_ 2654339184 GenericFailSts_FD08_SGW 0;
BA_ "GenSigTimeoutTime_TCM" SG_ 2654339184 GenericFailSts_FD08_SGW 0;
BA_ "GenSigTimeoutTime_AGSM" SG_ 2654339184 GenericFailSts_FD11_SGW 0;
BA_ "GenSigTimeoutTime_BCM" SG_ 2654339184 GenericFailSts_FD11_SGW 0;
BA_ "GenSigTimeoutTime_BSM" SG_ 2654339184 GenericFailSts_FD11_SGW 0;
BA_ "GenSigTimeoutTime_CADM" SG_ 2654339184 GenericFailSts_FD11_SGW 0;
BA_ "GenSigTimeoutTime_DMSM" SG_ 2654339184 GenericFailSts_FD11_SGW 0;
BA_ "GenSigTimeoutTime_DTCM" SG_ 2654339184 GenericFailSts_FD11_SGW 0;
BA_ "GenSigTimeoutTime_ECM" SG_ 2654339184 GenericFailSts_FD11_SGW 0;
BA_ "GenSigTimeoutTime_EVCU2" SG_ 2654339184 GenericFailSts_FD11_SGW 0;
BA_ "GenSigTimeoutTime_GNMM" SG_ 2654339184 GenericFailSts_FD11_SGW 0;
BA_ "GenSigTimeoutTime_HCP" SG_ 2654339184 GenericFailSts_FD11_SGW 0;
BA_ "GenSigTimeoutTime_IPC" SG_ 2654339184 GenericFailSts_FD11_SGW 0;
BA_ "GenSigTimeoutTime_RFHM" SG_ 2654339184 GenericFailSts_FD11_SGW 0;
BA_ "GenSigTimeoutTime_SGW" SG_ 2654339184 GenericFailSts_FD11_SGW 0;
BA_ "GenSigTimeoutTime_TCM" SG_ 2654339184 GenericFailSts_FD11_SGW 0;
BA_ "GenSigTimeoutTime_AGSM" SG_ 2654339184 PreviousCanNMState_FD01_SGW 0;
BA_ "GenSigTimeoutTime_BCM" SG_ 2654339184 PreviousCanNMState_FD01_SGW 0;
BA_ "GenSigTimeoutTime_BSM" SG_ 2654339184 PreviousCanNMState_FD01_SGW 0;
BA_ "GenSigTimeoutTime_CADM" SG_ 2654339184 PreviousCanNMState_FD01_SGW 0;
BA_ "GenSigTimeoutTime_DMSM" SG_ 2654339184 PreviousCanNMState_FD01_SGW 0;
BA_ "GenSigTimeoutTime_DTCM" SG_ 2654339184 PreviousCanNMState_FD01_SGW 0;
BA_ "GenSigTimeoutTime_ECM" SG_ 2654339184 PreviousCanNMState_FD01_SGW 0;
BA_ "GenSigTimeoutTime_EVCU2" SG_ 2654339184 PreviousCanNMState_FD01_SGW 0;
BA_ "GenSigTimeoutTime_GNMM" SG_ 2654339184 PreviousCanNMState_FD01_SGW 0;
BA_ "GenSigTimeoutTime_HCP" SG_ 2654339184 PreviousCanNMState_FD01_SGW 0;
BA_ "GenSigTimeoutTime_IPC" SG_ 2654339184 PreviousCanNMState_FD01_SGW 0;
BA_ "GenSigTimeoutTime_RFHM" SG_ 2654339184 PreviousCanNMState_FD01_SGW 0;
BA_ "GenSigTimeoutTime_SGW" SG_ 2654339184 PreviousCanNMState_FD01_SGW 0;
BA_ "GenSigTimeoutTime_TCM" SG_ 2654339184 PreviousCanNMState_FD01_SGW 0;
BA_ "GenSigTimeoutTime_AGSM" SG_ 2654339184 PreviousCanNMState_FD02_SGW 0;
BA_ "GenSigTimeoutTime_BCM" SG_ 2654339184 PreviousCanNMState_FD02_SGW 0;
BA_ "GenSigTimeoutTime_BSM" SG_ 2654339184 PreviousCanNMState_FD02_SGW 0;
BA_ "GenSigTimeoutTime_CADM" SG_ 2654339184 PreviousCanNMState_FD02_SGW 0;
BA_ "GenSigTimeoutTime_DMSM" SG_ 2654339184 PreviousCanNMState_FD02_SGW 0;
BA_ "GenSigTimeoutTime_DTCM" SG_ 2654339184 PreviousCanNMState_FD02_SGW 0;
BA_ "GenSigTimeoutTime_ECM" SG_ 2654339184 PreviousCanNMState_FD02_SGW 0;
BA_ "GenSigTimeoutTime_EVCU2" SG_ 2654339184 PreviousCanNMState_FD02_SGW 0;
BA_ "GenSigTimeoutTime_GNMM" SG_ 2654339184 PreviousCanNMState_FD02_SGW 0;
BA_ "GenSigTimeoutTime_HCP" SG_ 2654339184 PreviousCanNMState_FD02_SGW 0;
BA_ "GenSigTimeoutTime_IPC" SG_ 2654339184 PreviousCanNMState_FD02_SGW 0;
BA_ "GenSigTimeoutTime_RFHM" SG_ 2654339184 PreviousCanNMState_FD02_SGW 0;
BA_ "GenSigTimeoutTime_SGW" SG_ 2654339184 PreviousCanNMState_FD02_SGW 0;
BA_ "GenSigTimeoutTime_TCM" SG_ 2654339184 PreviousCanNMState_FD02_SGW 0;
BA_ "GenSigTimeoutTime_AGSM" SG_ 2654339184 PreviousCanNMState_FD03_SGW 0;
BA_ "GenSigTimeoutTime_BCM" SG_ 2654339184 PreviousCanNMState_FD03_SGW 0;
BA_ "GenSigTimeoutTime_BSM" SG_ 2654339184 PreviousCanNMState_FD03_SGW 0;
BA_ "GenSigTimeoutTime_CADM" SG_ 2654339184 PreviousCanNMState_FD03_SGW 0;
BA_ "GenSigTimeoutTime_DMSM" SG_ 2654339184 PreviousCanNMState_FD03_SGW 0;
BA_ "GenSigTimeoutTime_DTCM" SG_ 2654339184 PreviousCanNMState_FD03_SGW 0;
BA_ "GenSigTimeoutTime_ECM" SG_ 2654339184 PreviousCanNMState_FD03_SGW 0;
BA_ "GenSigTimeoutTime_EVCU2" SG_ 2654339184 PreviousCanNMState_FD03_SGW 0;
BA_ "GenSigTimeoutTime_GNMM" SG_ 2654339184 PreviousCanNMState_FD03_SGW 0;
BA_ "GenSigTimeoutTime_HCP" SG_ 2654339184 PreviousCanNMState_FD03_SGW 0;
BA_ "GenSigTimeoutTime_IPC" SG_ 2654339184 PreviousCanNMState_FD03_SGW 0;
BA_ "GenSigTimeoutTime_RFHM" SG_ 2654339184 PreviousCanNMState_FD03_SGW 0;
BA_ "GenSigTimeoutTime_SGW" SG_ 2654339184 PreviousCanNMState_FD03_SGW 0;
BA_ "GenSigTimeoutTime_TCM" SG_ 2654339184 PreviousCanNMState_FD03_SGW 0;
BA_ "GenSigTimeoutTime_AGSM" SG_ 2654339184 PreviousCanNMState_FD08_SGW 0;
BA_ "GenSigTimeoutTime_BCM" SG_ 2654339184 PreviousCanNMState_FD08_SGW 0;
BA_ "GenSigTimeoutTime_BSM" SG_ 2654339184 PreviousCanNMState_FD08_SGW 0;
BA_ "GenSigTimeoutTime_CADM" SG_ 2654339184 PreviousCanNMState_FD08_SGW 0;
BA_ "GenSigTimeoutTime_DMSM" SG_ 2654339184 PreviousCanNMState_FD08_SGW 0;
BA_ "GenSigTimeoutTime_DTCM" SG_ 2654339184 PreviousCanNMState_FD08_SGW 0;
BA_ "GenSigTimeoutTime_ECM" SG_ 2654339184 PreviousCanNMState_FD08_SGW 0;
BA_ "GenSigTimeoutTime_EVCU2" SG_ 2654339184 PreviousCanNMState_FD08_SGW 0;
BA_ "GenSigTimeoutTime_GNMM" SG_ 2654339184 PreviousCanNMState_FD08_SGW 0;
BA_ "GenSigTimeoutTime_HCP" SG_ 2654339184 PreviousCanNMState_FD08_SGW 0;
BA_ "GenSigTimeoutTime_IPC" SG_ 2654339184 PreviousCanNMState_FD08_SGW 0;
BA_ "GenSigTimeoutTime_RFHM" SG_ 2654339184 PreviousCanNMState_FD08_SGW 0;
BA_ "GenSigTimeoutTime_SGW" SG_ 2654339184 PreviousCanNMState_FD08_SGW 0;
BA_ "GenSigTimeoutTime_TCM" SG_ 2654339184 PreviousCanNMState_FD08_SGW 0;
BA_ "GenSigTimeoutTime_AGSM" SG_ 2654339184 PreviousCanNMState_FD11_SGW 0;
BA_ "GenSigTimeoutTime_BCM" SG_ 2654339184 PreviousCanNMState_FD11_SGW 0;
BA_ "GenSigTimeoutTime_BSM" SG_ 2654339184 PreviousCanNMState_FD11_SGW 0;
BA_ "GenSigTimeoutTime_CADM" SG_ 2654339184 PreviousCanNMState_FD11_SGW 0;
BA_ "GenSigTimeoutTime_DMSM" SG_ 2654339184 PreviousCanNMState_FD11_SGW 0;
BA_ "GenSigTimeoutTime_DTCM" SG_ 2654339184 PreviousCanNMState_FD11_SGW 0;
BA_ "GenSigTimeoutTime_ECM" SG_ 2654339184 PreviousCanNMState_FD11_SGW 0;
BA_ "GenSigTimeoutTime_EVCU2" SG_ 2654339184 PreviousCanNMState_FD11_SGW 0;
BA_ "GenSigTimeoutTime_GNMM" SG_ 2654339184 PreviousCanNMState_FD11_SGW 0;
BA_ "GenSigTimeoutTime_HCP" SG_ 2654339184 PreviousCanNMState_FD11_SGW 0;
BA_ "GenSigTimeoutTime_IPC" SG_ 2654339184 PreviousCanNMState_FD11_SGW 0;
BA_ "GenSigTimeoutTime_RFHM" SG_ 2654339184 PreviousCanNMState_FD11_SGW 0;
BA_ "GenSigTimeoutTime_SGW" SG_ 2654339184 PreviousCanNMState_FD11_SGW 0;
BA_ "GenSigTimeoutTime_TCM" SG_ 2654339184 PreviousCanNMState_FD11_SGW 0;
BA_ "GenSigTimeoutTime_AGSM" SG_ 2654339184 StayActiveSource_FD01_SGW 0;
BA_ "GenSigTimeoutTime_BCM" SG_ 2654339184 StayActiveSource_FD01_SGW 0;
BA_ "GenSigTimeoutTime_BSM" SG_ 2654339184 StayActiveSource_FD01_SGW 0;
BA_ "GenSigTimeoutTime_CADM" SG_ 2654339184 StayActiveSource_FD01_SGW 0;
BA_ "GenSigTimeoutTime_DMSM" SG_ 2654339184 StayActiveSource_FD01_SGW 0;
BA_ "GenSigTimeoutTime_DTCM" SG_ 2654339184 StayActiveSource_FD01_SGW 0;
BA_ "GenSigTimeoutTime_ECM" SG_ 2654339184 StayActiveSource_FD01_SGW 0;
BA_ "GenSigTimeoutTime_EVCU2" SG_ 2654339184 StayActiveSource_FD01_SGW 0;
BA_ "GenSigTimeoutTime_GNMM" SG_ 2654339184 StayActiveSource_FD01_SGW 0;
BA_ "GenSigTimeoutTime_HCP" SG_ 2654339184 StayActiveSource_FD01_SGW 0;
BA_ "GenSigTimeoutTime_IPC" SG_ 2654339184 StayActiveSource_FD01_SGW 0;
BA_ "GenSigTimeoutTime_RFHM" SG_ 2654339184 StayActiveSource_FD01_SGW 0;
BA_ "GenSigTimeoutTime_SGW" SG_ 2654339184 StayActiveSource_FD01_SGW 0;
BA_ "GenSigTimeoutTime_TCM" SG_ 2654339184 StayActiveSource_FD01_SGW 0;
BA_ "GenSigTimeoutTime_AGSM" SG_ 2654339184 StayActiveSource_FD02_SGW 0;
BA_ "GenSigTimeoutTime_BCM" SG_ 2654339184 StayActiveSource_FD02_SGW 0;
BA_ "GenSigTimeoutTime_BSM" SG_ 2654339184 StayActiveSource_FD02_SGW 0;
BA_ "GenSigTimeoutTime_CADM" SG_ 2654339184 StayActiveSource_FD02_SGW 0;
BA_ "GenSigTimeoutTime_DMSM" SG_ 2654339184 StayActiveSource_FD02_SGW 0;
BA_ "GenSigTimeoutTime_DTCM" SG_ 2654339184 StayActiveSource_FD02_SGW 0;
BA_ "GenSigTimeoutTime_ECM" SG_ 2654339184 StayActiveSource_FD02_SGW 0;
BA_ "GenSigTimeoutTime_EVCU2" SG_ 2654339184 StayActiveSource_FD02_SGW 0;
BA_ "GenSigTimeoutTime_GNMM" SG_ 2654339184 StayActiveSource_FD02_SGW 0;
BA_ "GenSigTimeoutTime_HCP" SG_ 2654339184 StayActiveSource_FD02_SGW 0;
BA_ "GenSigTimeoutTime_IPC" SG_ 2654339184 StayActiveSource_FD02_SGW 0;
BA_ "GenSigTimeoutTime_RFHM" SG_ 2654339184 StayActiveSource_FD02_SGW 0;
BA_ "GenSigTimeoutTime_SGW" SG_ 2654339184 StayActiveSource_FD02_SGW 0;
BA_ "GenSigTimeoutTime_TCM" SG_ 2654339184 StayActiveSource_FD02_SGW 0;
BA_ "GenSigTimeoutTime_AGSM" SG_ 2654339184 StayActiveSource_FD03_SGW 0;
BA_ "GenSigTimeoutTime_BCM" SG_ 2654339184 StayActiveSource_FD03_SGW 0;
BA_ "GenSigTimeoutTime_BSM" SG_ 2654339184 StayActiveSource_FD03_SGW 0;
BA_ "GenSigTimeoutTime_CADM" SG_ 2654339184 StayActiveSource_FD03_SGW 0;
BA_ "GenSigTimeoutTime_DMSM" SG_ 2654339184 StayActiveSource_FD03_SGW 0;
BA_ "GenSigTimeoutTime_DTCM" SG_ 2654339184 StayActiveSource_FD03_SGW 0;
BA_ "GenSigTimeoutTime_ECM" SG_ 2654339184 StayActiveSource_FD03_SGW 0;
BA_ "GenSigTimeoutTime_EVCU2" SG_ 2654339184 StayActiveSource_FD03_SGW 0;
BA_ "GenSigTimeoutTime_GNMM" SG_ 2654339184 StayActiveSource_FD03_SGW 0;
BA_ "GenSigTimeoutTime_HCP" SG_ 2654339184 StayActiveSource_FD03_SGW 0;
BA_ "GenSigTimeoutTime_IPC" SG_ 2654339184 StayActiveSource_FD03_SGW 0;
BA_ "GenSigTimeoutTime_RFHM" SG_ 2654339184 StayActiveSource_FD03_SGW 0;
BA_ "GenSigTimeoutTime_SGW" SG_ 2654339184 StayActiveSource_FD03_SGW 0;
BA_ "GenSigTimeoutTime_TCM" SG_ 2654339184 StayActiveSource_FD03_SGW 0;
BA_ "GenSigTimeoutTime_AGSM" SG_ 2654339184 StayActiveSource_FD08_SGW 0;
BA_ "GenSigTimeoutTime_BCM" SG_ 2654339184 StayActiveSource_FD08_SGW 0;
BA_ "GenSigTimeoutTime_BSM" SG_ 2654339184 StayActiveSource_FD08_SGW 0;
BA_ "GenSigTimeoutTime_CADM" SG_ 2654339184 StayActiveSource_FD08_SGW 0;
BA_ "GenSigTimeoutTime_DMSM" SG_ 2654339184 StayActiveSource_FD08_SGW 0;
BA_ "GenSigTimeoutTime_DTCM" SG_ 2654339184 StayActiveSource_FD08_SGW 0;
BA_ "GenSigTimeoutTime_ECM" SG_ 2654339184 StayActiveSource_FD08_SGW 0;
BA_ "GenSigTimeoutTime_EVCU2" SG_ 2654339184 StayActiveSource_FD08_SGW 0;
BA_ "GenSigTimeoutTime_GNMM" SG_ 2654339184 StayActiveSource_FD08_SGW 0;
BA_ "GenSigTimeoutTime_HCP" SG_ 2654339184 StayActiveSource_FD08_SGW 0;
BA_ "GenSigTimeoutTime_IPC" SG_ 2654339184 StayActiveSource_FD08_SGW 0;
BA_ "GenSigTimeoutTime_RFHM" SG_ 2654339184 StayActiveSource_FD08_SGW 0;
BA_ "GenSigTimeoutTime_SGW" SG_ 2654339184 StayActiveSource_FD08_SGW 0;
BA_ "GenSigTimeoutTime_TCM" SG_ 2654339184 StayActiveSource_FD08_SGW 0;
BA_ "GenSigTimeoutTime_AGSM" SG_ 2654339184 StayActiveSource_FD11_SGW 0;
BA_ "GenSigTimeoutTime_BCM" SG_ 2654339184 StayActiveSource_FD11_SGW 0;
BA_ "GenSigTimeoutTime_BSM" SG_ 2654339184 StayActiveSource_FD11_SGW 0;
BA_ "GenSigTimeoutTime_CADM" SG_ 2654339184 StayActiveSource_FD11_SGW 0;
BA_ "GenSigTimeoutTime_DMSM" SG_ 2654339184 StayActiveSource_FD11_SGW 0;
BA_ "GenSigTimeoutTime_DTCM" SG_ 2654339184 StayActiveSource_FD11_SGW 0;
BA_ "GenSigTimeoutTime_ECM" SG_ 2654339184 StayActiveSource_FD11_SGW 0;
BA_ "GenSigTimeoutTime_EVCU2" SG_ 2654339184 StayActiveSource_FD11_SGW 0;
BA_ "GenSigTimeoutTime_GNMM" SG_ 2654339184 StayActiveSource_FD11_SGW 0;
BA_ "GenSigTimeoutTime_HCP" SG_ 2654339184 StayActiveSource_FD11_SGW 0;
BA_ "GenSigTimeoutTime_IPC" SG_ 2654339184 StayActiveSource_FD11_SGW 0;
BA_ "GenSigTimeoutTime_RFHM" SG_ 2654339184 StayActiveSource_FD11_SGW 0;
BA_ "GenSigTimeoutTime_SGW" SG_ 2654339184 StayActiveSource_FD11_SGW 0;
BA_ "GenSigTimeoutTime_TCM" SG_ 2654339184 StayActiveSource_FD11_SGW 0;
BA_ "GenSigTimeoutTime_AGSM" SG_ 2654339184 WakeupSource_FD01_SGW 0;
BA_ "GenSigTimeoutTime_BCM" SG_ 2654339184 WakeupSource_FD01_SGW 0;
BA_ "GenSigTimeoutTime_BSM" SG_ 2654339184 WakeupSource_FD01_SGW 0;
BA_ "GenSigTimeoutTime_CADM" SG_ 2654339184 WakeupSource_FD01_SGW 0;
BA_ "GenSigTimeoutTime_DMSM" SG_ 2654339184 WakeupSource_FD01_SGW 0;
BA_ "GenSigTimeoutTime_DTCM" SG_ 2654339184 WakeupSource_FD01_SGW 0;
BA_ "GenSigTimeoutTime_ECM" SG_ 2654339184 WakeupSource_FD01_SGW 0;
BA_ "GenSigTimeoutTime_EVCU2" SG_ 2654339184 WakeupSource_FD01_SGW 0;
BA_ "GenSigTimeoutTime_GNMM" SG_ 2654339184 WakeupSource_FD01_SGW 0;
BA_ "GenSigTimeoutTime_HCP" SG_ 2654339184 WakeupSource_FD01_SGW 0;
BA_ "GenSigTimeoutTime_IPC" SG_ 2654339184 WakeupSource_FD01_SGW 0;
BA_ "GenSigTimeoutTime_RFHM" SG_ 2654339184 WakeupSource_FD01_SGW 0;
BA_ "GenSigTimeoutTime_SGW" SG_ 2654339184 WakeupSource_FD01_SGW 0;
BA_ "GenSigTimeoutTime_TCM" SG_ 2654339184 WakeupSource_FD01_SGW 0;
BA_ "GenSigTimeoutTime_AGSM" SG_ 2654339184 WakeupSource_FD02_SGW 0;
BA_ "GenSigTimeoutTime_BCM" SG_ 2654339184 WakeupSource_FD02_SGW 0;
BA_ "GenSigTimeoutTime_BSM" SG_ 2654339184 WakeupSource_FD02_SGW 0;
BA_ "GenSigTimeoutTime_CADM" SG_ 2654339184 WakeupSource_FD02_SGW 0;
BA_ "GenSigTimeoutTime_DMSM" SG_ 2654339184 WakeupSource_FD02_SGW 0;
BA_ "GenSigTimeoutTime_DTCM" SG_ 2654339184 WakeupSource_FD02_SGW 0;
BA_ "GenSigTimeoutTime_ECM" SG_ 2654339184 WakeupSource_FD02_SGW 0;
BA_ "GenSigTimeoutTime_EVCU2" SG_ 2654339184 WakeupSource_FD02_SGW 0;
BA_ "GenSigTimeoutTime_GNMM" SG_ 2654339184 WakeupSource_FD02_SGW 0;
BA_ "GenSigTimeoutTime_HCP" SG_ 2654339184 WakeupSource_FD02_SGW 0;
BA_ "GenSigTimeoutTime_IPC" SG_ 2654339184 WakeupSource_FD02_SGW 0;
BA_ "GenSigTimeoutTime_RFHM" SG_ 2654339184 WakeupSource_FD02_SGW 0;
BA_ "GenSigTimeoutTime_SGW" SG_ 2654339184 WakeupSource_FD02_SGW 0;
BA_ "GenSigTimeoutTime_TCM" SG_ 2654339184 WakeupSource_FD02_SGW 0;
BA_ "GenSigTimeoutTime_AGSM" SG_ 2654339184 WakeupSource_FD03_SGW 0;
BA_ "GenSigTimeoutTime_BCM" SG_ 2654339184 WakeupSource_FD03_SGW 0;
BA_ "GenSigTimeoutTime_BSM" SG_ 2654339184 WakeupSource_FD03_SGW 0;
BA_ "GenSigTimeoutTime_CADM" SG_ 2654339184 WakeupSource_FD03_SGW 0;
BA_ "GenSigTimeoutTime_DMSM" SG_ 2654339184 WakeupSource_FD03_SGW 0;
BA_ "GenSigTimeoutTime_DTCM" SG_ 2654339184 WakeupSource_FD03_SGW 0;
BA_ "GenSigTimeoutTime_ECM" SG_ 2654339184 WakeupSource_FD03_SGW 0;
BA_ "GenSigTimeoutTime_EVCU2" SG_ 2654339184 WakeupSource_FD03_SGW 0;
BA_ "GenSigTimeoutTime_GNMM" SG_ 2654339184 WakeupSource_FD03_SGW 0;
BA_ "GenSigTimeoutTime_HCP" SG_ 2654339184 WakeupSource_FD03_SGW 0;
BA_ "GenSigTimeoutTime_IPC" SG_ 2654339184 WakeupSource_FD03_SGW 0;
BA_ "GenSigTimeoutTime_RFHM" SG_ 2654339184 WakeupSource_FD03_SGW 0;
BA_ "GenSigTimeoutTime_SGW" SG_ 2654339184 WakeupSource_FD03_SGW 0;
BA_ "GenSigTimeoutTime_TCM" SG_ 2654339184 WakeupSource_FD03_SGW 0;
BA_ "GenSigTimeoutTime_AGSM" SG_ 2654339184 WakeupSource_FD08_SGW 0;
BA_ "GenSigTimeoutTime_BCM" SG_ 2654339184 WakeupSource_FD08_SGW 0;
BA_ "GenSigTimeoutTime_BSM" SG_ 2654339184 WakeupSource_FD08_SGW 0;
BA_ "GenSigTimeoutTime_CADM" SG_ 2654339184 WakeupSource_FD08_SGW 0;
BA_ "GenSigTimeoutTime_DMSM" SG_ 2654339184 WakeupSource_FD08_SGW 0;
BA_ "GenSigTimeoutTime_DTCM" SG_ 2654339184 WakeupSource_FD08_SGW 0;
BA_ "GenSigTimeoutTime_ECM" SG_ 2654339184 WakeupSource_FD08_SGW 0;
BA_ "GenSigTimeoutTime_EVCU2" SG_ 2654339184 WakeupSource_FD08_SGW 0;
BA_ "GenSigTimeoutTime_GNMM" SG_ 2654339184 WakeupSource_FD08_SGW 0;
BA_ "GenSigTimeoutTime_HCP" SG_ 2654339184 WakeupSource_FD08_SGW 0;
BA_ "GenSigTimeoutTime_IPC" SG_ 2654339184 WakeupSource_FD08_SGW 0;
BA_ "GenSigTimeoutTime_RFHM" SG_ 2654339184 WakeupSource_FD08_SGW 0;
BA_ "GenSigTimeoutTime_SGW" SG_ 2654339184 WakeupSource_FD08_SGW 0;
BA_ "GenSigTimeoutTime_TCM" SG_ 2654339184 WakeupSource_FD08_SGW 0;
BA_ "GenSigTimeoutTime_AGSM" SG_ 2654339184 WakeupSource_FD11_SGW 0;
BA_ "GenSigTimeoutTime_BCM" SG_ 2654339184 WakeupSource_FD11_SGW 0;
BA_ "GenSigTimeoutTime_BSM" SG_ 2654339184 WakeupSource_FD11_SGW 0;
BA_ "GenSigTimeoutTime_CADM" SG_ 2654339184 WakeupSource_FD11_SGW 0;
BA_ "GenSigTimeoutTime_DMSM" SG_ 2654339184 WakeupSource_FD11_SGW 0;
BA_ "GenSigTimeoutTime_DTCM" SG_ 2654339184 WakeupSource_FD11_SGW 0;
BA_ "GenSigTimeoutTime_ECM" SG_ 2654339184 WakeupSource_FD11_SGW 0;
BA_ "GenSigTimeoutTime_EVCU2" SG_ 2654339184 WakeupSource_FD11_SGW 0;
BA_ "GenSigTimeoutTime_GNMM" SG_ 2654339184 WakeupSource_FD11_SGW 0;
BA_ "GenSigTimeoutTime_HCP" SG_ 2654339184 WakeupSource_FD11_SGW 0;
BA_ "GenSigTimeoutTime_IPC" SG_ 2654339184 WakeupSource_FD11_SGW 0;
BA_ "GenSigTimeoutTime_RFHM" SG_ 2654339184 WakeupSource_FD11_SGW 0;
BA_ "GenSigTimeoutTime_SGW" SG_ 2654339184 WakeupSource_FD11_SGW 0;
BA_ "GenSigTimeoutTime_TCM" SG_ 2654339184 WakeupSource_FD11_SGW 0;
BA_ "GenSigTimeoutTime_AGSM" SG_ 2654339107 CurrentCanNMState_FD08_TBM 0;
BA_ "GenSigTimeoutTime_BCM" SG_ 2654339107 CurrentCanNMState_FD08_TBM 0;
BA_ "GenSigTimeoutTime_BSM" SG_ 2654339107 CurrentCanNMState_FD08_TBM 0;
BA_ "GenSigTimeoutTime_CADM" SG_ 2654339107 CurrentCanNMState_FD08_TBM 0;
BA_ "GenSigTimeoutTime_DMSM" SG_ 2654339107 CurrentCanNMState_FD08_TBM 0;
BA_ "GenSigTimeoutTime_DTCM" SG_ 2654339107 CurrentCanNMState_FD08_TBM 0;
BA_ "GenSigTimeoutTime_ECM" SG_ 2654339107 CurrentCanNMState_FD08_TBM 0;
BA_ "GenSigTimeoutTime_EVCU2" SG_ 2654339107 CurrentCanNMState_FD08_TBM 0;
BA_ "GenSigTimeoutTime_GNMM" SG_ 2654339107 CurrentCanNMState_FD08_TBM 0;
BA_ "GenSigTimeoutTime_HCP" SG_ 2654339107 CurrentCanNMState_FD08_TBM 0;
BA_ "GenSigTimeoutTime_IPC" SG_ 2654339107 CurrentCanNMState_FD08_TBM 0;
BA_ "GenSigTimeoutTime_RFHM" SG_ 2654339107 CurrentCanNMState_FD08_TBM 0;
BA_ "GenSigTimeoutTime_SGW" SG_ 2654339107 CurrentCanNMState_FD08_TBM 0;
BA_ "GenSigTimeoutTime_TCM" SG_ 2654339107 CurrentCanNMState_FD08_TBM 0;
BA_ "GenSigTimeoutTime_AGSM" SG_ 2654339107 CurrentFailSts_FD08_TBM 0;
BA_ "GenSigTimeoutTime_BSM" SG_ 2654339107 CurrentFailSts_FD08_TBM 0;
BA_ "GenSigTimeoutTime_CADM" SG_ 2654339107 CurrentFailSts_FD08_TBM 0;
BA_ "GenSigTimeoutTime_DMSM" SG_ 2654339107 CurrentFailSts_FD08_TBM 0;
BA_ "GenSigTimeoutTime_DTCM" SG_ 2654339107 CurrentFailSts_FD08_TBM 0;
BA_ "GenSigTimeoutTime_ECM" SG_ 2654339107 CurrentFailSts_FD08_TBM 0;
BA_ "GenSigTimeoutTime_EVCU2" SG_ 2654339107 CurrentFailSts_FD08_TBM 0;
BA_ "GenSigTimeoutTime_GNMM" SG_ 2654339107 CurrentFailSts_FD08_TBM 0;
BA_ "GenSigTimeoutTime_HCP" SG_ 2654339107 CurrentFailSts_FD08_TBM 0;
BA_ "GenSigTimeoutTime_IPC" SG_ 2654339107 CurrentFailSts_FD08_TBM 0;
BA_ "GenSigTimeoutTime_RFHM" SG_ 2654339107 CurrentFailSts_FD08_TBM 0;
BA_ "GenSigTimeoutTime_SGW" SG_ 2654339107 CurrentFailSts_FD08_TBM 0;
BA_ "GenSigTimeoutTime_TCM" SG_ 2654339107 CurrentFailSts_FD08_TBM 0;
BA_ "GenSigTimeoutTime_AGSM" SG_ 2654339107 DES_FD08_TBM 0;
BA_ "GenSigTimeoutTime_BCM" SG_ 2654339107 DES_FD08_TBM 0;
BA_ "GenSigTimeoutTime_BSM" SG_ 2654339107 DES_FD08_TBM 0;
BA_ "GenSigTimeoutTime_CADM" SG_ 2654339107 DES_FD08_TBM 0;
BA_ "GenSigTimeoutTime_DMSM" SG_ 2654339107 DES_FD08_TBM 0;
BA_ "GenSigTimeoutTime_DTCM" SG_ 2654339107 DES_FD08_TBM 0;
BA_ "GenSigTimeoutTime_ECM" SG_ 2654339107 DES_FD08_TBM 0;
BA_ "GenSigTimeoutTime_EVCU2" SG_ 2654339107 DES_FD08_TBM 0;
BA_ "GenSigTimeoutTime_GNMM" SG_ 2654339107 DES_FD08_TBM 0;
BA_ "GenSigTimeoutTime_HCP" SG_ 2654339107 DES_FD08_TBM 0;
BA_ "GenSigTimeoutTime_IPC" SG_ 2654339107 DES_FD08_TBM 0;
BA_ "GenSigTimeoutTime_RFHM" SG_ 2654339107 DES_FD08_TBM 0;
BA_ "GenSigTimeoutTime_SGW" SG_ 2654339107 DES_FD08_TBM 0;
BA_ "GenSigTimeoutTime_TCM" SG_ 2654339107 DES_FD08_TBM 0;
BA_ "GenSigTimeoutTime_AGSM" SG_ 2654339107 EOL_FD08_TBM 0;
BA_ "GenSigTimeoutTime_BSM" SG_ 2654339107 EOL_FD08_TBM 0;
BA_ "GenSigTimeoutTime_CADM" SG_ 2654339107 EOL_FD08_TBM 0;
BA_ "GenSigTimeoutTime_DMSM" SG_ 2654339107 EOL_FD08_TBM 0;
BA_ "GenSigTimeoutTime_DTCM" SG_ 2654339107 EOL_FD08_TBM 0;
BA_ "GenSigTimeoutTime_ECM" SG_ 2654339107 EOL_FD08_TBM 0;
BA_ "GenSigTimeoutTime_EVCU2" SG_ 2654339107 EOL_FD08_TBM 0;
BA_ "GenSigTimeoutTime_GNMM" SG_ 2654339107 EOL_FD08_TBM 0;
BA_ "GenSigTimeoutTime_HCP" SG_ 2654339107 EOL_FD08_TBM 0;
BA_ "GenSigTimeoutTime_IPC" SG_ 2654339107 EOL_FD08_TBM 0;
BA_ "GenSigTimeoutTime_RFHM" SG_ 2654339107 EOL_FD08_TBM 0;
BA_ "GenSigTimeoutTime_SGW" SG_ 2654339107 EOL_FD08_TBM 0;
BA_ "GenSigTimeoutTime_TCM" SG_ 2654339107 EOL_FD08_TBM 0;
BA_ "GenSigTimeoutTime_AGSM" SG_ 2654339107 GenericFailSts_FD08_TBM 0;
BA_ "GenSigTimeoutTime_BSM" SG_ 2654339107 GenericFailSts_FD08_TBM 0;
BA_ "GenSigTimeoutTime_CADM" SG_ 2654339107 GenericFailSts_FD08_TBM 0;
BA_ "GenSigTimeoutTime_DMSM" SG_ 2654339107 GenericFailSts_FD08_TBM 0;
BA_ "GenSigTimeoutTime_DTCM" SG_ 2654339107 GenericFailSts_FD08_TBM 0;
BA_ "GenSigTimeoutTime_ECM" SG_ 2654339107 GenericFailSts_FD08_TBM 0;
BA_ "GenSigTimeoutTime_EVCU2" SG_ 2654339107 GenericFailSts_FD08_TBM 0;
BA_ "GenSigTimeoutTime_GNMM" SG_ 2654339107 GenericFailSts_FD08_TBM 0;
BA_ "GenSigTimeoutTime_HCP" SG_ 2654339107 GenericFailSts_FD08_TBM 0;
BA_ "GenSigTimeoutTime_IPC" SG_ 2654339107 GenericFailSts_FD08_TBM 0;
BA_ "GenSigTimeoutTime_RFHM" SG_ 2654339107 GenericFailSts_FD08_TBM 0;
BA_ "GenSigTimeoutTime_SGW" SG_ 2654339107 GenericFailSts_FD08_TBM 0;
BA_ "GenSigTimeoutTime_TCM" SG_ 2654339107 GenericFailSts_FD08_TBM 0;
BA_ "GenSigTimeoutTime_AGSM" SG_ 2654339107 PreviousCanNMState_FD08_TBM 0;
BA_ "GenSigTimeoutTime_BCM" SG_ 2654339107 PreviousCanNMState_FD08_TBM 0;
BA_ "GenSigTimeoutTime_BSM" SG_ 2654339107 PreviousCanNMState_FD08_TBM 0;
BA_ "GenSigTimeoutTime_CADM" SG_ 2654339107 PreviousCanNMState_FD08_TBM 0;
BA_ "GenSigTimeoutTime_DMSM" SG_ 2654339107 PreviousCanNMState_FD08_TBM 0;
BA_ "GenSigTimeoutTime_DTCM" SG_ 2654339107 PreviousCanNMState_FD08_TBM 0;
BA_ "GenSigTimeoutTime_ECM" SG_ 2654339107 PreviousCanNMState_FD08_TBM 0;
BA_ "GenSigTimeoutTime_EVCU2" SG_ 2654339107 PreviousCanNMState_FD08_TBM 0;
BA_ "GenSigTimeoutTime_GNMM" SG_ 2654339107 PreviousCanNMState_FD08_TBM 0;
BA_ "GenSigTimeoutTime_HCP" SG_ 2654339107 PreviousCanNMState_FD08_TBM 0;
BA_ "GenSigTimeoutTime_IPC" SG_ 2654339107 PreviousCanNMState_FD08_TBM 0;
BA_ "GenSigTimeoutTime_RFHM" SG_ 2654339107 PreviousCanNMState_FD08_TBM 0;
BA_ "GenSigTimeoutTime_SGW" SG_ 2654339107 PreviousCanNMState_FD08_TBM 0;
BA_ "GenSigTimeoutTime_TCM" SG_ 2654339107 PreviousCanNMState_FD08_TBM 0;
BA_ "GenSigTimeoutTime_AGSM" SG_ 2654339107 StayActiveSource_FD08_TBM 0;
BA_ "GenSigTimeoutTime_BCM" SG_ 2654339107 StayActiveSource_FD08_TBM 0;
BA_ "GenSigTimeoutTime_BSM" SG_ 2654339107 StayActiveSource_FD08_TBM 0;
BA_ "GenSigTimeoutTime_CADM" SG_ 2654339107 StayActiveSource_FD08_TBM 0;
BA_ "GenSigTimeoutTime_DMSM" SG_ 2654339107 StayActiveSource_FD08_TBM 0;
BA_ "GenSigTimeoutTime_DTCM" SG_ 2654339107 StayActiveSource_FD08_TBM 0;
BA_ "GenSigTimeoutTime_ECM" SG_ 2654339107 StayActiveSource_FD08_TBM 0;
BA_ "GenSigTimeoutTime_EVCU2" SG_ 2654339107 StayActiveSource_FD08_TBM 0;
BA_ "GenSigTimeoutTime_GNMM" SG_ 2654339107 StayActiveSource_FD08_TBM 0;
BA_ "GenSigTimeoutTime_HCP" SG_ 2654339107 StayActiveSource_FD08_TBM 0;
BA_ "GenSigTimeoutTime_IPC" SG_ 2654339107 StayActiveSource_FD08_TBM 0;
BA_ "GenSigTimeoutTime_RFHM" SG_ 2654339107 StayActiveSource_FD08_TBM 0;
BA_ "GenSigTimeoutTime_SGW" SG_ 2654339107 StayActiveSource_FD08_TBM 0;
BA_ "GenSigTimeoutTime_TCM" SG_ 2654339107 StayActiveSource_FD08_TBM 0;
BA_ "GenSigTimeoutTime_AGSM" SG_ 2654339107 WakeupSource_FD08_TBM 0;
BA_ "GenSigTimeoutTime_BCM" SG_ 2654339107 WakeupSource_FD08_TBM 0;
BA_ "GenSigTimeoutTime_BSM" SG_ 2654339107 WakeupSource_FD08_TBM 0;
BA_ "GenSigTimeoutTime_CADM" SG_ 2654339107 WakeupSource_FD08_TBM 0;
BA_ "GenSigTimeoutTime_DMSM" SG_ 2654339107 WakeupSource_FD08_TBM 0;
BA_ "GenSigTimeoutTime_DTCM" SG_ 2654339107 WakeupSource_FD08_TBM 0;
BA_ "GenSigTimeoutTime_ECM" SG_ 2654339107 WakeupSource_FD08_TBM 0;
BA_ "GenSigTimeoutTime_EVCU2" SG_ 2654339107 WakeupSource_FD08_TBM 0;
BA_ "GenSigTimeoutTime_GNMM" SG_ 2654339107 WakeupSource_FD08_TBM 0;
BA_ "GenSigTimeoutTime_HCP" SG_ 2654339107 WakeupSource_FD08_TBM 0;
BA_ "GenSigTimeoutTime_IPC" SG_ 2654339107 WakeupSource_FD08_TBM 0;
BA_ "GenSigTimeoutTime_RFHM" SG_ 2654339107 WakeupSource_FD08_TBM 0;
BA_ "GenSigTimeoutTime_SGW" SG_ 2654339107 WakeupSource_FD08_TBM 0;
BA_ "GenSigTimeoutTime_TCM" SG_ 2654339107 WakeupSource_FD08_TBM 0;
BA_ "GenSigTimeoutTime_AGSM" SG_ 2654339083 CurrentCanNMState_FD03_TCM 0;
BA_ "GenSigTimeoutTime_BCM" SG_ 2654339083 CurrentCanNMState_FD03_TCM 0;
BA_ "GenSigTimeoutTime_BSM" SG_ 2654339083 CurrentCanNMState_FD03_TCM 0;
BA_ "GenSigTimeoutTime_CADM" SG_ 2654339083 CurrentCanNMState_FD03_TCM 0;
BA_ "GenSigTimeoutTime_DMSM" SG_ 2654339083 CurrentCanNMState_FD03_TCM 0;
BA_ "GenSigTimeoutTime_DTCM" SG_ 2654339083 CurrentCanNMState_FD03_TCM 0;
BA_ "GenSigTimeoutTime_ECM" SG_ 2654339083 CurrentCanNMState_FD03_TCM 0;
BA_ "GenSigTimeoutTime_EVCU2" SG_ 2654339083 CurrentCanNMState_FD03_TCM 0;
BA_ "GenSigTimeoutTime_GNMM" SG_ 2654339083 CurrentCanNMState_FD03_TCM 0;
BA_ "GenSigTimeoutTime_HCP" SG_ 2654339083 CurrentCanNMState_FD03_TCM 0;
BA_ "GenSigTimeoutTime_IPC" SG_ 2654339083 CurrentCanNMState_FD03_TCM 0;
BA_ "GenSigTimeoutTime_RFHM" SG_ 2654339083 CurrentCanNMState_FD03_TCM 0;
BA_ "GenSigTimeoutTime_TCM" SG_ 2654339083 CurrentCanNMState_FD03_TCM 0;
BA_ "GenSigTimeoutTime_AGSM" SG_ 2654339083 CurrentFailSts_FD03_TCM 0;
BA_ "GenSigTimeoutTime_BSM" SG_ 2654339083 CurrentFailSts_FD03_TCM 0;
BA_ "GenSigTimeoutTime_CADM" SG_ 2654339083 CurrentFailSts_FD03_TCM 0;
BA_ "GenSigTimeoutTime_DMSM" SG_ 2654339083 CurrentFailSts_FD03_TCM 0;
BA_ "GenSigTimeoutTime_DTCM" SG_ 2654339083 CurrentFailSts_FD03_TCM 0;
BA_ "GenSigTimeoutTime_ECM" SG_ 2654339083 CurrentFailSts_FD03_TCM 0;
BA_ "GenSigTimeoutTime_EVCU2" SG_ 2654339083 CurrentFailSts_FD03_TCM 0;
BA_ "GenSigTimeoutTime_GNMM" SG_ 2654339083 CurrentFailSts_FD03_TCM 0;
BA_ "GenSigTimeoutTime_HCP" SG_ 2654339083 CurrentFailSts_FD03_TCM 0;
BA_ "GenSigTimeoutTime_IPC" SG_ 2654339083 CurrentFailSts_FD03_TCM 0;
BA_ "GenSigTimeoutTime_RFHM" SG_ 2654339083 CurrentFailSts_FD03_TCM 0;
BA_ "GenSigTimeoutTime_TCM" SG_ 2654339083 CurrentFailSts_FD03_TCM 0;
BA_ "GenSigTimeoutTime_AGSM" SG_ 2654339083 DES_FD03_TCM 0;
BA_ "GenSigTimeoutTime_BCM" SG_ 2654339083 DES_FD03_TCM 0;
BA_ "GenSigTimeoutTime_BSM" SG_ 2654339083 DES_FD03_TCM 0;
BA_ "GenSigTimeoutTime_CADM" SG_ 2654339083 DES_FD03_TCM 0;
BA_ "GenSigTimeoutTime_DMSM" SG_ 2654339083 DES_FD03_TCM 0;
BA_ "GenSigTimeoutTime_DTCM" SG_ 2654339083 DES_FD03_TCM 0;
BA_ "GenSigTimeoutTime_ECM" SG_ 2654339083 DES_FD03_TCM 0;
BA_ "GenSigTimeoutTime_EVCU2" SG_ 2654339083 DES_FD03_TCM 0;
BA_ "GenSigTimeoutTime_GNMM" SG_ 2654339083 DES_FD03_TCM 0;
BA_ "GenSigTimeoutTime_HCP" SG_ 2654339083 DES_FD03_TCM 0;
BA_ "GenSigTimeoutTime_IPC" SG_ 2654339083 DES_FD03_TCM 0;
BA_ "GenSigTimeoutTime_RFHM" SG_ 2654339083 DES_FD03_TCM 0;
BA_ "GenSigTimeoutTime_TCM" SG_ 2654339083 DES_FD03_TCM 0;
BA_ "GenSigTimeoutTime_AGSM" SG_ 2654339083 EOL_FD03_TCM 0;
BA_ "GenSigTimeoutTime_BSM" SG_ 2654339083 EOL_FD03_TCM 0;
BA_ "GenSigTimeoutTime_CADM" SG_ 2654339083 EOL_FD03_TCM 0;
BA_ "GenSigTimeoutTime_DMSM" SG_ 2654339083 EOL_FD03_TCM 0;
BA_ "GenSigTimeoutTime_DTCM" SG_ 2654339083 EOL_FD03_TCM 0;
BA_ "GenSigTimeoutTime_ECM" SG_ 2654339083 EOL_FD03_TCM 0;
BA_ "GenSigTimeoutTime_EVCU2" SG_ 2654339083 EOL_FD03_TCM 0;
BA_ "GenSigTimeoutTime_GNMM" SG_ 2654339083 EOL_FD03_TCM 0;
BA_ "GenSigTimeoutTime_HCP" SG_ 2654339083 EOL_FD03_TCM 0;
BA_ "GenSigTimeoutTime_IPC" SG_ 2654339083 EOL_FD03_TCM 0;
BA_ "GenSigTimeoutTime_RFHM" SG_ 2654339083 EOL_FD03_TCM 0;
BA_ "GenSigTimeoutTime_TCM" SG_ 2654339083 EOL_FD03_TCM 0;
BA_ "GenSigTimeoutTime_AGSM" SG_ 2654339083 GenericFailSts_FD03_TCM 0;
BA_ "GenSigTimeoutTime_BSM" SG_ 2654339083 GenericFailSts_FD03_TCM 0;
BA_ "GenSigTimeoutTime_CADM" SG_ 2654339083 GenericFailSts_FD03_TCM 0;
BA_ "GenSigTimeoutTime_DMSM" SG_ 2654339083 GenericFailSts_FD03_TCM 0;
BA_ "GenSigTimeoutTime_DTCM" SG_ 2654339083 GenericFailSts_FD03_TCM 0;
BA_ "GenSigTimeoutTime_ECM" SG_ 2654339083 GenericFailSts_FD03_TCM 0;
BA_ "GenSigTimeoutTime_EVCU2" SG_ 2654339083 GenericFailSts_FD03_TCM 0;
BA_ "GenSigTimeoutTime_GNMM" SG_ 2654339083 GenericFailSts_FD03_TCM 0;
BA_ "GenSigTimeoutTime_HCP" SG_ 2654339083 GenericFailSts_FD03_TCM 0;
BA_ "GenSigTimeoutTime_IPC" SG_ 2654339083 GenericFailSts_FD03_TCM 0;
BA_ "GenSigTimeoutTime_RFHM" SG_ 2654339083 GenericFailSts_FD03_TCM 0;
BA_ "GenSigTimeoutTime_TCM" SG_ 2654339083 GenericFailSts_FD03_TCM 0;
BA_ "GenSigTimeoutTime_AGSM" SG_ 2654339083 PreviousCanNMState_FD03_TCM 0;
BA_ "GenSigTimeoutTime_BCM" SG_ 2654339083 PreviousCanNMState_FD03_TCM 0;
BA_ "GenSigTimeoutTime_BSM" SG_ 2654339083 PreviousCanNMState_FD03_TCM 0;
BA_ "GenSigTimeoutTime_CADM" SG_ 2654339083 PreviousCanNMState_FD03_TCM 0;
BA_ "GenSigTimeoutTime_DMSM" SG_ 2654339083 PreviousCanNMState_FD03_TCM 0;
BA_ "GenSigTimeoutTime_DTCM" SG_ 2654339083 PreviousCanNMState_FD03_TCM 0;
BA_ "GenSigTimeoutTime_ECM" SG_ 2654339083 PreviousCanNMState_FD03_TCM 0;
BA_ "GenSigTimeoutTime_EVCU2" SG_ 2654339083 PreviousCanNMState_FD03_TCM 0;
BA_ "GenSigTimeoutTime_GNMM" SG_ 2654339083 PreviousCanNMState_FD03_TCM 0;
BA_ "GenSigTimeoutTime_HCP" SG_ 2654339083 PreviousCanNMState_FD03_TCM 0;
BA_ "GenSigTimeoutTime_IPC" SG_ 2654339083 PreviousCanNMState_FD03_TCM 0;
BA_ "GenSigTimeoutTime_RFHM" SG_ 2654339083 PreviousCanNMState_FD03_TCM 0;
BA_ "GenSigTimeoutTime_TCM" SG_ 2654339083 PreviousCanNMState_FD03_TCM 0;
BA_ "GenSigTimeoutTime_AGSM" SG_ 2654339083 StayActiveSource_FD03_TCM 0;
BA_ "GenSigTimeoutTime_BCM" SG_ 2654339083 StayActiveSource_FD03_TCM 0;
BA_ "GenSigTimeoutTime_BSM" SG_ 2654339083 StayActiveSource_FD03_TCM 0;
BA_ "GenSigTimeoutTime_CADM" SG_ 2654339083 StayActiveSource_FD03_TCM 0;
BA_ "GenSigTimeoutTime_DMSM" SG_ 2654339083 StayActiveSource_FD03_TCM 0;
BA_ "GenSigTimeoutTime_DTCM" SG_ 2654339083 StayActiveSource_FD03_TCM 0;
BA_ "GenSigTimeoutTime_ECM" SG_ 2654339083 StayActiveSource_FD03_TCM 0;
BA_ "GenSigTimeoutTime_EVCU2" SG_ 2654339083 StayActiveSource_FD03_TCM 0;
BA_ "GenSigTimeoutTime_GNMM" SG_ 2654339083 StayActiveSource_FD03_TCM 0;
BA_ "GenSigTimeoutTime_HCP" SG_ 2654339083 StayActiveSource_FD03_TCM 0;
BA_ "GenSigTimeoutTime_IPC" SG_ 2654339083 StayActiveSource_FD03_TCM 0;
BA_ "GenSigTimeoutTime_RFHM" SG_ 2654339083 StayActiveSource_FD03_TCM 0;
BA_ "GenSigTimeoutTime_TCM" SG_ 2654339083 StayActiveSource_FD03_TCM 0;
BA_ "GenSigTimeoutTime_AGSM" SG_ 2654339083 WakeupSource_FD03_TCM 0;
BA_ "GenSigTimeoutTime_BCM" SG_ 2654339083 WakeupSource_FD03_TCM 0;
BA_ "GenSigTimeoutTime_BSM" SG_ 2654339083 WakeupSource_FD03_TCM 0;
BA_ "GenSigTimeoutTime_CADM" SG_ 2654339083 WakeupSource_FD03_TCM 0;
BA_ "GenSigTimeoutTime_DMSM" SG_ 2654339083 WakeupSource_FD03_TCM 0;
BA_ "GenSigTimeoutTime_DTCM" SG_ 2654339083 WakeupSource_FD03_TCM 0;
BA_ "GenSigTimeoutTime_ECM" SG_ 2654339083 WakeupSource_FD03_TCM 0;
BA_ "GenSigTimeoutTime_EVCU2" SG_ 2654339083 WakeupSource_FD03_TCM 0;
BA_ "GenSigTimeoutTime_GNMM" SG_ 2654339083 WakeupSource_FD03_TCM 0;
BA_ "GenSigTimeoutTime_HCP" SG_ 2654339083 WakeupSource_FD03_TCM 0;
BA_ "GenSigTimeoutTime_IPC" SG_ 2654339083 WakeupSource_FD03_TCM 0;
BA_ "GenSigTimeoutTime_RFHM" SG_ 2654339083 WakeupSource_FD03_TCM 0;
BA_ "GenSigTimeoutTime_TCM" SG_ 2654339083 WakeupSource_FD03_TCM 0;
BA_ "GenSigTimeoutTime_AGSM" SG_ 263 AlternatorFail_PT 0;
BA_ "GenSigTimeoutTime_BCM" SG_ 263 AlternatorFail_PT 0;
BA_ "GenSigTimeoutTime_BSM" SG_ 263 AlternatorFail_PT 0;
BA_ "GenSigTimeoutTime_CADM" SG_ 263 AlternatorFail_PT 0;
BA_ "GenSigTimeoutTime_DMSM" SG_ 263 AlternatorFail_PT 0;
BA_ "GenSigTimeoutTime_DTCM" SG_ 263 AlternatorFail_PT 0;
BA_ "GenSigTimeoutTime_ECM" SG_ 263 AlternatorFail_PT 0;
BA_ "GenSigTimeoutTime_EVCU2" SG_ 263 AlternatorFail_PT 0;
BA_ "GenSigTimeoutTime_GNMM" SG_ 263 AlternatorFail_PT 0;
BA_ "GenSigTimeoutTime_HCP" SG_ 263 AlternatorFail_PT 0;
BA_ "GenSigTimeoutTime_RFHM" SG_ 263 AlternatorFail_PT 0;
BA_ "GenSigTimeoutTime_SGW" SG_ 263 AlternatorFail_PT 0;
BA_ "GenSigTimeoutTime_TCM" SG_ 263 AlternatorFail_PT 0;
BA_ "GenSigTimeoutTime_BCM" SG_ 263 APCM_Rq_PT 0;
BA_ "GenSigTimeoutTime_BSM" SG_ 263 APCM_Rq_PT 0;
BA_ "GenSigTimeoutTime_CADM" SG_ 263 APCM_Rq_PT 0;
BA_ "GenSigTimeoutTime_DMSM" SG_ 263 APCM_Rq_PT 0;
BA_ "GenSigTimeoutTime_DTCM" SG_ 263 APCM_Rq_PT 0;
BA_ "GenSigTimeoutTime_ECM" SG_ 263 APCM_Rq_PT 0;
BA_ "GenSigTimeoutTime_EVCU2" SG_ 263 APCM_Rq_PT 0;
BA_ "GenSigTimeoutTime_GNMM" SG_ 263 APCM_Rq_PT 0;
BA_ "GenSigTimeoutTime_HCP" SG_ 263 APCM_Rq_PT 0;
BA_ "GenSigTimeoutTime_IPC" SG_ 263 APCM_Rq_PT 0;
BA_ "GenSigTimeoutTime_RFHM" SG_ 263 APCM_Rq_PT 0;
BA_ "GenSigTimeoutTime_TCM" SG_ 263 APCM_Rq_PT 0;
BA_ "GenSigTimeoutTime_AGSM" SG_ 263 AtmosphericPressure_PT 0;
BA_ "GenSigTimeoutTime_CADM" SG_ 263 AtmosphericPressure_PT 0;
BA_ "GenSigTimeoutTime_DMSM" SG_ 263 AtmosphericPressure_PT 0;
BA_ "GenSigTimeoutTime_DTCM" SG_ 263 AtmosphericPressure_PT 0;
BA_ "GenSigTimeoutTime_ECM" SG_ 263 AtmosphericPressure_PT 0;
BA_ "GenSigTimeoutTime_EVCU2" SG_ 263 AtmosphericPressure_PT 0;
BA_ "GenSigTimeoutTime_GNMM" SG_ 263 AtmosphericPressure_PT 0;
BA_ "GenSigTimeoutTime_HCP" SG_ 263 AtmosphericPressure_PT 0;
BA_ "GenSigTimeoutTime_IPC" SG_ 263 AtmosphericPressure_PT 0;
BA_ "GenSigTimeoutTime_TCM" SG_ 263 AtmosphericPressure_PT 0;
BA_ "GenSigTimeoutTime_AGSM" SG_ 263 AWD_Status_PT 0;
BA_ "GenSigTimeoutTime_BCM" SG_ 263 AWD_Status_PT 0;
BA_ "GenSigTimeoutTime_BSM" SG_ 263 AWD_Status_PT 0;
BA_ "GenSigTimeoutTime_CADM" SG_ 263 AWD_Status_PT 0;
BA_ "GenSigTimeoutTime_DMSM" SG_ 263 AWD_Status_PT 0;
BA_ "GenSigTimeoutTime_DTCM" SG_ 263 AWD_Status_PT 0;
BA_ "GenSigTimeoutTime_ECM" SG_ 263 AWD_Status_PT 0;
BA_ "GenSigTimeoutTime_EVCU2" SG_ 263 AWD_Status_PT 0;
BA_ "GenSigTimeoutTime_GNMM" SG_ 263 AWD_Status_PT 0;
BA_ "GenSigTimeoutTime_HCP" SG_ 263 AWD_Status_PT 0;
BA_ "GenSigTimeoutTime_IPC" SG_ 263 AWD_Status_PT 0;
BA_ "GenSigTimeoutTime_RFHM" SG_ 263 AWD_Status_PT 0;
BA_ "GenSigTimeoutTime_SGW" SG_ 263 AWD_Status_PT 0;
BA_ "GenSigTimeoutTime_TCM" SG_ 263 AWD_Status_PT 0;
BA_ "GenSigTimeoutTime_AGSM" SG_ 263 CrankEnable_PT 0;
BA_ "GenSigTimeoutTime_BCM" SG_ 263 CrankEnable_PT 0;
BA_ "GenSigTimeoutTime_BSM" SG_ 263 CrankEnable_PT 0;
BA_ "GenSigTimeoutTime_CADM" SG_ 263 CrankEnable_PT 0;
BA_ "GenSigTimeoutTime_DMSM" SG_ 263 CrankEnable_PT 0;
BA_ "GenSigTimeoutTime_DTCM" SG_ 263 CrankEnable_PT 0;
BA_ "GenSigTimeoutTime_ECM" SG_ 263 CrankEnable_PT 0;
BA_ "GenSigTimeoutTime_EVCU2" SG_ 263 CrankEnable_PT 0;
BA_ "GenSigTimeoutTime_GNMM" SG_ 263 CrankEnable_PT 0;
BA_ "GenSigTimeoutTime_HCP" SG_ 263 CrankEnable_PT 0;
BA_ "GenSigTimeoutTime_IPC" SG_ 263 CrankEnable_PT 0;
BA_ "GenSigTimeoutTime_RFHM" SG_ 263 CrankEnable_PT 0;
BA_ "GenSigTimeoutTime_TCM" SG_ 263 CrankEnable_PT 0;
BA_ "GenSigTimeoutTime_DMSM" SG_ 263 CRC_PT_SYSTEM_FD_1 0;
BA_ "GenSigTimeoutTime_DTCM" SG_ 263 CRC_PT_SYSTEM_FD_1 0;
BA_ "GenSigTimeoutTime_EVCU2" SG_ 263 CRC_PT_SYSTEM_FD_1 0;
BA_ "GenSigTimeoutTime_HCP" SG_ 263 CRC_PT_SYSTEM_FD_1 0;
BA_ "GenSigTimeoutTime_RFHM" SG_ 263 CRC_PT_SYSTEM_FD_1 0;
BA_ "GenSigTimeoutTime_SGW" SG_ 263 CRC_PT_SYSTEM_FD_1 0;
BA_ "GenSigTimeoutTime_TCM" SG_ 263 CRC_PT_SYSTEM_FD_1 0;
BA_ "GenSigTimeoutTime_AGSM" SG_ 263 DriveReady_PT 0;
BA_ "GenSigTimeoutTime_CADM" SG_ 263 DriveReady_PT 0;
BA_ "GenSigTimeoutTime_DMSM" SG_ 263 DriveReady_PT 0;
BA_ "GenSigTimeoutTime_DTCM" SG_ 263 DriveReady_PT 0;
BA_ "GenSigTimeoutTime_ECM" SG_ 263 DriveReady_PT 0;
BA_ "GenSigTimeoutTime_EVCU2" SG_ 263 DriveReady_PT 0;
BA_ "GenSigTimeoutTime_GNMM" SG_ 263 DriveReady_PT 0;
BA_ "GenSigTimeoutTime_HCP" SG_ 263 DriveReady_PT 0;
BA_ "GenSigTimeoutTime_RFHM" SG_ 263 DriveReady_PT 0;
BA_ "GenSigTimeoutTime_TCM" SG_ 263 DriveReady_PT 0;
BA_ "GenSigTimeoutTime_AGSM" SG_ 263 DriverPowerReq_PT 0;
BA_ "GenSigTimeoutTime_BCM" SG_ 263 DriverPowerReq_PT 0;
BA_ "GenSigTimeoutTime_BSM" SG_ 263 DriverPowerReq_PT 0;
BA_ "GenSigTimeoutTime_CADM" SG_ 263 DriverPowerReq_PT 0;
BA_ "GenSigTimeoutTime_DMSM" SG_ 263 DriverPowerReq_PT 0;
BA_ "GenSigTimeoutTime_DTCM" SG_ 263 DriverPowerReq_PT 0;
BA_ "GenSigTimeoutTime_ECM" SG_ 263 DriverPowerReq_PT 0;
BA_ "GenSigTimeoutTime_EVCU2" SG_ 263 DriverPowerReq_PT 0;
BA_ "GenSigTimeoutTime_GNMM" SG_ 263 DriverPowerReq_PT 0;
BA_ "GenSigTimeoutTime_HCP" SG_ 263 DriverPowerReq_PT 0;
BA_ "GenSigTimeoutTime_IPC" SG_ 263 DriverPowerReq_PT 0;
BA_ "GenSigTimeoutTime_RFHM" SG_ 263 DriverPowerReq_PT 0;
BA_ "GenSigTimeoutTime_SGW" SG_ 263 DriverPowerReq_PT 0;
BA_ "GenSigTimeoutTime_TCM" SG_ 263 DriverPowerReq_PT 0;
BA_ "GenSigTimeoutTime_AGSM" SG_ 263 DrvAway_Alert_PT 0;
BA_ "GenSigTimeoutTime_BCM" SG_ 263 DrvAway_Alert_PT 0;
BA_ "GenSigTimeoutTime_BSM" SG_ 263 DrvAway_Alert_PT 0;
BA_ "GenSigTimeoutTime_CADM" SG_ 263 DrvAway_Alert_PT 0;
BA_ "GenSigTimeoutTime_DMSM" SG_ 263 DrvAway_Alert_PT 0;
BA_ "GenSigTimeoutTime_DTCM" SG_ 263 DrvAway_Alert_PT 0;
BA_ "GenSigTimeoutTime_ECM" SG_ 263 DrvAway_Alert_PT 0;
BA_ "GenSigTimeoutTime_EVCU2" SG_ 263 DrvAway_Alert_PT 0;
BA_ "GenSigTimeoutTime_GNMM" SG_ 263 DrvAway_Alert_PT 0;
BA_ "GenSigTimeoutTime_HCP" SG_ 263 DrvAway_Alert_PT 0;
BA_ "GenSigTimeoutTime_RFHM" SG_ 263 DrvAway_Alert_PT 0;
BA_ "GenSigTimeoutTime_SGW" SG_ 263 DrvAway_Alert_PT 0;
BA_ "GenSigTimeoutTime_TCM" SG_ 263 DrvAway_Alert_PT 0;
BA_ "GenSigTimeoutTime_AGSM" SG_ 263 DrvAway_Inhibit_PT 0;
BA_ "GenSigTimeoutTime_BCM" SG_ 263 DrvAway_Inhibit_PT 0;
BA_ "GenSigTimeoutTime_BSM" SG_ 263 DrvAway_Inhibit_PT 0;
BA_ "GenSigTimeoutTime_CADM" SG_ 263 DrvAway_Inhibit_PT 0;
BA_ "GenSigTimeoutTime_DMSM" SG_ 263 DrvAway_Inhibit_PT 0;
BA_ "GenSigTimeoutTime_DTCM" SG_ 263 DrvAway_Inhibit_PT 0;
BA_ "GenSigTimeoutTime_ECM" SG_ 263 DrvAway_Inhibit_PT 0;
BA_ "GenSigTimeoutTime_EVCU2" SG_ 263 DrvAway_Inhibit_PT 0;
BA_ "GenSigTimeoutTime_GNMM" SG_ 263 DrvAway_Inhibit_PT 0;
BA_ "GenSigTimeoutTime_HCP" SG_ 263 DrvAway_Inhibit_PT 0;
BA_ "GenSigTimeoutTime_RFHM" SG_ 263 DrvAway_Inhibit_PT 0;
BA_ "GenSigTimeoutTime_SGW" SG_ 263 DrvAway_Inhibit_PT 0;
BA_ "GenSigTimeoutTime_TCM" SG_ 263 DrvAway_Inhibit_PT 0;
BA_ "GenSigTimeoutTime_AGSM" SG_ 263 ESS_RqShftPark_PT 0;
BA_ "GenSigTimeoutTime_BCM" SG_ 263 ESS_RqShftPark_PT 0;
BA_ "GenSigTimeoutTime_BSM" SG_ 263 ESS_RqShftPark_PT 0;
BA_ "GenSigTimeoutTime_CADM" SG_ 263 ESS_RqShftPark_PT 0;
BA_ "GenSigTimeoutTime_DMSM" SG_ 263 ESS_RqShftPark_PT 0;
BA_ "GenSigTimeoutTime_DTCM" SG_ 263 ESS_RqShftPark_PT 0;
BA_ "GenSigTimeoutTime_ECM" SG_ 263 ESS_RqShftPark_PT 0;
BA_ "GenSigTimeoutTime_EVCU2" SG_ 263 ESS_RqShftPark_PT 0;
BA_ "GenSigTimeoutTime_GNMM" SG_ 263 ESS_RqShftPark_PT 0;
BA_ "GenSigTimeoutTime_HCP" SG_ 263 ESS_RqShftPark_PT 0;
BA_ "GenSigTimeoutTime_IPC" SG_ 263 ESS_RqShftPark_PT 0;
BA_ "GenSigTimeoutTime_RFHM" SG_ 263 ESS_RqShftPark_PT 0;
BA_ "GenSigTimeoutTime_SGW" SG_ 263 ESS_RqShftPark_PT 0;
BA_ "GenSigTimeoutTime_TCM" SG_ 263 ESS_RqShftPark_PT 0;
BA_ "GenSigTimeoutTime_AGSM" SG_ 263 EVCU2_THA_Resp 0;
BA_ "GenSigTimeoutTime_BSM" SG_ 263 EVCU2_THA_Resp 0;
BA_ "GenSigTimeoutTime_CADM" SG_ 263 EVCU2_THA_Resp 0;
BA_ "GenSigTimeoutTime_DMSM" SG_ 263 EVCU2_THA_Resp 0;
BA_ "GenSigTimeoutTime_DTCM" SG_ 263 EVCU2_THA_Resp 0;
BA_ "GenSigTimeoutTime_ECM" SG_ 263 EVCU2_THA_Resp 0;
BA_ "GenSigTimeoutTime_EVCU2" SG_ 263 EVCU2_THA_Resp 0;
BA_ "GenSigTimeoutTime_GNMM" SG_ 263 EVCU2_THA_Resp 0;
BA_ "GenSigTimeoutTime_HCP" SG_ 263 EVCU2_THA_Resp 0;
BA_ "GenSigTimeoutTime_IPC" SG_ 263 EVCU2_THA_Resp 0;
BA_ "GenSigTimeoutTime_RFHM" SG_ 263 EVCU2_THA_Resp 0;
BA_ "GenSigTimeoutTime_SGW" SG_ 263 EVCU2_THA_Resp 0;
BA_ "GenSigTimeoutTime_TCM" SG_ 263 EVCU2_THA_Resp 0;
BA_ "GenSigTimeoutTime_AGSM" SG_ 263 GasPedalPosition_PT 0;
BA_ "GenSigTimeoutTime_CADM" SG_ 263 GasPedalPosition_PT 0;
BA_ "GenSigTimeoutTime_DMSM" SG_ 263 GasPedalPosition_PT 0;
BA_ "GenSigTimeoutTime_DTCM" SG_ 263 GasPedalPosition_PT 0;
BA_ "GenSigTimeoutTime_GNMM" SG_ 263 GasPedalPosition_PT 0;
BA_ "GenSigTimeoutTime_HCP" SG_ 263 GasPedalPosition_PT 0;
BA_ "GenSigTimeoutTime_IPC" SG_ 263 GasPedalPosition_PT 0;
BA_ "GenSigTimeoutTime_RFHM" SG_ 263 GasPedalPosition_PT 0;
BA_ "GenSigTimeoutTime_AGSM" SG_ 263 GasPedalPositionFailSts_PT 0;
BA_ "GenSigTimeoutTime_CADM" SG_ 263 GasPedalPositionFailSts_PT 0;
BA_ "GenSigTimeoutTime_DMSM" SG_ 263 GasPedalPositionFailSts_PT 0;
BA_ "GenSigTimeoutTime_DTCM" SG_ 263 GasPedalPositionFailSts_PT 0;
BA_ "GenSigTimeoutTime_ECM" SG_ 263 GasPedalPositionFailSts_PT 0;
BA_ "GenSigTimeoutTime_EVCU2" SG_ 263 GasPedalPositionFailSts_PT 0;
BA_ "GenSigTimeoutTime_GNMM" SG_ 263 GasPedalPositionFailSts_PT 0;
BA_ "GenSigTimeoutTime_HCP" SG_ 263 GasPedalPositionFailSts_PT 0;
BA_ "GenSigTimeoutTime_IPC" SG_ 263 GasPedalPositionFailSts_PT 0;
BA_ "GenSigTimeoutTime_RFHM" SG_ 263 GasPedalPositionFailSts_PT 0;
BA_ "GenSigTimeoutTime_TCM" SG_ 263 GasPedalPositionFailSts_PT 0;
BA_ "GenSigTimeoutTime_AGSM" SG_ 263 GearEngaged_PT 0;
BA_ "GenSigTimeoutTime_DMSM" SG_ 263 GearEngaged_PT 0;
BA_ "GenSigTimeoutTime_DTCM" SG_ 263 GearEngaged_PT 0;
BA_ "GenSigTimeoutTime_GNMM" SG_ 263 GearEngaged_PT 0;
BA_ "GenSigTimeoutTime_HCP" SG_ 263 GearEngaged_PT 0;
BA_ "GenSigTimeoutTime_TCM" SG_ 263 GearEngaged_PT 0;
BA_ "GenSigTimeoutTime_DMSM" SG_ 263 GearEngagedForDisplay_PT 0;
BA_ "GenSigTimeoutTime_DTCM" SG_ 263 GearEngagedForDisplay_PT 0;
BA_ "GenSigTimeoutTime_HCP" SG_ 263 GearEngagedForDisplay_PT 0;
BA_ "GenSigTimeoutTime_BCM" SG_ 263 GearIndicationSts_PT 0;
BA_ "GenSigTimeoutTime_BSM" SG_ 263 GearIndicationSts_PT 0;
BA_ "GenSigTimeoutTime_CADM" SG_ 263 GearIndicationSts_PT 0;
BA_ "GenSigTimeoutTime_DMSM" SG_ 263 GearIndicationSts_PT 0;
BA_ "GenSigTimeoutTime_DTCM" SG_ 263 GearIndicationSts_PT 0;
BA_ "GenSigTimeoutTime_ECM" SG_ 263 GearIndicationSts_PT 0;
BA_ "GenSigTimeoutTime_EVCU2" SG_ 263 GearIndicationSts_PT 0;
BA_ "GenSigTimeoutTime_GNMM" SG_ 263 GearIndicationSts_PT 0;
BA_ "GenSigTimeoutTime_HCP" SG_ 263 GearIndicationSts_PT 0;
BA_ "GenSigTimeoutTime_RFHM" SG_ 263 GearIndicationSts_PT 0;
BA_ "GenSigTimeoutTime_SGW" SG_ 263 GearIndicationSts_PT 0;
BA_ "GenSigTimeoutTime_TCM" SG_ 263 GearIndicationSts_PT 0;
BA_ "GenSigTimeoutTime_AGSM" SG_ 263 HAS_SoH_PT 0;
BA_ "GenSigTimeoutTime_BSM" SG_ 263 HAS_SoH_PT 0;
BA_ "GenSigTimeoutTime_DMSM" SG_ 263 HAS_SoH_PT 0;
BA_ "GenSigTimeoutTime_DTCM" SG_ 263 HAS_SoH_PT 0;
BA_ "GenSigTimeoutTime_ECM" SG_ 263 HAS_SoH_PT 0;
BA_ "GenSigTimeoutTime_EVCU2" SG_ 263 HAS_SoH_PT 0;
BA_ "GenSigTimeoutTime_GNMM" SG_ 263 HAS_SoH_PT 0;
BA_ "GenSigTimeoutTime_HCP" SG_ 263 HAS_SoH_PT 0;
BA_ "GenSigTimeoutTime_IPC" SG_ 263 HAS_SoH_PT 0;
BA_ "GenSigTimeoutTime_RFHM" SG_ 263 HAS_SoH_PT 0;
BA_ "GenSigTimeoutTime_SGW" SG_ 263 HAS_SoH_PT 0;
BA_ "GenSigTimeoutTime_TCM" SG_ 263 HAS_SoH_PT 0;
BA_ "GenSigTimeoutTime_DMSM" SG_ 263 MessageCounter_PT_SYSTEM_FD_1 0;
BA_ "GenSigTimeoutTime_DTCM" SG_ 263 MessageCounter_PT_SYSTEM_FD_1 0;
BA_ "GenSigTimeoutTime_EVCU2" SG_ 263 MessageCounter_PT_SYSTEM_FD_1 0;
BA_ "GenSigTimeoutTime_HCP" SG_ 263 MessageCounter_PT_SYSTEM_FD_1 0;
BA_ "GenSigTimeoutTime_RFHM" SG_ 263 MessageCounter_PT_SYSTEM_FD_1 0;
BA_ "GenSigTimeoutTime_SGW" SG_ 263 MessageCounter_PT_SYSTEM_FD_1 0;
BA_ "GenSigTimeoutTime_TCM" SG_ 263 MessageCounter_PT_SYSTEM_FD_1 0;
BA_ "GenSigTimeoutTime_AGSM" SG_ 263 ParkingFailSts_PT 0;
BA_ "GenSigTimeoutTime_BCM" SG_ 263 ParkingFailSts_PT 0;
BA_ "GenSigTimeoutTime_BSM" SG_ 263 ParkingFailSts_PT 0;
BA_ "GenSigTimeoutTime_CADM" SG_ 263 ParkingFailSts_PT 0;
BA_ "GenSigTimeoutTime_DMSM" SG_ 263 ParkingFailSts_PT 0;
BA_ "GenSigTimeoutTime_DTCM" SG_ 263 ParkingFailSts_PT 0;
BA_ "GenSigTimeoutTime_ECM" SG_ 263 ParkingFailSts_PT 0;
BA_ "GenSigTimeoutTime_EVCU2" SG_ 263 ParkingFailSts_PT 0;
BA_ "GenSigTimeoutTime_GNMM" SG_ 263 ParkingFailSts_PT 0;
BA_ "GenSigTimeoutTime_HCP" SG_ 263 ParkingFailSts_PT 0;
BA_ "GenSigTimeoutTime_IPC" SG_ 263 ParkingFailSts_PT 0;
BA_ "GenSigTimeoutTime_RFHM" SG_ 263 ParkingFailSts_PT 0;
BA_ "GenSigTimeoutTime_SGW" SG_ 263 ParkingFailSts_PT 0;
BA_ "GenSigTimeoutTime_TCM" SG_ 263 ParkingFailSts_PT 0;
BA_ "GenSigTimeoutTime_AGSM" SG_ 263 ParkingSts_PT 0;
BA_ "GenSigTimeoutTime_BCM" SG_ 263 ParkingSts_PT 0;
BA_ "GenSigTimeoutTime_BSM" SG_ 263 ParkingSts_PT 0;
BA_ "GenSigTimeoutTime_CADM" SG_ 263 ParkingSts_PT 0;
BA_ "GenSigTimeoutTime_DMSM" SG_ 263 ParkingSts_PT 0;
BA_ "GenSigTimeoutTime_DTCM" SG_ 263 ParkingSts_PT 0;
BA_ "GenSigTimeoutTime_ECM" SG_ 263 ParkingSts_PT 0;
BA_ "GenSigTimeoutTime_EVCU2" SG_ 263 ParkingSts_PT 0;
BA_ "GenSigTimeoutTime_GNMM" SG_ 263 ParkingSts_PT 0;
BA_ "GenSigTimeoutTime_HCP" SG_ 263 ParkingSts_PT 0;
BA_ "GenSigTimeoutTime_IPC" SG_ 263 ParkingSts_PT 0;
BA_ "GenSigTimeoutTime_RFHM" SG_ 263 ParkingSts_PT 0;
BA_ "GenSigTimeoutTime_SGW" SG_ 263 ParkingSts_PT 0;
BA_ "GenSigTimeoutTime_TCM" SG_ 263 ParkingSts_PT 0;
BA_ "GenSigTimeoutTime_AGSM" SG_ 263 PdlPosActual_PT 0;
BA_ "GenSigTimeoutTime_DMSM" SG_ 263 PdlPosActual_PT 0;
BA_ "GenSigTimeoutTime_DTCM" SG_ 263 PdlPosActual_PT 0;
BA_ "GenSigTimeoutTime_ECM" SG_ 263 PdlPosActual_PT 0;
BA_ "GenSigTimeoutTime_EVCU2" SG_ 263 PdlPosActual_PT 0;
BA_ "GenSigTimeoutTime_GNMM" SG_ 263 PdlPosActual_PT 0;
BA_ "GenSigTimeoutTime_HCP" SG_ 263 PdlPosActual_PT 0;
BA_ "GenSigTimeoutTime_IPC" SG_ 263 PdlPosActual_PT 0;
BA_ "GenSigTimeoutTime_RFHM" SG_ 263 PdlPosActual_PT 0;
BA_ "GenSigTimeoutTime_TCM" SG_ 263 PdlPosActual_PT 0;
BA_ "GenSigTimeoutTime_AGSM" SG_ 263 PowertrainPrplsnActv_PT 0;
BA_ "GenSigTimeoutTime_DMSM" SG_ 263 PowertrainPrplsnActv_PT 0;
BA_ "GenSigTimeoutTime_DTCM" SG_ 263 PowertrainPrplsnActv_PT 0;
BA_ "GenSigTimeoutTime_GNMM" SG_ 263 PowertrainPrplsnActv_PT 0;
BA_ "GenSigTimeoutTime_HCP" SG_ 263 PowertrainPrplsnActv_PT 0;
BA_ "GenSigTimeoutTime_AGSM" SG_ 263 R_SHFT_LOCK_PT 0;
BA_ "GenSigTimeoutTime_BCM" SG_ 263 R_SHFT_LOCK_PT 0;
BA_ "GenSigTimeoutTime_BSM" SG_ 263 R_SHFT_LOCK_PT 0;
BA_ "GenSigTimeoutTime_CADM" SG_ 263 R_SHFT_LOCK_PT 0;
BA_ "GenSigTimeoutTime_DMSM" SG_ 263 R_SHFT_LOCK_PT 0;
BA_ "GenSigTimeoutTime_DTCM" SG_ 263 R_SHFT_LOCK_PT 0;
BA_ "GenSigTimeoutTime_ECM" SG_ 263 R_SHFT_LOCK_PT 0;
BA_ "GenSigTimeoutTime_EVCU2" SG_ 263 R_SHFT_LOCK_PT 0;
BA_ "GenSigTimeoutTime_GNMM" SG_ 263 R_SHFT_LOCK_PT 0;
BA_ "GenSigTimeoutTime_HCP" SG_ 263 R_SHFT_LOCK_PT 0;
BA_ "GenSigTimeoutTime_IPC" SG_ 263 R_SHFT_LOCK_PT 0;
BA_ "GenSigTimeoutTime_RFHM" SG_ 263 R_SHFT_LOCK_PT 0;
BA_ "GenSigTimeoutTime_SGW" SG_ 263 R_SHFT_LOCK_PT 0;
BA_ "GenSigTimeoutTime_TCM" SG_ 263 R_SHFT_LOCK_PT 0;
BA_ "GenSigStartValue" SG_ 263 RawPVS1_PT 255;
BA_ "GenSigTimeoutTime_AGSM" SG_ 263 RawPVS1_PT 0;
BA_ "GenSigTimeoutTime_BCM" SG_ 263 RawPVS1_PT 0;
BA_ "GenSigTimeoutTime_BSM" SG_ 263 RawPVS1_PT 0;
BA_ "GenSigTimeoutTime_CADM" SG_ 263 RawPVS1_PT 0;
BA_ "GenSigTimeoutTime_DMSM" SG_ 263 RawPVS1_PT 0;
BA_ "GenSigTimeoutTime_DTCM" SG_ 263 RawPVS1_PT 0;
BA_ "GenSigTimeoutTime_ECM" SG_ 263 RawPVS1_PT 0;
BA_ "GenSigTimeoutTime_EVCU2" SG_ 263 RawPVS1_PT 0;
BA_ "GenSigTimeoutTime_GNMM" SG_ 263 RawPVS1_PT 0;
BA_ "GenSigTimeoutTime_HCP" SG_ 263 RawPVS1_PT 0;
BA_ "GenSigTimeoutTime_IPC" SG_ 263 RawPVS1_PT 0;
BA_ "GenSigTimeoutTime_RFHM" SG_ 263 RawPVS1_PT 0;
BA_ "GenSigTimeoutTime_SGW" SG_ 263 RawPVS1_PT 0;
BA_ "GenSigTimeoutTime_TCM" SG_ 263 RawPVS1_PT 0;
BA_ "GenSigStartValue" SG_ 263 RawPVS2_PT 255;
BA_ "GenSigTimeoutTime_AGSM" SG_ 263 RawPVS2_PT 0;
BA_ "GenSigTimeoutTime_BCM" SG_ 263 RawPVS2_PT 0;
BA_ "GenSigTimeoutTime_BSM" SG_ 263 RawPVS2_PT 0;
BA_ "GenSigTimeoutTime_CADM" SG_ 263 RawPVS2_PT 0;
BA_ "GenSigTimeoutTime_DMSM" SG_ 263 RawPVS2_PT 0;
BA_ "GenSigTimeoutTime_DTCM" SG_ 263 RawPVS2_PT 0;
BA_ "GenSigTimeoutTime_ECM" SG_ 263 RawPVS2_PT 0;
BA_ "GenSigTimeoutTime_EVCU2" SG_ 263 RawPVS2_PT 0;
BA_ "GenSigTimeoutTime_GNMM" SG_ 263 RawPVS2_PT 0;
BA_ "GenSigTimeoutTime_HCP" SG_ 263 RawPVS2_PT 0;
BA_ "GenSigTimeoutTime_IPC" SG_ 263 RawPVS2_PT 0;
BA_ "GenSigTimeoutTime_RFHM" SG_ 263 RawPVS2_PT 0;
BA_ "GenSigTimeoutTime_SGW" SG_ 263 RawPVS2_PT 0;
BA_ "GenSigTimeoutTime_TCM" SG_ 263 RawPVS2_PT 0;
BA_ "GenSigTimeoutTime_AGSM" SG_ 263 ShiftLeverLockReq_PT 0;
BA_ "GenSigTimeoutTime_BCM" SG_ 263 ShiftLeverLockReq_PT 0;
BA_ "GenSigTimeoutTime_BSM" SG_ 263 ShiftLeverLockReq_PT 0;
BA_ "GenSigTimeoutTime_CADM" SG_ 263 ShiftLeverLockReq_PT 0;
BA_ "GenSigTimeoutTime_DMSM" SG_ 263 ShiftLeverLockReq_PT 0;
BA_ "GenSigTimeoutTime_DTCM" SG_ 263 ShiftLeverLockReq_PT 0;
BA_ "GenSigTimeoutTime_ECM" SG_ 263 ShiftLeverLockReq_PT 0;
BA_ "GenSigTimeoutTime_EVCU2" SG_ 263 ShiftLeverLockReq_PT 0;
BA_ "GenSigTimeoutTime_GNMM" SG_ 263 ShiftLeverLockReq_PT 0;
BA_ "GenSigTimeoutTime_HCP" SG_ 263 ShiftLeverLockReq_PT 0;
BA_ "GenSigTimeoutTime_IPC" SG_ 263 ShiftLeverLockReq_PT 0;
BA_ "GenSigTimeoutTime_RFHM" SG_ 263 ShiftLeverLockReq_PT 0;
BA_ "GenSigTimeoutTime_SGW" SG_ 263 ShiftLeverLockReq_PT 0;
BA_ "GenSigTimeoutTime_TCM" SG_ 263 ShiftLeverLockReq_PT 0;
BA_ "GenSigTimeoutTime_DMSM" SG_ 263 ShiftLeverPosition_PT 0;
BA_ "GenSigTimeoutTime_DTCM" SG_ 263 ShiftLeverPosition_PT 0;
BA_ "GenSigTimeoutTime_ECM" SG_ 263 ShiftLeverPosition_PT 0;
BA_ "GenSigTimeoutTime_EVCU2" SG_ 263 ShiftLeverPosition_PT 0;
BA_ "GenSigTimeoutTime_GNMM" SG_ 263 ShiftLeverPosition_PT 0;
BA_ "GenSigTimeoutTime_HCP" SG_ 263 ShiftLeverPosition_PT 0;
BA_ "GenSigTimeoutTime_RFHM" SG_ 263 ShiftLeverPosition_PT 0;
BA_ "GenSigTimeoutTime_TCM" SG_ 263 ShiftLeverPosition_PT 0;
BA_ "GenSigTimeoutTime_AGSM" SG_ 263 TargetGear_PT 0;
BA_ "GenSigTimeoutTime_DMSM" SG_ 263 TargetGear_PT 0;
BA_ "GenSigTimeoutTime_DTCM" SG_ 263 TargetGear_PT 0;
BA_ "GenSigTimeoutTime_ECM" SG_ 263 TargetGear_PT 0;
BA_ "GenSigTimeoutTime_EVCU2" SG_ 263 TargetGear_PT 0;
BA_ "GenSigTimeoutTime_GNMM" SG_ 263 TargetGear_PT 0;
BA_ "GenSigTimeoutTime_HCP" SG_ 263 TargetGear_PT 0;
BA_ "GenSigTimeoutTime_RFHM" SG_ 263 TargetGear_PT 0;
BA_ "GenSigTimeoutTime_TCM" SG_ 263 TargetGear_PT 0;
BA_ "GenSigTimeoutTime_AGSM" SG_ 263 TerrainModeStat_PT 0;
BA_ "GenSigTimeoutTime_DMSM" SG_ 263 TerrainModeStat_PT 0;
BA_ "GenSigTimeoutTime_DTCM" SG_ 263 TerrainModeStat_PT 0;
BA_ "GenSigTimeoutTime_ECM" SG_ 263 TerrainModeStat_PT 0;
BA_ "GenSigTimeoutTime_EVCU2" SG_ 263 TerrainModeStat_PT 0;
BA_ "GenSigTimeoutTime_GNMM" SG_ 263 TerrainModeStat_PT 0;
BA_ "GenSigTimeoutTime_HCP" SG_ 263 TerrainModeStat_PT 0;
BA_ "GenSigTimeoutTime_RFHM" SG_ 263 TerrainModeStat_PT 0;
BA_ "GenSigTimeoutTime_TCM" SG_ 263 TerrainModeStat_PT 0;
BA_ "GenSigTimeoutTime_BSM" SG_ 263 TransmissionFailSts_PT 0;
BA_ "GenSigTimeoutTime_CADM" SG_ 263 TransmissionFailSts_PT 0;
BA_ "GenSigTimeoutTime_DMSM" SG_ 263 TransmissionFailSts_PT 0;
BA_ "GenSigTimeoutTime_DTCM" SG_ 263 TransmissionFailSts_PT 0;
BA_ "GenSigTimeoutTime_EVCU2" SG_ 263 TransmissionFailSts_PT 0;
BA_ "GenSigTimeoutTime_GNMM" SG_ 263 TransmissionFailSts_PT 0;
BA_ "GenSigTimeoutTime_HCP" SG_ 263 TransmissionFailSts_PT 0;
BA_ "GenSigTimeoutTime_IPC" SG_ 263 TransmissionFailSts_PT 0;
BA_ "GenSigTimeoutTime_RFHM" SG_ 263 TransmissionFailSts_PT 0;
BA_ "GenSigTimeoutTime_TCM" SG_ 263 TransmissionFailSts_PT 0;
BA_ "GenSigTimeoutTime_AGSM" SG_ 263 TransmissionWarnings_PT 0;
BA_ "GenSigTimeoutTime_BSM" SG_ 263 TransmissionWarnings_PT 0;
BA_ "GenSigTimeoutTime_CADM" SG_ 263 TransmissionWarnings_PT 0;
BA_ "GenSigTimeoutTime_DMSM" SG_ 263 TransmissionWarnings_PT 0;
BA_ "GenSigTimeoutTime_DTCM" SG_ 263 TransmissionWarnings_PT 0;
BA_ "GenSigTimeoutTime_ECM" SG_ 263 TransmissionWarnings_PT 0;
BA_ "GenSigTimeoutTime_EVCU2" SG_ 263 TransmissionWarnings_PT 0;
BA_ "GenSigTimeoutTime_GNMM" SG_ 263 TransmissionWarnings_PT 0;
BA_ "GenSigTimeoutTime_HCP" SG_ 263 TransmissionWarnings_PT 0;
BA_ "GenSigTimeoutTime_RFHM" SG_ 263 TransmissionWarnings_PT 0;
BA_ "GenSigTimeoutTime_TCM" SG_ 263 TransmissionWarnings_PT 0;
BA_ "GenSigTimeoutTime_AGSM" SG_ 263 TurtleModeSts_PT 0;
BA_ "GenSigTimeoutTime_BCM" SG_ 263 TurtleModeSts_PT 0;
BA_ "GenSigTimeoutTime_BSM" SG_ 263 TurtleModeSts_PT 0;
BA_ "GenSigTimeoutTime_CADM" SG_ 263 TurtleModeSts_PT 0;
BA_ "GenSigTimeoutTime_DMSM" SG_ 263 TurtleModeSts_PT 0;
BA_ "GenSigTimeoutTime_DTCM" SG_ 263 TurtleModeSts_PT 0;
BA_ "GenSigTimeoutTime_ECM" SG_ 263 TurtleModeSts_PT 0;
BA_ "GenSigTimeoutTime_EVCU2" SG_ 263 TurtleModeSts_PT 0;
BA_ "GenSigTimeoutTime_GNMM" SG_ 263 TurtleModeSts_PT 0;
BA_ "GenSigTimeoutTime_HCP" SG_ 263 TurtleModeSts_PT 0;
BA_ "GenSigTimeoutTime_RFHM" SG_ 263 TurtleModeSts_PT 0;
BA_ "GenSigTimeoutTime_SGW" SG_ 263 TurtleModeSts_PT 0;
BA_ "GenSigTimeoutTime_TCM" SG_ 263 TurtleModeSts_PT 0;
BA_ "GenSigTimeoutTime_AGSM" SG_ 263 VehSpd_Overridden_PT 0;
BA_ "GenSigTimeoutTime_BCM" SG_ 263 VehSpd_Overridden_PT 0;
BA_ "GenSigTimeoutTime_BSM" SG_ 263 VehSpd_Overridden_PT 0;
BA_ "GenSigTimeoutTime_CADM" SG_ 263 VehSpd_Overridden_PT 0;
BA_ "GenSigTimeoutTime_DMSM" SG_ 263 VehSpd_Overridden_PT 0;
BA_ "GenSigTimeoutTime_DTCM" SG_ 263 VehSpd_Overridden_PT 0;
BA_ "GenSigTimeoutTime_ECM" SG_ 263 VehSpd_Overridden_PT 0;
BA_ "GenSigTimeoutTime_EVCU2" SG_ 263 VehSpd_Overridden_PT 0;
BA_ "GenSigTimeoutTime_GNMM" SG_ 263 VehSpd_Overridden_PT 0;
BA_ "GenSigTimeoutTime_HCP" SG_ 263 VehSpd_Overridden_PT 0;
BA_ "GenSigTimeoutTime_RFHM" SG_ 263 VehSpd_Overridden_PT 0;
BA_ "GenSigTimeoutTime_SGW" SG_ 263 VehSpd_Overridden_PT 0;
BA_ "GenSigTimeoutTime_TCM" SG_ 263 VehSpd_Overridden_PT 0;
BA_ "GenSigTimeoutTime_AGSM" SG_ 263 Warn_BTO_PT 0;
BA_ "GenSigTimeoutTime_BCM" SG_ 263 Warn_BTO_PT 0;
BA_ "GenSigTimeoutTime_BSM" SG_ 263 Warn_BTO_PT 0;
BA_ "GenSigTimeoutTime_CADM" SG_ 263 Warn_BTO_PT 0;
BA_ "GenSigTimeoutTime_DMSM" SG_ 263 Warn_BTO_PT 0;
BA_ "GenSigTimeoutTime_DTCM" SG_ 263 Warn_BTO_PT 0;
BA_ "GenSigTimeoutTime_ECM" SG_ 263 Warn_BTO_PT 0;
BA_ "GenSigTimeoutTime_EVCU2" SG_ 263 Warn_BTO_PT 0;
BA_ "GenSigTimeoutTime_GNMM" SG_ 263 Warn_BTO_PT 0;
BA_ "GenSigTimeoutTime_HCP" SG_ 263 Warn_BTO_PT 0;
BA_ "GenSigTimeoutTime_RFHM" SG_ 263 Warn_BTO_PT 0;
BA_ "GenSigTimeoutTime_SGW" SG_ 263 Warn_BTO_PT 0;
BA_ "GenSigTimeoutTime_TCM" SG_ 263 Warn_BTO_PT 0;
VAL_ 2654339161 CurrentCanNMState_FD05_MCPB 0 "Uninitialized State" 1 "Bus-Sleep State" 2 "Prepare-Bus State" 3 "Ready-Sleep State" 4 "Normal Operation State" 5 "Repeat Message State" 6 "Synchronize State" 7 "Offline State";
VAL_ 2654339161 CurrentCanNMState_FD16_MCPB 0 "Uninitialized State" 1 "Bus-Sleep State" 2 "Prepare-Bus State" 3 "Ready-Sleep State" 4 "Normal Operation State" 5 "Repeat Message State" 6 "Synchronize State" 7 "Offline State";
VAL_ 2654339161 CurrentFailSts_FD05_MCPB 0 "No_Fail_Present" 1 "Fail_Present";
VAL_ 2654339161 CurrentFailSts_FD16_MCPB 0 "No_Fail_Present" 1 "Fail_Present";
VAL_ 2654339161 DES_FD05_MCPB 0 "Error_Active_state" 1 "Error_passive_warning_state" 2 "Bus_off_state" 3 "Not_used";
VAL_ 2654339161 DES_FD16_MCPB 0 "Error_Active_state" 1 "Error_passive_warning_state" 2 "Bus_off_state" 3 "Not_used";
VAL_ 2654339161 EOL_FD05_MCPB 0 "No_EOL_Programming" 1 "EOL_Programming";
VAL_ 2654339161 EOL_FD16_MCPB 0 "No_EOL_Programming" 1 "EOL_Programming";
VAL_ 2654339161 GenericFailSts_FD05_MCPB 0 "No_Fail_Present" 1 "Fail_Present";
VAL_ 2654339161 GenericFailSts_FD16_MCPB 0 "No_Fail_Present" 1 "Fail_Present";
VAL_ 2654339161 PreviousCanNMState_FD05_MCPB 0 "Uninitialized State" 1 "Bus-Sleep State" 2 "Prepare-Bus State" 3 "Ready-Sleep State" 4 "Normal Operation State" 5 "Repeat Message State" 6 "Synchronize State" 7 "Offline State";
VAL_ 2654339161 PreviousCanNMState_FD16_MCPB 0 "Uninitialized State" 1 "Bus-Sleep State" 2 "Prepare-Bus State" 3 "Ready-Sleep State" 4 "Normal Operation State" 5 "Repeat Message State" 6 "Synchronize State" 7 "Offline State";
VAL_ 2654339161 WakeupSource_FD05_MCPB 0 "No_Wakeup";
VAL_ 2654339161 WakeupSource_FD16_MCPB 0 "No_Wakeup";
VAL_ 2654339286 CurrentCanNMState_FD05_PPIM 0 "Uninitialized State" 1 "Bus-Sleep State" 2 "Prepare-Bus State" 3 "Ready-Sleep State" 4 "Normal Operation State" 5 "Repeat Message State" 6 "Synchronize State" 7 "Offline State";
VAL_ 2654339286 CurrentCanNMState_FD11_PPIM 0 "Uninitialized State" 1 "Bus-Sleep State" 2 "Prepare-Bus State" 3 "Ready-Sleep State" 4 "Normal Operation State" 5 "Repeat Message State" 6 "Synchronize State" 7 "Offline State";
VAL_ 2654339286 CurrentFailSts_FD05_PPIM 0 "No_Fail_Present" 1 "Fail_Present";
VAL_ 2654339286 CurrentFailSts_FD11_PPIM 0 "No_Fail_Present" 1 "Fail_Present";
VAL_ 2654339286 DES_FD05_PPIM 0 "Error_Active_state" 1 "Error_passive_warning_state" 2 "Bus_off_state" 3 "Not_used";
VAL_ 2654339286 DES_FD11_PPIM 0 "Error_Active_state" 1 "Error_passive_warning_state" 2 "Bus_off_state" 3 "Not_used";
VAL_ 2654339286 EOL_FD05_PPIM 0 "No_EOL_Programming" 1 "EOL_Programming";
VAL_ 2654339286 EOL_FD11_PPIM 0 "No_EOL_Programming" 1 "EOL_Programming";
VAL_ 2654339286 GenericFailSts_FD05_PPIM 0 "No_Fail_Present" 1 "Fail_Present";
VAL_ 2654339286 GenericFailSts_FD11_PPIM 0 "No_Fail_Present" 1 "Fail_Present";
VAL_ 2654339286 PreviousCanNMState_FD05_PPIM 0 "Uninitialized State" 1 "Bus-Sleep State" 2 "Prepare-Bus State" 3 "Ready-Sleep State" 4 "Normal Operation State" 5 "Repeat Message State" 6 "Synchronize State" 7 "Offline State";
VAL_ 2654339286 PreviousCanNMState_FD11_PPIM 0 "Uninitialized State" 1 "Bus-Sleep State" 2 "Prepare-Bus State" 3 "Ready-Sleep State" 4 "Normal Operation State" 5 "Repeat Message State" 6 "Synchronize State" 7 "Offline State";
VAL_ 2654339286 WakeupSource_FD05_PPIM 0 "No_Wakeup";
VAL_ 2654339286 WakeupSource_FD11_PPIM 0 "No_Wakeup";
VAL_ 2654339137 CurrentCanNMState_FD03_RFHM 0 "Uninitialized State" 1 "Bus-Sleep State" 2 "Prepare-Bus State" 3 "Ready-Sleep State" 4 "Normal Operation State" 5 "Repeat Message State" 6 "Synchronize State" 7 "Offline State";
VAL_ 2654339137 CurrentCanNMState_FD09_RFHM 0 "Uninitialized State" 1 "Bus-Sleep State" 2 "Prepare-Bus State" 3 "Ready-Sleep State" 4 "Normal Operation State" 5 "Repeat Message State" 6 "Synchronize State" 7 "Offline State";
VAL_ 2654339137 CurrentFailSts_FD03_RFHM 0 "No_Fail_Present" 1 "Fail_Present";
VAL_ 2654339137 CurrentFailSts_FD09_RFHM 0 "No_Fail_Present" 1 "Fail_Present";
VAL_ 2654339137 DES_FD03_RFHM 0 "Error_Active_state" 1 "Error_passive_warning_state" 2 "Bus_off_state" 3 "Not_used";
VAL_ 2654339137 DES_FD09_RFHM 0 "Error_Active_state" 1 "Error_passive_warning_state" 2 "Bus_off_state" 3 "Not_used";
VAL_ 2654339137 EOL_FD03_RFHM 0 "No_EOL_Programming" 1 "EOL_Programming";
VAL_ 2654339137 EOL_FD09_RFHM 0 "No_EOL_Programming" 1 "EOL_Programming";
VAL_ 2654339137 GenericFailSts_FD03_RFHM 0 "No_Fail_Present" 1 "Fail_Present";
VAL_ 2654339137 GenericFailSts_FD09_RFHM 0 "No_Fail_Present" 1 "Fail_Present";
VAL_ 2654339137 PreviousCanNMState_FD03_RFHM 0 "Uninitialized State" 1 "Bus-Sleep State" 2 "Prepare-Bus State" 3 "Ready-Sleep State" 4 "Normal Operation State" 5 "Repeat Message State" 6 "Synchronize State" 7 "Offline State";
VAL_ 2654339137 PreviousCanNMState_FD09_RFHM 0 "Uninitialized State" 1 "Bus-Sleep State" 2 "Prepare-Bus State" 3 "Ready-Sleep State" 4 "Normal Operation State" 5 "Repeat Message State" 6 "Synchronize State" 7 "Offline State";
VAL_ 2654339137 StayActiveSource_FD03_RFHM 0 "CANNM_Ready_Sleep" 1 "IGN_ON" 2 "NonDefault_Diag" 4 "ING_OFF_NormSt_RptSt" 15 "None" 16 "Ignition_RUN_START" 17 "RKE_Lock" 18 "RKE_Unlock" 19 "RKE_Trunk" 20 "RKE_Panic" 21 "RKE_AS" 22 "RKE_RS" 23 "Fob_Search_Request_BCM" 24 "Liftgate_Lock" 25 "KIN_Press" 26 "Warning_Reserved" 27 "Proximity_Wakeup" 28 "NM_From_Other_ECU_CANFD3" 29 "CANFD9" 30 "PE_FL_Lock" 31 "PE_FL_Unlock" 32 "PE_FL_Pull" 33 "PE_FR_Lock" 34 "PE_FR_Unlock" 35 "PE_FR_Pull" 36 "PE_RL_Lock" 37 "PE_RL_Unlock" 38 "PE_RL_Pull" 39 "PE_RR_Lock" 40 "PE_RR_Unlock" 41 "PE_RR_Pull";
VAL_ 2654339137 StayActiveSource_FD09_RFHM 0 "CANNM_Ready_Sleep" 1 "IGN_ON" 2 "NonDefault_Diag" 4 "ING_OFF_NormSt_RptSt";
VAL_ 2654339137 WakeupSource_FD03_RFHM 0 "No_Wakeup" 1 "Diagnostic" 2 "Network_FD3" 3 "Start_Stop_Ignition_Button" 4 "Left_Front_Door_Handle_Input" 5 "Right_Front_Door_Handle_Input" 6 "Left_Rear_Door_Handle_Input" 7 "Right_Rear_Door_Handle_Input" 8 "Trunk_Liftgate_Input" 9 "RF_Input" 10 "Reset" 11 "Cap_Sens_24Hr_Reset_Timer_Expire" 12 "Clutch_Input" 13 "Network_FD9" 14 "Proximity" 15 "None" 16 "Ignition_RUN_START" 17 "RKE_Lock" 18 "RKE_Unlock" 19 "RKE_Trunk" 20 "RKE_Panic" 21 "RKE_AS" 22 "RKE_RS" 23 "Fob_Search_Request_BCM" 24 "Liftgate_Lock" 25 "KIN_Press" 26 "Warning_Reserved" 27 "Proximity_Wakeup" 28 "NM_From_Other_ECU_CANFD3" 29 "CANFD9" 30 "PE_FL_Lock" 31 "PE_FL_Unlock" 32 "PE_FL_Pull" 33 "PE_FR_Lock" 34 "PE_FR_Unlock" 35 "PE_FR_Pull" 36 "PE_RL_Lock" 37 "PE_RL_Unlock" 38 "PE_RL_Pull" 39 "PE_RR_Lock" 40 "PE_RR_Unlock" 41 "PE_RR_Pull" 129 "FD1_Psv_WU" 130 "FD2_Psv_WU" 131 "FD3_Psv_WU" 132 "FD4_Psv_WU" 133 "FD5_Psv_WU" 134 "FD6_Psv_WU" 135 "FD7_Psv_WU" 136 "FD8_Psv_WU" 137 "FD9_Psv_WU" 138 "FD10_Psv_WU" 139 "FD11_Psv_WU" 140 "FD12_Psv_WU" 141 "FD13_Psv_WU" 142 "FD14_Psv_WU" 143 "FD15_Psv_WU" 144 "FD16_Psv_WU" 145 "FD17_Psv_WU" 146 "FD18_Psv_WU" 147 "FD19_Psv_WU" 148 "FD20_Psv_WU" 149 "FD21_Psv_WU" 150 "FD22_Psv_WU" 151 "FD23_Psv_WU" 152 "FD24_Psv_WU" 153 "FD25_Psv_WU" 154 "FD26_Psv_WU" 155 "FD27_Psv_WU" 156 "FD28_Psv_WU" 157 "FD29_Psv_WU" 158 "BHCAN_Psv_WU" 159 "CCAN_Psv_WU" 255 "SNA";
VAL_ 2654339137 WakeupSource_FD09_RFHM 0 "No_Wakeup" 1 "Diagnostic" 2 "Network_FD3" 3 "Start_Stop_Ignition_Button" 4 "Left_Front_Door_Handle_Input" 5 "Right_Front_Door_Handle_Input" 6 "Left_Rear_Door_Handle_Input" 7 "Right_Rear_Door_Handle_Input" 8 "Trunk_Liftgate_Input" 9 "RF_Input" 10 "Reset" 11 "Cap_Sens_24Hr_Reset_Timer_Expire" 12 "Clutch_Input" 13 "Network_FD9" 14 "Proximity" 15 "SNA" 129 "FD1_Psv_WU" 130 "FD2_Psv_WU" 131 "FD3_Psv_WU" 132 "FD4_Psv_WU" 133 "FD5_Psv_WU" 134 "FD6_Psv_WU" 135 "FD7_Psv_WU" 136 "FD8_Psv_WU" 137 "FD9_Psv_WU" 138 "FD10_Psv_WU" 139 "FD11_Psv_WU" 140 "FD12_Psv_WU" 141 "FD13_Psv_WU" 142 "FD14_Psv_WU" 143 "FD15_Psv_WU" 144 "FD16_Psv_WU" 145 "FD17_Psv_WU" 146 "FD18_Psv_WU" 147 "FD19_Psv_WU" 148 "FD20_Psv_WU" 149 "FD21_Psv_WU" 150 "FD22_Psv_WU" 151 "FD23_Psv_WU" 152 "FD24_Psv_WU" 153 "FD25_Psv_WU" 154 "FD26_Psv_WU" 155 "FD27_Psv_WU" 156 "FD28_Psv_WU" 157 "FD29_Psv_WU" 158 "BHCAN_Psv_WU" 159 "CCAN_Psv_WU";
VAL_ 2654339273 CurrentCanNMState_FD05_SGCP 0 "Uninitialized State" 1 "Bus-Sleep State" 2 "Prepare-Bus State" 3 "Ready-Sleep State" 4 "Normal Operation State" 5 "Repeat Message State" 6 "Synchronize State" 7 "Offline State";
VAL_ 2654339273 CurrentCanNMState_FD16_SGCP 0 "Uninitialized State" 1 "Bus-Sleep State" 2 "Prepare-Bus State" 3 "Ready-Sleep State" 4 "Normal Operation State" 5 "Repeat Message State" 6 "Synchronize State" 7 "Offline State";
VAL_ 2654339273 CurrentFailSts_FD05_SGCP 0 "No_Fail_Present" 1 "Fail_Present";
VAL_ 2654339273 CurrentFailSts_FD16_SGCP 0 "No_Fail_Present" 1 "Fail_Present";
VAL_ 2654339273 DES_FD05_SGCP 0 "Error_Active_state" 1 "Error_passive_warning_state" 2 "Bus_off_state" 3 "Not_used";
VAL_ 2654339273 DES_FD16_SGCP 0 "Error_Active_state" 1 "Error_passive_warning_state" 2 "Bus_off_state" 3 "Not_used";
VAL_ 2654339273 EOL_FD05_SGCP 0 "No_EOL_Programming" 1 "EOL_Programming";
VAL_ 2654339273 EOL_FD16_SGCP 0 "No_EOL_Programming" 1 "EOL_Programming";
VAL_ 2654339273 GenericFailSts_FD05_SGCP 0 "No_Fail_Present" 1 "Fail_Present";
VAL_ 2654339273 GenericFailSts_FD16_SGCP 0 "No_Fail_Present" 1 "Fail_Present";
VAL_ 2654339273 PreviousCanNMState_FD05_SGCP 0 "Uninitialized State" 1 "Bus-Sleep State" 2 "Prepare-Bus State" 3 "Ready-Sleep State" 4 "Normal Operation State" 5 "Repeat Message State" 6 "Synchronize State" 7 "Offline State";
VAL_ 2654339273 PreviousCanNMState_FD16_SGCP 0 "Uninitialized State" 1 "Bus-Sleep State" 2 "Prepare-Bus State" 3 "Ready-Sleep State" 4 "Normal Operation State" 5 "Repeat Message State" 6 "Synchronize State" 7 "Offline State";
VAL_ 2654339273 WakeupSource_FD05_SGCP 0 "No_Wakeup";
VAL_ 2654339273 WakeupSource_FD16_SGCP 0 "No_Wakeup";
VAL_ 2654339184 CurrentCanNMState_FD01_SGW 0 "Uninitialized State" 1 "Bus-Sleep State" 2 "Prepare-Bus State" 3 "Ready-Sleep State" 4 "Normal Operation State" 5 "Repeat Message State" 6 "Synchronize State" 7 "Offline State";
VAL_ 2654339184 CurrentCanNMState_FD02_SGW 0 "Uninitialized State" 1 "Bus-Sleep State" 2 "Prepare-Bus State" 3 "Ready-Sleep State" 4 "Normal Operation State" 5 "Repeat Message State" 6 "Synchronize State" 7 "Offline State";
VAL_ 2654339184 CurrentCanNMState_FD03_SGW 0 "Uninitialized State" 1 "Bus-Sleep State" 2 "Prepare-Bus State" 3 "Ready-Sleep State" 4 "Normal Operation State" 5 "Repeat Message State" 6 "Synchronize State" 7 "Offline State";
VAL_ 2654339184 CurrentCanNMState_FD08_SGW 0 "Uninitialized State" 1 "Bus-Sleep State" 2 "Prepare-Bus State" 3 "Ready-Sleep State" 4 "Normal Operation State" 5 "Repeat Message State" 6 "Synchronize State" 7 "Offline State";
VAL_ 2654339184 CurrentCanNMState_FD11_SGW 0 "Uninitialized State" 1 "Bus-Sleep State" 2 "Prepare-Bus State" 3 "Ready-Sleep State" 4 "Normal Operation State" 5 "Repeat Message State" 6 "Synchronize State" 7 "Offline State";
VAL_ 2654339184 CurrentFailSts_FD01_SGW 0 "No_Fail_Present" 1 "Fail_Present";
VAL_ 2654339184 CurrentFailSts_FD02_SGW 0 "No_Fail_Present" 1 "Fail_Present";
VAL_ 2654339184 CurrentFailSts_FD03_SGW 0 "No_Fail_Present" 1 "Fail_Present";
VAL_ 2654339184 CurrentFailSts_FD08_SGW 0 "No_Fail_Present" 1 "Fail_Present";
VAL_ 2654339184 CurrentFailSts_FD11_SGW 0 "No_Fail_Present" 1 "Fail_Present";
VAL_ 2654339184 DES_FD01_SGW 0 "Error_Active_state" 1 "Error_passive_warning_state" 2 "Bus_off_state" 3 "Not_used";
VAL_ 2654339184 DES_FD02_SGW 0 "Error_Active_state" 1 "Error_passive_warning_state" 2 "Bus_off_state" 3 "Not_used";
VAL_ 2654339184 DES_FD03_SGW 0 "Error_Active_state" 1 "Error_passive_warning_state" 2 "Bus_off_state" 3 "Not_used";
VAL_ 2654339184 DES_FD08_SGW 0 "Error_Active_state" 1 "Error_passive_warning_state" 2 "Bus_off_state" 3 "Not_used";
VAL_ 2654339184 DES_FD11_SGW 0 "Error_Active_state" 1 "Error_passive_warning_state" 2 "Bus_off_state" 3 "Not_used";
VAL_ 2654339184 EOL_FD01_SGW 0 "No_EOL_Programming" 1 "EOL_Programming";
VAL_ 2654339184 EOL_FD02_SGW 0 "No_EOL_Programming" 1 "EOL_Programming";
VAL_ 2654339184 EOL_FD03_SGW 0 "No_EOL_Programming" 1 "EOL_Programming";
VAL_ 2654339184 EOL_FD08_SGW 0 "No_EOL_Programming" 1 "EOL_Programming";
VAL_ 2654339184 EOL_FD11_SGW 0 "No_EOL_Programming" 1 "EOL_Programming";
VAL_ 2654339184 GenericFailSts_FD01_SGW 0 "No_Fail_Present" 1 "Fail_Present";
VAL_ 2654339184 GenericFailSts_FD02_SGW 0 "No_Fail_Present" 1 "Fail_Present";
VAL_ 2654339184 GenericFailSts_FD03_SGW 0 "No_Fail_Present" 1 "Fail_Present";
VAL_ 2654339184 GenericFailSts_FD08_SGW 0 "No_Fail_Present" 1 "Fail_Present";
VAL_ 2654339184 GenericFailSts_FD11_SGW 0 "No_Fail_Present" 1 "Fail_Present";
VAL_ 2654339184 PreviousCanNMState_FD01_SGW 0 "Uninitialized State" 1 "Bus-Sleep State" 2 "Prepare-Bus State" 3 "Ready-Sleep State" 4 "Normal Operation State" 5 "Repeat Message State" 6 "Synchronize State" 7 "Offline State";
VAL_ 2654339184 PreviousCanNMState_FD02_SGW 0 "Uninitialized State" 1 "Bus-Sleep State" 2 "Prepare-Bus State" 3 "Ready-Sleep State" 4 "Normal Operation State" 5 "Repeat Message State" 6 "Synchronize State" 7 "Offline State";
VAL_ 2654339184 PreviousCanNMState_FD03_SGW 0 "Uninitialized State" 1 "Bus-Sleep State" 2 "Prepare-Bus State" 3 "Ready-Sleep State" 4 "Normal Operation State" 5 "Repeat Message State" 6 "Synchronize State" 7 "Offline State";
VAL_ 2654339184 PreviousCanNMState_FD08_SGW 0 "Uninitialized State" 1 "Bus-Sleep State" 2 "Prepare-Bus State" 3 "Ready-Sleep State" 4 "Normal Operation State" 5 "Repeat Message State" 6 "Synchronize State" 7 "Offline State";
VAL_ 2654339184 PreviousCanNMState_FD11_SGW 0 "Uninitialized State" 1 "Bus-Sleep State" 2 "Prepare-Bus State" 3 "Ready-Sleep State" 4 "Normal Operation State" 5 "Repeat Message State" 6 "Synchronize State" 7 "Offline State";
VAL_ 2654339184 StayActiveSource_FD01_SGW 0 "CANNM_Ready_Sleep" 1 "IGN_ON" 2 "NonDefault_Diag" 4 "ING_OFF_NormSt_RptSt";
VAL_ 2654339184 StayActiveSource_FD02_SGW 0 "CANNM_Ready_Sleep" 1 "IGN_ON" 2 "NonDefault_Diag" 4 "ING_OFF_NormSt_RptSt";
VAL_ 2654339184 StayActiveSource_FD03_SGW 0 "CANNM_Ready_Sleep" 1 "IGN_ON" 2 "NonDefault_Diag" 4 "ING_OFF_NormSt_RptSt";
VAL_ 2654339184 StayActiveSource_FD08_SGW 0 "CANNM_Ready_Sleep" 1 "IGN_ON" 2 "NonDefault_Diag" 4 "ING_OFF_NormSt_RptSt";
VAL_ 2654339184 StayActiveSource_FD11_SGW 0 "CANNM_Ready_Sleep" 1 "IGN_ON" 2 "NonDefault_Diag" 4 "ING_OFF_NormSt_RptSt";
VAL_ 2654339184 WakeupSource_FD01_SGW 0 "No_Wakeup" 1 "IGN_ON" 129 "FD1_Psv_WU" 130 "FD2_Psv_WU" 131 "FD3_Psv_WU" 132 "FD4_Psv_WU" 133 "FD5_Psv_WU" 134 "FD6_Psv_WU" 135 "FD7_Psv_WU" 136 "FD8_Psv_WU" 137 "FD9_Psv_WU" 138 "FD10_Psv_WU" 139 "FD11_Psv_WU" 140 "FD12_Psv_WU" 141 "FD13_Psv_WU" 142 "FD14_Psv_WU" 143 "FD15_Psv_WU" 144 "FD16_Psv_WU" 145 "FD17_Psv_WU" 146 "FD18_Psv_WU" 147 "FD19_Psv_WU" 148 "FD20_Psv_WU" 149 "FD21_Psv_WU" 150 "FD22_Psv_WU" 151 "FD23_Psv_WU" 152 "FD24_Psv_WU" 153 "FD25_Psv_WU" 154 "FD26_Psv_WU" 155 "FD27_Psv_WU" 156 "FD28_Psv_WU" 157 "FD29_Psv_WU" 158 "BHCAN_Psv_WU" 159 "CCAN_Psv_WU";
VAL_ 2654339184 WakeupSource_FD02_SGW 0 "No_Wakeup" 1 "IGN_ON" 129 "FD1_Psv_WU" 130 "FD2_Psv_WU" 131 "FD3_Psv_WU" 132 "FD4_Psv_WU" 133 "FD5_Psv_WU" 134 "FD6_Psv_WU" 135 "FD7_Psv_WU" 136 "FD8_Psv_WU" 137 "FD9_Psv_WU" 138 "FD10_Psv_WU" 139 "FD11_Psv_WU" 140 "FD12_Psv_WU" 141 "FD13_Psv_WU" 142 "FD14_Psv_WU" 143 "FD15_Psv_WU" 144 "FD16_Psv_WU" 145 "FD17_Psv_WU" 146 "FD18_Psv_WU" 147 "FD19_Psv_WU" 148 "FD20_Psv_WU" 149 "FD21_Psv_WU" 150 "FD22_Psv_WU" 151 "FD23_Psv_WU" 152 "FD24_Psv_WU" 153 "FD25_Psv_WU" 154 "FD26_Psv_WU" 155 "FD27_Psv_WU" 156 "FD28_Psv_WU" 157 "FD29_Psv_WU" 158 "BHCAN_Psv_WU" 159 "CCAN_Psv_WU";
VAL_ 2654339184 WakeupSource_FD03_SGW 0 "No_Wakeup" 1 "IGN_ON" 129 "FD1_Psv_WU" 130 "FD2_Psv_WU" 131 "FD3_Psv_WU" 132 "FD4_Psv_WU" 133 "FD5_Psv_WU" 134 "FD6_Psv_WU" 135 "FD7_Psv_WU" 136 "FD8_Psv_WU" 137 "FD9_Psv_WU" 138 "FD10_Psv_WU" 139 "FD11_Psv_WU" 140 "FD12_Psv_WU" 141 "FD13_Psv_WU" 142 "FD14_Psv_WU" 143 "FD15_Psv_WU" 144 "FD16_Psv_WU" 145 "FD17_Psv_WU" 146 "FD18_Psv_WU" 147 "FD19_Psv_WU" 148 "FD20_Psv_WU" 149 "FD21_Psv_WU" 150 "FD22_Psv_WU" 151 "FD23_Psv_WU" 152 "FD24_Psv_WU" 153 "FD25_Psv_WU" 154 "FD26_Psv_WU" 155 "FD27_Psv_WU" 156 "FD28_Psv_WU" 157 "FD29_Psv_WU" 158 "BHCAN_Psv_WU" 159 "CCAN_Psv_WU";
VAL_ 2654339184 WakeupSource_FD08_SGW 0 "No_Wakeup" 1 "IGN_ON" 129 "FD1_Psv_WU" 130 "FD2_Psv_WU" 131 "FD3_Psv_WU" 132 "FD4_Psv_WU" 133 "FD5_Psv_WU" 134 "FD6_Psv_WU" 135 "FD7_Psv_WU" 136 "FD8_Psv_WU" 137 "FD9_Psv_WU" 138 "FD10_Psv_WU" 139 "FD11_Psv_WU" 140 "FD12_Psv_WU" 141 "FD13_Psv_WU" 142 "FD14_Psv_WU" 143 "FD15_Psv_WU" 144 "FD16_Psv_WU" 145 "FD17_Psv_WU" 146 "FD18_Psv_WU" 147 "FD19_Psv_WU" 148 "FD20_Psv_WU" 149 "FD21_Psv_WU" 150 "FD22_Psv_WU" 151 "FD23_Psv_WU" 152 "FD24_Psv_WU" 153 "FD25_Psv_WU" 154 "FD26_Psv_WU" 155 "FD27_Psv_WU" 156 "FD28_Psv_WU" 157 "FD29_Psv_WU" 158 "BHCAN_Psv_WU" 159 "CCAN_Psv_WU";
VAL_ 2654339184 WakeupSource_FD11_SGW 0 "No_Wakeup" 1 "IGN_ON" 129 "FD1_Psv_WU" 130 "FD2_Psv_WU" 131 "FD3_Psv_WU" 132 "FD4_Psv_WU" 133 "FD5_Psv_WU" 134 "FD6_Psv_WU" 135 "FD7_Psv_WU" 136 "FD8_Psv_WU" 137 "FD9_Psv_WU" 138 "FD10_Psv_WU" 139 "FD11_Psv_WU" 140 "FD12_Psv_WU" 141 "FD13_Psv_WU" 142 "FD14_Psv_WU" 143 "FD15_Psv_WU" 144 "FD16_Psv_WU" 145 "FD17_Psv_WU" 146 "FD18_Psv_WU" 147 "FD19_Psv_WU" 148 "FD20_Psv_WU" 149 "FD21_Psv_WU" 150 "FD22_Psv_WU" 151 "FD23_Psv_WU" 152 "FD24_Psv_WU" 153 "FD25_Psv_WU" 154 "FD26_Psv_WU" 155 "FD27_Psv_WU" 156 "FD28_Psv_WU" 157 "FD29_Psv_WU" 158 "BHCAN_Psv_WU" 159 "CCAN_Psv_WU";
VAL_ 2654339107 CurrentCanNMState_FD08_TBM 0 "Uninitialized State" 1 "Bus-Sleep State" 2 "Prepare-Bus State" 3 "Ready-Sleep State" 4 "Normal Operation State" 5 "Repeat Message State" 6 "Synchronize State" 7 "Offline State";
VAL_ 2654339107 CurrentFailSts_FD08_TBM 0 "No_Fail_Present" 1 "Fail_Present";
VAL_ 2654339107 DES_FD08_TBM 0 "Error_Active_state" 1 "Error_passive_warning_state" 2 "Bus_off_state" 3 "Not_used";
VAL_ 2654339107 EOL_FD08_TBM 0 "No_EOL_Programming" 1 "EOL_Programming";
VAL_ 2654339107 GenericFailSts_FD08_TBM 0 "No_Fail_Present" 1 "Fail_Present";
VAL_ 2654339107 PreviousCanNMState_FD08_TBM 0 "Uninitialized State" 1 "Bus-Sleep State" 2 "Prepare-Bus State" 3 "Ready-Sleep State" 4 "Normal Operation State" 5 "Repeat Message State" 6 "Synchronize State" 7 "Offline State";
VAL_ 2654339107 StayActiveSource_FD08_TBM 0 "CANNM_Ready_Sleep" 1 "IGN_ON" 2 "NonDefault_Diag" 4 "ING_OFF_NormSt_RptSt";
VAL_ 2654339107 WakeupSource_FD08_TBM 0 "No_Wakeup" 1 "IGN_ON" 129 "FD1_Psv_WU" 130 "FD2_Psv_WU" 131 "FD3_Psv_WU" 132 "FD4_Psv_WU" 133 "FD5_Psv_WU" 134 "FD6_Psv_WU" 135 "FD7_Psv_WU" 136 "FD8_Psv_WU" 137 "FD9_Psv_WU" 138 "FD10_Psv_WU" 139 "FD11_Psv_WU" 140 "FD12_Psv_WU" 141 "FD13_Psv_WU" 142 "FD14_Psv_WU" 143 "FD15_Psv_WU" 144 "FD16_Psv_WU" 145 "FD17_Psv_WU" 146 "FD18_Psv_WU" 147 "FD19_Psv_WU" 148 "FD20_Psv_WU" 149 "FD21_Psv_WU" 150 "FD22_Psv_WU" 151 "FD23_Psv_WU" 152 "FD24_Psv_WU" 153 "FD25_Psv_WU" 154 "FD26_Psv_WU" 155 "FD27_Psv_WU" 156 "FD28_Psv_WU" 157 "FD29_Psv_WU" 158 "BHCAN_Psv_WU" 159 "CCAN_Psv_WU";
VAL_ 2654339083 CurrentCanNMState_FD03_TCM 0 "Uninitialized State" 1 "Bus-Sleep State" 2 "Prepare-Bus State" 3 "Ready-Sleep State" 4 "Normal Operation State" 5 "Repeat Message State" 6 "Synchronize State" 7 "Offline State";
VAL_ 2654339083 CurrentFailSts_FD03_TCM 0 "No_Fail_Present" 1 "Fail_Present";
VAL_ 2654339083 DES_FD03_TCM 0 "Error_Active_state" 1 "Error_passive_warning_state" 2 "Bus_off_state" 3 "Not_used";
VAL_ 2654339083 EOL_FD03_TCM 0 "No_EOL_Programming" 1 "EOL_Programming";
VAL_ 2654339083 GenericFailSts_FD03_TCM 0 "No_Fail_Present" 1 "Fail_Present";
VAL_ 2654339083 PreviousCanNMState_FD03_TCM 0 "Uninitialized State" 1 "Bus-Sleep State" 2 "Prepare-Bus State" 3 "Ready-Sleep State" 4 "Normal Operation State" 5 "Repeat Message State" 6 "Synchronize State" 7 "Offline State";
VAL_ 2654339083 WakeupSource_FD03_TCM 0 "No_Wakeup";
VAL_ 263 AlternatorFail_PT 0 "Alternator_Fail" 1 "Alternator_Not_In_Fail";
VAL_ 263 APCM_Rq_PT 0 "OFF" 1 "ON" 2 "Pending" 3 "SNA";
VAL_ 263 AtmosphericPressure_PT 255 "SNA";
VAL_ 263 AWD_Status_PT 0 "NOT_PRESENT" 1 "DISABLE" 2 "INIT" 3 "SOFT_ON" 4 "NORMAL" 5 "DEGRADED" 6 "SOFT_OFF";
VAL_ 263 CrankEnable_PT 0 "Disabled" 1 "Enabled";
VAL_ 263 DriveReady_PT 0 "Default" 1 "Veh_Allwd_Shift_Out_Of_P_Or_N";
VAL_ 263 DriverPowerReq_PT 2047 "SNA";
VAL_ 263 DrvAway_Alert_PT 0 "False" 1 "True";
VAL_ 263 DrvAway_Inhibit_PT 0 "False" 1 "True";
VAL_ 263 ESS_RqShftPark_PT 0 "No_Request" 1 "Request";
VAL_ 263 EVCU2_THA_Resp 0 "Off" 1 "Active" 3 "SNA";
VAL_ 263 GasPedalPosition_PT 255 "SNA";
VAL_ 263 GasPedalPositionFailSts_PT 0 "Fail_not_present" 1 "Fail_present";
VAL_ 263 GearEngaged_PT 0 "Neutral" 1 "ForwardGear_1" 2 "ForwardGear_2" 3 "ForwardGear_3" 4 "ForwardGear_4" 5 "ForwardGear_5" 6 "ForwardGear_6" 7 "ForwardGear_7" 8 "ForwardGear_8" 9 "ForwardGear_9" 13 "Parking" 14 "ReverseGear" 15 "SNA";
VAL_ 263 GearEngagedForDisplay_PT 0 "Initialize" 1 "Gear_1st" 2 "Gear_2nd" 3 "Gear_3rd" 4 "Gear_4th" 5 "Gear_5th" 6 "Gear_6th" 7 "Gear_7th" 8 "Gear_8th" 9 "Gear_9th" 12 "Park" 13 "Neutral" 14 "Reverse" 15 "Drive" 16 "Low" 17 "Manual" 18 "Sport_Mode" 31 "SNA";
VAL_ 263 GearIndicationSts_PT 0 "Normal" 1 "Blocking";
VAL_ 263 HAS_SoH_PT 0 "No_Fault" 1 "Fault";
VAL_ 263 ParkingFailSts_PT 0 "Fail_not_present" 1 "Fail_present";
VAL_ 263 ParkingSts_PT 0 "Not_Parking" 1 "Parking";
VAL_ 263 PdlPosActual_PT 255 "SNA";
VAL_ 263 PowertrainPrplsnActv_PT 0 "Not_Active" 1 "Active";
VAL_ 263 R_SHFT_LOCK_PT 0 "Unlocked" 1 "Locked";
VAL_ 263 ShiftLeverLockReq_PT 0 "Not_Active" 1 "Active";
VAL_ 263 ShiftLeverPosition_PT 0 "No_Selection_Active_Or_Available" 1 "Park" 2 "Reverse" 3 "Neutral" 4 "Drive" 5 "Low" 6 "TIP_Autostick" 7 "Plus" 8 "Minus" 9 "Sport" 15 "SNA";
VAL_ 263 TargetGear_PT 0 "Neutral" 1 "ForwardGear_1" 2 "ForwardGear_2" 3 "ForwardGear_3" 4 "ForwardGear_4" 5 "ForwardGear_5" 6 "ForwardGear_6" 7 "ForwardGear_7" 8 "ForwardGear_8" 9 "ForwardGear_9" 13 "Parking" 14 "ReverseGear" 15 "SNA";
VAL_ 263 TerrainModeStat_PT 0 "Auto" 1 "Auto_Fault" 2 "Rock" 3 "Track" 4 "Snow" 5 "Offroad" 6 "Eco" 7 "Corsa" 8 "Sport" 9 "Mud_Sand" 10 "Mud" 11 "Sand" 12 "Valet" 13 "Custom" 14 "Tow" 15 "DRAG" 16 "BAJA" 18 "Drift" 19 "Donut" 31 "SNA";
VAL_ 263 TransmissionFailSts_PT 0 "Fail_not_present" 1 "Fail_present";
VAL_ 263 TransmissionWarnings_PT 0 "No_Warning" 1 "Press_Brake_Pedal" 2 "Tip_Not_Available" 3 "Lower_Gear_Shifts" 4 "Manual_Mode_Not_Available" 5 "Insert_N" 6 "Automatic_Mode_Not_Available" 7 "Press_Brk_Dlyd_Startup_Warning" 8 "Clutch_Overtemperature" 9 "Manoeuvre_Not_Allowed" 10 "Press_Brake_Pedal_Repeat" 11 "Gear_Not_Available" 12 "Shift_Not_Allowed" 13 "Shift_to_Neutral_Then_DR" 14 "Reduce_Gear_Changes" 15 "Clutch_Overheater_Must_Cool" 16 "Service_Transmission" 17 "Service_Shifter" 18 "Engage_Park_Brake" 19 "Trans_Too_Cold_Pls_Wait" 20 "Push_Button_to_Shift" 21 "Return_Shifter_To_Home" 22 "Press_Brake_Push_Button_Shift" 23 "Service_Trans_Shut_Off" 24 "Already_in_Des_Gear" 25 "Start_Engine_to_Shift" 26 "Service_Trans_Use_Pk_Brk" 27 "Vehicle_Speed_Too_High" 28 "Tow_Haul_Not_available" 29 "Tow_Haul_Disengaged" 30 "Trans_Cool_Ready_to_Drive" 31 "Veh_Speed_Too_High_to_Shift_P" 32 "Veh_Speed_Too_High_to_Shift_R" 33 "Veh_Speed_Too_High_to_Shift_D" 34 "Manual_Shift_Temp_Not_Available" 35 "Veh_Speed_Too_High_to_Shift_L_S" 36 "Shift_to_P_To_Obtain_Drivability" 37 "Shift_to_P_To_Start" 38 "APCM_in_Progress" 39 "Stop_Vehicle_To_Shift" 40 "Service_Trans_Stop_Veh_To_Shift" 41 "Serv_StpVeh_RestartInPark" 42 "Serv_StpVehShift_RestartInPark" 43 "Press_Brk_To_Prevent_Veh_Rolling" 45 "Trans_Recover_Mode_Warning" 46 "Press_Brake_To_Start" 47 "Unintended_park_disengagement" 48 "paddles_shift_not_available" 49 "M_mode_exit_hold_right_paddles" 50 "Veh_Spd_Too_High_to_Shift_M_gate" 51 "M_Mode_Active_Hold_Plus_to_Exit" 52 "Paddles_Disabled_by_User" 53 "Launch_Clutch_Over_Temp";
VAL_ 263 TurtleModeSts_PT 0 "No_Turtle_Mode" 1 "Turtle_Level1" 2 "Turtle_Level2" 3 "Turtle_Level3" 4 "Turtle_Level4" 7 "SNA";
VAL_ 263 VehSpd_Overridden_PT 0 "No_Request" 1 "HMI_PopUp_Turtle" 2 "HMI_Telltale_Turtle" 3 "HMI_PopUp_Camel" 4 "HMI_Telltale_Camel";
VAL_ 263 Warn_BTO_PT 0 "Not_Active" 1 "Active";
