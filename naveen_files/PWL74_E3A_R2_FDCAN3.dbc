VERSION ""

NS_ :

BS_:

BU_: AGSM BCM BSM CADM DMSM DTCM ECM EVCU2 GNMM HCP IPC RFHM SGW TCM
BO_ 1952 HYBRID_HVAC: 32 EVCU2
 SG_ CabinConditioningSts : 15|4@0+ (1,0) [0|9] "-" BCM,SGW
 SG_ CabinPreconditionReqSts : 85|4@0+ (1,0) [0|14] "" IPC
 SG_ CompressorState : 11|4@0+ (1,0) [0|14] "" BCM,SGW
 SG_ ElecClntHtrInletTemp : 39|8@0+ (1,-40) [-40|214] "°C" ECM
 SG_ ElecCoolantHtrPwr : 23|8@0+ (0.04,0) [0|10.16] "kW" BCM,ECM,SGW
 SG_ FRfShVlvSts : 80|1@0+ (1,0) [0|1] "" BCM,SGW
 SG_ HeaterCoreInletTemp : 7|8@0+ (1,-40) [-40|214] "°C" BCM,ECM
 SG_ HTAuxPmpMontrngRPM : 89|2@0+ (1,0) [0|2] "-" ECM
 SG_ HTAuxPmpRPMAct : 31|8@0+ (24,0) [0|6096] "rpm" BCM,ECM,SGW
 SG_ HTShtOffVlvReq : 47|1@0+ (1,0) [0|1] "-" BCM,ECM,SGW
 SG_ HVBatCoolantLevelLow_DPT : 87|2@0+ (1,0) [0|2] "" IPC,SGW
 SG_ HVBatCritCondT : 81|1@0+ (1,0) [0|1] "" BCM,SGW
 SG_ Sch_PreCondition_Sts : 97|2@0+ (1,0) [0|2] "" BCM
 SG_ SchCond_Time_Till_Dep : 78|7@0+ (1,0) [0|126] "min" BCM

BO_ 276 HYBRID_POWERTRAIN1: 64 EVCU2
 SG_ Belt_Slip_Detected : 69|1@0+ (1,0) [0|1] "" ECM
 SG_ BSGMaxTrqDyn : 209|10@0+ (0.32,-163.52) [-163.52|163.52] "Nm" ECM
 SG_ BSGMinTrqDyn : 225|10@0+ (0.32,-163.52) [-163.52|163.52] "Nm" ECM
 SG_ CRC_HYBRID_POWERTRAIN1 : 447|8@0+ (1,0) [0|255] "-" BSM,CADM,ECM,IPC,TCM
 SG_ DriveMode_PopUpRequest : 431|4@0+ (1,0) [0|14] "-" IPC
 SG_ DriveModeSts_EPT : 427|4@0+ (1,0) [0|14] "-" Vector__XXX
 SG_ DriveReady : 423|1@0+ (1,0) [0|1] "-" BCM,IPC,SGW
 SG_ ECMPrepIdleRes : 295|1@0+ (1,0) [0|0] "-" ECM
 SG_ Eng_Off_Allowed : 292|1@0+ (1,0) [0|0] "-" ECM
 SG_ EngActDmpgDsblReq : 291|1@0+ (1,0) [0|0] "-" ECM
 SG_ EngCntrlMode : 283|1@0+ (1,0) [0|0] "-" ECM
 SG_ EngTrqReserveCmd : 263|8@0+ (0.32,0) [0|81.28] "Nm" ECM
 SG_ GeneratorSetpointOverride : 422|1@0+ (1,0) [0|0] "-" ECM
 SG_ HEV_ESS_Mode : 271|4@0+ (1,0) [0|0] "-" ECM
 SG_ HVBatteryShutOff : 54|1@0+ (1,0) [0|1] "" IPC
 SG_ HybCmndEngTorqImmed : 131|12@0+ (0.32,-300.16) [-300.16|1008] "Nm" ECM
 SG_ HybCmndEngTorqPrdtd : 147|12@0+ (0.32,-300.16) [-300.16|1008] "Nm" ECM
 SG_ HybCmndEngTorqRespTyp : 277|2@0+ (1,0) [0|0] "-" ECM
 SG_ HybCrnkAbrted : 282|1@0+ (1,0) [0|0] "-" ECM
 SG_ HybDFCO_Req : 281|1@0+ (1,0) [0|0] "-" ECM
 SG_ HybEngCylDeactReq : 289|1@0+ (1,0) [0|0] "-" ECM
 SG_ HybFeedback_Engine : 294|1@0+ (1,0) [0|0] "-" ECM
 SG_ HybFstTrqRq_Trans : 293|1@0+ (1,0) [0|0] "-" ECM
 SG_ Hybrid_Remedial_Stop : 290|1@0+ (1,0) [0|0] "-" ECM
 SG_ HybTransSt : 255|8@0+ (1,0) [0|0] "-" ECM
 SG_ InputSpdRaw : 179|12@0+ (1,-2048) [-2048|2046] "rpm" ECM
 SG_ LV_SystemFailure : 421|1@0+ (1,0) [0|0] "-" ECM
 SG_ MessageCounter_HYBRID_POWERTRAI : 435|4@0+ (1,0) [0|15] "-" BSM,CADM,ECM,IPC,TCM
 SG_ PropulsionSystemActive : 408|1@0+ (1,0) [0|1] "-" BCM,ECM,IPC,SGW
 SG_ RegenTarget : 195|12@0+ (0.32,-300.16) [-300.16|1008] "Nm" ECM
 SG_ RollingIdleSpeedTarget : 84|13@0+ (1,0) [0|8191] "rpm" ECM
 SG_ TransInpSpdPrfl : 68|13@0+ (1,0) [0|8191] "rpm" ECM

BO_ 269 HYBRID_POWERTRAIN2: 64 HCP
 SG_ BSGActualTorque : 257|10@0+ (0.32,-163.52) [-163.52|163.2] "Nm" BCM,ECM
 SG_ BSGChrgIdleSpeedTarget : 52|13@0+ (1,0) [0|8190] "rpm" ECM
 SG_ CODE_CLR_HCP : 288|1@0+ (1,0) [0|1] "-" ECM
 SG_ CRC_HYBRID_POWERTRAIN2 : 447|8@0+ (1,0) [0|255] "-" BSM,ECM,TCM
 SG_ HybridEngineMaxTorqAllowed : 115|12@0+ (0.32,-300.16) [-300.16|1008] "Nm" ECM
 SG_ IdleSpeedActiveSts : 302|1@0+ (1,0) [0|0] "-" ECM
 SG_ MessageCounter_HYBRID_POWERTRAI : 435|4@0+ (1,0) [0|15] "-" BSM,ECM,TCM
 SG_ REPRGD_PFC_CLR_HCP : 303|1@0+ (1,0) [0|1] "-" ECM
 SG_ ReqTorqueOverLayActive : 297|1@0+ (1,0) [0|1] "-" BCM,TCM
 SG_ TCC_Slip_Rgn : 296|1@0+ (1,0) [0|0] "-" TCM

BO_ 1033 HYBRID_POWERTRAIN5: 32 EVCU2
 SG_ BattPowerUse_Display : 146|11@0+ (1,-750) [-750|1297] "kW" IPC,SGW
 SG_ BattPowerUse_DisplayV : 87|1@0+ (1,0) [0|1] "-" IPC,SGW
 SG_ CRC_HYBRID_POWERTRAIN5 : 191|8@0+ (1,0) [0|255] "-" ECM,TCM
 SG_ ElectricTrqMult4Pedal : 55|8@0+ (0.0078125,-0.9921875) [-0.9921875|0.9921875] "-" ECM
 SG_ HCP_Stop_Start_Fault : 21|1@0+ (1,0) [0|1] "-" ECM
 SG_ HCPMaxEngRPM : 63|8@0+ (32,0) [0|8128] "rpm" ECM
 SG_ HEV_HybPwrtrnRdcdPerfCmnd : 22|1@0+ (1,0) [0|0] "-" ECM
 SG_ Hybrid_AGS2Position : 103|7@0+ (1,0) [0|127] "%" ECM
 SG_ Hybrid_AGSPosition : 31|7@0+ (1,0) [0|127] "%" ECM
 SG_ Hybrid_EVT_ModeSts : 7|1@0+ (1,0) [0|1] "-" BCM,SGW
 SG_ HybridEmissionsMalfunction : 20|1@0+ (1,0) [0|1] "-" Vector__XXX
 SG_ IdleCLoopTrq : 33|10@0+ (0.32,-163.52) [-163.52|163.52] "Nm" ECM
 SG_ MessageCounter_HYBRID_POWERTRAI : 179|4@0+ (1,0) [0|15] "-" ECM,TCM
 SG_ Motor1PowerUse_Display : 96|9@0+ (1,-255) [-255|256] "kW" SGW
 SG_ Motor1PowerUse_DisplayV : 86|1@0+ (1,0) [0|1] "-" SGW
 SG_ Motor2PowerUse_Display : 112|9@0+ (1,-255) [-255|256] "kW" SGW
 SG_ Motor2PowerUse_DisplayV : 85|1@0+ (1,0) [0|1] "-" SGW
 SG_ MotorsPowerUse_Display : 162|11@0+ (1,-1023) [-1023|1024] "kW" SGW
 SG_ MotorsPowerUse_DisplayV : 183|1@0+ (1,0) [0|1] "-" SGW
 SG_ PT_WorkSite_Invtr_Capacity_HCP : 95|5@0+ (100,0) [0|3100] "W" BCM
 SG_ PT_WorkSite_Invtr_Sts_HCP : 182|2@0+ (1,0) [0|3] "" BCM
 SG_ Smartload_Actv : 89|2@0+ (1,0) [0|1] "" ECM

BO_ 1580 HYBRID_POWERTRAIN6: 32 EVCU2
 SG_ V2H_Discharge_Capacity : 55|12@0+ (0.1,0) [0|409.5] "kW" SGW

BO_ 1956 HYBRID_RM_MOTORS: 32 EVCU2
 SG_ MotorA_DC_Current : 38|15@0+ (0.1,-1638.4) [-1638.4|1638.3] "A" Vector__XXX
 SG_ MotorA_DC_Voltage : 97|10@0+ (1,0) [0|1023] "V" Vector__XXX
 SG_ MotorA_InverterState : 101|4@0+ (1,0) [0|15] "" Vector__XXX
 SG_ MotorA_InverterTemp : 143|8@0+ (1,-40) [-40|215] "oC" Vector__XXX
 SG_ MotorA_RPM : 7|16@0+ (1,-32768) [-32768|32767] "RPM" Vector__XXX
 SG_ MotorA_Temperature : 135|8@0+ (1,-40) [-40|215] "oC" IPC
 SG_ MotorA_TorqueAchieved : 68|13@0+ (0.125,-512) [-512|511.875] "Nm" Vector__XXX
 SG_ MotorB_DC_Current : 54|15@0+ (0.1,-1638.4) [-1638.4|1638.3] "A" Vector__XXX
 SG_ MotorB_DC_Voltage : 113|10@0+ (1,0) [0|1023] "V" Vector__XXX
 SG_ MotorB_InverterState : 117|4@0+ (1,0) [0|15] "" Vector__XXX
 SG_ MotorB_InverterTemp : 159|8@0+ (1,-40) [-40|215] "oC" Vector__XXX
 SG_ MotorB_RPM : 23|16@0+ (1,-32768) [-32768|32767] "RPM" Vector__XXX
 SG_ MotorB_Temperature : 151|8@0+ (1,-40) [-40|215] "oC" IPC
 SG_ MotorB_TorqueAchieved : 84|13@0+ (0.125,-512) [-512|511.875] "Nm" Vector__XXX
 SG_ Warning_DCDCPerformance_DPT : 85|1@0+ (1,0) [0|1] "" Vector__XXX
 SG_ Warning_DCDCTemp_DPT : 71|1@0+ (1,0) [0|1] "" Vector__XXX
 SG_ Warning_InverterA_Overtemp : 69|1@0+ (1,0) [0|1] "" Vector__XXX
 SG_ Warning_InverterB_Overtemp : 70|1@0+ (1,0) [0|1] "" Vector__XXX
 SG_ Warning_MotorA_Overtemp : 39|1@0+ (1,0) [0|1] "" Vector__XXX
 SG_ Warning_MotorB_Overtemp : 55|1@0+ (1,0) [0|1] "" Vector__XXX

BO_ 1853 HYBRID_RM_MOTORS_2: 32 EVCU2
 SG_ APM_CtrlSts_Fbk : 145|4@0+ (1,0) [0|15] "" Vector__XXX
 SG_ APM_FailureReason : 151|6@0+ (1,0) [0|63] "" Vector__XXX
 SG_ APM_OutputPower : 119|10@0+ (3,0) [0|3069] "W" Vector__XXX

BO_ 1032 HYBRID_THERMAL_COMMAND: 32 EVCU2
 SG_ AirflowRequest : 62|7@0+ (1,0) [0|100] "%" ECM
 SG_ LTR_PumpFlowRequest : 70|7@0+ (1,0) [0|100] "%" ECM
 SG_ RadiatorFanSts : 78|7@0+ (1,0) [0|100] "%" ECM

BO_ 752 IBS3_DATA_1: 32 BCM
 SG_ CRC_IBS3DATA1 : 191|8@0+ (1,0) [0|255] "0" ECM,EVCU2
 SG_ CurrBattFailStatus : 103|1@0+ (1,0) [0|1] "" ECM,EVCU2
 SG_ IBS3_Error_Internal : 101|1@0+ (1,0) [0|1] "" ECM,EVCU2
 SG_ IBS3_Ibatt : 87|16@0+ (0.02,-1000) [-1000|310.68] "A" ECM,EVCU2,SGW
 SG_ IBS3_SOF_V_Accuracy : 99|1@0+ (1,0) [0|1] "" ECM,EVCU2
 SG_ IBS3_SOF_VC : 118|7@0+ (0.05,5) [5|11.3] "V" ECM,EVCU2
 SG_ IBS3_Vbatt : 96|9@0+ (0.025,5) [5|17.75] "V" ECM,EVCU2,HCP,SGW
 SG_ MessageCounter_IBS3DATA1 : 179|4@0+ (1,0) [0|15] "0" ECM,EVCU2
 SG_ RsErrIBS3 : 100|1@0+ (1,0) [0|1] "" ECM,EVCU2
 SG_ VoltBattFailStatus : 102|1@0+ (1,0) [0|1] "" ECM,EVCU2,HCP

BO_ 754 IBS3_DATA_1_2: 32 BCM
 SG_ CurrBattFailStatus_2 : 103|1@0+ (1,0) [0|1] "" Vector__XXX
 SG_ IBS3_Error_Internal_2 : 101|1@0+ (1,0) [0|1] "" Vector__XXX
 SG_ RsErrIBS3_2 : 100|1@0+ (1,0) [0|1] "" Vector__XXX
 SG_ VoltBattFailStatus_2 : 102|1@0+ (1,0) [0|1] "" Vector__XXX

BO_ 1955 IBS3_DATA_2: 32 BCM
 SG_ CRC_IBS3DATA2 : 191|8@0+ (1,0) [0|255] "0" EVCU2
 SG_ IBS3_CRC_IBS_1 : 15|8@0+ (1,0) [0|254] "" CADM
 SG_ IBS3_CRC_IBS_2 : 71|8@0+ (1,0) [0|254] "" CADM
 SG_ IBS3_FLAG_DISCONNECT : 117|1@0+ (1,0) [0|1] "" ECM,EVCU2
 SG_ IBS3_FLAG_DISCONNECT_ADAS : 1|2@0+ (1,0) [0|2] "" CADM
 SG_ IBS3_FLAG_DISCONNECT_ADAS_2 : 17|2@0+ (1,0) [0|2] "" CADM
 SG_ IBS3_IBS_ADAS_OK : 3|2@0+ (1,0) [0|2] "" CADM
 SG_ IBS3_IBS_ADAS_OK_2 : 19|2@0+ (1,0) [0|2] "" CADM
 SG_ IBS3_MC_IBS_1 : 7|4@0+ (1,0) [0|15] "" CADM
 SG_ IBS3_MC_IBS_2 : 23|4@0+ (1,0) [0|15] "" CADM
 SG_ IBS3_Q_received : 159|16@0+ (0.125,0) [0|8191.75] "Ah" EVCU2
 SG_ IBS3_Q_released : 31|16@0+ (0.125,0) [0|8191.75] "Ah" EVCU2
 SG_ IBS3_R_Batt : 63|8@0+ (0.1,0) [0|25.4] "mOhm" EVCU2
 SG_ IBS3_R_Batt_25 : 79|8@0+ (0.1,0) [0|25.4] "mOhm" EVCU2
 SG_ IBS3_SOC : 86|7@0+ (1,0) [0|100] "%" CADM,ECM,EVCU2,HCP,SGW
 SG_ IBS3_SOC_Accuracy : 87|1@0+ (1,0) [0|1] "" ECM,EVCU2,HCP,SGW
 SG_ IBS3_SOF_Q : 103|8@0+ (1,0) [0|254] "Ah" EVCU2
 SG_ IBS3_SOF_Q_Accuracy : 118|1@0+ (1,0) [0|1] "" EVCU2
 SG_ IBS3_SOH_COR : 46|7@0+ (1,0) [0|100] "%" EVCU2
 SG_ IBS3_SOH_COR_Accuracy : 47|1@0+ (1,0) [0|1] "" EVCU2
 SG_ IBS3_SOH_Q : 110|7@0+ (2,0) [0|252] "Ah" ECM,EVCU2
 SG_ IBS3_SOH_Q_Accuracy : 119|1@0+ (1,0) [0|1] "" ECM,EVCU2
 SG_ IBS3_SOH_SUL : 54|7@0+ (1,0) [0|100] "%" EVCU2
 SG_ IBS3_SOH_SUL_Accuracy : 55|1@0+ (1,0) [0|1] "" EVCU2
 SG_ IBS3_T_BATT : 95|8@0+ (1,-40) [-40|105] "°C" ECM,EVCU2,HCP,SGW
 SG_ IBS3_TempFailStatus : 111|1@0+ (1,0) [0|1] "" ECM,EVCU2,HCP,SGW
 SG_ IBS3_Tm_Lst_Reset_Days : 139|12@0+ (1,0) [0|4094] "Days" EVCU2
 SG_ IBS3_Tm_Lst_Reset_Sec : 127|16@0+ (2,0) [0|86398] "sec" EVCU2
 SG_ MessageCounter_IBS3DATA2 : 179|4@0+ (1,0) [0|15] "0" EVCU2

BO_ 100 IMMO_CODE_REQUEST: 32 ECM
 SG_ ControlEncodingReq : 87|8@0+ (1,0) [0|255] "-" BCM
 SG_ f1_1 : 95|8@0+ (1,0) [0|255] "-" BCM
 SG_ f1_2 : 103|8@0+ (1,0) [0|255] "-" BCM
 SG_ rnd_1 : 111|8@0+ (1,0) [0|255] "-" BCM
 SG_ rnd_2 : 119|8@0+ (1,0) [0|255] "-" BCM
 SG_ rnd_3 : 127|8@0+ (1,0) [0|255] "-" BCM
 SG_ rnd_4 : 135|8@0+ (1,0) [0|255] "-" BCM

BO_ 104 IMMO_CODE_RESPONSE: 32 BCM
 SG_ ControlEncodingRsp : 87|8@0+ (1,0) [0|255] "-" ECM,EVCU2
 SG_ ImmoParkReq : 7|1@0+ (1,0) [0|1] "-" EVCU2
 SG_ MKKey_3 : 111|8@0+ (1,0) [0|255] "-" ECM,EVCU2
 SG_ MKKey_4 : 119|8@0+ (1,0) [0|255] "-" ECM,EVCU2
 SG_ MKKey_5 : 127|8@0+ (1,0) [0|255] "-" ECM,EVCU2
 SG_ MKKey_6 : 135|8@0+ (1,0) [0|255] "-" ECM,EVCU2
 SG_ MKKey1org21 : 95|8@0+ (1,0) [0|255] "-" ECM,EVCU2
 SG_ MKKey2org22 : 103|8@0+ (1,0) [0|255] "-" ECM,EVCU2

BO_ 1626 IMPACT_INFO: 32 BCM
 SG_ CRC_IMPACTINFO : 191|8@0+ (1,0) [0|255] "-" DMSM,HCP
 SG_ IMPACTCommand : 80|1@0+ (1,0) [0|1] "-" DMSM,ECM,EVCU2
 SG_ IMPACTConfirm : 81|1@0+ (1,0) [0|1] "-" DMSM,ECM,EVCU2
 SG_ IMPACTThreshold : 103|1@0+ (1,0) [0|1] "-" ECM
 SG_ MessageCounter_IMPACTINFO : 179|4@0+ (1,0) [0|15] "-" DMSM,HCP

BO_ 1829 IPC_FD_1: 32 IPC
 SG_ CRC_IPC1 : 191|8@0+ (1,0) [0|255] "-" BCM,BSM,CADM,DMSM,ECM
 SG_ InstantaneousFuelConsumption1 : 134|4@0+ (1,0) [0|15] "-" SGW
 SG_ InstantaneousFuelConsumption2 : 150|4@0+ (1,0) [0|15] "-" SGW
 SG_ InstantaneousFuelConsumption3 : 166|4@0+ (1,0) [0|15] "-" SGW
 SG_ MessageCounter_IPC1 : 179|4@0+ (1,0) [0|15] "-" BCM,BSM,CADM,DMSM,ECM
 SG_ TotalOdometer : 75|20@0+ (1,0) [0|1048575] "km" AGSM,BCM,BSM,CADM,DMSM,DTCM,ECM,EVCU2,GNMM,HCP,IPC,RFHM,SGW,TCM
 SG_ Trailer_Trp_Rst : 151|1@0+ (1,0) [0|1] "" BCM

BO_ 1441 IPC_FD_10: 32 IPC
 SG_ DTE_Ave_Fuel_Econ : 161|10@0+ (0.05,0) [0|50] "kmpl" Vector__XXX

BO_ 1455 IPC_FD_11: 32 IPC
 SG_ A_EV_Kilometers : 55|24@0+ (0.1,0) [0|16093.3] "km" SGW
 SG_ A_EV_Miles : 31|24@0+ (0.1,0) [0|9999.9] "Mile" SGW
 SG_ A_Hybrid_Kilometers : 103|24@0+ (0.1,0) [0|16093.3] "km" SGW
 SG_ A_Hybrid_Miles : 79|24@0+ (0.1,0) [0|9999.9] "Mile" SGW
 SG_ AudioMenuPopup : 0|1@0+ (1,0) [0|1] "-" SGW
 SG_ Avg_Fuel_Econ : 9|10@0+ (0.05,0) [0|50] "kmpl" SGW
 SG_ Cluster_In_Audio_Md : 10|1@0+ (1,0) [0|1] "-" SGW
 SG_ IC_ETM_HUDCustom_Req : 2|2@0+ (1,0) [0|3] "-" SGW
 SG_ IPC_NavigationMap_Req : 5|2@0+ (1,0) [0|2] "-" SGW
 SG_ NavigationMapPopUP : 6|1@0+ (1,0) [0|1] "-" SGW
 SG_ NextNavInstructionPanelTheme : 183|4@0+ (1,0) [0|14] "" SGW

BO_ 1844 IPC_FD_12: 32 IPC
 SG_ B_EV_Kilometers : 63|24@0+ (0.1,0) [0|16093.3] "km" SGW
 SG_ B_EV_Miles : 39|24@0+ (0.1,0) [0|9999.9] "Mile" SGW
 SG_ B_Hybrid_Kilometers : 111|24@0+ (0.1,0) [0|16093.3] "km" SGW
 SG_ B_Hybrid_Miles : 87|24@0+ (0.1,0) [0|9999.9] "Mile" SGW

BO_ 1842 IPC_FD_13: 32 IPC
 SG_ FuelLvlIndicator : 71|8@0+ (1,0) [0|255] "%" SGW
 SG_ Gas_Range : 49|10@0+ (1,0) [0|1022] "km" BCM,SGW
 SG_ Total_Range : 34|11@0+ (1,0) [0|2046] "km" SGW

BO_TX_BU_ 276 : EVCU2,HCP;
BO_TX_BU_ 1033 : EVCU2,HCP;
BO_TX_BU_ 1032 : EVCU2,HCP;
BO_TX_BU_ 100 : ECM,EVCU2;
CM_ SG_ 1952 CabinConditioningSts "Cabin condition status";
CM_ SG_ 1952 CabinPreconditionReqSts "Cabin Preconditioning Request Status";
CM_ SG_ 1952 CompressorState "comppressor state";
CM_ SG_ 1952 ElecClntHtrInletTemp "Electric Coolant Heater Inlet Temperature";
CM_ SG_ 1952 ElecCoolantHtrPwr "Electric Coolant Heater Power";
CM_ SG_ 1952 FRfShVlvSts "Front Refrigerant Shutoff Valve Status  [0] = Open, [1] = Closed";
CM_ SG_ 1952 HeaterCoreInletTemp "Heater Core Inlet Temp";
CM_ SG_ 1952 HTAuxPmpMontrngRPM "High Temp Aux Pump RPM monitoring active";
CM_ SG_ 1952 HTAuxPmpRPMAct "High Temp Aux Pump Status";
CM_ SG_ 1952 HTShtOffVlvReq "High temp shut off valve request; [0] = Open, [1] = Closed";
CM_ SG_ 1952 HVBatCoolantLevelLow_DPT "Battery coolant level low";
CM_ SG_ 1952 HVBatCritCondT "High Voltage Battery Temperature Critical Condition, [1] = True";
CM_ SG_ 1952 Sch_PreCondition_Sts "HCP Status for Scheduled Pre Conditioning Request";
CM_ SG_ 1952 SchCond_Time_Till_Dep "Schedule Cabin Conditonting - Time till Departure for HVAC";
CM_ SG_ 276 Belt_Slip_Detected "Signal to indicate belt slip of BSG";
CM_ SG_ 276 CRC_HYBRID_POWERTRAIN1 "CRC according to SAE J1850 standard at each frame transmission.";
CM_ SG_ 276 DriveMode_PopUpRequest "Drive modes HMI pop-up message request";
CM_ SG_ 276 DriveModeSts_EPT "Final eDrive mode status";
CM_ SG_ 276 DriveReady "Ready to Drive, [1] = Vehicle is allowed to shift out of park or neutral";
CM_ SG_ 276 ECMPrepIdleRes "ECM to prep for rolling idle reserve";
CM_ SG_ 276 Eng_Off_Allowed "Engine Stop Allowed. 0 = ENG_OFF_NOT_ALLOWED, 1 = ENG_OFF_ALLOWED";
CM_ SG_ 276 EngActDmpgDsblReq "Engine Active Damping Disable Request";
CM_ SG_ 276 EngCntrlMode "EngCntrlMode, [0] = Torque Mode, [1] = Speed Mode";
CM_ SG_ 276 EngTrqReserveCmd "Engine torque reserve command";
CM_ SG_ 276 GeneratorSetpointOverride "Hybrid generator setpoint duty cycle powertrain override active";
CM_ SG_ 276 HEV_ESS_Mode "Engine start stop information:  engine start stop mode";
CM_ SG_ 276 HVBatteryShutOff "HV Battery Shutoff indication for China market";
CM_ SG_ 276 HybCmndEngTorqImmed "Hybrid commanded engine torque immediate torque (fast path)";
CM_ SG_ 276 HybCmndEngTorqPrdtd "Hybrid commanded engine torque predicted torque (slow path).";
CM_ SG_ 276 HybCmndEngTorqRespTyp "Hybrid Commanded Engine Torque Response Type";
CM_ SG_ 276 HybCrnkAbrted "Hybrid Crank Aborted";
CM_ SG_ 276 HybDFCO_Req "Hybrid deceleration fuel cut off request";
CM_ SG_ 276 HybEngCylDeactReq "Hybrid engine cylinder deactivation request";
CM_ SG_ 276 HybFeedback_Engine "Indication that the HCP is receiving valid data from the ECM. 0 - False; 1 - True.";
CM_ SG_ 276 HybFstTrqRq_Trans "HCP request for Spark Retard to honor Trans Torque reduction request. 0 - False; 1 - True.";
CM_ SG_ 276 Hybrid_Remedial_Stop "Engine Start Allowed.0 = ENG_ON_ALLOWED, 1 = ENG_ON_NOT_ALLOW";
CM_ SG_ 276 HybTransSt "Hybrid transmission state";
CM_ SG_ 276 InputSpdRaw "Trans input speed from HCP.";
CM_ SG_ 276 LV_SystemFailure "Low voltage system failed";
CM_ SG_ 276 MessageCounter_HYBRID_POWERTRAI "This signal is a counter used for safety checks strategies. This counter is incremented of 1 (one) unit at each frame transmission.";
CM_ SG_ 276 PropulsionSystemActive "Propulsion system active, [1] = active";
CM_ SG_ 276 RegenTarget "Offset for sum torque request due to regen";
CM_ SG_ 276 RollingIdleSpeedTarget "Idle Speed Target";
CM_ SG_ 276 TransInpSpdPrfl "Transmission Input Speed Profile";
CM_ SG_ 269 BSGActualTorque "BSG Actual Torque";
CM_ SG_ 269 BSGChrgIdleSpeedTarget "BSG Charge Idle Speed Target";
CM_ SG_ 269 CODE_CLR_HCP "Clear emission related faults";
CM_ SG_ 269 CRC_HYBRID_POWERTRAIN2 "CRC according to SAE J1850 standard at each frame transmission.";
CM_ SG_ 269 HybridEngineMaxTorqAllowed "HCP maximum torque limit";
CM_ SG_ 269 IdleSpeedActiveSts "Flag to indicate idle speed target [1] = TRUE";
CM_ SG_ 269 MessageCounter_HYBRID_POWERTRAI "This signal is a counter used for safety checks strategies. This counter is incremented of 1 (one) unit at each frame transmission.";
CM_ SG_ 269 REPRGD_PFC_CLR_HCP "Set readiness to \"incomplete\"";
CM_ SG_ 269 ReqTorqueOverLayActive "Regeneration Shift Schedule Request (1 = Active)";
CM_ SG_ 269 TCC_Slip_Rgn "TCC slip during transition regen; Active = [1]";
CM_ SG_ 1033 BattPowerUse_Display "Battery power usage for HMI, in KW";
CM_ SG_ 1033 BattPowerUse_DisplayV "Validity bit for signal BatPwrUsageDisp, 0=Valid";
CM_ SG_ 1033 CRC_HYBRID_POWERTRAIN5 "CRC according to SAE J1850 standard at each frame transmission.";
CM_ SG_ 1033 ElectricTrqMult4Pedal "Adjustment factor for elctric components of pedal max torque.";
CM_ SG_ 1033 HCP_Stop_Start_Fault "Stop/Start Fault, [1] = Active";
CM_ SG_ 1033 HCPMaxEngRPM "Engine rev limit due to HCP/MGU limits";
CM_ SG_ 1033 HEV_HybPwrtrnRdcdPerfCmnd "Driver torque request modifier due to system remedial acion";
CM_ SG_ 1033 Hybrid_AGS2Position "AGS2 position sent to ECM on CAN by the hybrid controller";
CM_ SG_ 1033 Hybrid_AGSPosition "AGS position sent to ECM on CAN by the hybrid controller";
CM_ SG_ 1033 Hybrid_EVT_ModeSts "The system is in EVT mode; Hybrid mode = [0], EV Mode = [1]";
CM_ SG_ 1033 HybridEmissionsMalfunction "Emissions Related Malfunction Active";
CM_ SG_ 1033 IdleCLoopTrq "Electric motor PID torque to maintain idle speed.";
CM_ SG_ 1033 MessageCounter_HYBRID_POWERTRAI "This signal is a counter used for safety checks strategies. This counter is incremented of 1 (one) unit at each frame transmission.";
CM_ SG_ 1033 Motor1PowerUse_Display "Motor A power usage for HMI, in KW";
CM_ SG_ 1033 Motor1PowerUse_DisplayV "Validity bit for signal MtrPwrUsageDisp, 0=Valid";
CM_ SG_ 1033 Motor2PowerUse_Display "Motor B power usage for HMI, in KW";
CM_ SG_ 1033 Motor2PowerUse_DisplayV "Validity bit for signal MtrPwrUsageDisp, 0=Valid";
CM_ SG_ 1033 MotorsPowerUse_Display "Motor Sum power usage for HMI, in KW";
CM_ SG_ 1033 MotorsPowerUse_DisplayV "Validity bit for signal MtrPwrUsageDisp, 0=Valid";
CM_ SG_ 1033 PT_WorkSite_Invtr_Capacity_HCP "Powertrain power support capacity for the 2KW Inverter";
CM_ SG_ 1033 PT_WorkSite_Invtr_Sts_HCP "Powertrain 2KW Inverter support status";
CM_ SG_ 1033 Smartload_Actv "Smartload engagement";
CM_ SG_ 1580 V2H_Discharge_Capacity "This signal indicates the maximum power to be drained during V2H event";
CM_ SG_ 1956 MotorA_DC_Current "Motor A DC Current";
CM_ SG_ 1956 MotorA_DC_Voltage "Motor A DC Voltage";
CM_ SG_ 1956 MotorA_InverterState "Inverter State of Operation";
CM_ SG_ 1956 MotorA_InverterTemp "Inverter A Temperature";
CM_ SG_ 1956 MotorA_RPM "Motor A Speed Raw";
CM_ SG_ 1956 MotorA_Temperature "Motor A temperature";
CM_ SG_ 1956 MotorA_TorqueAchieved "Motor A Torque Achieved";
CM_ SG_ 1956 MotorB_DC_Current "Motor B DC Current";
CM_ SG_ 1956 MotorB_DC_Voltage "Motor B DC Voltage";
CM_ SG_ 1956 MotorB_InverterState "Inverter State of Operation";
CM_ SG_ 1956 MotorB_InverterTemp "Inverter B Temperature";
CM_ SG_ 1956 MotorB_RPM "Motor B Speed Raw";
CM_ SG_ 1956 MotorB_Temperature "Motor B temperature";
CM_ SG_ 1956 MotorB_TorqueAchieved "Motor B Torque Achieved";
CM_ SG_ 1956 Warning_DCDCPerformance_DPT "APM performance warning";
CM_ SG_ 1956 Warning_DCDCTemp_DPT "APM temperature warning";
CM_ SG_ 1956 Warning_InverterA_Overtemp "Motor A inverter over-temperature warning";
CM_ SG_ 1956 Warning_InverterB_Overtemp "Motor B inverter over-temperature warning";
CM_ SG_ 1956 Warning_MotorA_Overtemp "Motor A over-temperature warning";
CM_ SG_ 1956 Warning_MotorB_Overtemp "Motor B over-temperature warning";
CM_ SG_ 1853 APM_CtrlSts_Fbk "This signal indicates the DC-DC feedback mode.";
CM_ SG_ 1853 APM_FailureReason "FailureReason";
CM_ SG_ 1853 APM_OutputPower "APM Output Power";
CM_ SG_ 1032 AirflowRequest "Air Flow Request";
CM_ SG_ 1032 LTR_PumpFlowRequest "Low Temperature Radiator Pump flow rate request from HCP";
CM_ SG_ 1032 RadiatorFanSts "Radiator Fan state";
CM_ SG_ 752 CRC_IBS3DATA1 "CRC according to SAE J1850 standard at each frame transmission.";
CM_ SG_ 752 CurrBattFailStatus "Failure Status of Current meas. (internal defect)";
CM_ SG_ 752 IBS3_Error_Internal "Error in IBS calibration data; No Error = [0], Error = [1]";
CM_ SG_ 752 IBS3_Ibatt "Battery current";
CM_ SG_ 752 IBS3_SOF_V_Accuracy "SOF_V accuracy; Data reliable = [0], unreliable = [1]";
CM_ SG_ 752 IBS3_SOF_VC "Predicted initial battery voltage dip during cranking (old CG spec)";
CM_ SG_ 752 IBS3_Vbatt "Battery voltage measured at the terminals";
CM_ SG_ 752 MessageCounter_IBS3DATA1 "This signal is a counter used for safety checks strategies. This counter is incremented of 1 (one) unit at each frame transmission.";
CM_ SG_ 752 RsErrIBS3 "Response Error IBS; Error=[1]";
CM_ SG_ 752 VoltBattFailStatus "Failure Status of Voltage meas. (internal defect)";
CM_ SG_ 754 CurrBattFailStatus_2 "Failure Status of Current meas. (internal defect)";
CM_ SG_ 754 IBS3_Error_Internal_2 "Error in IBS calibration data; No Error = [0], Error = [1]";
CM_ SG_ 754 RsErrIBS3_2 "Response Error IBS; Error=[1]";
CM_ SG_ 754 VoltBattFailStatus_2 "Failure Status of Voltage meas. (internal defect)";
CM_ SG_ 1955 CRC_IBS3DATA2 "CRC according to SAE J1850 standard at each frame transmission.";
CM_ SG_ 1955 IBS3_CRC_IBS_1 "CRC";
CM_ SG_ 1955 IBS3_CRC_IBS_2 "CRC";
CM_ SG_ 1955 IBS3_FLAG_DISCONNECT "Battery disconnection flag";
CM_ SG_ 1955 IBS3_FLAG_DISCONNECT_ADAS "IBS indicates that the reason for unknown values is a recent battery disconnection";
CM_ SG_ 1955 IBS3_FLAG_DISCONNECT_ADAS_2 "IBS indicates that the reason for unknown values is a recent battery disconnection";
CM_ SG_ 1955 IBS3_IBS_ADAS_OK "IBS indicates that battery is able to support ADAS operation";
CM_ SG_ 1955 IBS3_IBS_ADAS_OK_2 "IBS indicates that battery is able to support ADAS operation";
CM_ SG_ 1955 IBS3_MC_IBS_1 "Message Counter";
CM_ SG_ 1955 IBS3_MC_IBS_2 "Message Counter";
CM_ SG_ 1955 IBS3_Q_received "LifeTime charge received";
CM_ SG_ 1955 IBS3_Q_released "Lifetime charge released";
CM_ SG_ 1955 IBS3_R_Batt "Calculated battery resistance";
CM_ SG_ 1955 IBS3_R_Batt_25 "Batt resistance at 100% SOC and 25 degC";
CM_ SG_ 1955 IBS3_SOC "State of charge";
CM_ SG_ 1955 IBS3_SOC_Accuracy "SOC accuracy status";
CM_ SG_ 1955 IBS3_SOF_Q "Residual battery charge in Ah";
CM_ SG_ 1955 IBS3_SOF_Q_Accuracy "SOF_Q accuracy status";
CM_ SG_ 1955 IBS3_SOH_COR "Ageing related to voltage drop predicted for -18°C cold crank due to corrosion";
CM_ SG_ 1955 IBS3_SOH_COR_Accuracy "SOH_COR accuracy status ( Inaccurate = 0 / Accurate = 1)";
CM_ SG_ 1955 IBS3_SOH_Q "State of health related to capacity (energy)";
CM_ SG_ 1955 IBS3_SOH_Q_Accuracy "SOH_Q accuracy status";
CM_ SG_ 1955 IBS3_SOH_SUL "Maximum SOC available due to the fact that the battery could be sulphated";
CM_ SG_ 1955 IBS3_SOH_SUL_Accuracy "SOH_SUL accuracy status ( Inaccurate = 0 / Accurate = 1)";
CM_ SG_ 1955 IBS3_T_BATT "Battery temperature";
CM_ SG_ 1955 IBS3_TempFailStatus "Failure of ASIC Temperature meas. (internal defect)";
CM_ SG_ 1955 IBS3_Tm_Lst_Reset_Days "Accumulated time since last reset in days";
CM_ SG_ 1955 IBS3_Tm_Lst_Reset_Sec "Accumulated time since last reset in seconds";
CM_ SG_ 1955 MessageCounter_IBS3DATA2 "This signal is a counter used for safety checks strategies. This counter is incremented of 1 (one) unit at each frame transmission.";
CM_ SG_ 100 ControlEncodingReq "This signal is used for IMMO communication";
CM_ SG_ 100 f1_1 "This signal is used for IMMO communication";
CM_ SG_ 100 f1_2 "This signal is used for IMMO communication";
CM_ SG_ 100 rnd_1 "This signal is used for IMMO communication";
CM_ SG_ 100 rnd_2 "This signal is used for IMMO communication";
CM_ SG_ 100 rnd_3 "This signal is used for IMMO communication";
CM_ SG_ 100 rnd_4 "This signal is used for IMMO communication";
CM_ SG_ 104 ControlEncodingRsp "This signal is used for IMMO communication";
CM_ SG_ 104 ImmoParkReq "Parl lock request for immo code";
CM_ SG_ 104 MKKey_3 "This signal is used for IMMO communication";
CM_ SG_ 104 MKKey_4 "This signal is used for IMMO communication";
CM_ SG_ 104 MKKey_5 "This signal is used for IMMO communication";
CM_ SG_ 104 MKKey_6 "This signal is used for IMMO communication";
CM_ SG_ 104 MKKey1org21 "This signal is used for IMMO communication";
CM_ SG_ 104 MKKey2org22 "This signal is used for IMMO communication";
CM_ SG_ 1626 CRC_IMPACTINFO "CRC according to SAE J1850 standard at each frame transmission.";
CM_ SG_ 1626 IMPACTCommand "This signal is used to indicate that a crash happened";
CM_ SG_ 1626 IMPACTConfirm "This signal is used to confirm that a crash happened";
CM_ SG_ 1626 IMPACTThreshold "Upon a crash, the ORC Calibration Threshold was either \"Met\" or \"Not_Met\".";
CM_ SG_ 1626 MessageCounter_IMPACTINFO "This signal is a counter used for safety checks strategies. This counter is incremented of 1 (one) unit at each frame transmission.";
CM_ SG_ 1829 CRC_IPC1 "CRC according to SAE J1850 standard at each frame transmission.";
CM_ SG_ 1829 InstantaneousFuelConsumption1 "Used to give information about the tens of the instantaneous fuel consumption value.";
CM_ SG_ 1829 InstantaneousFuelConsumption2 "Used to give information about the units of the instantaneous fuel consumption value.";
CM_ SG_ 1829 InstantaneousFuelConsumption3 "Used to give information about the tenths of the instantaneous fuel consumption value.";
CM_ SG_ 1829 MessageCounter_IPC1 "This signal is a counter used for safety checks strategies. This counter is incremented of 1 (one) unit at each frame transmission.";
CM_ SG_ 1829 TotalOdometer "Used to give information about the total odometer value in km.";
CM_ SG_ 1829 Trailer_Trp_Rst "Trailer Trip Reset Request";
CM_ SG_ 1441 DTE_Ave_Fuel_Econ "Signal for giving average fuel economy used for calculating the distance to empty";
CM_ SG_ 1455 A_EV_Kilometers "Trip A EV distance in kilometers";
CM_ SG_ 1455 A_EV_Miles "Trip A EV distance in US miles";
CM_ SG_ 1455 A_Hybrid_Kilometers "Trip A hybrid distance in kilometers";
CM_ SG_ 1455 A_Hybrid_Miles "Trip A hybrid distance in US miles";
CM_ SG_ 1455 AudioMenuPopup "Pop-up present on the Audio Menu";
CM_ SG_ 1455 Avg_Fuel_Econ "Average fuel economy";
CM_ SG_ 1455 Cluster_In_Audio_Md "Cluster display screen for Audio mode";
CM_ SG_ 1455 IC_ETM_HUDCustom_Req "IC to ETM HUD Customization Request";
CM_ SG_ 1455 IPC_NavigationMap_Req "IPC Navigation Map Req";
CM_ SG_ 1455 NavigationMapPopUP "Navigation Map PopUP";
CM_ SG_ 1455 NextNavInstructionPanelTheme "Next Nav Instruction Panel Theme";
CM_ SG_ 1844 B_EV_Kilometers "Trip B EV distance in kilometers";
CM_ SG_ 1844 B_EV_Miles "Trip B EV distance in US miles";
CM_ SG_ 1844 B_Hybrid_Kilometers "Trip B hybrid distance in kilometers";
CM_ SG_ 1844 B_Hybrid_Miles "Trip B hybrid distance in US miles";
CM_ SG_ 1842 FuelLvlIndicator "Fuel Level gauge display";
CM_ SG_ 1842 Gas_Range "Gas range or DTE";
CM_ SG_ 1842 Total_Range "Total range or DTE";

BA_DEF_ SG_ "GenSigStartValue" INT 0 2147483647;
BA_DEF_ SG_ "GenSigInactiveValue" INT 0 2147483647;
BA_DEF_ SG_ "GenSigSendType" ENUM "NotUsed","OnWrite","OnWriteWithRepetition","OnChange","OnChangeWithRepetition","IfActive","IfActiveWithRepetition","NoSigSendType";
BA_DEF_ SG_ "SystemSignalLongSymbol" STRING ;
BA_DEF_ SG_ "GenSigTimeoutTime_AGSM" INT 0 65535;
BA_DEF_ SG_ "GenSigTimeoutTime_BCM" INT 0 65535;
BA_DEF_ SG_ "GenSigTimeoutTime_BSM" INT 0 65535;
BA_DEF_ SG_ "GenSigTimeoutTime_CADM" INT 0 65535;
BA_DEF_ SG_ "GenSigTimeoutTime_DMSM" INT 0 65535;
BA_DEF_ SG_ "GenSigTimeoutTime_DTCM" INT 0 65535;
BA_DEF_ SG_ "GenSigTimeoutTime_ECM" INT 0 65535;
BA_DEF_ SG_ "GenSigTimeoutTime_EVCU2" INT 0 65535;
BA_DEF_ SG_ "GenSigTimeoutTime_GNMM" INT 0 65535;
BA_DEF_ SG_ "GenSigTimeoutTime_HCP" INT 0 65535;
BA_DEF_ SG_ "GenSigTimeoutTime_IPC" INT 0 65535;
BA_DEF_ SG_ "GenSigTimeoutTime_RFHM" INT 0 65535;
BA_DEF_ SG_ "GenSigTimeoutTime_SGW" INT 0 65535;
BA_DEF_ SG_ "GenSigTimeoutTime_TCM" INT 0 65535;
BA_DEF_ BO_ "DiagRequest" ENUM "No","Yes";
BA_DEF_ BO_ "Type" ENUM "P","C","PE","COC","PE_Cntrl","E","E_Cntrl","OC","S","BAF","DC","EM","MM","ISO-TP","-";
BA_DEF_ BO_ "DiagResponse" ENUM "No","Yes";
BA_DEF_ BO_ "NmMessage" ENUM "No","Yes";
BA_DEF_ BO_ "GenMsgSendType" ENUM "Cyclic","NotUsed","NotUsed","NotUsed","NotUsed","NotUsed","NotUsed","NotUsed","NoMsgSendType";
BA_DEF_ BO_ "GenMsgNrOfRepetition" INT 0 255;
BA_DEF_ BO_ "GenMsgILSupport" ENUM "No","Yes";
BA_DEF_ BO_ "GenMsgStartDelayTime" INT 0 65535;
BA_DEF_ BO_ "GenMsgCycleTimeFast" INT 0 65535;
BA_DEF_ BO_ "GenMsgCycleTime" INT 0 65535;
BA_DEF_ BO_ "GenMsgDelayTime" INT 0 65535;
BA_DEF_ BO_ "NmAsrMessage" ENUM "No","Yes";
BA_DEF_ BO_ "DiagState" ENUM "No","Yes";
BA_DEF_ BO_ "DiagConnection" HEX 0 65535;
BA_DEF_ BO_ "VFrameFormat" ENUM "StandardCAN","ExtendedCAN","reserved","reserved","reserved","reserved","reserved","reserved","reserved","reserved","reserved","reserved","reserved","reserved","StandardCAN_FD","ExtendedCAN_FD";
BA_DEF_ BO_ "CANFD_BRS" ENUM "No","Yes";
BA_DEF_DEF_ "DiagRequest" "No";
BA_DEF_DEF_ "Type" "-";
BA_DEF_DEF_ "DiagResponse" "No";
BA_DEF_DEF_ "NmMessage" "No";
BA_DEF_DEF_ "GenMsgSendType" "NoMsgSendType";
BA_DEF_DEF_ "GenMsgNrOfRepetition" 0;
BA_DEF_DEF_ "GenMsgILSupport" "No";
BA_DEF_DEF_ "GenMsgStartDelayTime" 0;
BA_DEF_DEF_ "GenMsgCycleTimeFast" 0;
BA_DEF_DEF_ "GenMsgCycleTime" 0;
BA_DEF_DEF_ "GenMsgDelayTime" 0;
BA_DEF_DEF_ "NmAsrMessage" "No";
BA_DEF_DEF_ "DiagState" "No";
BA_DEF_DEF_ "DiagConnection" 0;
BA_DEF_DEF_ "VFrameFormat" "StandardCAN_FD";
BA_DEF_DEF_ "CANFD_BRS" "No";
BA_DEF_DEF_ "GenSigStartValue" 0;
BA_DEF_DEF_ "GenSigInactiveValue" 0;
BA_DEF_DEF_ "GenSigSendType" "NoSigSendType";
BA_DEF_DEF_ "SystemSignalLongSymbol" "";
BA_DEF_DEF_ "GenSigTimeoutTime_AGSM" 2500;
BA_DEF_DEF_ "GenSigTimeoutTime_BCM" 2500;
BA_DEF_DEF_ "GenSigTimeoutTime_BSM" 2500;
BA_DEF_DEF_ "GenSigTimeoutTime_CADM" 2500;
BA_DEF_DEF_ "GenSigTimeoutTime_DMSM" 2500;
BA_DEF_DEF_ "GenSigTimeoutTime_DTCM" 2500;
BA_DEF_DEF_ "GenSigTimeoutTime_ECM" 2500;
BA_DEF_DEF_ "GenSigTimeoutTime_EVCU2" 2500;
BA_DEF_DEF_ "GenSigTimeoutTime_GNMM" 2500;
BA_DEF_DEF_ "GenSigTimeoutTime_HCP" 2500;
BA_DEF_DEF_ "GenSigTimeoutTime_IPC" 2500;
BA_DEF_DEF_ "GenSigTimeoutTime_RFHM" 2500;
BA_DEF_DEF_ "GenSigTimeoutTime_SGW" 2500;
BA_DEF_DEF_ "GenSigTimeoutTime_TCM" 2500;
BA_ "Type" BO_ 1952 1;
BA_ "GenMsgSendType" BO_ 1952 0;
BA_ "GenMsgILSupport" BO_ 1952 1;
BA_ "GenMsgCycleTime" BO_ 1952 1000;
BA_ "CANFD_BRS" BO_ 1952 1;
BA_ "Type" BO_ 276 1;
BA_ "GenMsgSendType" BO_ 276 0;
BA_ "GenMsgILSupport" BO_ 276 1;
BA_ "GenMsgCycleTime" BO_ 276 10;
BA_ "CANFD_BRS" BO_ 276 1;
BA_ "Type" BO_ 269 1;
BA_ "GenMsgSendType" BO_ 269 0;
BA_ "GenMsgILSupport" BO_ 269 1;
BA_ "GenMsgCycleTime" BO_ 269 10;
BA_ "CANFD_BRS" BO_ 269 1;
BA_ "Type" BO_ 1033 1;
BA_ "GenMsgSendType" BO_ 1033 0;
BA_ "GenMsgILSupport" BO_ 1033 1;
BA_ "GenMsgCycleTime" BO_ 1033 100;
BA_ "CANFD_BRS" BO_ 1033 1;
BA_ "Type" BO_ 1580 1;
BA_ "GenMsgSendType" BO_ 1580 0;
BA_ "GenMsgILSupport" BO_ 1580 1;
BA_ "GenMsgCycleTime" BO_ 1580 500;
BA_ "CANFD_BRS" BO_ 1580 1;
BA_ "Type" BO_ 1956 1;
BA_ "GenMsgSendType" BO_ 1956 0;
BA_ "GenMsgILSupport" BO_ 1956 1;
BA_ "GenMsgCycleTime" BO_ 1956 1000;
BA_ "CANFD_BRS" BO_ 1956 1;
BA_ "Type" BO_ 1853 1;
BA_ "GenMsgSendType" BO_ 1853 0;
BA_ "GenMsgILSupport" BO_ 1853 1;
BA_ "GenMsgCycleTime" BO_ 1853 1000;
BA_ "CANFD_BRS" BO_ 1853 1;
BA_ "Type" BO_ 1032 1;
BA_ "GenMsgSendType" BO_ 1032 0;
BA_ "GenMsgILSupport" BO_ 1032 1;
BA_ "GenMsgCycleTime" BO_ 1032 100;
BA_ "CANFD_BRS" BO_ 1032 1;
BA_ "Type" BO_ 752 1;
BA_ "GenMsgSendType" BO_ 752 0;
BA_ "GenMsgILSupport" BO_ 752 1;
BA_ "GenMsgStartDelayTime" BO_ 752 40;
BA_ "GenMsgCycleTime" BO_ 752 50;
BA_ "CANFD_BRS" BO_ 752 1;
BA_ "Type" BO_ 754 1;
BA_ "GenMsgSendType" BO_ 754 0;
BA_ "GenMsgILSupport" BO_ 754 1;
BA_ "GenMsgStartDelayTime" BO_ 754 45;
BA_ "GenMsgCycleTime" BO_ 754 50;
BA_ "CANFD_BRS" BO_ 754 1;
BA_ "Type" BO_ 1955 1;
BA_ "GenMsgSendType" BO_ 1955 0;
BA_ "GenMsgILSupport" BO_ 1955 1;
BA_ "GenMsgStartDelayTime" BO_ 1955 420;
BA_ "GenMsgCycleTime" BO_ 1955 1000;
BA_ "CANFD_BRS" BO_ 1955 1;
BA_ "Type" BO_ 100 8;
BA_ "GenMsgNrOfRepetition" BO_ 100 2;
BA_ "GenMsgILSupport" BO_ 100 1;
BA_ "GenMsgCycleTimeFast" BO_ 100 20;
BA_ "GenMsgDelayTime" BO_ 100 20;
BA_ "CANFD_BRS" BO_ 100 1;
BA_ "Type" BO_ 104 11;
BA_ "GenMsgILSupport" BO_ 104 1;
BA_ "CANFD_BRS" BO_ 104 1;
BA_ "Type" BO_ 1626 10;
BA_ "GenMsgSendType" BO_ 1626 0;
BA_ "GenMsgILSupport" BO_ 1626 1;
BA_ "GenMsgStartDelayTime" BO_ 1626 55;
BA_ "GenMsgCycleTimeFast" BO_ 1626 10;
BA_ "GenMsgCycleTime" BO_ 1626 500;
BA_ "CANFD_BRS" BO_ 1626 1;
BA_ "Type" BO_ 1829 1;
BA_ "GenMsgSendType" BO_ 1829 0;
BA_ "GenMsgILSupport" BO_ 1829 1;
BA_ "GenMsgCycleTime" BO_ 1829 1000;
BA_ "CANFD_BRS" BO_ 1829 1;
BA_ "Type" BO_ 1441 3;
BA_ "GenMsgSendType" BO_ 1441 0;
BA_ "GenMsgNrOfRepetition" BO_ 1441 2;
BA_ "GenMsgILSupport" BO_ 1441 1;
BA_ "GenMsgCycleTimeFast" BO_ 1441 20;
BA_ "GenMsgCycleTime" BO_ 1441 1000;
BA_ "GenMsgDelayTime" BO_ 1441 20;
BA_ "CANFD_BRS" BO_ 1441 1;
BA_ "Type" BO_ 1455 3;
BA_ "GenMsgSendType" BO_ 1455 0;
BA_ "GenMsgNrOfRepetition" BO_ 1455 2;
BA_ "GenMsgILSupport" BO_ 1455 1;
BA_ "GenMsgCycleTimeFast" BO_ 1455 20;
BA_ "GenMsgCycleTime" BO_ 1455 1000;
BA_ "GenMsgDelayTime" BO_ 1455 20;
BA_ "CANFD_BRS" BO_ 1455 1;
BA_ "Type" BO_ 1844 1;
BA_ "GenMsgSendType" BO_ 1844 0;
BA_ "GenMsgNrOfRepetition" BO_ 1844 2;
BA_ "GenMsgILSupport" BO_ 1844 1;
BA_ "GenMsgCycleTimeFast" BO_ 1844 20;
BA_ "GenMsgCycleTime" BO_ 1844 1000;
BA_ "GenMsgDelayTime" BO_ 1844 20;
BA_ "CANFD_BRS" BO_ 1844 1;
BA_ "Type" BO_ 1842 1;
BA_ "GenMsgSendType" BO_ 1842 0;
BA_ "GenMsgILSupport" BO_ 1842 1;
BA_ "GenMsgCycleTime" BO_ 1842 1000;
BA_ "CANFD_BRS" BO_ 1842 1;
BA_ "GenSigSendType" SG_ 1952 CabinConditioningSts 3;
BA_ "GenSigTimeoutTime_AGSM" SG_ 1952 CabinConditioningSts 0;
BA_ "GenSigTimeoutTime_BSM" SG_ 1952 CabinConditioningSts 0;
BA_ "GenSigTimeoutTime_CADM" SG_ 1952 CabinConditioningSts 0;
BA_ "GenSigTimeoutTime_DMSM" SG_ 1952 CabinConditioningSts 0;
BA_ "GenSigTimeoutTime_DTCM" SG_ 1952 CabinConditioningSts 0;
BA_ "GenSigTimeoutTime_ECM" SG_ 1952 CabinConditioningSts 0;
BA_ "GenSigTimeoutTime_EVCU2" SG_ 1952 CabinConditioningSts 0;
BA_ "GenSigTimeoutTime_GNMM" SG_ 1952 CabinConditioningSts 0;
BA_ "GenSigTimeoutTime_HCP" SG_ 1952 CabinConditioningSts 0;
BA_ "GenSigTimeoutTime_IPC" SG_ 1952 CabinConditioningSts 0;
BA_ "GenSigTimeoutTime_RFHM" SG_ 1952 CabinConditioningSts 0;
BA_ "GenSigTimeoutTime_TCM" SG_ 1952 CabinConditioningSts 0;
BA_ "GenSigSendType" SG_ 1952 CabinPreconditionReqSts 3;
BA_ "GenSigTimeoutTime_AGSM" SG_ 1952 CabinPreconditionReqSts 0;
BA_ "GenSigTimeoutTime_BCM" SG_ 1952 CabinPreconditionReqSts 0;
BA_ "GenSigTimeoutTime_BSM" SG_ 1952 CabinPreconditionReqSts 0;
BA_ "GenSigTimeoutTime_CADM" SG_ 1952 CabinPreconditionReqSts 0;
BA_ "GenSigTimeoutTime_DMSM" SG_ 1952 CabinPreconditionReqSts 0;
BA_ "GenSigTimeoutTime_DTCM" SG_ 1952 CabinPreconditionReqSts 0;
BA_ "GenSigTimeoutTime_ECM" SG_ 1952 CabinPreconditionReqSts 0;
BA_ "GenSigTimeoutTime_EVCU2" SG_ 1952 CabinPreconditionReqSts 0;
BA_ "GenSigTimeoutTime_GNMM" SG_ 1952 CabinPreconditionReqSts 0;
BA_ "GenSigTimeoutTime_HCP" SG_ 1952 CabinPreconditionReqSts 0;
BA_ "GenSigTimeoutTime_RFHM" SG_ 1952 CabinPreconditionReqSts 0;
BA_ "GenSigTimeoutTime_SGW" SG_ 1952 CabinPreconditionReqSts 0;
BA_ "GenSigTimeoutTime_TCM" SG_ 1952 CabinPreconditionReqSts 0;
BA_ "GenSigSendType" SG_ 1952 CompressorState 3;
BA_ "GenSigTimeoutTime_AGSM" SG_ 1952 CompressorState 0;
BA_ "GenSigTimeoutTime_BSM" SG_ 1952 CompressorState 0;
BA_ "GenSigTimeoutTime_CADM" SG_ 1952 CompressorState 0;
BA_ "GenSigTimeoutTime_DMSM" SG_ 1952 CompressorState 0;
BA_ "GenSigTimeoutTime_DTCM" SG_ 1952 CompressorState 0;
BA_ "GenSigTimeoutTime_ECM" SG_ 1952 CompressorState 0;
BA_ "GenSigTimeoutTime_EVCU2" SG_ 1952 CompressorState 0;
BA_ "GenSigTimeoutTime_GNMM" SG_ 1952 CompressorState 0;
BA_ "GenSigTimeoutTime_HCP" SG_ 1952 CompressorState 0;
BA_ "GenSigTimeoutTime_IPC" SG_ 1952 CompressorState 0;
BA_ "GenSigTimeoutTime_RFHM" SG_ 1952 CompressorState 0;
BA_ "GenSigTimeoutTime_TCM" SG_ 1952 CompressorState 0;
BA_ "GenSigSendType" SG_ 1952 ElecClntHtrInletTemp 3;
BA_ "GenSigTimeoutTime_AGSM" SG_ 1952 ElecClntHtrInletTemp 0;
BA_ "GenSigTimeoutTime_BCM" SG_ 1952 ElecClntHtrInletTemp 0;
BA_ "GenSigTimeoutTime_BSM" SG_ 1952 ElecClntHtrInletTemp 0;
BA_ "GenSigTimeoutTime_CADM" SG_ 1952 ElecClntHtrInletTemp 0;
BA_ "GenSigTimeoutTime_DMSM" SG_ 1952 ElecClntHtrInletTemp 0;
BA_ "GenSigTimeoutTime_DTCM" SG_ 1952 ElecClntHtrInletTemp 0;
BA_ "GenSigTimeoutTime_EVCU2" SG_ 1952 ElecClntHtrInletTemp 0;
BA_ "GenSigTimeoutTime_GNMM" SG_ 1952 ElecClntHtrInletTemp 0;
BA_ "GenSigTimeoutTime_HCP" SG_ 1952 ElecClntHtrInletTemp 0;
BA_ "GenSigTimeoutTime_IPC" SG_ 1952 ElecClntHtrInletTemp 0;
BA_ "GenSigTimeoutTime_RFHM" SG_ 1952 ElecClntHtrInletTemp 0;
BA_ "GenSigTimeoutTime_SGW" SG_ 1952 ElecClntHtrInletTemp 0;
BA_ "GenSigTimeoutTime_TCM" SG_ 1952 ElecClntHtrInletTemp 0;
BA_ "GenSigSendType" SG_ 1952 ElecCoolantHtrPwr 3;
BA_ "GenSigTimeoutTime_AGSM" SG_ 1952 ElecCoolantHtrPwr 0;
BA_ "GenSigTimeoutTime_BSM" SG_ 1952 ElecCoolantHtrPwr 0;
BA_ "GenSigTimeoutTime_CADM" SG_ 1952 ElecCoolantHtrPwr 0;
BA_ "GenSigTimeoutTime_DMSM" SG_ 1952 ElecCoolantHtrPwr 0;
BA_ "GenSigTimeoutTime_DTCM" SG_ 1952 ElecCoolantHtrPwr 0;
BA_ "GenSigTimeoutTime_EVCU2" SG_ 1952 ElecCoolantHtrPwr 0;
BA_ "GenSigTimeoutTime_GNMM" SG_ 1952 ElecCoolantHtrPwr 0;
BA_ "GenSigTimeoutTime_HCP" SG_ 1952 ElecCoolantHtrPwr 0;
BA_ "GenSigTimeoutTime_IPC" SG_ 1952 ElecCoolantHtrPwr 0;
BA_ "GenSigTimeoutTime_RFHM" SG_ 1952 ElecCoolantHtrPwr 0;
BA_ "GenSigTimeoutTime_TCM" SG_ 1952 ElecCoolantHtrPwr 0;
BA_ "GenSigSendType" SG_ 1952 FRfShVlvSts 3;
BA_ "GenSigTimeoutTime_AGSM" SG_ 1952 FRfShVlvSts 0;
BA_ "GenSigTimeoutTime_BSM" SG_ 1952 FRfShVlvSts 0;
BA_ "GenSigTimeoutTime_CADM" SG_ 1952 FRfShVlvSts 0;
BA_ "GenSigTimeoutTime_DMSM" SG_ 1952 FRfShVlvSts 0;
BA_ "GenSigTimeoutTime_DTCM" SG_ 1952 FRfShVlvSts 0;
BA_ "GenSigTimeoutTime_ECM" SG_ 1952 FRfShVlvSts 0;
BA_ "GenSigTimeoutTime_EVCU2" SG_ 1952 FRfShVlvSts 0;
BA_ "GenSigTimeoutTime_GNMM" SG_ 1952 FRfShVlvSts 0;
BA_ "GenSigTimeoutTime_HCP" SG_ 1952 FRfShVlvSts 0;
BA_ "GenSigTimeoutTime_IPC" SG_ 1952 FRfShVlvSts 0;
BA_ "GenSigTimeoutTime_RFHM" SG_ 1952 FRfShVlvSts 0;
BA_ "GenSigTimeoutTime_TCM" SG_ 1952 FRfShVlvSts 0;
BA_ "GenSigSendType" SG_ 1952 HeaterCoreInletTemp 3;
BA_ "GenSigTimeoutTime_AGSM" SG_ 1952 HeaterCoreInletTemp 0;
BA_ "GenSigTimeoutTime_BSM" SG_ 1952 HeaterCoreInletTemp 0;
BA_ "GenSigTimeoutTime_CADM" SG_ 1952 HeaterCoreInletTemp 0;
BA_ "GenSigTimeoutTime_DMSM" SG_ 1952 HeaterCoreInletTemp 0;
BA_ "GenSigTimeoutTime_DTCM" SG_ 1952 HeaterCoreInletTemp 0;
BA_ "GenSigTimeoutTime_EVCU2" SG_ 1952 HeaterCoreInletTemp 0;
BA_ "GenSigTimeoutTime_GNMM" SG_ 1952 HeaterCoreInletTemp 0;
BA_ "GenSigTimeoutTime_HCP" SG_ 1952 HeaterCoreInletTemp 0;
BA_ "GenSigTimeoutTime_IPC" SG_ 1952 HeaterCoreInletTemp 0;
BA_ "GenSigTimeoutTime_RFHM" SG_ 1952 HeaterCoreInletTemp 0;
BA_ "GenSigTimeoutTime_SGW" SG_ 1952 HeaterCoreInletTemp 0;
BA_ "GenSigTimeoutTime_TCM" SG_ 1952 HeaterCoreInletTemp 0;
BA_ "GenSigStartValue" SG_ 1952 HTAuxPmpMontrngRPM 3;
BA_ "GenSigSendType" SG_ 1952 HTAuxPmpMontrngRPM 3;
BA_ "GenSigTimeoutTime_AGSM" SG_ 1952 HTAuxPmpMontrngRPM 0;
BA_ "GenSigTimeoutTime_BCM" SG_ 1952 HTAuxPmpMontrngRPM 0;
BA_ "GenSigTimeoutTime_BSM" SG_ 1952 HTAuxPmpMontrngRPM 0;
BA_ "GenSigTimeoutTime_CADM" SG_ 1952 HTAuxPmpMontrngRPM 0;
BA_ "GenSigTimeoutTime_DMSM" SG_ 1952 HTAuxPmpMontrngRPM 0;
BA_ "GenSigTimeoutTime_DTCM" SG_ 1952 HTAuxPmpMontrngRPM 0;
BA_ "GenSigTimeoutTime_EVCU2" SG_ 1952 HTAuxPmpMontrngRPM 0;
BA_ "GenSigTimeoutTime_GNMM" SG_ 1952 HTAuxPmpMontrngRPM 0;
BA_ "GenSigTimeoutTime_HCP" SG_ 1952 HTAuxPmpMontrngRPM 0;
BA_ "GenSigTimeoutTime_IPC" SG_ 1952 HTAuxPmpMontrngRPM 0;
BA_ "GenSigTimeoutTime_RFHM" SG_ 1952 HTAuxPmpMontrngRPM 0;
BA_ "GenSigTimeoutTime_SGW" SG_ 1952 HTAuxPmpMontrngRPM 0;
BA_ "GenSigTimeoutTime_TCM" SG_ 1952 HTAuxPmpMontrngRPM 0;
BA_ "GenSigSendType" SG_ 1952 HTAuxPmpRPMAct 3;
BA_ "GenSigTimeoutTime_AGSM" SG_ 1952 HTAuxPmpRPMAct 0;
BA_ "GenSigTimeoutTime_BSM" SG_ 1952 HTAuxPmpRPMAct 0;
BA_ "GenSigTimeoutTime_CADM" SG_ 1952 HTAuxPmpRPMAct 0;
BA_ "GenSigTimeoutTime_DMSM" SG_ 1952 HTAuxPmpRPMAct 0;
BA_ "GenSigTimeoutTime_DTCM" SG_ 1952 HTAuxPmpRPMAct 0;
BA_ "GenSigTimeoutTime_EVCU2" SG_ 1952 HTAuxPmpRPMAct 0;
BA_ "GenSigTimeoutTime_GNMM" SG_ 1952 HTAuxPmpRPMAct 0;
BA_ "GenSigTimeoutTime_HCP" SG_ 1952 HTAuxPmpRPMAct 0;
BA_ "GenSigTimeoutTime_IPC" SG_ 1952 HTAuxPmpRPMAct 0;
BA_ "GenSigTimeoutTime_RFHM" SG_ 1952 HTAuxPmpRPMAct 0;
BA_ "GenSigTimeoutTime_TCM" SG_ 1952 HTAuxPmpRPMAct 0;
BA_ "GenSigSendType" SG_ 1952 HTShtOffVlvReq 3;
BA_ "GenSigTimeoutTime_AGSM" SG_ 1952 HTShtOffVlvReq 0;
BA_ "GenSigTimeoutTime_BSM" SG_ 1952 HTShtOffVlvReq 0;
BA_ "GenSigTimeoutTime_CADM" SG_ 1952 HTShtOffVlvReq 0;
BA_ "GenSigTimeoutTime_DMSM" SG_ 1952 HTShtOffVlvReq 0;
BA_ "GenSigTimeoutTime_DTCM" SG_ 1952 HTShtOffVlvReq 0;
BA_ "GenSigTimeoutTime_EVCU2" SG_ 1952 HTShtOffVlvReq 0;
BA_ "GenSigTimeoutTime_GNMM" SG_ 1952 HTShtOffVlvReq 0;
BA_ "GenSigTimeoutTime_HCP" SG_ 1952 HTShtOffVlvReq 0;
BA_ "GenSigTimeoutTime_IPC" SG_ 1952 HTShtOffVlvReq 0;
BA_ "GenSigTimeoutTime_RFHM" SG_ 1952 HTShtOffVlvReq 0;
BA_ "GenSigTimeoutTime_TCM" SG_ 1952 HTShtOffVlvReq 0;
BA_ "GenSigSendType" SG_ 1952 HVBatCoolantLevelLow_DPT 3;
BA_ "GenSigTimeoutTime_AGSM" SG_ 1952 HVBatCoolantLevelLow_DPT 0;
BA_ "GenSigTimeoutTime_BCM" SG_ 1952 HVBatCoolantLevelLow_DPT 0;
BA_ "GenSigTimeoutTime_BSM" SG_ 1952 HVBatCoolantLevelLow_DPT 0;
BA_ "GenSigTimeoutTime_CADM" SG_ 1952 HVBatCoolantLevelLow_DPT 0;
BA_ "GenSigTimeoutTime_DMSM" SG_ 1952 HVBatCoolantLevelLow_DPT 0;
BA_ "GenSigTimeoutTime_DTCM" SG_ 1952 HVBatCoolantLevelLow_DPT 0;
BA_ "GenSigTimeoutTime_ECM" SG_ 1952 HVBatCoolantLevelLow_DPT 0;
BA_ "GenSigTimeoutTime_EVCU2" SG_ 1952 HVBatCoolantLevelLow_DPT 0;
BA_ "GenSigTimeoutTime_GNMM" SG_ 1952 HVBatCoolantLevelLow_DPT 0;
BA_ "GenSigTimeoutTime_HCP" SG_ 1952 HVBatCoolantLevelLow_DPT 0;
BA_ "GenSigTimeoutTime_RFHM" SG_ 1952 HVBatCoolantLevelLow_DPT 0;
BA_ "GenSigTimeoutTime_TCM" SG_ 1952 HVBatCoolantLevelLow_DPT 0;
BA_ "GenSigSendType" SG_ 1952 HVBatCritCondT 3;
BA_ "GenSigTimeoutTime_AGSM" SG_ 1952 HVBatCritCondT 0;
BA_ "GenSigTimeoutTime_BSM" SG_ 1952 HVBatCritCondT 0;
BA_ "GenSigTimeoutTime_CADM" SG_ 1952 HVBatCritCondT 0;
BA_ "GenSigTimeoutTime_DMSM" SG_ 1952 HVBatCritCondT 0;
BA_ "GenSigTimeoutTime_DTCM" SG_ 1952 HVBatCritCondT 0;
BA_ "GenSigTimeoutTime_ECM" SG_ 1952 HVBatCritCondT 0;
BA_ "GenSigTimeoutTime_EVCU2" SG_ 1952 HVBatCritCondT 0;
BA_ "GenSigTimeoutTime_GNMM" SG_ 1952 HVBatCritCondT 0;
BA_ "GenSigTimeoutTime_HCP" SG_ 1952 HVBatCritCondT 0;
BA_ "GenSigTimeoutTime_IPC" SG_ 1952 HVBatCritCondT 0;
BA_ "GenSigTimeoutTime_RFHM" SG_ 1952 HVBatCritCondT 0;
BA_ "GenSigTimeoutTime_TCM" SG_ 1952 HVBatCritCondT 0;
BA_ "GenSigTimeoutTime_AGSM" SG_ 1952 Sch_PreCondition_Sts 0;
BA_ "GenSigTimeoutTime_BSM" SG_ 1952 Sch_PreCondition_Sts 0;
BA_ "GenSigTimeoutTime_CADM" SG_ 1952 Sch_PreCondition_Sts 0;
BA_ "GenSigTimeoutTime_DMSM" SG_ 1952 Sch_PreCondition_Sts 0;
BA_ "GenSigTimeoutTime_DTCM" SG_ 1952 Sch_PreCondition_Sts 0;
BA_ "GenSigTimeoutTime_ECM" SG_ 1952 Sch_PreCondition_Sts 0;
BA_ "GenSigTimeoutTime_EVCU2" SG_ 1952 Sch_PreCondition_Sts 0;
BA_ "GenSigTimeoutTime_GNMM" SG_ 1952 Sch_PreCondition_Sts 0;
BA_ "GenSigTimeoutTime_HCP" SG_ 1952 Sch_PreCondition_Sts 0;
BA_ "GenSigTimeoutTime_IPC" SG_ 1952 Sch_PreCondition_Sts 0;
BA_ "GenSigTimeoutTime_RFHM" SG_ 1952 Sch_PreCondition_Sts 0;
BA_ "GenSigTimeoutTime_SGW" SG_ 1952 Sch_PreCondition_Sts 0;
BA_ "GenSigTimeoutTime_TCM" SG_ 1952 Sch_PreCondition_Sts 0;
BA_ "GenSigTimeoutTime_AGSM" SG_ 1952 SchCond_Time_Till_Dep 0;
BA_ "GenSigTimeoutTime_BSM" SG_ 1952 SchCond_Time_Till_Dep 0;
BA_ "GenSigTimeoutTime_CADM" SG_ 1952 SchCond_Time_Till_Dep 0;
BA_ "GenSigTimeoutTime_DMSM" SG_ 1952 SchCond_Time_Till_Dep 0;
BA_ "GenSigTimeoutTime_DTCM" SG_ 1952 SchCond_Time_Till_Dep 0;
BA_ "GenSigTimeoutTime_ECM" SG_ 1952 SchCond_Time_Till_Dep 0;
BA_ "GenSigTimeoutTime_EVCU2" SG_ 1952 SchCond_Time_Till_Dep 0;
BA_ "GenSigTimeoutTime_GNMM" SG_ 1952 SchCond_Time_Till_Dep 0;
BA_ "GenSigTimeoutTime_HCP" SG_ 1952 SchCond_Time_Till_Dep 0;
BA_ "GenSigTimeoutTime_IPC" SG_ 1952 SchCond_Time_Till_Dep 0;
BA_ "GenSigTimeoutTime_RFHM" SG_ 1952 SchCond_Time_Till_Dep 0;
BA_ "GenSigTimeoutTime_SGW" SG_ 1952 SchCond_Time_Till_Dep 0;
BA_ "GenSigTimeoutTime_TCM" SG_ 1952 SchCond_Time_Till_Dep 0;
BA_ "GenSigTimeoutTime_AGSM" SG_ 276 Belt_Slip_Detected 0;
BA_ "GenSigTimeoutTime_BCM" SG_ 276 Belt_Slip_Detected 0;
BA_ "GenSigTimeoutTime_BSM" SG_ 276 Belt_Slip_Detected 0;
BA_ "GenSigTimeoutTime_CADM" SG_ 276 Belt_Slip_Detected 0;
BA_ "GenSigTimeoutTime_DMSM" SG_ 276 Belt_Slip_Detected 0;
BA_ "GenSigTimeoutTime_DTCM" SG_ 276 Belt_Slip_Detected 0;
BA_ "GenSigTimeoutTime_EVCU2" SG_ 276 Belt_Slip_Detected 0;
BA_ "GenSigTimeoutTime_GNMM" SG_ 276 Belt_Slip_Detected 0;
BA_ "GenSigTimeoutTime_HCP" SG_ 276 Belt_Slip_Detected 0;
BA_ "GenSigTimeoutTime_IPC" SG_ 276 Belt_Slip_Detected 0;
BA_ "GenSigTimeoutTime_RFHM" SG_ 276 Belt_Slip_Detected 0;
BA_ "GenSigTimeoutTime_SGW" SG_ 276 Belt_Slip_Detected 0;
BA_ "GenSigTimeoutTime_TCM" SG_ 276 Belt_Slip_Detected 0;
BA_ "GenSigStartValue" SG_ 276 BSGMaxTrqDyn 511;
BA_ "GenSigTimeoutTime_AGSM" SG_ 276 BSGMaxTrqDyn 0;
BA_ "GenSigTimeoutTime_BCM" SG_ 276 BSGMaxTrqDyn 0;
BA_ "GenSigTimeoutTime_BSM" SG_ 276 BSGMaxTrqDyn 0;
BA_ "GenSigTimeoutTime_CADM" SG_ 276 BSGMaxTrqDyn 0;
BA_ "GenSigTimeoutTime_DMSM" SG_ 276 BSGMaxTrqDyn 0;
BA_ "GenSigTimeoutTime_DTCM" SG_ 276 BSGMaxTrqDyn 0;
BA_ "GenSigTimeoutTime_EVCU2" SG_ 276 BSGMaxTrqDyn 0;
BA_ "GenSigTimeoutTime_GNMM" SG_ 276 BSGMaxTrqDyn 0;
BA_ "GenSigTimeoutTime_HCP" SG_ 276 BSGMaxTrqDyn 0;
BA_ "GenSigTimeoutTime_IPC" SG_ 276 BSGMaxTrqDyn 0;
BA_ "GenSigTimeoutTime_RFHM" SG_ 276 BSGMaxTrqDyn 0;
BA_ "GenSigTimeoutTime_SGW" SG_ 276 BSGMaxTrqDyn 0;
BA_ "GenSigTimeoutTime_TCM" SG_ 276 BSGMaxTrqDyn 0;
BA_ "GenSigStartValue" SG_ 276 BSGMinTrqDyn 511;
BA_ "GenSigTimeoutTime_AGSM" SG_ 276 BSGMinTrqDyn 0;
BA_ "GenSigTimeoutTime_BCM" SG_ 276 BSGMinTrqDyn 0;
BA_ "GenSigTimeoutTime_BSM" SG_ 276 BSGMinTrqDyn 0;
BA_ "GenSigTimeoutTime_CADM" SG_ 276 BSGMinTrqDyn 0;
BA_ "GenSigTimeoutTime_DMSM" SG_ 276 BSGMinTrqDyn 0;
BA_ "GenSigTimeoutTime_DTCM" SG_ 276 BSGMinTrqDyn 0;
BA_ "GenSigTimeoutTime_EVCU2" SG_ 276 BSGMinTrqDyn 0;
BA_ "GenSigTimeoutTime_GNMM" SG_ 276 BSGMinTrqDyn 0;
BA_ "GenSigTimeoutTime_HCP" SG_ 276 BSGMinTrqDyn 0;
BA_ "GenSigTimeoutTime_IPC" SG_ 276 BSGMinTrqDyn 0;
BA_ "GenSigTimeoutTime_RFHM" SG_ 276 BSGMinTrqDyn 0;
BA_ "GenSigTimeoutTime_SGW" SG_ 276 BSGMinTrqDyn 0;
BA_ "GenSigTimeoutTime_TCM" SG_ 276 BSGMinTrqDyn 0;
BA_ "GenSigTimeoutTime_AGSM" SG_ 276 CRC_HYBRID_POWERTRAIN1 0;
BA_ "GenSigTimeoutTime_BCM" SG_ 276 CRC_HYBRID_POWERTRAIN1 0;
BA_ "GenSigTimeoutTime_DMSM" SG_ 276 CRC_HYBRID_POWERTRAIN1 0;
BA_ "GenSigTimeoutTime_DTCM" SG_ 276 CRC_HYBRID_POWERTRAIN1 0;
BA_ "GenSigTimeoutTime_EVCU2" SG_ 276 CRC_HYBRID_POWERTRAIN1 0;
BA_ "GenSigTimeoutTime_GNMM" SG_ 276 CRC_HYBRID_POWERTRAIN1 0;
BA_ "GenSigTimeoutTime_HCP" SG_ 276 CRC_HYBRID_POWERTRAIN1 0;
BA_ "GenSigTimeoutTime_RFHM" SG_ 276 CRC_HYBRID_POWERTRAIN1 0;
BA_ "GenSigTimeoutTime_SGW" SG_ 276 CRC_HYBRID_POWERTRAIN1 0;
BA_ "GenSigTimeoutTime_AGSM" SG_ 276 DriveMode_PopUpRequest 0;
BA_ "GenSigTimeoutTime_BCM" SG_ 276 DriveMode_PopUpRequest 0;
BA_ "GenSigTimeoutTime_BSM" SG_ 276 DriveMode_PopUpRequest 0;
BA_ "GenSigTimeoutTime_CADM" SG_ 276 DriveMode_PopUpRequest 0;
BA_ "GenSigTimeoutTime_DMSM" SG_ 276 DriveMode_PopUpRequest 0;
BA_ "GenSigTimeoutTime_DTCM" SG_ 276 DriveMode_PopUpRequest 0;
BA_ "GenSigTimeoutTime_ECM" SG_ 276 DriveMode_PopUpRequest 0;
BA_ "GenSigTimeoutTime_EVCU2" SG_ 276 DriveMode_PopUpRequest 0;
BA_ "GenSigTimeoutTime_GNMM" SG_ 276 DriveMode_PopUpRequest 0;
BA_ "GenSigTimeoutTime_HCP" SG_ 276 DriveMode_PopUpRequest 0;
BA_ "GenSigTimeoutTime_RFHM" SG_ 276 DriveMode_PopUpRequest 0;
BA_ "GenSigTimeoutTime_SGW" SG_ 276 DriveMode_PopUpRequest 0;
BA_ "GenSigTimeoutTime_TCM" SG_ 276 DriveMode_PopUpRequest 0;
BA_ "GenSigTimeoutTime_AGSM" SG_ 276 DriveModeSts_EPT 0;
BA_ "GenSigTimeoutTime_BCM" SG_ 276 DriveModeSts_EPT 0;
BA_ "GenSigTimeoutTime_BSM" SG_ 276 DriveModeSts_EPT 0;
BA_ "GenSigTimeoutTime_CADM" SG_ 276 DriveModeSts_EPT 0;
BA_ "GenSigTimeoutTime_DMSM" SG_ 276 DriveModeSts_EPT 0;
BA_ "GenSigTimeoutTime_DTCM" SG_ 276 DriveModeSts_EPT 0;
BA_ "GenSigTimeoutTime_ECM" SG_ 276 DriveModeSts_EPT 0;
BA_ "GenSigTimeoutTime_EVCU2" SG_ 276 DriveModeSts_EPT 0;
BA_ "GenSigTimeoutTime_GNMM" SG_ 276 DriveModeSts_EPT 0;
BA_ "GenSigTimeoutTime_HCP" SG_ 276 DriveModeSts_EPT 0;
BA_ "GenSigTimeoutTime_IPC" SG_ 276 DriveModeSts_EPT 0;
BA_ "GenSigTimeoutTime_RFHM" SG_ 276 DriveModeSts_EPT 0;
BA_ "GenSigTimeoutTime_SGW" SG_ 276 DriveModeSts_EPT 0;
BA_ "GenSigTimeoutTime_TCM" SG_ 276 DriveModeSts_EPT 0;
BA_ "GenSigTimeoutTime_AGSM" SG_ 276 DriveReady 0;
BA_ "GenSigTimeoutTime_BSM" SG_ 276 DriveReady 0;
BA_ "GenSigTimeoutTime_CADM" SG_ 276 DriveReady 0;
BA_ "GenSigTimeoutTime_DMSM" SG_ 276 DriveReady 0;
BA_ "GenSigTimeoutTime_DTCM" SG_ 276 DriveReady 0;
BA_ "GenSigTimeoutTime_ECM" SG_ 276 DriveReady 0;
BA_ "GenSigTimeoutTime_EVCU2" SG_ 276 DriveReady 0;
BA_ "GenSigTimeoutTime_GNMM" SG_ 276 DriveReady 0;
BA_ "GenSigTimeoutTime_HCP" SG_ 276 DriveReady 0;
BA_ "GenSigTimeoutTime_RFHM" SG_ 276 DriveReady 0;
BA_ "GenSigTimeoutTime_TCM" SG_ 276 DriveReady 0;
BA_ "GenSigTimeoutTime_AGSM" SG_ 276 ECMPrepIdleRes 0;
BA_ "GenSigTimeoutTime_BCM" SG_ 276 ECMPrepIdleRes 0;
BA_ "GenSigTimeoutTime_BSM" SG_ 276 ECMPrepIdleRes 0;
BA_ "GenSigTimeoutTime_CADM" SG_ 276 ECMPrepIdleRes 0;
BA_ "GenSigTimeoutTime_DMSM" SG_ 276 ECMPrepIdleRes 0;
BA_ "GenSigTimeoutTime_DTCM" SG_ 276 ECMPrepIdleRes 0;
BA_ "GenSigTimeoutTime_EVCU2" SG_ 276 ECMPrepIdleRes 0;
BA_ "GenSigTimeoutTime_GNMM" SG_ 276 ECMPrepIdleRes 0;
BA_ "GenSigTimeoutTime_HCP" SG_ 276 ECMPrepIdleRes 0;
BA_ "GenSigTimeoutTime_IPC" SG_ 276 ECMPrepIdleRes 0;
BA_ "GenSigTimeoutTime_RFHM" SG_ 276 ECMPrepIdleRes 0;
BA_ "GenSigTimeoutTime_SGW" SG_ 276 ECMPrepIdleRes 0;
BA_ "GenSigTimeoutTime_TCM" SG_ 276 ECMPrepIdleRes 0;
BA_ "GenSigTimeoutTime_AGSM" SG_ 276 Eng_Off_Allowed 0;
BA_ "GenSigTimeoutTime_BCM" SG_ 276 Eng_Off_Allowed 0;
BA_ "GenSigTimeoutTime_BSM" SG_ 276 Eng_Off_Allowed 0;
BA_ "GenSigTimeoutTime_CADM" SG_ 276 Eng_Off_Allowed 0;
BA_ "GenSigTimeoutTime_DMSM" SG_ 276 Eng_Off_Allowed 0;
BA_ "GenSigTimeoutTime_DTCM" SG_ 276 Eng_Off_Allowed 0;
BA_ "GenSigTimeoutTime_EVCU2" SG_ 276 Eng_Off_Allowed 0;
BA_ "GenSigTimeoutTime_GNMM" SG_ 276 Eng_Off_Allowed 0;
BA_ "GenSigTimeoutTime_HCP" SG_ 276 Eng_Off_Allowed 0;
BA_ "GenSigTimeoutTime_IPC" SG_ 276 Eng_Off_Allowed 0;
BA_ "GenSigTimeoutTime_RFHM" SG_ 276 Eng_Off_Allowed 0;
BA_ "GenSigTimeoutTime_SGW" SG_ 276 Eng_Off_Allowed 0;
BA_ "GenSigTimeoutTime_TCM" SG_ 276 Eng_Off_Allowed 0;
BA_ "GenSigTimeoutTime_AGSM" SG_ 276 EngActDmpgDsblReq 0;
BA_ "GenSigTimeoutTime_BCM" SG_ 276 EngActDmpgDsblReq 0;
BA_ "GenSigTimeoutTime_BSM" SG_ 276 EngActDmpgDsblReq 0;
BA_ "GenSigTimeoutTime_CADM" SG_ 276 EngActDmpgDsblReq 0;
BA_ "GenSigTimeoutTime_DMSM" SG_ 276 EngActDmpgDsblReq 0;
BA_ "GenSigTimeoutTime_DTCM" SG_ 276 EngActDmpgDsblReq 0;
BA_ "GenSigTimeoutTime_EVCU2" SG_ 276 EngActDmpgDsblReq 0;
BA_ "GenSigTimeoutTime_GNMM" SG_ 276 EngActDmpgDsblReq 0;
BA_ "GenSigTimeoutTime_HCP" SG_ 276 EngActDmpgDsblReq 0;
BA_ "GenSigTimeoutTime_IPC" SG_ 276 EngActDmpgDsblReq 0;
BA_ "GenSigTimeoutTime_RFHM" SG_ 276 EngActDmpgDsblReq 0;
BA_ "GenSigTimeoutTime_SGW" SG_ 276 EngActDmpgDsblReq 0;
BA_ "GenSigTimeoutTime_TCM" SG_ 276 EngActDmpgDsblReq 0;
BA_ "GenSigTimeoutTime_AGSM" SG_ 276 EngCntrlMode 0;
BA_ "GenSigTimeoutTime_BCM" SG_ 276 EngCntrlMode 0;
BA_ "GenSigTimeoutTime_BSM" SG_ 276 EngCntrlMode 0;
BA_ "GenSigTimeoutTime_CADM" SG_ 276 EngCntrlMode 0;
BA_ "GenSigTimeoutTime_DMSM" SG_ 276 EngCntrlMode 0;
BA_ "GenSigTimeoutTime_DTCM" SG_ 276 EngCntrlMode 0;
BA_ "GenSigTimeoutTime_EVCU2" SG_ 276 EngCntrlMode 0;
BA_ "GenSigTimeoutTime_GNMM" SG_ 276 EngCntrlMode 0;
BA_ "GenSigTimeoutTime_HCP" SG_ 276 EngCntrlMode 0;
BA_ "GenSigTimeoutTime_IPC" SG_ 276 EngCntrlMode 0;
BA_ "GenSigTimeoutTime_RFHM" SG_ 276 EngCntrlMode 0;
BA_ "GenSigTimeoutTime_SGW" SG_ 276 EngCntrlMode 0;
BA_ "GenSigTimeoutTime_TCM" SG_ 276 EngCntrlMode 0;
BA_ "GenSigTimeoutTime_AGSM" SG_ 276 EngTrqReserveCmd 0;
BA_ "GenSigTimeoutTime_BCM" SG_ 276 EngTrqReserveCmd 0;
BA_ "GenSigTimeoutTime_BSM" SG_ 276 EngTrqReserveCmd 0;
BA_ "GenSigTimeoutTime_CADM" SG_ 276 EngTrqReserveCmd 0;
BA_ "GenSigTimeoutTime_DMSM" SG_ 276 EngTrqReserveCmd 0;
BA_ "GenSigTimeoutTime_DTCM" SG_ 276 EngTrqReserveCmd 0;
BA_ "GenSigTimeoutTime_EVCU2" SG_ 276 EngTrqReserveCmd 0;
BA_ "GenSigTimeoutTime_GNMM" SG_ 276 EngTrqReserveCmd 0;
BA_ "GenSigTimeoutTime_HCP" SG_ 276 EngTrqReserveCmd 0;
BA_ "GenSigTimeoutTime_IPC" SG_ 276 EngTrqReserveCmd 0;
BA_ "GenSigTimeoutTime_RFHM" SG_ 276 EngTrqReserveCmd 0;
BA_ "GenSigTimeoutTime_SGW" SG_ 276 EngTrqReserveCmd 0;
BA_ "GenSigTimeoutTime_TCM" SG_ 276 EngTrqReserveCmd 0;
BA_ "GenSigTimeoutTime_AGSM" SG_ 276 GeneratorSetpointOverride 0;
BA_ "GenSigTimeoutTime_BCM" SG_ 276 GeneratorSetpointOverride 0;
BA_ "GenSigTimeoutTime_BSM" SG_ 276 GeneratorSetpointOverride 0;
BA_ "GenSigTimeoutTime_CADM" SG_ 276 GeneratorSetpointOverride 0;
BA_ "GenSigTimeoutTime_DMSM" SG_ 276 GeneratorSetpointOverride 0;
BA_ "GenSigTimeoutTime_DTCM" SG_ 276 GeneratorSetpointOverride 0;
BA_ "GenSigTimeoutTime_EVCU2" SG_ 276 GeneratorSetpointOverride 0;
BA_ "GenSigTimeoutTime_GNMM" SG_ 276 GeneratorSetpointOverride 0;
BA_ "GenSigTimeoutTime_HCP" SG_ 276 GeneratorSetpointOverride 0;
BA_ "GenSigTimeoutTime_IPC" SG_ 276 GeneratorSetpointOverride 0;
BA_ "GenSigTimeoutTime_RFHM" SG_ 276 GeneratorSetpointOverride 0;
BA_ "GenSigTimeoutTime_SGW" SG_ 276 GeneratorSetpointOverride 0;
BA_ "GenSigTimeoutTime_TCM" SG_ 276 GeneratorSetpointOverride 0;
BA_ "GenSigTimeoutTime_AGSM" SG_ 276 HEV_ESS_Mode 0;
BA_ "GenSigTimeoutTime_BCM" SG_ 276 HEV_ESS_Mode 0;
BA_ "GenSigTimeoutTime_BSM" SG_ 276 HEV_ESS_Mode 0;
BA_ "GenSigTimeoutTime_CADM" SG_ 276 HEV_ESS_Mode 0;
BA_ "GenSigTimeoutTime_DMSM" SG_ 276 HEV_ESS_Mode 0;
BA_ "GenSigTimeoutTime_DTCM" SG_ 276 HEV_ESS_Mode 0;
BA_ "GenSigTimeoutTime_EVCU2" SG_ 276 HEV_ESS_Mode 0;
BA_ "GenSigTimeoutTime_GNMM" SG_ 276 HEV_ESS_Mode 0;
BA_ "GenSigTimeoutTime_HCP" SG_ 276 HEV_ESS_Mode 0;
BA_ "GenSigTimeoutTime_IPC" SG_ 276 HEV_ESS_Mode 0;
BA_ "GenSigTimeoutTime_RFHM" SG_ 276 HEV_ESS_Mode 0;
BA_ "GenSigTimeoutTime_SGW" SG_ 276 HEV_ESS_Mode 0;
BA_ "GenSigTimeoutTime_TCM" SG_ 276 HEV_ESS_Mode 0;
BA_ "GenSigStartValue" SG_ 276 HVBatteryShutOff 1;
BA_ "GenSigTimeoutTime_AGSM" SG_ 276 HVBatteryShutOff 0;
BA_ "GenSigTimeoutTime_BCM" SG_ 276 HVBatteryShutOff 0;
BA_ "GenSigTimeoutTime_BSM" SG_ 276 HVBatteryShutOff 0;
BA_ "GenSigTimeoutTime_CADM" SG_ 276 HVBatteryShutOff 0;
BA_ "GenSigTimeoutTime_DMSM" SG_ 276 HVBatteryShutOff 0;
BA_ "GenSigTimeoutTime_DTCM" SG_ 276 HVBatteryShutOff 0;
BA_ "GenSigTimeoutTime_ECM" SG_ 276 HVBatteryShutOff 0;
BA_ "GenSigTimeoutTime_EVCU2" SG_ 276 HVBatteryShutOff 0;
BA_ "GenSigTimeoutTime_GNMM" SG_ 276 HVBatteryShutOff 0;
BA_ "GenSigTimeoutTime_HCP" SG_ 276 HVBatteryShutOff 0;
BA_ "GenSigTimeoutTime_RFHM" SG_ 276 HVBatteryShutOff 0;
BA_ "GenSigTimeoutTime_SGW" SG_ 276 HVBatteryShutOff 0;
BA_ "GenSigTimeoutTime_TCM" SG_ 276 HVBatteryShutOff 0;
BA_ "GenSigStartValue" SG_ 276 HybCmndEngTorqImmed 938;
BA_ "GenSigTimeoutTime_AGSM" SG_ 276 HybCmndEngTorqImmed 0;
BA_ "GenSigTimeoutTime_BCM" SG_ 276 HybCmndEngTorqImmed 0;
BA_ "GenSigTimeoutTime_BSM" SG_ 276 HybCmndEngTorqImmed 0;
BA_ "GenSigTimeoutTime_CADM" SG_ 276 HybCmndEngTorqImmed 0;
BA_ "GenSigTimeoutTime_DMSM" SG_ 276 HybCmndEngTorqImmed 0;
BA_ "GenSigTimeoutTime_DTCM" SG_ 276 HybCmndEngTorqImmed 0;
BA_ "GenSigTimeoutTime_EVCU2" SG_ 276 HybCmndEngTorqImmed 0;
BA_ "GenSigTimeoutTime_GNMM" SG_ 276 HybCmndEngTorqImmed 0;
BA_ "GenSigTimeoutTime_HCP" SG_ 276 HybCmndEngTorqImmed 0;
BA_ "GenSigTimeoutTime_IPC" SG_ 276 HybCmndEngTorqImmed 0;
BA_ "GenSigTimeoutTime_RFHM" SG_ 276 HybCmndEngTorqImmed 0;
BA_ "GenSigTimeoutTime_SGW" SG_ 276 HybCmndEngTorqImmed 0;
BA_ "GenSigTimeoutTime_TCM" SG_ 276 HybCmndEngTorqImmed 0;
BA_ "GenSigStartValue" SG_ 276 HybCmndEngTorqPrdtd 938;
BA_ "GenSigTimeoutTime_AGSM" SG_ 276 HybCmndEngTorqPrdtd 0;
BA_ "GenSigTimeoutTime_BCM" SG_ 276 HybCmndEngTorqPrdtd 0;
BA_ "GenSigTimeoutTime_BSM" SG_ 276 HybCmndEngTorqPrdtd 0;
BA_ "GenSigTimeoutTime_CADM" SG_ 276 HybCmndEngTorqPrdtd 0;
BA_ "GenSigTimeoutTime_DMSM" SG_ 276 HybCmndEngTorqPrdtd 0;
BA_ "GenSigTimeoutTime_DTCM" SG_ 276 HybCmndEngTorqPrdtd 0;
BA_ "GenSigTimeoutTime_EVCU2" SG_ 276 HybCmndEngTorqPrdtd 0;
BA_ "GenSigTimeoutTime_GNMM" SG_ 276 HybCmndEngTorqPrdtd 0;
BA_ "GenSigTimeoutTime_HCP" SG_ 276 HybCmndEngTorqPrdtd 0;
BA_ "GenSigTimeoutTime_IPC" SG_ 276 HybCmndEngTorqPrdtd 0;
BA_ "GenSigTimeoutTime_RFHM" SG_ 276 HybCmndEngTorqPrdtd 0;
BA_ "GenSigTimeoutTime_SGW" SG_ 276 HybCmndEngTorqPrdtd 0;
BA_ "GenSigTimeoutTime_TCM" SG_ 276 HybCmndEngTorqPrdtd 0;
BA_ "GenSigTimeoutTime_AGSM" SG_ 276 HybCmndEngTorqRespTyp 0;
BA_ "GenSigTimeoutTime_BCM" SG_ 276 HybCmndEngTorqRespTyp 0;
BA_ "GenSigTimeoutTime_BSM" SG_ 276 HybCmndEngTorqRespTyp 0;
BA_ "GenSigTimeoutTime_CADM" SG_ 276 HybCmndEngTorqRespTyp 0;
BA_ "GenSigTimeoutTime_DMSM" SG_ 276 HybCmndEngTorqRespTyp 0;
BA_ "GenSigTimeoutTime_DTCM" SG_ 276 HybCmndEngTorqRespTyp 0;
BA_ "GenSigTimeoutTime_EVCU2" SG_ 276 HybCmndEngTorqRespTyp 0;
BA_ "GenSigTimeoutTime_GNMM" SG_ 276 HybCmndEngTorqRespTyp 0;
BA_ "GenSigTimeoutTime_HCP" SG_ 276 HybCmndEngTorqRespTyp 0;
BA_ "GenSigTimeoutTime_IPC" SG_ 276 HybCmndEngTorqRespTyp 0;
BA_ "GenSigTimeoutTime_RFHM" SG_ 276 HybCmndEngTorqRespTyp 0;
BA_ "GenSigTimeoutTime_SGW" SG_ 276 HybCmndEngTorqRespTyp 0;
BA_ "GenSigTimeoutTime_TCM" SG_ 276 HybCmndEngTorqRespTyp 0;
BA_ "GenSigTimeoutTime_AGSM" SG_ 276 HybCrnkAbrted 0;
BA_ "GenSigTimeoutTime_BCM" SG_ 276 HybCrnkAbrted 0;
BA_ "GenSigTimeoutTime_BSM" SG_ 276 HybCrnkAbrted 0;
BA_ "GenSigTimeoutTime_CADM" SG_ 276 HybCrnkAbrted 0;
BA_ "GenSigTimeoutTime_DMSM" SG_ 276 HybCrnkAbrted 0;
BA_ "GenSigTimeoutTime_DTCM" SG_ 276 HybCrnkAbrted 0;
BA_ "GenSigTimeoutTime_EVCU2" SG_ 276 HybCrnkAbrted 0;
BA_ "GenSigTimeoutTime_GNMM" SG_ 276 HybCrnkAbrted 0;
BA_ "GenSigTimeoutTime_HCP" SG_ 276 HybCrnkAbrted 0;
BA_ "GenSigTimeoutTime_IPC" SG_ 276 HybCrnkAbrted 0;
BA_ "GenSigTimeoutTime_RFHM" SG_ 276 HybCrnkAbrted 0;
BA_ "GenSigTimeoutTime_SGW" SG_ 276 HybCrnkAbrted 0;
BA_ "GenSigTimeoutTime_TCM" SG_ 276 HybCrnkAbrted 0;
BA_ "GenSigTimeoutTime_AGSM" SG_ 276 HybDFCO_Req 0;
BA_ "GenSigTimeoutTime_BCM" SG_ 276 HybDFCO_Req 0;
BA_ "GenSigTimeoutTime_BSM" SG_ 276 HybDFCO_Req 0;
BA_ "GenSigTimeoutTime_CADM" SG_ 276 HybDFCO_Req 0;
BA_ "GenSigTimeoutTime_DMSM" SG_ 276 HybDFCO_Req 0;
BA_ "GenSigTimeoutTime_DTCM" SG_ 276 HybDFCO_Req 0;
BA_ "GenSigTimeoutTime_EVCU2" SG_ 276 HybDFCO_Req 0;
BA_ "GenSigTimeoutTime_GNMM" SG_ 276 HybDFCO_Req 0;
BA_ "GenSigTimeoutTime_HCP" SG_ 276 HybDFCO_Req 0;
BA_ "GenSigTimeoutTime_IPC" SG_ 276 HybDFCO_Req 0;
BA_ "GenSigTimeoutTime_RFHM" SG_ 276 HybDFCO_Req 0;
BA_ "GenSigTimeoutTime_SGW" SG_ 276 HybDFCO_Req 0;
BA_ "GenSigTimeoutTime_TCM" SG_ 276 HybDFCO_Req 0;
BA_ "GenSigTimeoutTime_AGSM" SG_ 276 HybEngCylDeactReq 0;
BA_ "GenSigTimeoutTime_BCM" SG_ 276 HybEngCylDeactReq 0;
BA_ "GenSigTimeoutTime_BSM" SG_ 276 HybEngCylDeactReq 0;
BA_ "GenSigTimeoutTime_CADM" SG_ 276 HybEngCylDeactReq 0;
BA_ "GenSigTimeoutTime_DMSM" SG_ 276 HybEngCylDeactReq 0;
BA_ "GenSigTimeoutTime_DTCM" SG_ 276 HybEngCylDeactReq 0;
BA_ "GenSigTimeoutTime_EVCU2" SG_ 276 HybEngCylDeactReq 0;
BA_ "GenSigTimeoutTime_GNMM" SG_ 276 HybEngCylDeactReq 0;
BA_ "GenSigTimeoutTime_HCP" SG_ 276 HybEngCylDeactReq 0;
BA_ "GenSigTimeoutTime_IPC" SG_ 276 HybEngCylDeactReq 0;
BA_ "GenSigTimeoutTime_RFHM" SG_ 276 HybEngCylDeactReq 0;
BA_ "GenSigTimeoutTime_SGW" SG_ 276 HybEngCylDeactReq 0;
BA_ "GenSigTimeoutTime_TCM" SG_ 276 HybEngCylDeactReq 0;
BA_ "GenSigTimeoutTime_AGSM" SG_ 276 HybFeedback_Engine 0;
BA_ "GenSigTimeoutTime_BCM" SG_ 276 HybFeedback_Engine 0;
BA_ "GenSigTimeoutTime_BSM" SG_ 276 HybFeedback_Engine 0;
BA_ "GenSigTimeoutTime_CADM" SG_ 276 HybFeedback_Engine 0;
BA_ "GenSigTimeoutTime_DMSM" SG_ 276 HybFeedback_Engine 0;
BA_ "GenSigTimeoutTime_DTCM" SG_ 276 HybFeedback_Engine 0;
BA_ "GenSigTimeoutTime_EVCU2" SG_ 276 HybFeedback_Engine 0;
BA_ "GenSigTimeoutTime_GNMM" SG_ 276 HybFeedback_Engine 0;
BA_ "GenSigTimeoutTime_HCP" SG_ 276 HybFeedback_Engine 0;
BA_ "GenSigTimeoutTime_IPC" SG_ 276 HybFeedback_Engine 0;
BA_ "GenSigTimeoutTime_RFHM" SG_ 276 HybFeedback_Engine 0;
BA_ "GenSigTimeoutTime_SGW" SG_ 276 HybFeedback_Engine 0;
BA_ "GenSigTimeoutTime_TCM" SG_ 276 HybFeedback_Engine 0;
BA_ "GenSigTimeoutTime_AGSM" SG_ 276 HybFstTrqRq_Trans 0;
BA_ "GenSigTimeoutTime_BCM" SG_ 276 HybFstTrqRq_Trans 0;
BA_ "GenSigTimeoutTime_BSM" SG_ 276 HybFstTrqRq_Trans 0;
BA_ "GenSigTimeoutTime_CADM" SG_ 276 HybFstTrqRq_Trans 0;
BA_ "GenSigTimeoutTime_DMSM" SG_ 276 HybFstTrqRq_Trans 0;
BA_ "GenSigTimeoutTime_DTCM" SG_ 276 HybFstTrqRq_Trans 0;
BA_ "GenSigTimeoutTime_EVCU2" SG_ 276 HybFstTrqRq_Trans 0;
BA_ "GenSigTimeoutTime_GNMM" SG_ 276 HybFstTrqRq_Trans 0;
BA_ "GenSigTimeoutTime_HCP" SG_ 276 HybFstTrqRq_Trans 0;
BA_ "GenSigTimeoutTime_IPC" SG_ 276 HybFstTrqRq_Trans 0;
BA_ "GenSigTimeoutTime_RFHM" SG_ 276 HybFstTrqRq_Trans 0;
BA_ "GenSigTimeoutTime_SGW" SG_ 276 HybFstTrqRq_Trans 0;
BA_ "GenSigTimeoutTime_TCM" SG_ 276 HybFstTrqRq_Trans 0;
BA_ "GenSigTimeoutTime_AGSM" SG_ 276 Hybrid_Remedial_Stop 0;
BA_ "GenSigTimeoutTime_BCM" SG_ 276 Hybrid_Remedial_Stop 0;
BA_ "GenSigTimeoutTime_BSM" SG_ 276 Hybrid_Remedial_Stop 0;
BA_ "GenSigTimeoutTime_CADM" SG_ 276 Hybrid_Remedial_Stop 0;
BA_ "GenSigTimeoutTime_DMSM" SG_ 276 Hybrid_Remedial_Stop 0;
BA_ "GenSigTimeoutTime_DTCM" SG_ 276 Hybrid_Remedial_Stop 0;
BA_ "GenSigTimeoutTime_EVCU2" SG_ 276 Hybrid_Remedial_Stop 0;
BA_ "GenSigTimeoutTime_GNMM" SG_ 276 Hybrid_Remedial_Stop 0;
BA_ "GenSigTimeoutTime_HCP" SG_ 276 Hybrid_Remedial_Stop 0;
BA_ "GenSigTimeoutTime_IPC" SG_ 276 Hybrid_Remedial_Stop 0;
BA_ "GenSigTimeoutTime_RFHM" SG_ 276 Hybrid_Remedial_Stop 0;
BA_ "GenSigTimeoutTime_SGW" SG_ 276 Hybrid_Remedial_Stop 0;
BA_ "GenSigTimeoutTime_TCM" SG_ 276 Hybrid_Remedial_Stop 0;
BA_ "GenSigTimeoutTime_AGSM" SG_ 276 HybTransSt 0;
BA_ "GenSigTimeoutTime_BCM" SG_ 276 HybTransSt 0;
BA_ "GenSigTimeoutTime_BSM" SG_ 276 HybTransSt 0;
BA_ "GenSigTimeoutTime_CADM" SG_ 276 HybTransSt 0;
BA_ "GenSigTimeoutTime_DMSM" SG_ 276 HybTransSt 0;
BA_ "GenSigTimeoutTime_DTCM" SG_ 276 HybTransSt 0;
BA_ "GenSigTimeoutTime_EVCU2" SG_ 276 HybTransSt 0;
BA_ "GenSigTimeoutTime_GNMM" SG_ 276 HybTransSt 0;
BA_ "GenSigTimeoutTime_HCP" SG_ 276 HybTransSt 0;
BA_ "GenSigTimeoutTime_IPC" SG_ 276 HybTransSt 0;
BA_ "GenSigTimeoutTime_RFHM" SG_ 276 HybTransSt 0;
BA_ "GenSigTimeoutTime_SGW" SG_ 276 HybTransSt 0;
BA_ "GenSigTimeoutTime_TCM" SG_ 276 HybTransSt 0;
BA_ "GenSigTimeoutTime_AGSM" SG_ 276 InputSpdRaw 0;
BA_ "GenSigTimeoutTime_BCM" SG_ 276 InputSpdRaw 0;
BA_ "GenSigTimeoutTime_BSM" SG_ 276 InputSpdRaw 0;
BA_ "GenSigTimeoutTime_CADM" SG_ 276 InputSpdRaw 0;
BA_ "GenSigTimeoutTime_DMSM" SG_ 276 InputSpdRaw 0;
BA_ "GenSigTimeoutTime_DTCM" SG_ 276 InputSpdRaw 0;
BA_ "GenSigTimeoutTime_EVCU2" SG_ 276 InputSpdRaw 0;
BA_ "GenSigTimeoutTime_GNMM" SG_ 276 InputSpdRaw 0;
BA_ "GenSigTimeoutTime_HCP" SG_ 276 InputSpdRaw 0;
BA_ "GenSigTimeoutTime_IPC" SG_ 276 InputSpdRaw 0;
BA_ "GenSigTimeoutTime_RFHM" SG_ 276 InputSpdRaw 0;
BA_ "GenSigTimeoutTime_SGW" SG_ 276 InputSpdRaw 0;
BA_ "GenSigTimeoutTime_TCM" SG_ 276 InputSpdRaw 0;
BA_ "GenSigTimeoutTime_AGSM" SG_ 276 LV_SystemFailure 0;
BA_ "GenSigTimeoutTime_BCM" SG_ 276 LV_SystemFailure 0;
BA_ "GenSigTimeoutTime_BSM" SG_ 276 LV_SystemFailure 0;
BA_ "GenSigTimeoutTime_CADM" SG_ 276 LV_SystemFailure 0;
BA_ "GenSigTimeoutTime_DMSM" SG_ 276 LV_SystemFailure 0;
BA_ "GenSigTimeoutTime_DTCM" SG_ 276 LV_SystemFailure 0;
BA_ "GenSigTimeoutTime_EVCU2" SG_ 276 LV_SystemFailure 0;
BA_ "GenSigTimeoutTime_GNMM" SG_ 276 LV_SystemFailure 0;
BA_ "GenSigTimeoutTime_HCP" SG_ 276 LV_SystemFailure 0;
BA_ "GenSigTimeoutTime_IPC" SG_ 276 LV_SystemFailure 0;
BA_ "GenSigTimeoutTime_RFHM" SG_ 276 LV_SystemFailure 0;
BA_ "GenSigTimeoutTime_SGW" SG_ 276 LV_SystemFailure 0;
BA_ "GenSigTimeoutTime_TCM" SG_ 276 LV_SystemFailure 0;
BA_ "SystemSignalLongSymbol" SG_ 276 MessageCounter_HYBRID_POWERTRAI "MessageCounter_HYBRID_POWERTRAIN1";
BA_ "GenSigTimeoutTime_AGSM" SG_ 276 MessageCounter_HYBRID_POWERTRAI 0;
BA_ "GenSigTimeoutTime_BCM" SG_ 276 MessageCounter_HYBRID_POWERTRAI 0;
BA_ "GenSigTimeoutTime_DMSM" SG_ 276 MessageCounter_HYBRID_POWERTRAI 0;
BA_ "GenSigTimeoutTime_DTCM" SG_ 276 MessageCounter_HYBRID_POWERTRAI 0;
BA_ "GenSigTimeoutTime_EVCU2" SG_ 276 MessageCounter_HYBRID_POWERTRAI 0;
BA_ "GenSigTimeoutTime_GNMM" SG_ 276 MessageCounter_HYBRID_POWERTRAI 0;
BA_ "GenSigTimeoutTime_HCP" SG_ 276 MessageCounter_HYBRID_POWERTRAI 0;
BA_ "GenSigTimeoutTime_RFHM" SG_ 276 MessageCounter_HYBRID_POWERTRAI 0;
BA_ "GenSigTimeoutTime_SGW" SG_ 276 MessageCounter_HYBRID_POWERTRAI 0;
BA_ "GenSigTimeoutTime_AGSM" SG_ 276 PropulsionSystemActive 0;
BA_ "GenSigTimeoutTime_BSM" SG_ 276 PropulsionSystemActive 0;
BA_ "GenSigTimeoutTime_CADM" SG_ 276 PropulsionSystemActive 0;
BA_ "GenSigTimeoutTime_DMSM" SG_ 276 PropulsionSystemActive 0;
BA_ "GenSigTimeoutTime_DTCM" SG_ 276 PropulsionSystemActive 0;
BA_ "GenSigTimeoutTime_EVCU2" SG_ 276 PropulsionSystemActive 0;
BA_ "GenSigTimeoutTime_GNMM" SG_ 276 PropulsionSystemActive 0;
BA_ "GenSigTimeoutTime_HCP" SG_ 276 PropulsionSystemActive 0;
BA_ "GenSigTimeoutTime_RFHM" SG_ 276 PropulsionSystemActive 0;
BA_ "GenSigTimeoutTime_TCM" SG_ 276 PropulsionSystemActive 0;
BA_ "GenSigStartValue" SG_ 276 RegenTarget 938;
BA_ "GenSigTimeoutTime_AGSM" SG_ 276 RegenTarget 0;
BA_ "GenSigTimeoutTime_BCM" SG_ 276 RegenTarget 0;
BA_ "GenSigTimeoutTime_BSM" SG_ 276 RegenTarget 0;
BA_ "GenSigTimeoutTime_CADM" SG_ 276 RegenTarget 0;
BA_ "GenSigTimeoutTime_DMSM" SG_ 276 RegenTarget 0;
BA_ "GenSigTimeoutTime_DTCM" SG_ 276 RegenTarget 0;
BA_ "GenSigTimeoutTime_EVCU2" SG_ 276 RegenTarget 0;
BA_ "GenSigTimeoutTime_GNMM" SG_ 276 RegenTarget 0;
BA_ "GenSigTimeoutTime_HCP" SG_ 276 RegenTarget 0;
BA_ "GenSigTimeoutTime_IPC" SG_ 276 RegenTarget 0;
BA_ "GenSigTimeoutTime_RFHM" SG_ 276 RegenTarget 0;
BA_ "GenSigTimeoutTime_SGW" SG_ 276 RegenTarget 0;
BA_ "GenSigTimeoutTime_TCM" SG_ 276 RegenTarget 0;
BA_ "GenSigTimeoutTime_AGSM" SG_ 276 RollingIdleSpeedTarget 0;
BA_ "GenSigTimeoutTime_BCM" SG_ 276 RollingIdleSpeedTarget 0;
BA_ "GenSigTimeoutTime_BSM" SG_ 276 RollingIdleSpeedTarget 0;
BA_ "GenSigTimeoutTime_CADM" SG_ 276 RollingIdleSpeedTarget 0;
BA_ "GenSigTimeoutTime_DMSM" SG_ 276 RollingIdleSpeedTarget 0;
BA_ "GenSigTimeoutTime_DTCM" SG_ 276 RollingIdleSpeedTarget 0;
BA_ "GenSigTimeoutTime_EVCU2" SG_ 276 RollingIdleSpeedTarget 0;
BA_ "GenSigTimeoutTime_GNMM" SG_ 276 RollingIdleSpeedTarget 0;
BA_ "GenSigTimeoutTime_HCP" SG_ 276 RollingIdleSpeedTarget 0;
BA_ "GenSigTimeoutTime_IPC" SG_ 276 RollingIdleSpeedTarget 0;
BA_ "GenSigTimeoutTime_RFHM" SG_ 276 RollingIdleSpeedTarget 0;
BA_ "GenSigTimeoutTime_SGW" SG_ 276 RollingIdleSpeedTarget 0;
BA_ "GenSigTimeoutTime_TCM" SG_ 276 RollingIdleSpeedTarget 0;
BA_ "GenSigTimeoutTime_AGSM" SG_ 276 TransInpSpdPrfl 0;
BA_ "GenSigTimeoutTime_BCM" SG_ 276 TransInpSpdPrfl 0;
BA_ "GenSigTimeoutTime_BSM" SG_ 276 TransInpSpdPrfl 0;
BA_ "GenSigTimeoutTime_CADM" SG_ 276 TransInpSpdPrfl 0;
BA_ "GenSigTimeoutTime_DMSM" SG_ 276 TransInpSpdPrfl 0;
BA_ "GenSigTimeoutTime_DTCM" SG_ 276 TransInpSpdPrfl 0;
BA_ "GenSigTimeoutTime_EVCU2" SG_ 276 TransInpSpdPrfl 0;
BA_ "GenSigTimeoutTime_GNMM" SG_ 276 TransInpSpdPrfl 0;
BA_ "GenSigTimeoutTime_HCP" SG_ 276 TransInpSpdPrfl 0;
BA_ "GenSigTimeoutTime_IPC" SG_ 276 TransInpSpdPrfl 0;
BA_ "GenSigTimeoutTime_RFHM" SG_ 276 TransInpSpdPrfl 0;
BA_ "GenSigTimeoutTime_SGW" SG_ 276 TransInpSpdPrfl 0;
BA_ "GenSigTimeoutTime_TCM" SG_ 276 TransInpSpdPrfl 0;
BA_ "GenSigTimeoutTime_AGSM" SG_ 269 BSGActualTorque 0;
BA_ "GenSigTimeoutTime_BSM" SG_ 269 BSGActualTorque 0;
BA_ "GenSigTimeoutTime_CADM" SG_ 269 BSGActualTorque 0;
BA_ "GenSigTimeoutTime_DMSM" SG_ 269 BSGActualTorque 0;
BA_ "GenSigTimeoutTime_DTCM" SG_ 269 BSGActualTorque 0;
BA_ "GenSigTimeoutTime_EVCU2" SG_ 269 BSGActualTorque 0;
BA_ "GenSigTimeoutTime_GNMM" SG_ 269 BSGActualTorque 0;
BA_ "GenSigTimeoutTime_HCP" SG_ 269 BSGActualTorque 0;
BA_ "GenSigTimeoutTime_IPC" SG_ 269 BSGActualTorque 0;
BA_ "GenSigTimeoutTime_RFHM" SG_ 269 BSGActualTorque 0;
BA_ "GenSigTimeoutTime_SGW" SG_ 269 BSGActualTorque 0;
BA_ "GenSigTimeoutTime_TCM" SG_ 269 BSGActualTorque 0;
BA_ "GenSigTimeoutTime_AGSM" SG_ 269 BSGChrgIdleSpeedTarget 0;
BA_ "GenSigTimeoutTime_BCM" SG_ 269 BSGChrgIdleSpeedTarget 0;
BA_ "GenSigTimeoutTime_BSM" SG_ 269 BSGChrgIdleSpeedTarget 0;
BA_ "GenSigTimeoutTime_CADM" SG_ 269 BSGChrgIdleSpeedTarget 0;
BA_ "GenSigTimeoutTime_DMSM" SG_ 269 BSGChrgIdleSpeedTarget 0;
BA_ "GenSigTimeoutTime_DTCM" SG_ 269 BSGChrgIdleSpeedTarget 0;
BA_ "GenSigTimeoutTime_EVCU2" SG_ 269 BSGChrgIdleSpeedTarget 0;
BA_ "GenSigTimeoutTime_GNMM" SG_ 269 BSGChrgIdleSpeedTarget 0;
BA_ "GenSigTimeoutTime_HCP" SG_ 269 BSGChrgIdleSpeedTarget 0;
BA_ "GenSigTimeoutTime_IPC" SG_ 269 BSGChrgIdleSpeedTarget 0;
BA_ "GenSigTimeoutTime_RFHM" SG_ 269 BSGChrgIdleSpeedTarget 0;
BA_ "GenSigTimeoutTime_SGW" SG_ 269 BSGChrgIdleSpeedTarget 0;
BA_ "GenSigTimeoutTime_TCM" SG_ 269 BSGChrgIdleSpeedTarget 0;
BA_ "GenSigTimeoutTime_AGSM" SG_ 269 CODE_CLR_HCP 0;
BA_ "GenSigTimeoutTime_BCM" SG_ 269 CODE_CLR_HCP 0;
BA_ "GenSigTimeoutTime_BSM" SG_ 269 CODE_CLR_HCP 0;
BA_ "GenSigTimeoutTime_CADM" SG_ 269 CODE_CLR_HCP 0;
BA_ "GenSigTimeoutTime_DMSM" SG_ 269 CODE_CLR_HCP 0;
BA_ "GenSigTimeoutTime_DTCM" SG_ 269 CODE_CLR_HCP 0;
BA_ "GenSigTimeoutTime_EVCU2" SG_ 269 CODE_CLR_HCP 0;
BA_ "GenSigTimeoutTime_GNMM" SG_ 269 CODE_CLR_HCP 0;
BA_ "GenSigTimeoutTime_HCP" SG_ 269 CODE_CLR_HCP 0;
BA_ "GenSigTimeoutTime_IPC" SG_ 269 CODE_CLR_HCP 0;
BA_ "GenSigTimeoutTime_RFHM" SG_ 269 CODE_CLR_HCP 0;
BA_ "GenSigTimeoutTime_SGW" SG_ 269 CODE_CLR_HCP 0;
BA_ "GenSigTimeoutTime_TCM" SG_ 269 CODE_CLR_HCP 0;
BA_ "GenSigTimeoutTime_AGSM" SG_ 269 CRC_HYBRID_POWERTRAIN2 0;
BA_ "GenSigTimeoutTime_BCM" SG_ 269 CRC_HYBRID_POWERTRAIN2 0;
BA_ "GenSigTimeoutTime_CADM" SG_ 269 CRC_HYBRID_POWERTRAIN2 0;
BA_ "GenSigTimeoutTime_DMSM" SG_ 269 CRC_HYBRID_POWERTRAIN2 0;
BA_ "GenSigTimeoutTime_DTCM" SG_ 269 CRC_HYBRID_POWERTRAIN2 0;
BA_ "GenSigTimeoutTime_EVCU2" SG_ 269 CRC_HYBRID_POWERTRAIN2 0;
BA_ "GenSigTimeoutTime_GNMM" SG_ 269 CRC_HYBRID_POWERTRAIN2 0;
BA_ "GenSigTimeoutTime_HCP" SG_ 269 CRC_HYBRID_POWERTRAIN2 0;
BA_ "GenSigTimeoutTime_IPC" SG_ 269 CRC_HYBRID_POWERTRAIN2 0;
BA_ "GenSigTimeoutTime_RFHM" SG_ 269 CRC_HYBRID_POWERTRAIN2 0;
BA_ "GenSigTimeoutTime_SGW" SG_ 269 CRC_HYBRID_POWERTRAIN2 0;
BA_ "GenSigStartValue" SG_ 269 HybridEngineMaxTorqAllowed 938;
BA_ "GenSigTimeoutTime_AGSM" SG_ 269 HybridEngineMaxTorqAllowed 0;
BA_ "GenSigTimeoutTime_BCM" SG_ 269 HybridEngineMaxTorqAllowed 0;
BA_ "GenSigTimeoutTime_BSM" SG_ 269 HybridEngineMaxTorqAllowed 0;
BA_ "GenSigTimeoutTime_CADM" SG_ 269 HybridEngineMaxTorqAllowed 0;
BA_ "GenSigTimeoutTime_DMSM" SG_ 269 HybridEngineMaxTorqAllowed 0;
BA_ "GenSigTimeoutTime_DTCM" SG_ 269 HybridEngineMaxTorqAllowed 0;
BA_ "GenSigTimeoutTime_EVCU2" SG_ 269 HybridEngineMaxTorqAllowed 0;
BA_ "GenSigTimeoutTime_GNMM" SG_ 269 HybridEngineMaxTorqAllowed 0;
BA_ "GenSigTimeoutTime_HCP" SG_ 269 HybridEngineMaxTorqAllowed 0;
BA_ "GenSigTimeoutTime_IPC" SG_ 269 HybridEngineMaxTorqAllowed 0;
BA_ "GenSigTimeoutTime_RFHM" SG_ 269 HybridEngineMaxTorqAllowed 0;
BA_ "GenSigTimeoutTime_SGW" SG_ 269 HybridEngineMaxTorqAllowed 0;
BA_ "GenSigTimeoutTime_TCM" SG_ 269 HybridEngineMaxTorqAllowed 0;
BA_ "GenSigTimeoutTime_AGSM" SG_ 269 IdleSpeedActiveSts 0;
BA_ "GenSigTimeoutTime_BCM" SG_ 269 IdleSpeedActiveSts 0;
BA_ "GenSigTimeoutTime_BSM" SG_ 269 IdleSpeedActiveSts 0;
BA_ "GenSigTimeoutTime_CADM" SG_ 269 IdleSpeedActiveSts 0;
BA_ "GenSigTimeoutTime_DMSM" SG_ 269 IdleSpeedActiveSts 0;
BA_ "GenSigTimeoutTime_DTCM" SG_ 269 IdleSpeedActiveSts 0;
BA_ "GenSigTimeoutTime_EVCU2" SG_ 269 IdleSpeedActiveSts 0;
BA_ "GenSigTimeoutTime_GNMM" SG_ 269 IdleSpeedActiveSts 0;
BA_ "GenSigTimeoutTime_HCP" SG_ 269 IdleSpeedActiveSts 0;
BA_ "GenSigTimeoutTime_IPC" SG_ 269 IdleSpeedActiveSts 0;
BA_ "GenSigTimeoutTime_RFHM" SG_ 269 IdleSpeedActiveSts 0;
BA_ "GenSigTimeoutTime_SGW" SG_ 269 IdleSpeedActiveSts 0;
BA_ "GenSigTimeoutTime_TCM" SG_ 269 IdleSpeedActiveSts 0;
BA_ "SystemSignalLongSymbol" SG_ 269 MessageCounter_HYBRID_POWERTRAI "MessageCounter_HYBRID_POWERTRAIN2";
BA_ "GenSigTimeoutTime_AGSM" SG_ 269 MessageCounter_HYBRID_POWERTRAI 0;
BA_ "GenSigTimeoutTime_BCM" SG_ 269 MessageCounter_HYBRID_POWERTRAI 0;
BA_ "GenSigTimeoutTime_CADM" SG_ 269 MessageCounter_HYBRID_POWERTRAI 0;
BA_ "GenSigTimeoutTime_DMSM" SG_ 269 MessageCounter_HYBRID_POWERTRAI 0;
BA_ "GenSigTimeoutTime_DTCM" SG_ 269 MessageCounter_HYBRID_POWERTRAI 0;
BA_ "GenSigTimeoutTime_EVCU2" SG_ 269 MessageCounter_HYBRID_POWERTRAI 0;
BA_ "GenSigTimeoutTime_GNMM" SG_ 269 MessageCounter_HYBRID_POWERTRAI 0;
BA_ "GenSigTimeoutTime_HCP" SG_ 269 MessageCounter_HYBRID_POWERTRAI 0;
BA_ "GenSigTimeoutTime_IPC" SG_ 269 MessageCounter_HYBRID_POWERTRAI 0;
BA_ "GenSigTimeoutTime_RFHM" SG_ 269 MessageCounter_HYBRID_POWERTRAI 0;
BA_ "GenSigTimeoutTime_SGW" SG_ 269 MessageCounter_HYBRID_POWERTRAI 0;
BA_ "GenSigTimeoutTime_AGSM" SG_ 269 REPRGD_PFC_CLR_HCP 0;
BA_ "GenSigTimeoutTime_BCM" SG_ 269 REPRGD_PFC_CLR_HCP 0;
BA_ "GenSigTimeoutTime_BSM" SG_ 269 REPRGD_PFC_CLR_HCP 0;
BA_ "GenSigTimeoutTime_CADM" SG_ 269 REPRGD_PFC_CLR_HCP 0;
BA_ "GenSigTimeoutTime_DMSM" SG_ 269 REPRGD_PFC_CLR_HCP 0;
BA_ "GenSigTimeoutTime_DTCM" SG_ 269 REPRGD_PFC_CLR_HCP 0;
BA_ "GenSigTimeoutTime_EVCU2" SG_ 269 REPRGD_PFC_CLR_HCP 0;
BA_ "GenSigTimeoutTime_GNMM" SG_ 269 REPRGD_PFC_CLR_HCP 0;
BA_ "GenSigTimeoutTime_HCP" SG_ 269 REPRGD_PFC_CLR_HCP 0;
BA_ "GenSigTimeoutTime_IPC" SG_ 269 REPRGD_PFC_CLR_HCP 0;
BA_ "GenSigTimeoutTime_RFHM" SG_ 269 REPRGD_PFC_CLR_HCP 0;
BA_ "GenSigTimeoutTime_SGW" SG_ 269 REPRGD_PFC_CLR_HCP 0;
BA_ "GenSigTimeoutTime_TCM" SG_ 269 REPRGD_PFC_CLR_HCP 0;
BA_ "GenSigTimeoutTime_AGSM" SG_ 269 ReqTorqueOverLayActive 0;
BA_ "GenSigTimeoutTime_BSM" SG_ 269 ReqTorqueOverLayActive 0;
BA_ "GenSigTimeoutTime_CADM" SG_ 269 ReqTorqueOverLayActive 0;
BA_ "GenSigTimeoutTime_DMSM" SG_ 269 ReqTorqueOverLayActive 0;
BA_ "GenSigTimeoutTime_DTCM" SG_ 269 ReqTorqueOverLayActive 0;
BA_ "GenSigTimeoutTime_ECM" SG_ 269 ReqTorqueOverLayActive 0;
BA_ "GenSigTimeoutTime_EVCU2" SG_ 269 ReqTorqueOverLayActive 0;
BA_ "GenSigTimeoutTime_GNMM" SG_ 269 ReqTorqueOverLayActive 0;
BA_ "GenSigTimeoutTime_HCP" SG_ 269 ReqTorqueOverLayActive 0;
BA_ "GenSigTimeoutTime_IPC" SG_ 269 ReqTorqueOverLayActive 0;
BA_ "GenSigTimeoutTime_RFHM" SG_ 269 ReqTorqueOverLayActive 0;
BA_ "GenSigTimeoutTime_SGW" SG_ 269 ReqTorqueOverLayActive 0;
BA_ "GenSigTimeoutTime_AGSM" SG_ 269 TCC_Slip_Rgn 0;
BA_ "GenSigTimeoutTime_BCM" SG_ 269 TCC_Slip_Rgn 0;
BA_ "GenSigTimeoutTime_BSM" SG_ 269 TCC_Slip_Rgn 0;
BA_ "GenSigTimeoutTime_CADM" SG_ 269 TCC_Slip_Rgn 0;
BA_ "GenSigTimeoutTime_DMSM" SG_ 269 TCC_Slip_Rgn 0;
BA_ "GenSigTimeoutTime_DTCM" SG_ 269 TCC_Slip_Rgn 0;
BA_ "GenSigTimeoutTime_ECM" SG_ 269 TCC_Slip_Rgn 0;
BA_ "GenSigTimeoutTime_EVCU2" SG_ 269 TCC_Slip_Rgn 0;
BA_ "GenSigTimeoutTime_GNMM" SG_ 269 TCC_Slip_Rgn 0;
BA_ "GenSigTimeoutTime_HCP" SG_ 269 TCC_Slip_Rgn 0;
BA_ "GenSigTimeoutTime_IPC" SG_ 269 TCC_Slip_Rgn 0;
BA_ "GenSigTimeoutTime_RFHM" SG_ 269 TCC_Slip_Rgn 0;
BA_ "GenSigTimeoutTime_SGW" SG_ 269 TCC_Slip_Rgn 0;
BA_ "GenSigTimeoutTime_AGSM" SG_ 1033 BattPowerUse_Display 0;
BA_ "GenSigTimeoutTime_BCM" SG_ 1033 BattPowerUse_Display 0;
BA_ "GenSigTimeoutTime_BSM" SG_ 1033 BattPowerUse_Display 0;
BA_ "GenSigTimeoutTime_CADM" SG_ 1033 BattPowerUse_Display 0;
BA_ "GenSigTimeoutTime_DMSM" SG_ 1033 BattPowerUse_Display 0;
BA_ "GenSigTimeoutTime_DTCM" SG_ 1033 BattPowerUse_Display 0;
BA_ "GenSigTimeoutTime_ECM" SG_ 1033 BattPowerUse_Display 0;
BA_ "GenSigTimeoutTime_EVCU2" SG_ 1033 BattPowerUse_Display 0;
BA_ "GenSigTimeoutTime_GNMM" SG_ 1033 BattPowerUse_Display 0;
BA_ "GenSigTimeoutTime_HCP" SG_ 1033 BattPowerUse_Display 0;
BA_ "GenSigTimeoutTime_RFHM" SG_ 1033 BattPowerUse_Display 0;
BA_ "GenSigTimeoutTime_TCM" SG_ 1033 BattPowerUse_Display 0;
BA_ "GenSigTimeoutTime_AGSM" SG_ 1033 BattPowerUse_DisplayV 0;
BA_ "GenSigTimeoutTime_BCM" SG_ 1033 BattPowerUse_DisplayV 0;
BA_ "GenSigTimeoutTime_BSM" SG_ 1033 BattPowerUse_DisplayV 0;
BA_ "GenSigTimeoutTime_CADM" SG_ 1033 BattPowerUse_DisplayV 0;
BA_ "GenSigTimeoutTime_DMSM" SG_ 1033 BattPowerUse_DisplayV 0;
BA_ "GenSigTimeoutTime_DTCM" SG_ 1033 BattPowerUse_DisplayV 0;
BA_ "GenSigTimeoutTime_ECM" SG_ 1033 BattPowerUse_DisplayV 0;
BA_ "GenSigTimeoutTime_EVCU2" SG_ 1033 BattPowerUse_DisplayV 0;
BA_ "GenSigTimeoutTime_GNMM" SG_ 1033 BattPowerUse_DisplayV 0;
BA_ "GenSigTimeoutTime_HCP" SG_ 1033 BattPowerUse_DisplayV 0;
BA_ "GenSigTimeoutTime_RFHM" SG_ 1033 BattPowerUse_DisplayV 0;
BA_ "GenSigTimeoutTime_TCM" SG_ 1033 BattPowerUse_DisplayV 0;
BA_ "GenSigTimeoutTime_AGSM" SG_ 1033 CRC_HYBRID_POWERTRAIN5 0;
BA_ "GenSigTimeoutTime_BCM" SG_ 1033 CRC_HYBRID_POWERTRAIN5 0;
BA_ "GenSigTimeoutTime_BSM" SG_ 1033 CRC_HYBRID_POWERTRAIN5 0;
BA_ "GenSigTimeoutTime_CADM" SG_ 1033 CRC_HYBRID_POWERTRAIN5 0;
BA_ "GenSigTimeoutTime_DMSM" SG_ 1033 CRC_HYBRID_POWERTRAIN5 0;
BA_ "GenSigTimeoutTime_DTCM" SG_ 1033 CRC_HYBRID_POWERTRAIN5 0;
BA_ "GenSigTimeoutTime_EVCU2" SG_ 1033 CRC_HYBRID_POWERTRAIN5 0;
BA_ "GenSigTimeoutTime_GNMM" SG_ 1033 CRC_HYBRID_POWERTRAIN5 0;
BA_ "GenSigTimeoutTime_HCP" SG_ 1033 CRC_HYBRID_POWERTRAIN5 0;
BA_ "GenSigTimeoutTime_IPC" SG_ 1033 CRC_HYBRID_POWERTRAIN5 0;
BA_ "GenSigTimeoutTime_RFHM" SG_ 1033 CRC_HYBRID_POWERTRAIN5 0;
BA_ "GenSigTimeoutTime_SGW" SG_ 1033 CRC_HYBRID_POWERTRAIN5 0;
BA_ "GenSigTimeoutTime_AGSM" SG_ 1033 ElectricTrqMult4Pedal 0;
BA_ "GenSigTimeoutTime_BCM" SG_ 1033 ElectricTrqMult4Pedal 0;
BA_ "GenSigTimeoutTime_BSM" SG_ 1033 ElectricTrqMult4Pedal 0;
BA_ "GenSigTimeoutTime_CADM" SG_ 1033 ElectricTrqMult4Pedal 0;
BA_ "GenSigTimeoutTime_DMSM" SG_ 1033 ElectricTrqMult4Pedal 0;
BA_ "GenSigTimeoutTime_DTCM" SG_ 1033 ElectricTrqMult4Pedal 0;
BA_ "GenSigTimeoutTime_EVCU2" SG_ 1033 ElectricTrqMult4Pedal 0;
BA_ "GenSigTimeoutTime_GNMM" SG_ 1033 ElectricTrqMult4Pedal 0;
BA_ "GenSigTimeoutTime_HCP" SG_ 1033 ElectricTrqMult4Pedal 0;
BA_ "GenSigTimeoutTime_IPC" SG_ 1033 ElectricTrqMult4Pedal 0;
BA_ "GenSigTimeoutTime_RFHM" SG_ 1033 ElectricTrqMult4Pedal 0;
BA_ "GenSigTimeoutTime_SGW" SG_ 1033 ElectricTrqMult4Pedal 0;
BA_ "GenSigTimeoutTime_TCM" SG_ 1033 ElectricTrqMult4Pedal 0;
BA_ "GenSigTimeoutTime_AGSM" SG_ 1033 HCP_Stop_Start_Fault 0;
BA_ "GenSigTimeoutTime_BCM" SG_ 1033 HCP_Stop_Start_Fault 0;
BA_ "GenSigTimeoutTime_BSM" SG_ 1033 HCP_Stop_Start_Fault 0;
BA_ "GenSigTimeoutTime_CADM" SG_ 1033 HCP_Stop_Start_Fault 0;
BA_ "GenSigTimeoutTime_DMSM" SG_ 1033 HCP_Stop_Start_Fault 0;
BA_ "GenSigTimeoutTime_DTCM" SG_ 1033 HCP_Stop_Start_Fault 0;
BA_ "GenSigTimeoutTime_EVCU2" SG_ 1033 HCP_Stop_Start_Fault 0;
BA_ "GenSigTimeoutTime_GNMM" SG_ 1033 HCP_Stop_Start_Fault 0;
BA_ "GenSigTimeoutTime_HCP" SG_ 1033 HCP_Stop_Start_Fault 0;
BA_ "GenSigTimeoutTime_IPC" SG_ 1033 HCP_Stop_Start_Fault 0;
BA_ "GenSigTimeoutTime_RFHM" SG_ 1033 HCP_Stop_Start_Fault 0;
BA_ "GenSigTimeoutTime_SGW" SG_ 1033 HCP_Stop_Start_Fault 0;
BA_ "GenSigTimeoutTime_TCM" SG_ 1033 HCP_Stop_Start_Fault 0;
BA_ "GenSigStartValue" SG_ 1033 HCPMaxEngRPM 255;
BA_ "GenSigTimeoutTime_AGSM" SG_ 1033 HCPMaxEngRPM 0;
BA_ "GenSigTimeoutTime_BCM" SG_ 1033 HCPMaxEngRPM 0;
BA_ "GenSigTimeoutTime_BSM" SG_ 1033 HCPMaxEngRPM 0;
BA_ "GenSigTimeoutTime_CADM" SG_ 1033 HCPMaxEngRPM 0;
BA_ "GenSigTimeoutTime_DMSM" SG_ 1033 HCPMaxEngRPM 0;
BA_ "GenSigTimeoutTime_DTCM" SG_ 1033 HCPMaxEngRPM 0;
BA_ "GenSigTimeoutTime_EVCU2" SG_ 1033 HCPMaxEngRPM 0;
BA_ "GenSigTimeoutTime_GNMM" SG_ 1033 HCPMaxEngRPM 0;
BA_ "GenSigTimeoutTime_HCP" SG_ 1033 HCPMaxEngRPM 0;
BA_ "GenSigTimeoutTime_IPC" SG_ 1033 HCPMaxEngRPM 0;
BA_ "GenSigTimeoutTime_RFHM" SG_ 1033 HCPMaxEngRPM 0;
BA_ "GenSigTimeoutTime_SGW" SG_ 1033 HCPMaxEngRPM 0;
BA_ "GenSigTimeoutTime_TCM" SG_ 1033 HCPMaxEngRPM 0;
BA_ "GenSigTimeoutTime_AGSM" SG_ 1033 HEV_HybPwrtrnRdcdPerfCmnd 0;
BA_ "GenSigTimeoutTime_BCM" SG_ 1033 HEV_HybPwrtrnRdcdPerfCmnd 0;
BA_ "GenSigTimeoutTime_BSM" SG_ 1033 HEV_HybPwrtrnRdcdPerfCmnd 0;
BA_ "GenSigTimeoutTime_CADM" SG_ 1033 HEV_HybPwrtrnRdcdPerfCmnd 0;
BA_ "GenSigTimeoutTime_DMSM" SG_ 1033 HEV_HybPwrtrnRdcdPerfCmnd 0;
BA_ "GenSigTimeoutTime_DTCM" SG_ 1033 HEV_HybPwrtrnRdcdPerfCmnd 0;
BA_ "GenSigTimeoutTime_EVCU2" SG_ 1033 HEV_HybPwrtrnRdcdPerfCmnd 0;
BA_ "GenSigTimeoutTime_GNMM" SG_ 1033 HEV_HybPwrtrnRdcdPerfCmnd 0;
BA_ "GenSigTimeoutTime_HCP" SG_ 1033 HEV_HybPwrtrnRdcdPerfCmnd 0;
BA_ "GenSigTimeoutTime_IPC" SG_ 1033 HEV_HybPwrtrnRdcdPerfCmnd 0;
BA_ "GenSigTimeoutTime_RFHM" SG_ 1033 HEV_HybPwrtrnRdcdPerfCmnd 0;
BA_ "GenSigTimeoutTime_SGW" SG_ 1033 HEV_HybPwrtrnRdcdPerfCmnd 0;
BA_ "GenSigTimeoutTime_TCM" SG_ 1033 HEV_HybPwrtrnRdcdPerfCmnd 0;
BA_ "GenSigTimeoutTime_AGSM" SG_ 1033 Hybrid_AGS2Position 0;
BA_ "GenSigTimeoutTime_BCM" SG_ 1033 Hybrid_AGS2Position 0;
BA_ "GenSigTimeoutTime_BSM" SG_ 1033 Hybrid_AGS2Position 0;
BA_ "GenSigTimeoutTime_CADM" SG_ 1033 Hybrid_AGS2Position 0;
BA_ "GenSigTimeoutTime_DMSM" SG_ 1033 Hybrid_AGS2Position 0;
BA_ "GenSigTimeoutTime_DTCM" SG_ 1033 Hybrid_AGS2Position 0;
BA_ "GenSigTimeoutTime_EVCU2" SG_ 1033 Hybrid_AGS2Position 0;
BA_ "GenSigTimeoutTime_GNMM" SG_ 1033 Hybrid_AGS2Position 0;
BA_ "GenSigTimeoutTime_HCP" SG_ 1033 Hybrid_AGS2Position 0;
BA_ "GenSigTimeoutTime_IPC" SG_ 1033 Hybrid_AGS2Position 0;
BA_ "GenSigTimeoutTime_RFHM" SG_ 1033 Hybrid_AGS2Position 0;
BA_ "GenSigTimeoutTime_SGW" SG_ 1033 Hybrid_AGS2Position 0;
BA_ "GenSigTimeoutTime_TCM" SG_ 1033 Hybrid_AGS2Position 0;
BA_ "GenSigTimeoutTime_AGSM" SG_ 1033 Hybrid_AGSPosition 0;
BA_ "GenSigTimeoutTime_BCM" SG_ 1033 Hybrid_AGSPosition 0;
BA_ "GenSigTimeoutTime_BSM" SG_ 1033 Hybrid_AGSPosition 0;
BA_ "GenSigTimeoutTime_CADM" SG_ 1033 Hybrid_AGSPosition 0;
BA_ "GenSigTimeoutTime_DMSM" SG_ 1033 Hybrid_AGSPosition 0;
BA_ "GenSigTimeoutTime_DTCM" SG_ 1033 Hybrid_AGSPosition 0;
BA_ "GenSigTimeoutTime_EVCU2" SG_ 1033 Hybrid_AGSPosition 0;
BA_ "GenSigTimeoutTime_GNMM" SG_ 1033 Hybrid_AGSPosition 0;
BA_ "GenSigTimeoutTime_HCP" SG_ 1033 Hybrid_AGSPosition 0;
BA_ "GenSigTimeoutTime_IPC" SG_ 1033 Hybrid_AGSPosition 0;
BA_ "GenSigTimeoutTime_RFHM" SG_ 1033 Hybrid_AGSPosition 0;
BA_ "GenSigTimeoutTime_SGW" SG_ 1033 Hybrid_AGSPosition 0;
BA_ "GenSigTimeoutTime_TCM" SG_ 1033 Hybrid_AGSPosition 0;
BA_ "GenSigTimeoutTime_AGSM" SG_ 1033 Hybrid_EVT_ModeSts 0;
BA_ "GenSigTimeoutTime_BSM" SG_ 1033 Hybrid_EVT_ModeSts 0;
BA_ "GenSigTimeoutTime_CADM" SG_ 1033 Hybrid_EVT_ModeSts 0;
BA_ "GenSigTimeoutTime_DMSM" SG_ 1033 Hybrid_EVT_ModeSts 0;
BA_ "GenSigTimeoutTime_DTCM" SG_ 1033 Hybrid_EVT_ModeSts 0;
BA_ "GenSigTimeoutTime_ECM" SG_ 1033 Hybrid_EVT_ModeSts 0;
BA_ "GenSigTimeoutTime_EVCU2" SG_ 1033 Hybrid_EVT_ModeSts 0;
BA_ "GenSigTimeoutTime_GNMM" SG_ 1033 Hybrid_EVT_ModeSts 0;
BA_ "GenSigTimeoutTime_HCP" SG_ 1033 Hybrid_EVT_ModeSts 0;
BA_ "GenSigTimeoutTime_IPC" SG_ 1033 Hybrid_EVT_ModeSts 0;
BA_ "GenSigTimeoutTime_RFHM" SG_ 1033 Hybrid_EVT_ModeSts 0;
BA_ "GenSigTimeoutTime_TCM" SG_ 1033 Hybrid_EVT_ModeSts 0;
BA_ "GenSigTimeoutTime_AGSM" SG_ 1033 HybridEmissionsMalfunction 0;
BA_ "GenSigTimeoutTime_BCM" SG_ 1033 HybridEmissionsMalfunction 0;
BA_ "GenSigTimeoutTime_BSM" SG_ 1033 HybridEmissionsMalfunction 0;
BA_ "GenSigTimeoutTime_CADM" SG_ 1033 HybridEmissionsMalfunction 0;
BA_ "GenSigTimeoutTime_DMSM" SG_ 1033 HybridEmissionsMalfunction 0;
BA_ "GenSigTimeoutTime_DTCM" SG_ 1033 HybridEmissionsMalfunction 0;
BA_ "GenSigTimeoutTime_ECM" SG_ 1033 HybridEmissionsMalfunction 0;
BA_ "GenSigTimeoutTime_EVCU2" SG_ 1033 HybridEmissionsMalfunction 0;
BA_ "GenSigTimeoutTime_GNMM" SG_ 1033 HybridEmissionsMalfunction 0;
BA_ "GenSigTimeoutTime_HCP" SG_ 1033 HybridEmissionsMalfunction 0;
BA_ "GenSigTimeoutTime_IPC" SG_ 1033 HybridEmissionsMalfunction 0;
BA_ "GenSigTimeoutTime_RFHM" SG_ 1033 HybridEmissionsMalfunction 0;
BA_ "GenSigTimeoutTime_SGW" SG_ 1033 HybridEmissionsMalfunction 0;
BA_ "GenSigTimeoutTime_TCM" SG_ 1033 HybridEmissionsMalfunction 0;
BA_ "GenSigStartValue" SG_ 1033 IdleCLoopTrq 511;
BA_ "GenSigTimeoutTime_AGSM" SG_ 1033 IdleCLoopTrq 0;
BA_ "GenSigTimeoutTime_BCM" SG_ 1033 IdleCLoopTrq 0;
BA_ "GenSigTimeoutTime_BSM" SG_ 1033 IdleCLoopTrq 0;
BA_ "GenSigTimeoutTime_CADM" SG_ 1033 IdleCLoopTrq 0;
BA_ "GenSigTimeoutTime_DMSM" SG_ 1033 IdleCLoopTrq 0;
BA_ "GenSigTimeoutTime_DTCM" SG_ 1033 IdleCLoopTrq 0;
BA_ "GenSigTimeoutTime_EVCU2" SG_ 1033 IdleCLoopTrq 0;
BA_ "GenSigTimeoutTime_GNMM" SG_ 1033 IdleCLoopTrq 0;
BA_ "GenSigTimeoutTime_HCP" SG_ 1033 IdleCLoopTrq 0;
BA_ "GenSigTimeoutTime_IPC" SG_ 1033 IdleCLoopTrq 0;
BA_ "GenSigTimeoutTime_RFHM" SG_ 1033 IdleCLoopTrq 0;
BA_ "GenSigTimeoutTime_SGW" SG_ 1033 IdleCLoopTrq 0;
BA_ "GenSigTimeoutTime_TCM" SG_ 1033 IdleCLoopTrq 0;
BA_ "SystemSignalLongSymbol" SG_ 1033 MessageCounter_HYBRID_POWERTRAI "MessageCounter_HYBRID_POWERTRAIN5";
BA_ "GenSigTimeoutTime_AGSM" SG_ 1033 MessageCounter_HYBRID_POWERTRAI 0;
BA_ "GenSigTimeoutTime_BCM" SG_ 1033 MessageCounter_HYBRID_POWERTRAI 0;
BA_ "GenSigTimeoutTime_BSM" SG_ 1033 MessageCounter_HYBRID_POWERTRAI 0;
BA_ "GenSigTimeoutTime_CADM" SG_ 1033 MessageCounter_HYBRID_POWERTRAI 0;
BA_ "GenSigTimeoutTime_DMSM" SG_ 1033 MessageCounter_HYBRID_POWERTRAI 0;
BA_ "GenSigTimeoutTime_DTCM" SG_ 1033 MessageCounter_HYBRID_POWERTRAI 0;
BA_ "GenSigTimeoutTime_EVCU2" SG_ 1033 MessageCounter_HYBRID_POWERTRAI 0;
BA_ "GenSigTimeoutTime_GNMM" SG_ 1033 MessageCounter_HYBRID_POWERTRAI 0;
BA_ "GenSigTimeoutTime_HCP" SG_ 1033 MessageCounter_HYBRID_POWERTRAI 0;
BA_ "GenSigTimeoutTime_IPC" SG_ 1033 MessageCounter_HYBRID_POWERTRAI 0;
BA_ "GenSigTimeoutTime_RFHM" SG_ 1033 MessageCounter_HYBRID_POWERTRAI 0;
BA_ "GenSigTimeoutTime_SGW" SG_ 1033 MessageCounter_HYBRID_POWERTRAI 0;
BA_ "GenSigTimeoutTime_AGSM" SG_ 1033 Motor1PowerUse_Display 0;
BA_ "GenSigTimeoutTime_BCM" SG_ 1033 Motor1PowerUse_Display 0;
BA_ "GenSigTimeoutTime_BSM" SG_ 1033 Motor1PowerUse_Display 0;
BA_ "GenSigTimeoutTime_CADM" SG_ 1033 Motor1PowerUse_Display 0;
BA_ "GenSigTimeoutTime_DMSM" SG_ 1033 Motor1PowerUse_Display 0;
BA_ "GenSigTimeoutTime_DTCM" SG_ 1033 Motor1PowerUse_Display 0;
BA_ "GenSigTimeoutTime_ECM" SG_ 1033 Motor1PowerUse_Display 0;
BA_ "GenSigTimeoutTime_EVCU2" SG_ 1033 Motor1PowerUse_Display 0;
BA_ "GenSigTimeoutTime_GNMM" SG_ 1033 Motor1PowerUse_Display 0;
BA_ "GenSigTimeoutTime_HCP" SG_ 1033 Motor1PowerUse_Display 0;
BA_ "GenSigTimeoutTime_IPC" SG_ 1033 Motor1PowerUse_Display 0;
BA_ "GenSigTimeoutTime_RFHM" SG_ 1033 Motor1PowerUse_Display 0;
BA_ "GenSigTimeoutTime_TCM" SG_ 1033 Motor1PowerUse_Display 0;
BA_ "GenSigTimeoutTime_AGSM" SG_ 1033 Motor1PowerUse_DisplayV 0;
BA_ "GenSigTimeoutTime_BCM" SG_ 1033 Motor1PowerUse_DisplayV 0;
BA_ "GenSigTimeoutTime_BSM" SG_ 1033 Motor1PowerUse_DisplayV 0;
BA_ "GenSigTimeoutTime_CADM" SG_ 1033 Motor1PowerUse_DisplayV 0;
BA_ "GenSigTimeoutTime_DMSM" SG_ 1033 Motor1PowerUse_DisplayV 0;
BA_ "GenSigTimeoutTime_DTCM" SG_ 1033 Motor1PowerUse_DisplayV 0;
BA_ "GenSigTimeoutTime_ECM" SG_ 1033 Motor1PowerUse_DisplayV 0;
BA_ "GenSigTimeoutTime_EVCU2" SG_ 1033 Motor1PowerUse_DisplayV 0;
BA_ "GenSigTimeoutTime_GNMM" SG_ 1033 Motor1PowerUse_DisplayV 0;
BA_ "GenSigTimeoutTime_HCP" SG_ 1033 Motor1PowerUse_DisplayV 0;
BA_ "GenSigTimeoutTime_IPC" SG_ 1033 Motor1PowerUse_DisplayV 0;
BA_ "GenSigTimeoutTime_RFHM" SG_ 1033 Motor1PowerUse_DisplayV 0;
BA_ "GenSigTimeoutTime_TCM" SG_ 1033 Motor1PowerUse_DisplayV 0;
BA_ "GenSigTimeoutTime_AGSM" SG_ 1033 Motor2PowerUse_Display 0;
BA_ "GenSigTimeoutTime_BCM" SG_ 1033 Motor2PowerUse_Display 0;
BA_ "GenSigTimeoutTime_BSM" SG_ 1033 Motor2PowerUse_Display 0;
BA_ "GenSigTimeoutTime_CADM" SG_ 1033 Motor2PowerUse_Display 0;
BA_ "GenSigTimeoutTime_DMSM" SG_ 1033 Motor2PowerUse_Display 0;
BA_ "GenSigTimeoutTime_DTCM" SG_ 1033 Motor2PowerUse_Display 0;
BA_ "GenSigTimeoutTime_ECM" SG_ 1033 Motor2PowerUse_Display 0;
BA_ "GenSigTimeoutTime_EVCU2" SG_ 1033 Motor2PowerUse_Display 0;
BA_ "GenSigTimeoutTime_GNMM" SG_ 1033 Motor2PowerUse_Display 0;
BA_ "GenSigTimeoutTime_HCP" SG_ 1033 Motor2PowerUse_Display 0;
BA_ "GenSigTimeoutTime_IPC" SG_ 1033 Motor2PowerUse_Display 0;
BA_ "GenSigTimeoutTime_RFHM" SG_ 1033 Motor2PowerUse_Display 0;
BA_ "GenSigTimeoutTime_TCM" SG_ 1033 Motor2PowerUse_Display 0;
BA_ "GenSigTimeoutTime_AGSM" SG_ 1033 Motor2PowerUse_DisplayV 0;
BA_ "GenSigTimeoutTime_BCM" SG_ 1033 Motor2PowerUse_DisplayV 0;
BA_ "GenSigTimeoutTime_BSM" SG_ 1033 Motor2PowerUse_DisplayV 0;
BA_ "GenSigTimeoutTime_CADM" SG_ 1033 Motor2PowerUse_DisplayV 0;
BA_ "GenSigTimeoutTime_DMSM" SG_ 1033 Motor2PowerUse_DisplayV 0;
BA_ "GenSigTimeoutTime_DTCM" SG_ 1033 Motor2PowerUse_DisplayV 0;
BA_ "GenSigTimeoutTime_ECM" SG_ 1033 Motor2PowerUse_DisplayV 0;
BA_ "GenSigTimeoutTime_EVCU2" SG_ 1033 Motor2PowerUse_DisplayV 0;
BA_ "GenSigTimeoutTime_GNMM" SG_ 1033 Motor2PowerUse_DisplayV 0;
BA_ "GenSigTimeoutTime_HCP" SG_ 1033 Motor2PowerUse_DisplayV 0;
BA_ "GenSigTimeoutTime_IPC" SG_ 1033 Motor2PowerUse_DisplayV 0;
BA_ "GenSigTimeoutTime_RFHM" SG_ 1033 Motor2PowerUse_DisplayV 0;
BA_ "GenSigTimeoutTime_TCM" SG_ 1033 Motor2PowerUse_DisplayV 0;
BA_ "GenSigTimeoutTime_AGSM" SG_ 1033 MotorsPowerUse_Display 0;
BA_ "GenSigTimeoutTime_BCM" SG_ 1033 MotorsPowerUse_Display 0;
BA_ "GenSigTimeoutTime_BSM" SG_ 1033 MotorsPowerUse_Display 0;
BA_ "GenSigTimeoutTime_CADM" SG_ 1033 MotorsPowerUse_Display 0;
BA_ "GenSigTimeoutTime_DMSM" SG_ 1033 MotorsPowerUse_Display 0;
BA_ "GenSigTimeoutTime_DTCM" SG_ 1033 MotorsPowerUse_Display 0;
BA_ "GenSigTimeoutTime_ECM" SG_ 1033 MotorsPowerUse_Display 0;
BA_ "GenSigTimeoutTime_EVCU2" SG_ 1033 MotorsPowerUse_Display 0;
BA_ "GenSigTimeoutTime_GNMM" SG_ 1033 MotorsPowerUse_Display 0;
BA_ "GenSigTimeoutTime_HCP" SG_ 1033 MotorsPowerUse_Display 0;
BA_ "GenSigTimeoutTime_IPC" SG_ 1033 MotorsPowerUse_Display 0;
BA_ "GenSigTimeoutTime_RFHM" SG_ 1033 MotorsPowerUse_Display 0;
BA_ "GenSigTimeoutTime_TCM" SG_ 1033 MotorsPowerUse_Display 0;
BA_ "GenSigTimeoutTime_AGSM" SG_ 1033 MotorsPowerUse_DisplayV 0;
BA_ "GenSigTimeoutTime_BCM" SG_ 1033 MotorsPowerUse_DisplayV 0;
BA_ "GenSigTimeoutTime_BSM" SG_ 1033 MotorsPowerUse_DisplayV 0;
BA_ "GenSigTimeoutTime_CADM" SG_ 1033 MotorsPowerUse_DisplayV 0;
BA_ "GenSigTimeoutTime_DMSM" SG_ 1033 MotorsPowerUse_DisplayV 0;
BA_ "GenSigTimeoutTime_DTCM" SG_ 1033 MotorsPowerUse_DisplayV 0;
BA_ "GenSigTimeoutTime_ECM" SG_ 1033 MotorsPowerUse_DisplayV 0;
BA_ "GenSigTimeoutTime_EVCU2" SG_ 1033 MotorsPowerUse_DisplayV 0;
BA_ "GenSigTimeoutTime_GNMM" SG_ 1033 MotorsPowerUse_DisplayV 0;
BA_ "GenSigTimeoutTime_HCP" SG_ 1033 MotorsPowerUse_DisplayV 0;
BA_ "GenSigTimeoutTime_IPC" SG_ 1033 MotorsPowerUse_DisplayV 0;
BA_ "GenSigTimeoutTime_RFHM" SG_ 1033 MotorsPowerUse_DisplayV 0;
BA_ "GenSigTimeoutTime_TCM" SG_ 1033 MotorsPowerUse_DisplayV 0;
BA_ "GenSigTimeoutTime_AGSM" SG_ 1033 PT_WorkSite_Invtr_Capacity_HCP 0;
BA_ "GenSigTimeoutTime_BSM" SG_ 1033 PT_WorkSite_Invtr_Capacity_HCP 0;
BA_ "GenSigTimeoutTime_CADM" SG_ 1033 PT_WorkSite_Invtr_Capacity_HCP 0;
BA_ "GenSigTimeoutTime_DMSM" SG_ 1033 PT_WorkSite_Invtr_Capacity_HCP 0;
BA_ "GenSigTimeoutTime_DTCM" SG_ 1033 PT_WorkSite_Invtr_Capacity_HCP 0;
BA_ "GenSigTimeoutTime_ECM" SG_ 1033 PT_WorkSite_Invtr_Capacity_HCP 0;
BA_ "GenSigTimeoutTime_EVCU2" SG_ 1033 PT_WorkSite_Invtr_Capacity_HCP 0;
BA_ "GenSigTimeoutTime_GNMM" SG_ 1033 PT_WorkSite_Invtr_Capacity_HCP 0;
BA_ "GenSigTimeoutTime_HCP" SG_ 1033 PT_WorkSite_Invtr_Capacity_HCP 0;
BA_ "GenSigTimeoutTime_IPC" SG_ 1033 PT_WorkSite_Invtr_Capacity_HCP 0;
BA_ "GenSigTimeoutTime_RFHM" SG_ 1033 PT_WorkSite_Invtr_Capacity_HCP 0;
BA_ "GenSigTimeoutTime_SGW" SG_ 1033 PT_WorkSite_Invtr_Capacity_HCP 0;
BA_ "GenSigTimeoutTime_TCM" SG_ 1033 PT_WorkSite_Invtr_Capacity_HCP 0;
BA_ "GenSigTimeoutTime_AGSM" SG_ 1033 PT_WorkSite_Invtr_Sts_HCP 0;
BA_ "GenSigTimeoutTime_BSM" SG_ 1033 PT_WorkSite_Invtr_Sts_HCP 0;
BA_ "GenSigTimeoutTime_CADM" SG_ 1033 PT_WorkSite_Invtr_Sts_HCP 0;
BA_ "GenSigTimeoutTime_DMSM" SG_ 1033 PT_WorkSite_Invtr_Sts_HCP 0;
BA_ "GenSigTimeoutTime_DTCM" SG_ 1033 PT_WorkSite_Invtr_Sts_HCP 0;
BA_ "GenSigTimeoutTime_ECM" SG_ 1033 PT_WorkSite_Invtr_Sts_HCP 0;
BA_ "GenSigTimeoutTime_EVCU2" SG_ 1033 PT_WorkSite_Invtr_Sts_HCP 0;
BA_ "GenSigTimeoutTime_GNMM" SG_ 1033 PT_WorkSite_Invtr_Sts_HCP 0;
BA_ "GenSigTimeoutTime_HCP" SG_ 1033 PT_WorkSite_Invtr_Sts_HCP 0;
BA_ "GenSigTimeoutTime_IPC" SG_ 1033 PT_WorkSite_Invtr_Sts_HCP 0;
BA_ "GenSigTimeoutTime_RFHM" SG_ 1033 PT_WorkSite_Invtr_Sts_HCP 0;
BA_ "GenSigTimeoutTime_SGW" SG_ 1033 PT_WorkSite_Invtr_Sts_HCP 0;
BA_ "GenSigTimeoutTime_TCM" SG_ 1033 PT_WorkSite_Invtr_Sts_HCP 0;
BA_ "GenSigTimeoutTime_AGSM" SG_ 1033 Smartload_Actv 0;
BA_ "GenSigTimeoutTime_BCM" SG_ 1033 Smartload_Actv 0;
BA_ "GenSigTimeoutTime_BSM" SG_ 1033 Smartload_Actv 0;
BA_ "GenSigTimeoutTime_CADM" SG_ 1033 Smartload_Actv 0;
BA_ "GenSigTimeoutTime_DMSM" SG_ 1033 Smartload_Actv 0;
BA_ "GenSigTimeoutTime_DTCM" SG_ 1033 Smartload_Actv 0;
BA_ "GenSigTimeoutTime_EVCU2" SG_ 1033 Smartload_Actv 0;
BA_ "GenSigTimeoutTime_GNMM" SG_ 1033 Smartload_Actv 0;
BA_ "GenSigTimeoutTime_HCP" SG_ 1033 Smartload_Actv 0;
BA_ "GenSigTimeoutTime_IPC" SG_ 1033 Smartload_Actv 0;
BA_ "GenSigTimeoutTime_RFHM" SG_ 1033 Smartload_Actv 0;
BA_ "GenSigTimeoutTime_SGW" SG_ 1033 Smartload_Actv 0;
BA_ "GenSigTimeoutTime_TCM" SG_ 1033 Smartload_Actv 0;
BA_ "GenSigTimeoutTime_AGSM" SG_ 1580 V2H_Discharge_Capacity 0;
BA_ "GenSigTimeoutTime_BCM" SG_ 1580 V2H_Discharge_Capacity 0;
BA_ "GenSigTimeoutTime_BSM" SG_ 1580 V2H_Discharge_Capacity 0;
BA_ "GenSigTimeoutTime_CADM" SG_ 1580 V2H_Discharge_Capacity 0;
BA_ "GenSigTimeoutTime_DMSM" SG_ 1580 V2H_Discharge_Capacity 0;
BA_ "GenSigTimeoutTime_DTCM" SG_ 1580 V2H_Discharge_Capacity 0;
BA_ "GenSigTimeoutTime_ECM" SG_ 1580 V2H_Discharge_Capacity 0;
BA_ "GenSigTimeoutTime_EVCU2" SG_ 1580 V2H_Discharge_Capacity 0;
BA_ "GenSigTimeoutTime_GNMM" SG_ 1580 V2H_Discharge_Capacity 0;
BA_ "GenSigTimeoutTime_HCP" SG_ 1580 V2H_Discharge_Capacity 0;
BA_ "GenSigTimeoutTime_IPC" SG_ 1580 V2H_Discharge_Capacity 0;
BA_ "GenSigTimeoutTime_RFHM" SG_ 1580 V2H_Discharge_Capacity 0;
BA_ "GenSigTimeoutTime_TCM" SG_ 1580 V2H_Discharge_Capacity 0;
BA_ "GenSigStartValue" SG_ 1956 MotorA_DC_Current 16384;
BA_ "GenSigTimeoutTime_AGSM" SG_ 1956 MotorA_DC_Current 0;
BA_ "GenSigTimeoutTime_BCM" SG_ 1956 MotorA_DC_Current 0;
BA_ "GenSigTimeoutTime_BSM" SG_ 1956 MotorA_DC_Current 0;
BA_ "GenSigTimeoutTime_CADM" SG_ 1956 MotorA_DC_Current 0;
BA_ "GenSigTimeoutTime_DMSM" SG_ 1956 MotorA_DC_Current 0;
BA_ "GenSigTimeoutTime_DTCM" SG_ 1956 MotorA_DC_Current 0;
BA_ "GenSigTimeoutTime_ECM" SG_ 1956 MotorA_DC_Current 0;
BA_ "GenSigTimeoutTime_EVCU2" SG_ 1956 MotorA_DC_Current 0;
BA_ "GenSigTimeoutTime_GNMM" SG_ 1956 MotorA_DC_Current 0;
BA_ "GenSigTimeoutTime_HCP" SG_ 1956 MotorA_DC_Current 0;
BA_ "GenSigTimeoutTime_IPC" SG_ 1956 MotorA_DC_Current 0;
BA_ "GenSigTimeoutTime_RFHM" SG_ 1956 MotorA_DC_Current 0;
BA_ "GenSigTimeoutTime_SGW" SG_ 1956 MotorA_DC_Current 0;
BA_ "GenSigTimeoutTime_TCM" SG_ 1956 MotorA_DC_Current 0;
BA_ "GenSigTimeoutTime_AGSM" SG_ 1956 MotorA_DC_Voltage 0;
BA_ "GenSigTimeoutTime_BCM" SG_ 1956 MotorA_DC_Voltage 0;
BA_ "GenSigTimeoutTime_BSM" SG_ 1956 MotorA_DC_Voltage 0;
BA_ "GenSigTimeoutTime_CADM" SG_ 1956 MotorA_DC_Voltage 0;
BA_ "GenSigTimeoutTime_DMSM" SG_ 1956 MotorA_DC_Voltage 0;
BA_ "GenSigTimeoutTime_DTCM" SG_ 1956 MotorA_DC_Voltage 0;
BA_ "GenSigTimeoutTime_ECM" SG_ 1956 MotorA_DC_Voltage 0;
BA_ "GenSigTimeoutTime_EVCU2" SG_ 1956 MotorA_DC_Voltage 0;
BA_ "GenSigTimeoutTime_GNMM" SG_ 1956 MotorA_DC_Voltage 0;
BA_ "GenSigTimeoutTime_HCP" SG_ 1956 MotorA_DC_Voltage 0;
BA_ "GenSigTimeoutTime_IPC" SG_ 1956 MotorA_DC_Voltage 0;
BA_ "GenSigTimeoutTime_RFHM" SG_ 1956 MotorA_DC_Voltage 0;
BA_ "GenSigTimeoutTime_SGW" SG_ 1956 MotorA_DC_Voltage 0;
BA_ "GenSigTimeoutTime_TCM" SG_ 1956 MotorA_DC_Voltage 0;
BA_ "GenSigTimeoutTime_AGSM" SG_ 1956 MotorA_InverterState 0;
BA_ "GenSigTimeoutTime_BCM" SG_ 1956 MotorA_InverterState 0;
BA_ "GenSigTimeoutTime_BSM" SG_ 1956 MotorA_InverterState 0;
BA_ "GenSigTimeoutTime_CADM" SG_ 1956 MotorA_InverterState 0;
BA_ "GenSigTimeoutTime_DMSM" SG_ 1956 MotorA_InverterState 0;
BA_ "GenSigTimeoutTime_DTCM" SG_ 1956 MotorA_InverterState 0;
BA_ "GenSigTimeoutTime_ECM" SG_ 1956 MotorA_InverterState 0;
BA_ "GenSigTimeoutTime_EVCU2" SG_ 1956 MotorA_InverterState 0;
BA_ "GenSigTimeoutTime_GNMM" SG_ 1956 MotorA_InverterState 0;
BA_ "GenSigTimeoutTime_HCP" SG_ 1956 MotorA_InverterState 0;
BA_ "GenSigTimeoutTime_IPC" SG_ 1956 MotorA_InverterState 0;
BA_ "GenSigTimeoutTime_RFHM" SG_ 1956 MotorA_InverterState 0;
BA_ "GenSigTimeoutTime_SGW" SG_ 1956 MotorA_InverterState 0;
BA_ "GenSigTimeoutTime_TCM" SG_ 1956 MotorA_InverterState 0;
BA_ "GenSigStartValue" SG_ 1956 MotorA_InverterTemp 40;
BA_ "GenSigTimeoutTime_AGSM" SG_ 1956 MotorA_InverterTemp 0;
BA_ "GenSigTimeoutTime_BCM" SG_ 1956 MotorA_InverterTemp 0;
BA_ "GenSigTimeoutTime_BSM" SG_ 1956 MotorA_InverterTemp 0;
BA_ "GenSigTimeoutTime_CADM" SG_ 1956 MotorA_InverterTemp 0;
BA_ "GenSigTimeoutTime_DMSM" SG_ 1956 MotorA_InverterTemp 0;
BA_ "GenSigTimeoutTime_DTCM" SG_ 1956 MotorA_InverterTemp 0;
BA_ "GenSigTimeoutTime_ECM" SG_ 1956 MotorA_InverterTemp 0;
BA_ "GenSigTimeoutTime_EVCU2" SG_ 1956 MotorA_InverterTemp 0;
BA_ "GenSigTimeoutTime_GNMM" SG_ 1956 MotorA_InverterTemp 0;
BA_ "GenSigTimeoutTime_HCP" SG_ 1956 MotorA_InverterTemp 0;
BA_ "GenSigTimeoutTime_IPC" SG_ 1956 MotorA_InverterTemp 0;
BA_ "GenSigTimeoutTime_RFHM" SG_ 1956 MotorA_InverterTemp 0;
BA_ "GenSigTimeoutTime_SGW" SG_ 1956 MotorA_InverterTemp 0;
BA_ "GenSigTimeoutTime_TCM" SG_ 1956 MotorA_InverterTemp 0;
BA_ "GenSigStartValue" SG_ 1956 MotorA_RPM 32768;
BA_ "GenSigTimeoutTime_AGSM" SG_ 1956 MotorA_RPM 0;
BA_ "GenSigTimeoutTime_BCM" SG_ 1956 MotorA_RPM 0;
BA_ "GenSigTimeoutTime_BSM" SG_ 1956 MotorA_RPM 0;
BA_ "GenSigTimeoutTime_CADM" SG_ 1956 MotorA_RPM 0;
BA_ "GenSigTimeoutTime_DMSM" SG_ 1956 MotorA_RPM 0;
BA_ "GenSigTimeoutTime_DTCM" SG_ 1956 MotorA_RPM 0;
BA_ "GenSigTimeoutTime_ECM" SG_ 1956 MotorA_RPM 0;
BA_ "GenSigTimeoutTime_EVCU2" SG_ 1956 MotorA_RPM 0;
BA_ "GenSigTimeoutTime_GNMM" SG_ 1956 MotorA_RPM 0;
BA_ "GenSigTimeoutTime_HCP" SG_ 1956 MotorA_RPM 0;
BA_ "GenSigTimeoutTime_IPC" SG_ 1956 MotorA_RPM 0;
BA_ "GenSigTimeoutTime_RFHM" SG_ 1956 MotorA_RPM 0;
BA_ "GenSigTimeoutTime_SGW" SG_ 1956 MotorA_RPM 0;
BA_ "GenSigTimeoutTime_TCM" SG_ 1956 MotorA_RPM 0;
BA_ "GenSigStartValue" SG_ 1956 MotorA_Temperature 40;
BA_ "GenSigTimeoutTime_AGSM" SG_ 1956 MotorA_Temperature 0;
BA_ "GenSigTimeoutTime_BCM" SG_ 1956 MotorA_Temperature 0;
BA_ "GenSigTimeoutTime_BSM" SG_ 1956 MotorA_Temperature 0;
BA_ "GenSigTimeoutTime_CADM" SG_ 1956 MotorA_Temperature 0;
BA_ "GenSigTimeoutTime_DMSM" SG_ 1956 MotorA_Temperature 0;
BA_ "GenSigTimeoutTime_DTCM" SG_ 1956 MotorA_Temperature 0;
BA_ "GenSigTimeoutTime_ECM" SG_ 1956 MotorA_Temperature 0;
BA_ "GenSigTimeoutTime_EVCU2" SG_ 1956 MotorA_Temperature 0;
BA_ "GenSigTimeoutTime_GNMM" SG_ 1956 MotorA_Temperature 0;
BA_ "GenSigTimeoutTime_HCP" SG_ 1956 MotorA_Temperature 0;
BA_ "GenSigTimeoutTime_RFHM" SG_ 1956 MotorA_Temperature 0;
BA_ "GenSigTimeoutTime_SGW" SG_ 1956 MotorA_Temperature 0;
BA_ "GenSigTimeoutTime_TCM" SG_ 1956 MotorA_Temperature 0;
BA_ "GenSigStartValue" SG_ 1956 MotorA_TorqueAchieved 4096;
BA_ "GenSigTimeoutTime_AGSM" SG_ 1956 MotorA_TorqueAchieved 0;
BA_ "GenSigTimeoutTime_BCM" SG_ 1956 MotorA_TorqueAchieved 0;
BA_ "GenSigTimeoutTime_BSM" SG_ 1956 MotorA_TorqueAchieved 0;
BA_ "GenSigTimeoutTime_CADM" SG_ 1956 MotorA_TorqueAchieved 0;
BA_ "GenSigTimeoutTime_DMSM" SG_ 1956 MotorA_TorqueAchieved 0;
BA_ "GenSigTimeoutTime_DTCM" SG_ 1956 MotorA_TorqueAchieved 0;
BA_ "GenSigTimeoutTime_ECM" SG_ 1956 MotorA_TorqueAchieved 0;
BA_ "GenSigTimeoutTime_EVCU2" SG_ 1956 MotorA_TorqueAchieved 0;
BA_ "GenSigTimeoutTime_GNMM" SG_ 1956 MotorA_TorqueAchieved 0;
BA_ "GenSigTimeoutTime_HCP" SG_ 1956 MotorA_TorqueAchieved 0;
BA_ "GenSigTimeoutTime_IPC" SG_ 1956 MotorA_TorqueAchieved 0;
BA_ "GenSigTimeoutTime_RFHM" SG_ 1956 MotorA_TorqueAchieved 0;
BA_ "GenSigTimeoutTime_SGW" SG_ 1956 MotorA_TorqueAchieved 0;
BA_ "GenSigTimeoutTime_TCM" SG_ 1956 MotorA_TorqueAchieved 0;
BA_ "GenSigStartValue" SG_ 1956 MotorB_DC_Current 16384;
BA_ "GenSigTimeoutTime_AGSM" SG_ 1956 MotorB_DC_Current 0;
BA_ "GenSigTimeoutTime_BCM" SG_ 1956 MotorB_DC_Current 0;
BA_ "GenSigTimeoutTime_BSM" SG_ 1956 MotorB_DC_Current 0;
BA_ "GenSigTimeoutTime_CADM" SG_ 1956 MotorB_DC_Current 0;
BA_ "GenSigTimeoutTime_DMSM" SG_ 1956 MotorB_DC_Current 0;
BA_ "GenSigTimeoutTime_DTCM" SG_ 1956 MotorB_DC_Current 0;
BA_ "GenSigTimeoutTime_ECM" SG_ 1956 MotorB_DC_Current 0;
BA_ "GenSigTimeoutTime_EVCU2" SG_ 1956 MotorB_DC_Current 0;
BA_ "GenSigTimeoutTime_GNMM" SG_ 1956 MotorB_DC_Current 0;
BA_ "GenSigTimeoutTime_HCP" SG_ 1956 MotorB_DC_Current 0;
BA_ "GenSigTimeoutTime_IPC" SG_ 1956 MotorB_DC_Current 0;
BA_ "GenSigTimeoutTime_RFHM" SG_ 1956 MotorB_DC_Current 0;
BA_ "GenSigTimeoutTime_SGW" SG_ 1956 MotorB_DC_Current 0;
BA_ "GenSigTimeoutTime_TCM" SG_ 1956 MotorB_DC_Current 0;
BA_ "GenSigTimeoutTime_AGSM" SG_ 1956 MotorB_DC_Voltage 0;
BA_ "GenSigTimeoutTime_BCM" SG_ 1956 MotorB_DC_Voltage 0;
BA_ "GenSigTimeoutTime_BSM" SG_ 1956 MotorB_DC_Voltage 0;
BA_ "GenSigTimeoutTime_CADM" SG_ 1956 MotorB_DC_Voltage 0;
BA_ "GenSigTimeoutTime_DMSM" SG_ 1956 MotorB_DC_Voltage 0;
BA_ "GenSigTimeoutTime_DTCM" SG_ 1956 MotorB_DC_Voltage 0;
BA_ "GenSigTimeoutTime_ECM" SG_ 1956 MotorB_DC_Voltage 0;
BA_ "GenSigTimeoutTime_EVCU2" SG_ 1956 MotorB_DC_Voltage 0;
BA_ "GenSigTimeoutTime_GNMM" SG_ 1956 MotorB_DC_Voltage 0;
BA_ "GenSigTimeoutTime_HCP" SG_ 1956 MotorB_DC_Voltage 0;
BA_ "GenSigTimeoutTime_IPC" SG_ 1956 MotorB_DC_Voltage 0;
BA_ "GenSigTimeoutTime_RFHM" SG_ 1956 MotorB_DC_Voltage 0;
BA_ "GenSigTimeoutTime_SGW" SG_ 1956 MotorB_DC_Voltage 0;
BA_ "GenSigTimeoutTime_TCM" SG_ 1956 MotorB_DC_Voltage 0;
BA_ "GenSigTimeoutTime_AGSM" SG_ 1956 MotorB_InverterState 0;
BA_ "GenSigTimeoutTime_BCM" SG_ 1956 MotorB_InverterState 0;
BA_ "GenSigTimeoutTime_BSM" SG_ 1956 MotorB_InverterState 0;
BA_ "GenSigTimeoutTime_CADM" SG_ 1956 MotorB_InverterState 0;
BA_ "GenSigTimeoutTime_DMSM" SG_ 1956 MotorB_InverterState 0;
BA_ "GenSigTimeoutTime_DTCM" SG_ 1956 MotorB_InverterState 0;
BA_ "GenSigTimeoutTime_ECM" SG_ 1956 MotorB_InverterState 0;
BA_ "GenSigTimeoutTime_EVCU2" SG_ 1956 MotorB_InverterState 0;
BA_ "GenSigTimeoutTime_GNMM" SG_ 1956 MotorB_InverterState 0;
BA_ "GenSigTimeoutTime_HCP" SG_ 1956 MotorB_InverterState 0;
BA_ "GenSigTimeoutTime_IPC" SG_ 1956 MotorB_InverterState 0;
BA_ "GenSigTimeoutTime_RFHM" SG_ 1956 MotorB_InverterState 0;
BA_ "GenSigTimeoutTime_SGW" SG_ 1956 MotorB_InverterState 0;
BA_ "GenSigTimeoutTime_TCM" SG_ 1956 MotorB_InverterState 0;
BA_ "GenSigStartValue" SG_ 1956 MotorB_InverterTemp 40;
BA_ "GenSigTimeoutTime_AGSM" SG_ 1956 MotorB_InverterTemp 0;
BA_ "GenSigTimeoutTime_BCM" SG_ 1956 MotorB_InverterTemp 0;
BA_ "GenSigTimeoutTime_BSM" SG_ 1956 MotorB_InverterTemp 0;
BA_ "GenSigTimeoutTime_CADM" SG_ 1956 MotorB_InverterTemp 0;
BA_ "GenSigTimeoutTime_DMSM" SG_ 1956 MotorB_InverterTemp 0;
BA_ "GenSigTimeoutTime_DTCM" SG_ 1956 MotorB_InverterTemp 0;
BA_ "GenSigTimeoutTime_ECM" SG_ 1956 MotorB_InverterTemp 0;
BA_ "GenSigTimeoutTime_EVCU2" SG_ 1956 MotorB_InverterTemp 0;
BA_ "GenSigTimeoutTime_GNMM" SG_ 1956 MotorB_InverterTemp 0;
BA_ "GenSigTimeoutTime_HCP" SG_ 1956 MotorB_InverterTemp 0;
BA_ "GenSigTimeoutTime_IPC" SG_ 1956 MotorB_InverterTemp 0;
BA_ "GenSigTimeoutTime_RFHM" SG_ 1956 MotorB_InverterTemp 0;
BA_ "GenSigTimeoutTime_SGW" SG_ 1956 MotorB_InverterTemp 0;
BA_ "GenSigTimeoutTime_TCM" SG_ 1956 MotorB_InverterTemp 0;
BA_ "GenSigStartValue" SG_ 1956 MotorB_RPM 32768;
BA_ "GenSigTimeoutTime_AGSM" SG_ 1956 MotorB_RPM 0;
BA_ "GenSigTimeoutTime_BCM" SG_ 1956 MotorB_RPM 0;
BA_ "GenSigTimeoutTime_BSM" SG_ 1956 MotorB_RPM 0;
BA_ "GenSigTimeoutTime_CADM" SG_ 1956 MotorB_RPM 0;
BA_ "GenSigTimeoutTime_DMSM" SG_ 1956 MotorB_RPM 0;
BA_ "GenSigTimeoutTime_DTCM" SG_ 1956 MotorB_RPM 0;
BA_ "GenSigTimeoutTime_ECM" SG_ 1956 MotorB_RPM 0;
BA_ "GenSigTimeoutTime_EVCU2" SG_ 1956 MotorB_RPM 0;
BA_ "GenSigTimeoutTime_GNMM" SG_ 1956 MotorB_RPM 0;
BA_ "GenSigTimeoutTime_HCP" SG_ 1956 MotorB_RPM 0;
BA_ "GenSigTimeoutTime_IPC" SG_ 1956 MotorB_RPM 0;
BA_ "GenSigTimeoutTime_RFHM" SG_ 1956 MotorB_RPM 0;
BA_ "GenSigTimeoutTime_SGW" SG_ 1956 MotorB_RPM 0;
BA_ "GenSigTimeoutTime_TCM" SG_ 1956 MotorB_RPM 0;
BA_ "GenSigStartValue" SG_ 1956 MotorB_Temperature 40;
BA_ "GenSigTimeoutTime_AGSM" SG_ 1956 MotorB_Temperature 0;
BA_ "GenSigTimeoutTime_BCM" SG_ 1956 MotorB_Temperature 0;
BA_ "GenSigTimeoutTime_BSM" SG_ 1956 MotorB_Temperature 0;
BA_ "GenSigTimeoutTime_CADM" SG_ 1956 MotorB_Temperature 0;
BA_ "GenSigTimeoutTime_DMSM" SG_ 1956 MotorB_Temperature 0;
BA_ "GenSigTimeoutTime_DTCM" SG_ 1956 MotorB_Temperature 0;
BA_ "GenSigTimeoutTime_ECM" SG_ 1956 MotorB_Temperature 0;
BA_ "GenSigTimeoutTime_EVCU2" SG_ 1956 MotorB_Temperature 0;
BA_ "GenSigTimeoutTime_GNMM" SG_ 1956 MotorB_Temperature 0;
BA_ "GenSigTimeoutTime_HCP" SG_ 1956 MotorB_Temperature 0;
BA_ "GenSigTimeoutTime_RFHM" SG_ 1956 MotorB_Temperature 0;
BA_ "GenSigTimeoutTime_SGW" SG_ 1956 MotorB_Temperature 0;
BA_ "GenSigTimeoutTime_TCM" SG_ 1956 MotorB_Temperature 0;
BA_ "GenSigStartValue" SG_ 1956 MotorB_TorqueAchieved 4096;
BA_ "GenSigTimeoutTime_AGSM" SG_ 1956 MotorB_TorqueAchieved 0;
BA_ "GenSigTimeoutTime_BCM" SG_ 1956 MotorB_TorqueAchieved 0;
BA_ "GenSigTimeoutTime_BSM" SG_ 1956 MotorB_TorqueAchieved 0;
BA_ "GenSigTimeoutTime_CADM" SG_ 1956 MotorB_TorqueAchieved 0;
BA_ "GenSigTimeoutTime_DMSM" SG_ 1956 MotorB_TorqueAchieved 0;
BA_ "GenSigTimeoutTime_DTCM" SG_ 1956 MotorB_TorqueAchieved 0;
BA_ "GenSigTimeoutTime_ECM" SG_ 1956 MotorB_TorqueAchieved 0;
BA_ "GenSigTimeoutTime_EVCU2" SG_ 1956 MotorB_TorqueAchieved 0;
BA_ "GenSigTimeoutTime_GNMM" SG_ 1956 MotorB_TorqueAchieved 0;
BA_ "GenSigTimeoutTime_HCP" SG_ 1956 MotorB_TorqueAchieved 0;
BA_ "GenSigTimeoutTime_IPC" SG_ 1956 MotorB_TorqueAchieved 0;
BA_ "GenSigTimeoutTime_RFHM" SG_ 1956 MotorB_TorqueAchieved 0;
BA_ "GenSigTimeoutTime_SGW" SG_ 1956 MotorB_TorqueAchieved 0;
BA_ "GenSigTimeoutTime_TCM" SG_ 1956 MotorB_TorqueAchieved 0;
BA_ "GenSigTimeoutTime_AGSM" SG_ 1956 Warning_DCDCPerformance_DPT 0;
BA_ "GenSigTimeoutTime_BCM" SG_ 1956 Warning_DCDCPerformance_DPT 0;
BA_ "GenSigTimeoutTime_BSM" SG_ 1956 Warning_DCDCPerformance_DPT 0;
BA_ "GenSigTimeoutTime_CADM" SG_ 1956 Warning_DCDCPerformance_DPT 0;
BA_ "GenSigTimeoutTime_DMSM" SG_ 1956 Warning_DCDCPerformance_DPT 0;
BA_ "GenSigTimeoutTime_DTCM" SG_ 1956 Warning_DCDCPerformance_DPT 0;
BA_ "GenSigTimeoutTime_ECM" SG_ 1956 Warning_DCDCPerformance_DPT 0;
BA_ "GenSigTimeoutTime_EVCU2" SG_ 1956 Warning_DCDCPerformance_DPT 0;
BA_ "GenSigTimeoutTime_GNMM" SG_ 1956 Warning_DCDCPerformance_DPT 0;
BA_ "GenSigTimeoutTime_HCP" SG_ 1956 Warning_DCDCPerformance_DPT 0;
BA_ "GenSigTimeoutTime_IPC" SG_ 1956 Warning_DCDCPerformance_DPT 0;
BA_ "GenSigTimeoutTime_RFHM" SG_ 1956 Warning_DCDCPerformance_DPT 0;
BA_ "GenSigTimeoutTime_SGW" SG_ 1956 Warning_DCDCPerformance_DPT 0;
BA_ "GenSigTimeoutTime_TCM" SG_ 1956 Warning_DCDCPerformance_DPT 0;
BA_ "GenSigTimeoutTime_AGSM" SG_ 1956 Warning_DCDCTemp_DPT 0;
BA_ "GenSigTimeoutTime_BCM" SG_ 1956 Warning_DCDCTemp_DPT 0;
BA_ "GenSigTimeoutTime_BSM" SG_ 1956 Warning_DCDCTemp_DPT 0;
BA_ "GenSigTimeoutTime_CADM" SG_ 1956 Warning_DCDCTemp_DPT 0;
BA_ "GenSigTimeoutTime_DMSM" SG_ 1956 Warning_DCDCTemp_DPT 0;
BA_ "GenSigTimeoutTime_DTCM" SG_ 1956 Warning_DCDCTemp_DPT 0;
BA_ "GenSigTimeoutTime_ECM" SG_ 1956 Warning_DCDCTemp_DPT 0;
BA_ "GenSigTimeoutTime_EVCU2" SG_ 1956 Warning_DCDCTemp_DPT 0;
BA_ "GenSigTimeoutTime_GNMM" SG_ 1956 Warning_DCDCTemp_DPT 0;
BA_ "GenSigTimeoutTime_HCP" SG_ 1956 Warning_DCDCTemp_DPT 0;
BA_ "GenSigTimeoutTime_IPC" SG_ 1956 Warning_DCDCTemp_DPT 0;
BA_ "GenSigTimeoutTime_RFHM" SG_ 1956 Warning_DCDCTemp_DPT 0;
BA_ "GenSigTimeoutTime_SGW" SG_ 1956 Warning_DCDCTemp_DPT 0;
BA_ "GenSigTimeoutTime_TCM" SG_ 1956 Warning_DCDCTemp_DPT 0;
BA_ "GenSigTimeoutTime_AGSM" SG_ 1956 Warning_InverterA_Overtemp 0;
BA_ "GenSigTimeoutTime_BCM" SG_ 1956 Warning_InverterA_Overtemp 0;
BA_ "GenSigTimeoutTime_BSM" SG_ 1956 Warning_InverterA_Overtemp 0;
BA_ "GenSigTimeoutTime_CADM" SG_ 1956 Warning_InverterA_Overtemp 0;
BA_ "GenSigTimeoutTime_DMSM" SG_ 1956 Warning_InverterA_Overtemp 0;
BA_ "GenSigTimeoutTime_DTCM" SG_ 1956 Warning_InverterA_Overtemp 0;
BA_ "GenSigTimeoutTime_ECM" SG_ 1956 Warning_InverterA_Overtemp 0;
BA_ "GenSigTimeoutTime_EVCU2" SG_ 1956 Warning_InverterA_Overtemp 0;
BA_ "GenSigTimeoutTime_GNMM" SG_ 1956 Warning_InverterA_Overtemp 0;
BA_ "GenSigTimeoutTime_HCP" SG_ 1956 Warning_InverterA_Overtemp 0;
BA_ "GenSigTimeoutTime_IPC" SG_ 1956 Warning_InverterA_Overtemp 0;
BA_ "GenSigTimeoutTime_RFHM" SG_ 1956 Warning_InverterA_Overtemp 0;
BA_ "GenSigTimeoutTime_SGW" SG_ 1956 Warning_InverterA_Overtemp 0;
BA_ "GenSigTimeoutTime_TCM" SG_ 1956 Warning_InverterA_Overtemp 0;
BA_ "GenSigTimeoutTime_AGSM" SG_ 1956 Warning_InverterB_Overtemp 0;
BA_ "GenSigTimeoutTime_BCM" SG_ 1956 Warning_InverterB_Overtemp 0;
BA_ "GenSigTimeoutTime_BSM" SG_ 1956 Warning_InverterB_Overtemp 0;
BA_ "GenSigTimeoutTime_CADM" SG_ 1956 Warning_InverterB_Overtemp 0;
BA_ "GenSigTimeoutTime_DMSM" SG_ 1956 Warning_InverterB_Overtemp 0;
BA_ "GenSigTimeoutTime_DTCM" SG_ 1956 Warning_InverterB_Overtemp 0;
BA_ "GenSigTimeoutTime_ECM" SG_ 1956 Warning_InverterB_Overtemp 0;
BA_ "GenSigTimeoutTime_EVCU2" SG_ 1956 Warning_InverterB_Overtemp 0;
BA_ "GenSigTimeoutTime_GNMM" SG_ 1956 Warning_InverterB_Overtemp 0;
BA_ "GenSigTimeoutTime_HCP" SG_ 1956 Warning_InverterB_Overtemp 0;
BA_ "GenSigTimeoutTime_IPC" SG_ 1956 Warning_InverterB_Overtemp 0;
BA_ "GenSigTimeoutTime_RFHM" SG_ 1956 Warning_InverterB_Overtemp 0;
BA_ "GenSigTimeoutTime_SGW" SG_ 1956 Warning_InverterB_Overtemp 0;
BA_ "GenSigTimeoutTime_TCM" SG_ 1956 Warning_InverterB_Overtemp 0;
BA_ "GenSigTimeoutTime_AGSM" SG_ 1956 Warning_MotorA_Overtemp 0;
BA_ "GenSigTimeoutTime_BCM" SG_ 1956 Warning_MotorA_Overtemp 0;
BA_ "GenSigTimeoutTime_BSM" SG_ 1956 Warning_MotorA_Overtemp 0;
BA_ "GenSigTimeoutTime_CADM" SG_ 1956 Warning_MotorA_Overtemp 0;
BA_ "GenSigTimeoutTime_DMSM" SG_ 1956 Warning_MotorA_Overtemp 0;
BA_ "GenSigTimeoutTime_DTCM" SG_ 1956 Warning_MotorA_Overtemp 0;
BA_ "GenSigTimeoutTime_ECM" SG_ 1956 Warning_MotorA_Overtemp 0;
BA_ "GenSigTimeoutTime_EVCU2" SG_ 1956 Warning_MotorA_Overtemp 0;
BA_ "GenSigTimeoutTime_GNMM" SG_ 1956 Warning_MotorA_Overtemp 0;
BA_ "GenSigTimeoutTime_HCP" SG_ 1956 Warning_MotorA_Overtemp 0;
BA_ "GenSigTimeoutTime_IPC" SG_ 1956 Warning_MotorA_Overtemp 0;
BA_ "GenSigTimeoutTime_RFHM" SG_ 1956 Warning_MotorA_Overtemp 0;
BA_ "GenSigTimeoutTime_SGW" SG_ 1956 Warning_MotorA_Overtemp 0;
BA_ "GenSigTimeoutTime_TCM" SG_ 1956 Warning_MotorA_Overtemp 0;
BA_ "GenSigTimeoutTime_AGSM" SG_ 1956 Warning_MotorB_Overtemp 0;
BA_ "GenSigTimeoutTime_BCM" SG_ 1956 Warning_MotorB_Overtemp 0;
BA_ "GenSigTimeoutTime_BSM" SG_ 1956 Warning_MotorB_Overtemp 0;
BA_ "GenSigTimeoutTime_CADM" SG_ 1956 Warning_MotorB_Overtemp 0;
BA_ "GenSigTimeoutTime_DMSM" SG_ 1956 Warning_MotorB_Overtemp 0;
BA_ "GenSigTimeoutTime_DTCM" SG_ 1956 Warning_MotorB_Overtemp 0;
BA_ "GenSigTimeoutTime_ECM" SG_ 1956 Warning_MotorB_Overtemp 0;
BA_ "GenSigTimeoutTime_EVCU2" SG_ 1956 Warning_MotorB_Overtemp 0;
BA_ "GenSigTimeoutTime_GNMM" SG_ 1956 Warning_MotorB_Overtemp 0;
BA_ "GenSigTimeoutTime_HCP" SG_ 1956 Warning_MotorB_Overtemp 0;
BA_ "GenSigTimeoutTime_IPC" SG_ 1956 Warning_MotorB_Overtemp 0;
BA_ "GenSigTimeoutTime_RFHM" SG_ 1956 Warning_MotorB_Overtemp 0;
BA_ "GenSigTimeoutTime_SGW" SG_ 1956 Warning_MotorB_Overtemp 0;
BA_ "GenSigTimeoutTime_TCM" SG_ 1956 Warning_MotorB_Overtemp 0;
BA_ "GenSigTimeoutTime_AGSM" SG_ 1853 APM_CtrlSts_Fbk 0;
BA_ "GenSigTimeoutTime_BCM" SG_ 1853 APM_CtrlSts_Fbk 0;
BA_ "GenSigTimeoutTime_BSM" SG_ 1853 APM_CtrlSts_Fbk 0;
BA_ "GenSigTimeoutTime_CADM" SG_ 1853 APM_CtrlSts_Fbk 0;
BA_ "GenSigTimeoutTime_DMSM" SG_ 1853 APM_CtrlSts_Fbk 0;
BA_ "GenSigTimeoutTime_DTCM" SG_ 1853 APM_CtrlSts_Fbk 0;
BA_ "GenSigTimeoutTime_ECM" SG_ 1853 APM_CtrlSts_Fbk 0;
BA_ "GenSigTimeoutTime_EVCU2" SG_ 1853 APM_CtrlSts_Fbk 0;
BA_ "GenSigTimeoutTime_GNMM" SG_ 1853 APM_CtrlSts_Fbk 0;
BA_ "GenSigTimeoutTime_HCP" SG_ 1853 APM_CtrlSts_Fbk 0;
BA_ "GenSigTimeoutTime_IPC" SG_ 1853 APM_CtrlSts_Fbk 0;
BA_ "GenSigTimeoutTime_RFHM" SG_ 1853 APM_CtrlSts_Fbk 0;
BA_ "GenSigTimeoutTime_SGW" SG_ 1853 APM_CtrlSts_Fbk 0;
BA_ "GenSigTimeoutTime_TCM" SG_ 1853 APM_CtrlSts_Fbk 0;
BA_ "GenSigTimeoutTime_AGSM" SG_ 1853 APM_FailureReason 0;
BA_ "GenSigTimeoutTime_BCM" SG_ 1853 APM_FailureReason 0;
BA_ "GenSigTimeoutTime_BSM" SG_ 1853 APM_FailureReason 0;
BA_ "GenSigTimeoutTime_CADM" SG_ 1853 APM_FailureReason 0;
BA_ "GenSigTimeoutTime_DMSM" SG_ 1853 APM_FailureReason 0;
BA_ "GenSigTimeoutTime_DTCM" SG_ 1853 APM_FailureReason 0;
BA_ "GenSigTimeoutTime_ECM" SG_ 1853 APM_FailureReason 0;
BA_ "GenSigTimeoutTime_EVCU2" SG_ 1853 APM_FailureReason 0;
BA_ "GenSigTimeoutTime_GNMM" SG_ 1853 APM_FailureReason 0;
BA_ "GenSigTimeoutTime_HCP" SG_ 1853 APM_FailureReason 0;
BA_ "GenSigTimeoutTime_IPC" SG_ 1853 APM_FailureReason 0;
BA_ "GenSigTimeoutTime_RFHM" SG_ 1853 APM_FailureReason 0;
BA_ "GenSigTimeoutTime_SGW" SG_ 1853 APM_FailureReason 0;
BA_ "GenSigTimeoutTime_TCM" SG_ 1853 APM_FailureReason 0;
BA_ "GenSigTimeoutTime_AGSM" SG_ 1853 APM_OutputPower 0;
BA_ "GenSigTimeoutTime_BCM" SG_ 1853 APM_OutputPower 0;
BA_ "GenSigTimeoutTime_BSM" SG_ 1853 APM_OutputPower 0;
BA_ "GenSigTimeoutTime_CADM" SG_ 1853 APM_OutputPower 0;
BA_ "GenSigTimeoutTime_DMSM" SG_ 1853 APM_OutputPower 0;
BA_ "GenSigTimeoutTime_DTCM" SG_ 1853 APM_OutputPower 0;
BA_ "GenSigTimeoutTime_ECM" SG_ 1853 APM_OutputPower 0;
BA_ "GenSigTimeoutTime_EVCU2" SG_ 1853 APM_OutputPower 0;
BA_ "GenSigTimeoutTime_GNMM" SG_ 1853 APM_OutputPower 0;
BA_ "GenSigTimeoutTime_HCP" SG_ 1853 APM_OutputPower 0;
BA_ "GenSigTimeoutTime_IPC" SG_ 1853 APM_OutputPower 0;
BA_ "GenSigTimeoutTime_RFHM" SG_ 1853 APM_OutputPower 0;
BA_ "GenSigTimeoutTime_SGW" SG_ 1853 APM_OutputPower 0;
BA_ "GenSigTimeoutTime_TCM" SG_ 1853 APM_OutputPower 0;
BA_ "GenSigTimeoutTime_AGSM" SG_ 1032 AirflowRequest 0;
BA_ "GenSigTimeoutTime_BCM" SG_ 1032 AirflowRequest 0;
BA_ "GenSigTimeoutTime_BSM" SG_ 1032 AirflowRequest 0;
BA_ "GenSigTimeoutTime_CADM" SG_ 1032 AirflowRequest 0;
BA_ "GenSigTimeoutTime_DMSM" SG_ 1032 AirflowRequest 0;
BA_ "GenSigTimeoutTime_DTCM" SG_ 1032 AirflowRequest 0;
BA_ "GenSigTimeoutTime_EVCU2" SG_ 1032 AirflowRequest 0;
BA_ "GenSigTimeoutTime_GNMM" SG_ 1032 AirflowRequest 0;
BA_ "GenSigTimeoutTime_HCP" SG_ 1032 AirflowRequest 0;
BA_ "GenSigTimeoutTime_IPC" SG_ 1032 AirflowRequest 0;
BA_ "GenSigTimeoutTime_RFHM" SG_ 1032 AirflowRequest 0;
BA_ "GenSigTimeoutTime_SGW" SG_ 1032 AirflowRequest 0;
BA_ "GenSigTimeoutTime_TCM" SG_ 1032 AirflowRequest 0;
BA_ "GenSigTimeoutTime_AGSM" SG_ 1032 LTR_PumpFlowRequest 0;
BA_ "GenSigTimeoutTime_BCM" SG_ 1032 LTR_PumpFlowRequest 0;
BA_ "GenSigTimeoutTime_BSM" SG_ 1032 LTR_PumpFlowRequest 0;
BA_ "GenSigTimeoutTime_CADM" SG_ 1032 LTR_PumpFlowRequest 0;
BA_ "GenSigTimeoutTime_DMSM" SG_ 1032 LTR_PumpFlowRequest 0;
BA_ "GenSigTimeoutTime_DTCM" SG_ 1032 LTR_PumpFlowRequest 0;
BA_ "GenSigTimeoutTime_EVCU2" SG_ 1032 LTR_PumpFlowRequest 0;
BA_ "GenSigTimeoutTime_GNMM" SG_ 1032 LTR_PumpFlowRequest 0;
BA_ "GenSigTimeoutTime_HCP" SG_ 1032 LTR_PumpFlowRequest 0;
BA_ "GenSigTimeoutTime_IPC" SG_ 1032 LTR_PumpFlowRequest 0;
BA_ "GenSigTimeoutTime_RFHM" SG_ 1032 LTR_PumpFlowRequest 0;
BA_ "GenSigTimeoutTime_SGW" SG_ 1032 LTR_PumpFlowRequest 0;
BA_ "GenSigTimeoutTime_TCM" SG_ 1032 LTR_PumpFlowRequest 0;
BA_ "GenSigTimeoutTime_AGSM" SG_ 1032 RadiatorFanSts 0;
BA_ "GenSigTimeoutTime_BCM" SG_ 1032 RadiatorFanSts 0;
BA_ "GenSigTimeoutTime_BSM" SG_ 1032 RadiatorFanSts 0;
BA_ "GenSigTimeoutTime_CADM" SG_ 1032 RadiatorFanSts 0;
BA_ "GenSigTimeoutTime_DMSM" SG_ 1032 RadiatorFanSts 0;
BA_ "GenSigTimeoutTime_DTCM" SG_ 1032 RadiatorFanSts 0;
BA_ "GenSigTimeoutTime_EVCU2" SG_ 1032 RadiatorFanSts 0;
BA_ "GenSigTimeoutTime_GNMM" SG_ 1032 RadiatorFanSts 0;
BA_ "GenSigTimeoutTime_HCP" SG_ 1032 RadiatorFanSts 0;
BA_ "GenSigTimeoutTime_IPC" SG_ 1032 RadiatorFanSts 0;
BA_ "GenSigTimeoutTime_RFHM" SG_ 1032 RadiatorFanSts 0;
BA_ "GenSigTimeoutTime_SGW" SG_ 1032 RadiatorFanSts 0;
BA_ "GenSigTimeoutTime_TCM" SG_ 1032 RadiatorFanSts 0;
BA_ "GenSigTimeoutTime_AGSM" SG_ 752 CRC_IBS3DATA1 0;
BA_ "GenSigTimeoutTime_BCM" SG_ 752 CRC_IBS3DATA1 0;
BA_ "GenSigTimeoutTime_BSM" SG_ 752 CRC_IBS3DATA1 0;
BA_ "GenSigTimeoutTime_CADM" SG_ 752 CRC_IBS3DATA1 0;
BA_ "GenSigTimeoutTime_DMSM" SG_ 752 CRC_IBS3DATA1 0;
BA_ "GenSigTimeoutTime_DTCM" SG_ 752 CRC_IBS3DATA1 0;
BA_ "GenSigTimeoutTime_GNMM" SG_ 752 CRC_IBS3DATA1 0;
BA_ "GenSigTimeoutTime_HCP" SG_ 752 CRC_IBS3DATA1 0;
BA_ "GenSigTimeoutTime_IPC" SG_ 752 CRC_IBS3DATA1 0;
BA_ "GenSigTimeoutTime_RFHM" SG_ 752 CRC_IBS3DATA1 0;
BA_ "GenSigTimeoutTime_SGW" SG_ 752 CRC_IBS3DATA1 0;
BA_ "GenSigTimeoutTime_TCM" SG_ 752 CRC_IBS3DATA1 0;
BA_ "GenSigTimeoutTime_AGSM" SG_ 752 CurrBattFailStatus 0;
BA_ "GenSigTimeoutTime_BCM" SG_ 752 CurrBattFailStatus 0;
BA_ "GenSigTimeoutTime_BSM" SG_ 752 CurrBattFailStatus 0;
BA_ "GenSigTimeoutTime_CADM" SG_ 752 CurrBattFailStatus 0;
BA_ "GenSigTimeoutTime_DMSM" SG_ 752 CurrBattFailStatus 0;
BA_ "GenSigTimeoutTime_DTCM" SG_ 752 CurrBattFailStatus 0;
BA_ "GenSigTimeoutTime_GNMM" SG_ 752 CurrBattFailStatus 0;
BA_ "GenSigTimeoutTime_HCP" SG_ 752 CurrBattFailStatus 0;
BA_ "GenSigTimeoutTime_IPC" SG_ 752 CurrBattFailStatus 0;
BA_ "GenSigTimeoutTime_RFHM" SG_ 752 CurrBattFailStatus 0;
BA_ "GenSigTimeoutTime_SGW" SG_ 752 CurrBattFailStatus 0;
BA_ "GenSigTimeoutTime_TCM" SG_ 752 CurrBattFailStatus 0;
BA_ "GenSigTimeoutTime_AGSM" SG_ 752 IBS3_Error_Internal 0;
BA_ "GenSigTimeoutTime_BCM" SG_ 752 IBS3_Error_Internal 0;
BA_ "GenSigTimeoutTime_BSM" SG_ 752 IBS3_Error_Internal 0;
BA_ "GenSigTimeoutTime_CADM" SG_ 752 IBS3_Error_Internal 0;
BA_ "GenSigTimeoutTime_DMSM" SG_ 752 IBS3_Error_Internal 0;
BA_ "GenSigTimeoutTime_DTCM" SG_ 752 IBS3_Error_Internal 0;
BA_ "GenSigTimeoutTime_GNMM" SG_ 752 IBS3_Error_Internal 0;
BA_ "GenSigTimeoutTime_HCP" SG_ 752 IBS3_Error_Internal 0;
BA_ "GenSigTimeoutTime_IPC" SG_ 752 IBS3_Error_Internal 0;
BA_ "GenSigTimeoutTime_RFHM" SG_ 752 IBS3_Error_Internal 0;
BA_ "GenSigTimeoutTime_SGW" SG_ 752 IBS3_Error_Internal 0;
BA_ "GenSigTimeoutTime_TCM" SG_ 752 IBS3_Error_Internal 0;
BA_ "GenSigStartValue" SG_ 752 IBS3_Ibatt 65535;
BA_ "GenSigTimeoutTime_AGSM" SG_ 752 IBS3_Ibatt 0;
BA_ "GenSigTimeoutTime_BCM" SG_ 752 IBS3_Ibatt 0;
BA_ "GenSigTimeoutTime_BSM" SG_ 752 IBS3_Ibatt 0;
BA_ "GenSigTimeoutTime_CADM" SG_ 752 IBS3_Ibatt 0;
BA_ "GenSigTimeoutTime_DMSM" SG_ 752 IBS3_Ibatt 0;
BA_ "GenSigTimeoutTime_DTCM" SG_ 752 IBS3_Ibatt 0;
BA_ "GenSigTimeoutTime_GNMM" SG_ 752 IBS3_Ibatt 0;
BA_ "GenSigTimeoutTime_HCP" SG_ 752 IBS3_Ibatt 0;
BA_ "GenSigTimeoutTime_IPC" SG_ 752 IBS3_Ibatt 0;
BA_ "GenSigTimeoutTime_RFHM" SG_ 752 IBS3_Ibatt 0;
BA_ "GenSigTimeoutTime_TCM" SG_ 752 IBS3_Ibatt 0;
BA_ "GenSigStartValue" SG_ 752 IBS3_SOF_V_Accuracy 1;
BA_ "GenSigTimeoutTime_AGSM" SG_ 752 IBS3_SOF_V_Accuracy 0;
BA_ "GenSigTimeoutTime_BCM" SG_ 752 IBS3_SOF_V_Accuracy 0;
BA_ "GenSigTimeoutTime_BSM" SG_ 752 IBS3_SOF_V_Accuracy 0;
BA_ "GenSigTimeoutTime_CADM" SG_ 752 IBS3_SOF_V_Accuracy 0;
BA_ "GenSigTimeoutTime_DMSM" SG_ 752 IBS3_SOF_V_Accuracy 0;
BA_ "GenSigTimeoutTime_DTCM" SG_ 752 IBS3_SOF_V_Accuracy 0;
BA_ "GenSigTimeoutTime_GNMM" SG_ 752 IBS3_SOF_V_Accuracy 0;
BA_ "GenSigTimeoutTime_HCP" SG_ 752 IBS3_SOF_V_Accuracy 0;
BA_ "GenSigTimeoutTime_IPC" SG_ 752 IBS3_SOF_V_Accuracy 0;
BA_ "GenSigTimeoutTime_RFHM" SG_ 752 IBS3_SOF_V_Accuracy 0;
BA_ "GenSigTimeoutTime_SGW" SG_ 752 IBS3_SOF_V_Accuracy 0;
BA_ "GenSigTimeoutTime_TCM" SG_ 752 IBS3_SOF_V_Accuracy 0;
BA_ "GenSigTimeoutTime_AGSM" SG_ 752 IBS3_SOF_VC 0;
BA_ "GenSigTimeoutTime_BCM" SG_ 752 IBS3_SOF_VC 0;
BA_ "GenSigTimeoutTime_BSM" SG_ 752 IBS3_SOF_VC 0;
BA_ "GenSigTimeoutTime_CADM" SG_ 752 IBS3_SOF_VC 0;
BA_ "GenSigTimeoutTime_DMSM" SG_ 752 IBS3_SOF_VC 0;
BA_ "GenSigTimeoutTime_DTCM" SG_ 752 IBS3_SOF_VC 0;
BA_ "GenSigTimeoutTime_GNMM" SG_ 752 IBS3_SOF_VC 0;
BA_ "GenSigTimeoutTime_HCP" SG_ 752 IBS3_SOF_VC 0;
BA_ "GenSigTimeoutTime_IPC" SG_ 752 IBS3_SOF_VC 0;
BA_ "GenSigTimeoutTime_RFHM" SG_ 752 IBS3_SOF_VC 0;
BA_ "GenSigTimeoutTime_SGW" SG_ 752 IBS3_SOF_VC 0;
BA_ "GenSigTimeoutTime_TCM" SG_ 752 IBS3_SOF_VC 0;
BA_ "GenSigStartValue" SG_ 752 IBS3_Vbatt 511;
BA_ "GenSigTimeoutTime_AGSM" SG_ 752 IBS3_Vbatt 0;
BA_ "GenSigTimeoutTime_BCM" SG_ 752 IBS3_Vbatt 0;
BA_ "GenSigTimeoutTime_BSM" SG_ 752 IBS3_Vbatt 0;
BA_ "GenSigTimeoutTime_CADM" SG_ 752 IBS3_Vbatt 0;
BA_ "GenSigTimeoutTime_DMSM" SG_ 752 IBS3_Vbatt 0;
BA_ "GenSigTimeoutTime_DTCM" SG_ 752 IBS3_Vbatt 0;
BA_ "GenSigTimeoutTime_GNMM" SG_ 752 IBS3_Vbatt 0;
BA_ "GenSigTimeoutTime_IPC" SG_ 752 IBS3_Vbatt 0;
BA_ "GenSigTimeoutTime_RFHM" SG_ 752 IBS3_Vbatt 0;
BA_ "GenSigTimeoutTime_TCM" SG_ 752 IBS3_Vbatt 0;
BA_ "GenSigTimeoutTime_AGSM" SG_ 752 MessageCounter_IBS3DATA1 0;
BA_ "GenSigTimeoutTime_BCM" SG_ 752 MessageCounter_IBS3DATA1 0;
BA_ "GenSigTimeoutTime_BSM" SG_ 752 MessageCounter_IBS3DATA1 0;
BA_ "GenSigTimeoutTime_CADM" SG_ 752 MessageCounter_IBS3DATA1 0;
BA_ "GenSigTimeoutTime_DMSM" SG_ 752 MessageCounter_IBS3DATA1 0;
BA_ "GenSigTimeoutTime_DTCM" SG_ 752 MessageCounter_IBS3DATA1 0;
BA_ "GenSigTimeoutTime_GNMM" SG_ 752 MessageCounter_IBS3DATA1 0;
BA_ "GenSigTimeoutTime_HCP" SG_ 752 MessageCounter_IBS3DATA1 0;
BA_ "GenSigTimeoutTime_IPC" SG_ 752 MessageCounter_IBS3DATA1 0;
BA_ "GenSigTimeoutTime_RFHM" SG_ 752 MessageCounter_IBS3DATA1 0;
BA_ "GenSigTimeoutTime_SGW" SG_ 752 MessageCounter_IBS3DATA1 0;
BA_ "GenSigTimeoutTime_TCM" SG_ 752 MessageCounter_IBS3DATA1 0;
BA_ "GenSigTimeoutTime_AGSM" SG_ 752 RsErrIBS3 0;
BA_ "GenSigTimeoutTime_BCM" SG_ 752 RsErrIBS3 0;
BA_ "GenSigTimeoutTime_BSM" SG_ 752 RsErrIBS3 0;
BA_ "GenSigTimeoutTime_CADM" SG_ 752 RsErrIBS3 0;
BA_ "GenSigTimeoutTime_DMSM" SG_ 752 RsErrIBS3 0;
BA_ "GenSigTimeoutTime_DTCM" SG_ 752 RsErrIBS3 0;
BA_ "GenSigTimeoutTime_GNMM" SG_ 752 RsErrIBS3 0;
BA_ "GenSigTimeoutTime_HCP" SG_ 752 RsErrIBS3 0;
BA_ "GenSigTimeoutTime_IPC" SG_ 752 RsErrIBS3 0;
BA_ "GenSigTimeoutTime_RFHM" SG_ 752 RsErrIBS3 0;
BA_ "GenSigTimeoutTime_SGW" SG_ 752 RsErrIBS3 0;
BA_ "GenSigTimeoutTime_TCM" SG_ 752 RsErrIBS3 0;
BA_ "GenSigTimeoutTime_AGSM" SG_ 752 VoltBattFailStatus 0;
BA_ "GenSigTimeoutTime_BCM" SG_ 752 VoltBattFailStatus 0;
BA_ "GenSigTimeoutTime_BSM" SG_ 752 VoltBattFailStatus 0;
BA_ "GenSigTimeoutTime_CADM" SG_ 752 VoltBattFailStatus 0;
BA_ "GenSigTimeoutTime_DMSM" SG_ 752 VoltBattFailStatus 0;
BA_ "GenSigTimeoutTime_DTCM" SG_ 752 VoltBattFailStatus 0;
BA_ "GenSigTimeoutTime_GNMM" SG_ 752 VoltBattFailStatus 0;
BA_ "GenSigTimeoutTime_IPC" SG_ 752 VoltBattFailStatus 0;
BA_ "GenSigTimeoutTime_RFHM" SG_ 752 VoltBattFailStatus 0;
BA_ "GenSigTimeoutTime_SGW" SG_ 752 VoltBattFailStatus 0;
BA_ "GenSigTimeoutTime_TCM" SG_ 752 VoltBattFailStatus 0;
BA_ "GenSigTimeoutTime_AGSM" SG_ 754 CurrBattFailStatus_2 0;
BA_ "GenSigTimeoutTime_BCM" SG_ 754 CurrBattFailStatus_2 0;
BA_ "GenSigTimeoutTime_BSM" SG_ 754 CurrBattFailStatus_2 0;
BA_ "GenSigTimeoutTime_CADM" SG_ 754 CurrBattFailStatus_2 0;
BA_ "GenSigTimeoutTime_DMSM" SG_ 754 CurrBattFailStatus_2 0;
BA_ "GenSigTimeoutTime_DTCM" SG_ 754 CurrBattFailStatus_2 0;
BA_ "GenSigTimeoutTime_ECM" SG_ 754 CurrBattFailStatus_2 0;
BA_ "GenSigTimeoutTime_EVCU2" SG_ 754 CurrBattFailStatus_2 0;
BA_ "GenSigTimeoutTime_GNMM" SG_ 754 CurrBattFailStatus_2 0;
BA_ "GenSigTimeoutTime_HCP" SG_ 754 CurrBattFailStatus_2 0;
BA_ "GenSigTimeoutTime_IPC" SG_ 754 CurrBattFailStatus_2 0;
BA_ "GenSigTimeoutTime_RFHM" SG_ 754 CurrBattFailStatus_2 0;
BA_ "GenSigTimeoutTime_SGW" SG_ 754 CurrBattFailStatus_2 0;
BA_ "GenSigTimeoutTime_TCM" SG_ 754 CurrBattFailStatus_2 0;
BA_ "GenSigTimeoutTime_AGSM" SG_ 754 IBS3_Error_Internal_2 0;
BA_ "GenSigTimeoutTime_BCM" SG_ 754 IBS3_Error_Internal_2 0;
BA_ "GenSigTimeoutTime_BSM" SG_ 754 IBS3_Error_Internal_2 0;
BA_ "GenSigTimeoutTime_CADM" SG_ 754 IBS3_Error_Internal_2 0;
BA_ "GenSigTimeoutTime_DMSM" SG_ 754 IBS3_Error_Internal_2 0;
BA_ "GenSigTimeoutTime_DTCM" SG_ 754 IBS3_Error_Internal_2 0;
BA_ "GenSigTimeoutTime_ECM" SG_ 754 IBS3_Error_Internal_2 0;
BA_ "GenSigTimeoutTime_EVCU2" SG_ 754 IBS3_Error_Internal_2 0;
BA_ "GenSigTimeoutTime_GNMM" SG_ 754 IBS3_Error_Internal_2 0;
BA_ "GenSigTimeoutTime_HCP" SG_ 754 IBS3_Error_Internal_2 0;
BA_ "GenSigTimeoutTime_IPC" SG_ 754 IBS3_Error_Internal_2 0;
BA_ "GenSigTimeoutTime_RFHM" SG_ 754 IBS3_Error_Internal_2 0;
BA_ "GenSigTimeoutTime_SGW" SG_ 754 IBS3_Error_Internal_2 0;
BA_ "GenSigTimeoutTime_TCM" SG_ 754 IBS3_Error_Internal_2 0;
BA_ "GenSigTimeoutTime_AGSM" SG_ 754 RsErrIBS3_2 0;
BA_ "GenSigTimeoutTime_BCM" SG_ 754 RsErrIBS3_2 0;
BA_ "GenSigTimeoutTime_BSM" SG_ 754 RsErrIBS3_2 0;
BA_ "GenSigTimeoutTime_CADM" SG_ 754 RsErrIBS3_2 0;
BA_ "GenSigTimeoutTime_DMSM" SG_ 754 RsErrIBS3_2 0;
BA_ "GenSigTimeoutTime_DTCM" SG_ 754 RsErrIBS3_2 0;
BA_ "GenSigTimeoutTime_ECM" SG_ 754 RsErrIBS3_2 0;
BA_ "GenSigTimeoutTime_EVCU2" SG_ 754 RsErrIBS3_2 0;
BA_ "GenSigTimeoutTime_GNMM" SG_ 754 RsErrIBS3_2 0;
BA_ "GenSigTimeoutTime_HCP" SG_ 754 RsErrIBS3_2 0;
BA_ "GenSigTimeoutTime_IPC" SG_ 754 RsErrIBS3_2 0;
BA_ "GenSigTimeoutTime_RFHM" SG_ 754 RsErrIBS3_2 0;
BA_ "GenSigTimeoutTime_SGW" SG_ 754 RsErrIBS3_2 0;
BA_ "GenSigTimeoutTime_TCM" SG_ 754 RsErrIBS3_2 0;
BA_ "GenSigTimeoutTime_AGSM" SG_ 754 VoltBattFailStatus_2 0;
BA_ "GenSigTimeoutTime_BCM" SG_ 754 VoltBattFailStatus_2 0;
BA_ "GenSigTimeoutTime_BSM" SG_ 754 VoltBattFailStatus_2 0;
BA_ "GenSigTimeoutTime_CADM" SG_ 754 VoltBattFailStatus_2 0;
BA_ "GenSigTimeoutTime_DMSM" SG_ 754 VoltBattFailStatus_2 0;
BA_ "GenSigTimeoutTime_DTCM" SG_ 754 VoltBattFailStatus_2 0;
BA_ "GenSigTimeoutTime_ECM" SG_ 754 VoltBattFailStatus_2 0;
BA_ "GenSigTimeoutTime_EVCU2" SG_ 754 VoltBattFailStatus_2 0;
BA_ "GenSigTimeoutTime_GNMM" SG_ 754 VoltBattFailStatus_2 0;
BA_ "GenSigTimeoutTime_HCP" SG_ 754 VoltBattFailStatus_2 0;
BA_ "GenSigTimeoutTime_IPC" SG_ 754 VoltBattFailStatus_2 0;
BA_ "GenSigTimeoutTime_RFHM" SG_ 754 VoltBattFailStatus_2 0;
BA_ "GenSigTimeoutTime_SGW" SG_ 754 VoltBattFailStatus_2 0;
BA_ "GenSigTimeoutTime_TCM" SG_ 754 VoltBattFailStatus_2 0;
BA_ "GenSigTimeoutTime_AGSM" SG_ 1955 CRC_IBS3DATA2 0;
BA_ "GenSigTimeoutTime_BCM" SG_ 1955 CRC_IBS3DATA2 0;
BA_ "GenSigTimeoutTime_BSM" SG_ 1955 CRC_IBS3DATA2 0;
BA_ "GenSigTimeoutTime_CADM" SG_ 1955 CRC_IBS3DATA2 0;
BA_ "GenSigTimeoutTime_DMSM" SG_ 1955 CRC_IBS3DATA2 0;
BA_ "GenSigTimeoutTime_DTCM" SG_ 1955 CRC_IBS3DATA2 0;
BA_ "GenSigTimeoutTime_ECM" SG_ 1955 CRC_IBS3DATA2 0;
BA_ "GenSigTimeoutTime_GNMM" SG_ 1955 CRC_IBS3DATA2 0;
BA_ "GenSigTimeoutTime_HCP" SG_ 1955 CRC_IBS3DATA2 0;
BA_ "GenSigTimeoutTime_IPC" SG_ 1955 CRC_IBS3DATA2 0;
BA_ "GenSigTimeoutTime_RFHM" SG_ 1955 CRC_IBS3DATA2 0;
BA_ "GenSigTimeoutTime_SGW" SG_ 1955 CRC_IBS3DATA2 0;
BA_ "GenSigTimeoutTime_TCM" SG_ 1955 CRC_IBS3DATA2 0;
BA_ "GenSigTimeoutTime_AGSM" SG_ 1955 IBS3_CRC_IBS_1 0;
BA_ "GenSigTimeoutTime_BCM" SG_ 1955 IBS3_CRC_IBS_1 0;
BA_ "GenSigTimeoutTime_BSM" SG_ 1955 IBS3_CRC_IBS_1 0;
BA_ "GenSigTimeoutTime_DMSM" SG_ 1955 IBS3_CRC_IBS_1 0;
BA_ "GenSigTimeoutTime_DTCM" SG_ 1955 IBS3_CRC_IBS_1 0;
BA_ "GenSigTimeoutTime_ECM" SG_ 1955 IBS3_CRC_IBS_1 0;
BA_ "GenSigTimeoutTime_EVCU2" SG_ 1955 IBS3_CRC_IBS_1 0;
BA_ "GenSigTimeoutTime_GNMM" SG_ 1955 IBS3_CRC_IBS_1 0;
BA_ "GenSigTimeoutTime_HCP" SG_ 1955 IBS3_CRC_IBS_1 0;
BA_ "GenSigTimeoutTime_IPC" SG_ 1955 IBS3_CRC_IBS_1 0;
BA_ "GenSigTimeoutTime_RFHM" SG_ 1955 IBS3_CRC_IBS_1 0;
BA_ "GenSigTimeoutTime_SGW" SG_ 1955 IBS3_CRC_IBS_1 0;
BA_ "GenSigTimeoutTime_TCM" SG_ 1955 IBS3_CRC_IBS_1 0;
BA_ "GenSigTimeoutTime_AGSM" SG_ 1955 IBS3_CRC_IBS_2 0;
BA_ "GenSigTimeoutTime_BCM" SG_ 1955 IBS3_CRC_IBS_2 0;
BA_ "GenSigTimeoutTime_BSM" SG_ 1955 IBS3_CRC_IBS_2 0;
BA_ "GenSigTimeoutTime_DMSM" SG_ 1955 IBS3_CRC_IBS_2 0;
BA_ "GenSigTimeoutTime_DTCM" SG_ 1955 IBS3_CRC_IBS_2 0;
BA_ "GenSigTimeoutTime_ECM" SG_ 1955 IBS3_CRC_IBS_2 0;
BA_ "GenSigTimeoutTime_EVCU2" SG_ 1955 IBS3_CRC_IBS_2 0;
BA_ "GenSigTimeoutTime_GNMM" SG_ 1955 IBS3_CRC_IBS_2 0;
BA_ "GenSigTimeoutTime_HCP" SG_ 1955 IBS3_CRC_IBS_2 0;
BA_ "GenSigTimeoutTime_IPC" SG_ 1955 IBS3_CRC_IBS_2 0;
BA_ "GenSigTimeoutTime_RFHM" SG_ 1955 IBS3_CRC_IBS_2 0;
BA_ "GenSigTimeoutTime_SGW" SG_ 1955 IBS3_CRC_IBS_2 0;
BA_ "GenSigTimeoutTime_TCM" SG_ 1955 IBS3_CRC_IBS_2 0;
BA_ "GenSigTimeoutTime_AGSM" SG_ 1955 IBS3_FLAG_DISCONNECT 0;
BA_ "GenSigTimeoutTime_BCM" SG_ 1955 IBS3_FLAG_DISCONNECT 0;
BA_ "GenSigTimeoutTime_BSM" SG_ 1955 IBS3_FLAG_DISCONNECT 0;
BA_ "GenSigTimeoutTime_CADM" SG_ 1955 IBS3_FLAG_DISCONNECT 0;
BA_ "GenSigTimeoutTime_DMSM" SG_ 1955 IBS3_FLAG_DISCONNECT 0;
BA_ "GenSigTimeoutTime_DTCM" SG_ 1955 IBS3_FLAG_DISCONNECT 0;
BA_ "GenSigTimeoutTime_GNMM" SG_ 1955 IBS3_FLAG_DISCONNECT 0;
BA_ "GenSigTimeoutTime_HCP" SG_ 1955 IBS3_FLAG_DISCONNECT 0;
BA_ "GenSigTimeoutTime_IPC" SG_ 1955 IBS3_FLAG_DISCONNECT 0;
BA_ "GenSigTimeoutTime_RFHM" SG_ 1955 IBS3_FLAG_DISCONNECT 0;
BA_ "GenSigTimeoutTime_SGW" SG_ 1955 IBS3_FLAG_DISCONNECT 0;
BA_ "GenSigTimeoutTime_TCM" SG_ 1955 IBS3_FLAG_DISCONNECT 0;
BA_ "GenSigTimeoutTime_AGSM" SG_ 1955 IBS3_FLAG_DISCONNECT_ADAS 0;
BA_ "GenSigTimeoutTime_BCM" SG_ 1955 IBS3_FLAG_DISCONNECT_ADAS 0;
BA_ "GenSigTimeoutTime_BSM" SG_ 1955 IBS3_FLAG_DISCONNECT_ADAS 0;
BA_ "GenSigTimeoutTime_DMSM" SG_ 1955 IBS3_FLAG_DISCONNECT_ADAS 0;
BA_ "GenSigTimeoutTime_DTCM" SG_ 1955 IBS3_FLAG_DISCONNECT_ADAS 0;
BA_ "GenSigTimeoutTime_ECM" SG_ 1955 IBS3_FLAG_DISCONNECT_ADAS 0;
BA_ "GenSigTimeoutTime_EVCU2" SG_ 1955 IBS3_FLAG_DISCONNECT_ADAS 0;
BA_ "GenSigTimeoutTime_GNMM" SG_ 1955 IBS3_FLAG_DISCONNECT_ADAS 0;
BA_ "GenSigTimeoutTime_HCP" SG_ 1955 IBS3_FLAG_DISCONNECT_ADAS 0;
BA_ "GenSigTimeoutTime_IPC" SG_ 1955 IBS3_FLAG_DISCONNECT_ADAS 0;
BA_ "GenSigTimeoutTime_RFHM" SG_ 1955 IBS3_FLAG_DISCONNECT_ADAS 0;
BA_ "GenSigTimeoutTime_SGW" SG_ 1955 IBS3_FLAG_DISCONNECT_ADAS 0;
BA_ "GenSigTimeoutTime_TCM" SG_ 1955 IBS3_FLAG_DISCONNECT_ADAS 0;
BA_ "GenSigTimeoutTime_AGSM" SG_ 1955 IBS3_FLAG_DISCONNECT_ADAS_2 0;
BA_ "GenSigTimeoutTime_BCM" SG_ 1955 IBS3_FLAG_DISCONNECT_ADAS_2 0;
BA_ "GenSigTimeoutTime_BSM" SG_ 1955 IBS3_FLAG_DISCONNECT_ADAS_2 0;
BA_ "GenSigTimeoutTime_DMSM" SG_ 1955 IBS3_FLAG_DISCONNECT_ADAS_2 0;
BA_ "GenSigTimeoutTime_DTCM" SG_ 1955 IBS3_FLAG_DISCONNECT_ADAS_2 0;
BA_ "GenSigTimeoutTime_ECM" SG_ 1955 IBS3_FLAG_DISCONNECT_ADAS_2 0;
BA_ "GenSigTimeoutTime_EVCU2" SG_ 1955 IBS3_FLAG_DISCONNECT_ADAS_2 0;
BA_ "GenSigTimeoutTime_GNMM" SG_ 1955 IBS3_FLAG_DISCONNECT_ADAS_2 0;
BA_ "GenSigTimeoutTime_HCP" SG_ 1955 IBS3_FLAG_DISCONNECT_ADAS_2 0;
BA_ "GenSigTimeoutTime_IPC" SG_ 1955 IBS3_FLAG_DISCONNECT_ADAS_2 0;
BA_ "GenSigTimeoutTime_RFHM" SG_ 1955 IBS3_FLAG_DISCONNECT_ADAS_2 0;
BA_ "GenSigTimeoutTime_SGW" SG_ 1955 IBS3_FLAG_DISCONNECT_ADAS_2 0;
BA_ "GenSigTimeoutTime_TCM" SG_ 1955 IBS3_FLAG_DISCONNECT_ADAS_2 0;
BA_ "GenSigTimeoutTime_AGSM" SG_ 1955 IBS3_IBS_ADAS_OK 0;
BA_ "GenSigTimeoutTime_BCM" SG_ 1955 IBS3_IBS_ADAS_OK 0;
BA_ "GenSigTimeoutTime_BSM" SG_ 1955 IBS3_IBS_ADAS_OK 0;
BA_ "GenSigTimeoutTime_DMSM" SG_ 1955 IBS3_IBS_ADAS_OK 0;
BA_ "GenSigTimeoutTime_DTCM" SG_ 1955 IBS3_IBS_ADAS_OK 0;
BA_ "GenSigTimeoutTime_ECM" SG_ 1955 IBS3_IBS_ADAS_OK 0;
BA_ "GenSigTimeoutTime_EVCU2" SG_ 1955 IBS3_IBS_ADAS_OK 0;
BA_ "GenSigTimeoutTime_GNMM" SG_ 1955 IBS3_IBS_ADAS_OK 0;
BA_ "GenSigTimeoutTime_HCP" SG_ 1955 IBS3_IBS_ADAS_OK 0;
BA_ "GenSigTimeoutTime_IPC" SG_ 1955 IBS3_IBS_ADAS_OK 0;
BA_ "GenSigTimeoutTime_RFHM" SG_ 1955 IBS3_IBS_ADAS_OK 0;
BA_ "GenSigTimeoutTime_SGW" SG_ 1955 IBS3_IBS_ADAS_OK 0;
BA_ "GenSigTimeoutTime_TCM" SG_ 1955 IBS3_IBS_ADAS_OK 0;
BA_ "GenSigTimeoutTime_AGSM" SG_ 1955 IBS3_IBS_ADAS_OK_2 0;
BA_ "GenSigTimeoutTime_BCM" SG_ 1955 IBS3_IBS_ADAS_OK_2 0;
BA_ "GenSigTimeoutTime_BSM" SG_ 1955 IBS3_IBS_ADAS_OK_2 0;
BA_ "GenSigTimeoutTime_DMSM" SG_ 1955 IBS3_IBS_ADAS_OK_2 0;
BA_ "GenSigTimeoutTime_DTCM" SG_ 1955 IBS3_IBS_ADAS_OK_2 0;
BA_ "GenSigTimeoutTime_ECM" SG_ 1955 IBS3_IBS_ADAS_OK_2 0;
BA_ "GenSigTimeoutTime_EVCU2" SG_ 1955 IBS3_IBS_ADAS_OK_2 0;
BA_ "GenSigTimeoutTime_GNMM" SG_ 1955 IBS3_IBS_ADAS_OK_2 0;
BA_ "GenSigTimeoutTime_HCP" SG_ 1955 IBS3_IBS_ADAS_OK_2 0;
BA_ "GenSigTimeoutTime_IPC" SG_ 1955 IBS3_IBS_ADAS_OK_2 0;
BA_ "GenSigTimeoutTime_RFHM" SG_ 1955 IBS3_IBS_ADAS_OK_2 0;
BA_ "GenSigTimeoutTime_SGW" SG_ 1955 IBS3_IBS_ADAS_OK_2 0;
BA_ "GenSigTimeoutTime_TCM" SG_ 1955 IBS3_IBS_ADAS_OK_2 0;
BA_ "GenSigTimeoutTime_AGSM" SG_ 1955 IBS3_MC_IBS_1 0;
BA_ "GenSigTimeoutTime_BCM" SG_ 1955 IBS3_MC_IBS_1 0;
BA_ "GenSigTimeoutTime_BSM" SG_ 1955 IBS3_MC_IBS_1 0;
BA_ "GenSigTimeoutTime_DMSM" SG_ 1955 IBS3_MC_IBS_1 0;
BA_ "GenSigTimeoutTime_DTCM" SG_ 1955 IBS3_MC_IBS_1 0;
BA_ "GenSigTimeoutTime_ECM" SG_ 1955 IBS3_MC_IBS_1 0;
BA_ "GenSigTimeoutTime_EVCU2" SG_ 1955 IBS3_MC_IBS_1 0;
BA_ "GenSigTimeoutTime_GNMM" SG_ 1955 IBS3_MC_IBS_1 0;
BA_ "GenSigTimeoutTime_HCP" SG_ 1955 IBS3_MC_IBS_1 0;
BA_ "GenSigTimeoutTime_IPC" SG_ 1955 IBS3_MC_IBS_1 0;
BA_ "GenSigTimeoutTime_RFHM" SG_ 1955 IBS3_MC_IBS_1 0;
BA_ "GenSigTimeoutTime_SGW" SG_ 1955 IBS3_MC_IBS_1 0;
BA_ "GenSigTimeoutTime_TCM" SG_ 1955 IBS3_MC_IBS_1 0;
BA_ "GenSigTimeoutTime_AGSM" SG_ 1955 IBS3_MC_IBS_2 0;
BA_ "GenSigTimeoutTime_BCM" SG_ 1955 IBS3_MC_IBS_2 0;
BA_ "GenSigTimeoutTime_BSM" SG_ 1955 IBS3_MC_IBS_2 0;
BA_ "GenSigTimeoutTime_DMSM" SG_ 1955 IBS3_MC_IBS_2 0;
BA_ "GenSigTimeoutTime_DTCM" SG_ 1955 IBS3_MC_IBS_2 0;
BA_ "GenSigTimeoutTime_ECM" SG_ 1955 IBS3_MC_IBS_2 0;
BA_ "GenSigTimeoutTime_EVCU2" SG_ 1955 IBS3_MC_IBS_2 0;
BA_ "GenSigTimeoutTime_GNMM" SG_ 1955 IBS3_MC_IBS_2 0;
BA_ "GenSigTimeoutTime_HCP" SG_ 1955 IBS3_MC_IBS_2 0;
BA_ "GenSigTimeoutTime_IPC" SG_ 1955 IBS3_MC_IBS_2 0;
BA_ "GenSigTimeoutTime_RFHM" SG_ 1955 IBS3_MC_IBS_2 0;
BA_ "GenSigTimeoutTime_SGW" SG_ 1955 IBS3_MC_IBS_2 0;
BA_ "GenSigTimeoutTime_TCM" SG_ 1955 IBS3_MC_IBS_2 0;
BA_ "GenSigStartValue" SG_ 1955 IBS3_Q_received 65535;
BA_ "GenSigTimeoutTime_AGSM" SG_ 1955 IBS3_Q_received 0;
BA_ "GenSigTimeoutTime_BCM" SG_ 1955 IBS3_Q_received 0;
BA_ "GenSigTimeoutTime_BSM" SG_ 1955 IBS3_Q_received 0;
BA_ "GenSigTimeoutTime_CADM" SG_ 1955 IBS3_Q_received 0;
BA_ "GenSigTimeoutTime_DMSM" SG_ 1955 IBS3_Q_received 0;
BA_ "GenSigTimeoutTime_DTCM" SG_ 1955 IBS3_Q_received 0;
BA_ "GenSigTimeoutTime_ECM" SG_ 1955 IBS3_Q_received 0;
BA_ "GenSigTimeoutTime_GNMM" SG_ 1955 IBS3_Q_received 0;
BA_ "GenSigTimeoutTime_HCP" SG_ 1955 IBS3_Q_received 0;
BA_ "GenSigTimeoutTime_IPC" SG_ 1955 IBS3_Q_received 0;
BA_ "GenSigTimeoutTime_RFHM" SG_ 1955 IBS3_Q_received 0;
BA_ "GenSigTimeoutTime_SGW" SG_ 1955 IBS3_Q_received 0;
BA_ "GenSigTimeoutTime_TCM" SG_ 1955 IBS3_Q_received 0;
BA_ "GenSigStartValue" SG_ 1955 IBS3_Q_released 65535;
BA_ "GenSigTimeoutTime_AGSM" SG_ 1955 IBS3_Q_released 0;
BA_ "GenSigTimeoutTime_BCM" SG_ 1955 IBS3_Q_released 0;
BA_ "GenSigTimeoutTime_BSM" SG_ 1955 IBS3_Q_released 0;
BA_ "GenSigTimeoutTime_CADM" SG_ 1955 IBS3_Q_released 0;
BA_ "GenSigTimeoutTime_DMSM" SG_ 1955 IBS3_Q_released 0;
BA_ "GenSigTimeoutTime_DTCM" SG_ 1955 IBS3_Q_released 0;
BA_ "GenSigTimeoutTime_ECM" SG_ 1955 IBS3_Q_released 0;
BA_ "GenSigTimeoutTime_GNMM" SG_ 1955 IBS3_Q_released 0;
BA_ "GenSigTimeoutTime_HCP" SG_ 1955 IBS3_Q_released 0;
BA_ "GenSigTimeoutTime_IPC" SG_ 1955 IBS3_Q_released 0;
BA_ "GenSigTimeoutTime_RFHM" SG_ 1955 IBS3_Q_released 0;
BA_ "GenSigTimeoutTime_SGW" SG_ 1955 IBS3_Q_released 0;
BA_ "GenSigTimeoutTime_TCM" SG_ 1955 IBS3_Q_released 0;
BA_ "GenSigStartValue" SG_ 1955 IBS3_R_Batt 255;
BA_ "GenSigTimeoutTime_AGSM" SG_ 1955 IBS3_R_Batt 0;
BA_ "GenSigTimeoutTime_BCM" SG_ 1955 IBS3_R_Batt 0;
BA_ "GenSigTimeoutTime_BSM" SG_ 1955 IBS3_R_Batt 0;
BA_ "GenSigTimeoutTime_CADM" SG_ 1955 IBS3_R_Batt 0;
BA_ "GenSigTimeoutTime_DMSM" SG_ 1955 IBS3_R_Batt 0;
BA_ "GenSigTimeoutTime_DTCM" SG_ 1955 IBS3_R_Batt 0;
BA_ "GenSigTimeoutTime_ECM" SG_ 1955 IBS3_R_Batt 0;
BA_ "GenSigTimeoutTime_GNMM" SG_ 1955 IBS3_R_Batt 0;
BA_ "GenSigTimeoutTime_HCP" SG_ 1955 IBS3_R_Batt 0;
BA_ "GenSigTimeoutTime_IPC" SG_ 1955 IBS3_R_Batt 0;
BA_ "GenSigTimeoutTime_RFHM" SG_ 1955 IBS3_R_Batt 0;
BA_ "GenSigTimeoutTime_SGW" SG_ 1955 IBS3_R_Batt 0;
BA_ "GenSigTimeoutTime_TCM" SG_ 1955 IBS3_R_Batt 0;
BA_ "GenSigStartValue" SG_ 1955 IBS3_R_Batt_25 255;
BA_ "GenSigTimeoutTime_AGSM" SG_ 1955 IBS3_R_Batt_25 0;
BA_ "GenSigTimeoutTime_BCM" SG_ 1955 IBS3_R_Batt_25 0;
BA_ "GenSigTimeoutTime_BSM" SG_ 1955 IBS3_R_Batt_25 0;
BA_ "GenSigTimeoutTime_CADM" SG_ 1955 IBS3_R_Batt_25 0;
BA_ "GenSigTimeoutTime_DMSM" SG_ 1955 IBS3_R_Batt_25 0;
BA_ "GenSigTimeoutTime_DTCM" SG_ 1955 IBS3_R_Batt_25 0;
BA_ "GenSigTimeoutTime_ECM" SG_ 1955 IBS3_R_Batt_25 0;
BA_ "GenSigTimeoutTime_GNMM" SG_ 1955 IBS3_R_Batt_25 0;
BA_ "GenSigTimeoutTime_HCP" SG_ 1955 IBS3_R_Batt_25 0;
BA_ "GenSigTimeoutTime_IPC" SG_ 1955 IBS3_R_Batt_25 0;
BA_ "GenSigTimeoutTime_RFHM" SG_ 1955 IBS3_R_Batt_25 0;
BA_ "GenSigTimeoutTime_SGW" SG_ 1955 IBS3_R_Batt_25 0;
BA_ "GenSigTimeoutTime_TCM" SG_ 1955 IBS3_R_Batt_25 0;
BA_ "GenSigStartValue" SG_ 1955 IBS3_SOC 127;
BA_ "GenSigTimeoutTime_AGSM" SG_ 1955 IBS3_SOC 0;
BA_ "GenSigTimeoutTime_BCM" SG_ 1955 IBS3_SOC 0;
BA_ "GenSigTimeoutTime_BSM" SG_ 1955 IBS3_SOC 0;
BA_ "GenSigTimeoutTime_DMSM" SG_ 1955 IBS3_SOC 0;
BA_ "GenSigTimeoutTime_DTCM" SG_ 1955 IBS3_SOC 0;
BA_ "GenSigTimeoutTime_GNMM" SG_ 1955 IBS3_SOC 0;
BA_ "GenSigTimeoutTime_IPC" SG_ 1955 IBS3_SOC 0;
BA_ "GenSigTimeoutTime_RFHM" SG_ 1955 IBS3_SOC 0;
BA_ "GenSigTimeoutTime_TCM" SG_ 1955 IBS3_SOC 0;
BA_ "GenSigTimeoutTime_AGSM" SG_ 1955 IBS3_SOC_Accuracy 0;
BA_ "GenSigTimeoutTime_BCM" SG_ 1955 IBS3_SOC_Accuracy 0;
BA_ "GenSigTimeoutTime_BSM" SG_ 1955 IBS3_SOC_Accuracy 0;
BA_ "GenSigTimeoutTime_CADM" SG_ 1955 IBS3_SOC_Accuracy 0;
BA_ "GenSigTimeoutTime_DMSM" SG_ 1955 IBS3_SOC_Accuracy 0;
BA_ "GenSigTimeoutTime_DTCM" SG_ 1955 IBS3_SOC_Accuracy 0;
BA_ "GenSigTimeoutTime_GNMM" SG_ 1955 IBS3_SOC_Accuracy 0;
BA_ "GenSigTimeoutTime_IPC" SG_ 1955 IBS3_SOC_Accuracy 0;
BA_ "GenSigTimeoutTime_RFHM" SG_ 1955 IBS3_SOC_Accuracy 0;
BA_ "GenSigTimeoutTime_TCM" SG_ 1955 IBS3_SOC_Accuracy 0;
BA_ "GenSigStartValue" SG_ 1955 IBS3_SOF_Q 255;
BA_ "GenSigTimeoutTime_AGSM" SG_ 1955 IBS3_SOF_Q 0;
BA_ "GenSigTimeoutTime_BCM" SG_ 1955 IBS3_SOF_Q 0;
BA_ "GenSigTimeoutTime_BSM" SG_ 1955 IBS3_SOF_Q 0;
BA_ "GenSigTimeoutTime_CADM" SG_ 1955 IBS3_SOF_Q 0;
BA_ "GenSigTimeoutTime_DMSM" SG_ 1955 IBS3_SOF_Q 0;
BA_ "GenSigTimeoutTime_DTCM" SG_ 1955 IBS3_SOF_Q 0;
BA_ "GenSigTimeoutTime_ECM" SG_ 1955 IBS3_SOF_Q 0;
BA_ "GenSigTimeoutTime_GNMM" SG_ 1955 IBS3_SOF_Q 0;
BA_ "GenSigTimeoutTime_HCP" SG_ 1955 IBS3_SOF_Q 0;
BA_ "GenSigTimeoutTime_IPC" SG_ 1955 IBS3_SOF_Q 0;
BA_ "GenSigTimeoutTime_RFHM" SG_ 1955 IBS3_SOF_Q 0;
BA_ "GenSigTimeoutTime_SGW" SG_ 1955 IBS3_SOF_Q 0;
BA_ "GenSigTimeoutTime_TCM" SG_ 1955 IBS3_SOF_Q 0;
BA_ "GenSigTimeoutTime_AGSM" SG_ 1955 IBS3_SOF_Q_Accuracy 0;
BA_ "GenSigTimeoutTime_BCM" SG_ 1955 IBS3_SOF_Q_Accuracy 0;
BA_ "GenSigTimeoutTime_BSM" SG_ 1955 IBS3_SOF_Q_Accuracy 0;
BA_ "GenSigTimeoutTime_CADM" SG_ 1955 IBS3_SOF_Q_Accuracy 0;
BA_ "GenSigTimeoutTime_DMSM" SG_ 1955 IBS3_SOF_Q_Accuracy 0;
BA_ "GenSigTimeoutTime_DTCM" SG_ 1955 IBS3_SOF_Q_Accuracy 0;
BA_ "GenSigTimeoutTime_ECM" SG_ 1955 IBS3_SOF_Q_Accuracy 0;
BA_ "GenSigTimeoutTime_GNMM" SG_ 1955 IBS3_SOF_Q_Accuracy 0;
BA_ "GenSigTimeoutTime_HCP" SG_ 1955 IBS3_SOF_Q_Accuracy 0;
BA_ "GenSigTimeoutTime_IPC" SG_ 1955 IBS3_SOF_Q_Accuracy 0;
BA_ "GenSigTimeoutTime_RFHM" SG_ 1955 IBS3_SOF_Q_Accuracy 0;
BA_ "GenSigTimeoutTime_SGW" SG_ 1955 IBS3_SOF_Q_Accuracy 0;
BA_ "GenSigTimeoutTime_TCM" SG_ 1955 IBS3_SOF_Q_Accuracy 0;
BA_ "GenSigStartValue" SG_ 1955 IBS3_SOH_COR 127;
BA_ "GenSigTimeoutTime_AGSM" SG_ 1955 IBS3_SOH_COR 0;
BA_ "GenSigTimeoutTime_BCM" SG_ 1955 IBS3_SOH_COR 0;
BA_ "GenSigTimeoutTime_BSM" SG_ 1955 IBS3_SOH_COR 0;
BA_ "GenSigTimeoutTime_CADM" SG_ 1955 IBS3_SOH_COR 0;
BA_ "GenSigTimeoutTime_DMSM" SG_ 1955 IBS3_SOH_COR 0;
BA_ "GenSigTimeoutTime_DTCM" SG_ 1955 IBS3_SOH_COR 0;
BA_ "GenSigTimeoutTime_ECM" SG_ 1955 IBS3_SOH_COR 0;
BA_ "GenSigTimeoutTime_GNMM" SG_ 1955 IBS3_SOH_COR 0;
BA_ "GenSigTimeoutTime_HCP" SG_ 1955 IBS3_SOH_COR 0;
BA_ "GenSigTimeoutTime_IPC" SG_ 1955 IBS3_SOH_COR 0;
BA_ "GenSigTimeoutTime_RFHM" SG_ 1955 IBS3_SOH_COR 0;
BA_ "GenSigTimeoutTime_SGW" SG_ 1955 IBS3_SOH_COR 0;
BA_ "GenSigTimeoutTime_TCM" SG_ 1955 IBS3_SOH_COR 0;
BA_ "GenSigTimeoutTime_AGSM" SG_ 1955 IBS3_SOH_COR_Accuracy 0;
BA_ "GenSigTimeoutTime_BCM" SG_ 1955 IBS3_SOH_COR_Accuracy 0;
BA_ "GenSigTimeoutTime_BSM" SG_ 1955 IBS3_SOH_COR_Accuracy 0;
BA_ "GenSigTimeoutTime_CADM" SG_ 1955 IBS3_SOH_COR_Accuracy 0;
BA_ "GenSigTimeoutTime_DMSM" SG_ 1955 IBS3_SOH_COR_Accuracy 0;
BA_ "GenSigTimeoutTime_DTCM" SG_ 1955 IBS3_SOH_COR_Accuracy 0;
BA_ "GenSigTimeoutTime_ECM" SG_ 1955 IBS3_SOH_COR_Accuracy 0;
BA_ "GenSigTimeoutTime_GNMM" SG_ 1955 IBS3_SOH_COR_Accuracy 0;
BA_ "GenSigTimeoutTime_HCP" SG_ 1955 IBS3_SOH_COR_Accuracy 0;
BA_ "GenSigTimeoutTime_IPC" SG_ 1955 IBS3_SOH_COR_Accuracy 0;
BA_ "GenSigTimeoutTime_RFHM" SG_ 1955 IBS3_SOH_COR_Accuracy 0;
BA_ "GenSigTimeoutTime_SGW" SG_ 1955 IBS3_SOH_COR_Accuracy 0;
BA_ "GenSigTimeoutTime_TCM" SG_ 1955 IBS3_SOH_COR_Accuracy 0;
BA_ "GenSigStartValue" SG_ 1955 IBS3_SOH_Q 127;
BA_ "GenSigTimeoutTime_AGSM" SG_ 1955 IBS3_SOH_Q 0;
BA_ "GenSigTimeoutTime_BCM" SG_ 1955 IBS3_SOH_Q 0;
BA_ "GenSigTimeoutTime_BSM" SG_ 1955 IBS3_SOH_Q 0;
BA_ "GenSigTimeoutTime_CADM" SG_ 1955 IBS3_SOH_Q 0;
BA_ "GenSigTimeoutTime_DMSM" SG_ 1955 IBS3_SOH_Q 0;
BA_ "GenSigTimeoutTime_DTCM" SG_ 1955 IBS3_SOH_Q 0;
BA_ "GenSigTimeoutTime_GNMM" SG_ 1955 IBS3_SOH_Q 0;
BA_ "GenSigTimeoutTime_HCP" SG_ 1955 IBS3_SOH_Q 0;
BA_ "GenSigTimeoutTime_IPC" SG_ 1955 IBS3_SOH_Q 0;
BA_ "GenSigTimeoutTime_RFHM" SG_ 1955 IBS3_SOH_Q 0;
BA_ "GenSigTimeoutTime_SGW" SG_ 1955 IBS3_SOH_Q 0;
BA_ "GenSigTimeoutTime_TCM" SG_ 1955 IBS3_SOH_Q 0;
BA_ "GenSigTimeoutTime_AGSM" SG_ 1955 IBS3_SOH_Q_Accuracy 0;
BA_ "GenSigTimeoutTime_BCM" SG_ 1955 IBS3_SOH_Q_Accuracy 0;
BA_ "GenSigTimeoutTime_BSM" SG_ 1955 IBS3_SOH_Q_Accuracy 0;
BA_ "GenSigTimeoutTime_CADM" SG_ 1955 IBS3_SOH_Q_Accuracy 0;
BA_ "GenSigTimeoutTime_DMSM" SG_ 1955 IBS3_SOH_Q_Accuracy 0;
BA_ "GenSigTimeoutTime_DTCM" SG_ 1955 IBS3_SOH_Q_Accuracy 0;
BA_ "GenSigTimeoutTime_GNMM" SG_ 1955 IBS3_SOH_Q_Accuracy 0;
BA_ "GenSigTimeoutTime_HCP" SG_ 1955 IBS3_SOH_Q_Accuracy 0;
BA_ "GenSigTimeoutTime_IPC" SG_ 1955 IBS3_SOH_Q_Accuracy 0;
BA_ "GenSigTimeoutTime_RFHM" SG_ 1955 IBS3_SOH_Q_Accuracy 0;
BA_ "GenSigTimeoutTime_SGW" SG_ 1955 IBS3_SOH_Q_Accuracy 0;
BA_ "GenSigTimeoutTime_TCM" SG_ 1955 IBS3_SOH_Q_Accuracy 0;
BA_ "GenSigStartValue" SG_ 1955 IBS3_SOH_SUL 127;
BA_ "GenSigTimeoutTime_AGSM" SG_ 1955 IBS3_SOH_SUL 0;
BA_ "GenSigTimeoutTime_BCM" SG_ 1955 IBS3_SOH_SUL 0;
BA_ "GenSigTimeoutTime_BSM" SG_ 1955 IBS3_SOH_SUL 0;
BA_ "GenSigTimeoutTime_CADM" SG_ 1955 IBS3_SOH_SUL 0;
BA_ "GenSigTimeoutTime_DMSM" SG_ 1955 IBS3_SOH_SUL 0;
BA_ "GenSigTimeoutTime_DTCM" SG_ 1955 IBS3_SOH_SUL 0;
BA_ "GenSigTimeoutTime_ECM" SG_ 1955 IBS3_SOH_SUL 0;
BA_ "GenSigTimeoutTime_GNMM" SG_ 1955 IBS3_SOH_SUL 0;
BA_ "GenSigTimeoutTime_HCP" SG_ 1955 IBS3_SOH_SUL 0;
BA_ "GenSigTimeoutTime_IPC" SG_ 1955 IBS3_SOH_SUL 0;
BA_ "GenSigTimeoutTime_RFHM" SG_ 1955 IBS3_SOH_SUL 0;
BA_ "GenSigTimeoutTime_SGW" SG_ 1955 IBS3_SOH_SUL 0;
BA_ "GenSigTimeoutTime_TCM" SG_ 1955 IBS3_SOH_SUL 0;
BA_ "GenSigTimeoutTime_AGSM" SG_ 1955 IBS3_SOH_SUL_Accuracy 0;
BA_ "GenSigTimeoutTime_BCM" SG_ 1955 IBS3_SOH_SUL_Accuracy 0;
BA_ "GenSigTimeoutTime_BSM" SG_ 1955 IBS3_SOH_SUL_Accuracy 0;
BA_ "GenSigTimeoutTime_CADM" SG_ 1955 IBS3_SOH_SUL_Accuracy 0;
BA_ "GenSigTimeoutTime_DMSM" SG_ 1955 IBS3_SOH_SUL_Accuracy 0;
BA_ "GenSigTimeoutTime_DTCM" SG_ 1955 IBS3_SOH_SUL_Accuracy 0;
BA_ "GenSigTimeoutTime_ECM" SG_ 1955 IBS3_SOH_SUL_Accuracy 0;
BA_ "GenSigTimeoutTime_GNMM" SG_ 1955 IBS3_SOH_SUL_Accuracy 0;
BA_ "GenSigTimeoutTime_HCP" SG_ 1955 IBS3_SOH_SUL_Accuracy 0;
BA_ "GenSigTimeoutTime_IPC" SG_ 1955 IBS3_SOH_SUL_Accuracy 0;
BA_ "GenSigTimeoutTime_RFHM" SG_ 1955 IBS3_SOH_SUL_Accuracy 0;
BA_ "GenSigTimeoutTime_SGW" SG_ 1955 IBS3_SOH_SUL_Accuracy 0;
BA_ "GenSigTimeoutTime_TCM" SG_ 1955 IBS3_SOH_SUL_Accuracy 0;
BA_ "GenSigStartValue" SG_ 1955 IBS3_T_BATT 255;
BA_ "GenSigTimeoutTime_AGSM" SG_ 1955 IBS3_T_BATT 0;
BA_ "GenSigTimeoutTime_BCM" SG_ 1955 IBS3_T_BATT 0;
BA_ "GenSigTimeoutTime_BSM" SG_ 1955 IBS3_T_BATT 0;
BA_ "GenSigTimeoutTime_CADM" SG_ 1955 IBS3_T_BATT 0;
BA_ "GenSigTimeoutTime_DMSM" SG_ 1955 IBS3_T_BATT 0;
BA_ "GenSigTimeoutTime_DTCM" SG_ 1955 IBS3_T_BATT 0;
BA_ "GenSigTimeoutTime_GNMM" SG_ 1955 IBS3_T_BATT 0;
BA_ "GenSigTimeoutTime_IPC" SG_ 1955 IBS3_T_BATT 0;
BA_ "GenSigTimeoutTime_RFHM" SG_ 1955 IBS3_T_BATT 0;
BA_ "GenSigTimeoutTime_TCM" SG_ 1955 IBS3_T_BATT 0;
BA_ "GenSigTimeoutTime_AGSM" SG_ 1955 IBS3_TempFailStatus 0;
BA_ "GenSigTimeoutTime_BCM" SG_ 1955 IBS3_TempFailStatus 0;
BA_ "GenSigTimeoutTime_BSM" SG_ 1955 IBS3_TempFailStatus 0;
BA_ "GenSigTimeoutTime_CADM" SG_ 1955 IBS3_TempFailStatus 0;
BA_ "GenSigTimeoutTime_DMSM" SG_ 1955 IBS3_TempFailStatus 0;
BA_ "GenSigTimeoutTime_DTCM" SG_ 1955 IBS3_TempFailStatus 0;
BA_ "GenSigTimeoutTime_GNMM" SG_ 1955 IBS3_TempFailStatus 0;
BA_ "GenSigTimeoutTime_IPC" SG_ 1955 IBS3_TempFailStatus 0;
BA_ "GenSigTimeoutTime_RFHM" SG_ 1955 IBS3_TempFailStatus 0;
BA_ "GenSigTimeoutTime_TCM" SG_ 1955 IBS3_TempFailStatus 0;
BA_ "GenSigTimeoutTime_AGSM" SG_ 1955 IBS3_Tm_Lst_Reset_Days 0;
BA_ "GenSigTimeoutTime_BCM" SG_ 1955 IBS3_Tm_Lst_Reset_Days 0;
BA_ "GenSigTimeoutTime_BSM" SG_ 1955 IBS3_Tm_Lst_Reset_Days 0;
BA_ "GenSigTimeoutTime_CADM" SG_ 1955 IBS3_Tm_Lst_Reset_Days 0;
BA_ "GenSigTimeoutTime_DMSM" SG_ 1955 IBS3_Tm_Lst_Reset_Days 0;
BA_ "GenSigTimeoutTime_DTCM" SG_ 1955 IBS3_Tm_Lst_Reset_Days 0;
BA_ "GenSigTimeoutTime_ECM" SG_ 1955 IBS3_Tm_Lst_Reset_Days 0;
BA_ "GenSigTimeoutTime_GNMM" SG_ 1955 IBS3_Tm_Lst_Reset_Days 0;
BA_ "GenSigTimeoutTime_HCP" SG_ 1955 IBS3_Tm_Lst_Reset_Days 0;
BA_ "GenSigTimeoutTime_IPC" SG_ 1955 IBS3_Tm_Lst_Reset_Days 0;
BA_ "GenSigTimeoutTime_RFHM" SG_ 1955 IBS3_Tm_Lst_Reset_Days 0;
BA_ "GenSigTimeoutTime_SGW" SG_ 1955 IBS3_Tm_Lst_Reset_Days 0;
BA_ "GenSigTimeoutTime_TCM" SG_ 1955 IBS3_Tm_Lst_Reset_Days 0;
BA_ "GenSigTimeoutTime_AGSM" SG_ 1955 IBS3_Tm_Lst_Reset_Sec 0;
BA_ "GenSigTimeoutTime_BCM" SG_ 1955 IBS3_Tm_Lst_Reset_Sec 0;
BA_ "GenSigTimeoutTime_BSM" SG_ 1955 IBS3_Tm_Lst_Reset_Sec 0;
BA_ "GenSigTimeoutTime_CADM" SG_ 1955 IBS3_Tm_Lst_Reset_Sec 0;
BA_ "GenSigTimeoutTime_DMSM" SG_ 1955 IBS3_Tm_Lst_Reset_Sec 0;
BA_ "GenSigTimeoutTime_DTCM" SG_ 1955 IBS3_Tm_Lst_Reset_Sec 0;
BA_ "GenSigTimeoutTime_ECM" SG_ 1955 IBS3_Tm_Lst_Reset_Sec 0;
BA_ "GenSigTimeoutTime_GNMM" SG_ 1955 IBS3_Tm_Lst_Reset_Sec 0;
BA_ "GenSigTimeoutTime_HCP" SG_ 1955 IBS3_Tm_Lst_Reset_Sec 0;
BA_ "GenSigTimeoutTime_IPC" SG_ 1955 IBS3_Tm_Lst_Reset_Sec 0;
BA_ "GenSigTimeoutTime_RFHM" SG_ 1955 IBS3_Tm_Lst_Reset_Sec 0;
BA_ "GenSigTimeoutTime_SGW" SG_ 1955 IBS3_Tm_Lst_Reset_Sec 0;
BA_ "GenSigTimeoutTime_TCM" SG_ 1955 IBS3_Tm_Lst_Reset_Sec 0;
BA_ "GenSigTimeoutTime_AGSM" SG_ 1955 MessageCounter_IBS3DATA2 0;
BA_ "GenSigTimeoutTime_BCM" SG_ 1955 MessageCounter_IBS3DATA2 0;
BA_ "GenSigTimeoutTime_BSM" SG_ 1955 MessageCounter_IBS3DATA2 0;
BA_ "GenSigTimeoutTime_CADM" SG_ 1955 MessageCounter_IBS3DATA2 0;
BA_ "GenSigTimeoutTime_DMSM" SG_ 1955 MessageCounter_IBS3DATA2 0;
BA_ "GenSigTimeoutTime_DTCM" SG_ 1955 MessageCounter_IBS3DATA2 0;
BA_ "GenSigTimeoutTime_ECM" SG_ 1955 MessageCounter_IBS3DATA2 0;
BA_ "GenSigTimeoutTime_GNMM" SG_ 1955 MessageCounter_IBS3DATA2 0;
BA_ "GenSigTimeoutTime_HCP" SG_ 1955 MessageCounter_IBS3DATA2 0;
BA_ "GenSigTimeoutTime_IPC" SG_ 1955 MessageCounter_IBS3DATA2 0;
BA_ "GenSigTimeoutTime_RFHM" SG_ 1955 MessageCounter_IBS3DATA2 0;
BA_ "GenSigTimeoutTime_SGW" SG_ 1955 MessageCounter_IBS3DATA2 0;
BA_ "GenSigTimeoutTime_TCM" SG_ 1955 MessageCounter_IBS3DATA2 0;
BA_ "GenSigSendType" SG_ 100 ControlEncodingReq 1;
BA_ "GenSigTimeoutTime_AGSM" SG_ 100 ControlEncodingReq 0;
BA_ "GenSigTimeoutTime_BSM" SG_ 100 ControlEncodingReq 0;
BA_ "GenSigTimeoutTime_CADM" SG_ 100 ControlEncodingReq 0;
BA_ "GenSigTimeoutTime_DMSM" SG_ 100 ControlEncodingReq 0;
BA_ "GenSigTimeoutTime_DTCM" SG_ 100 ControlEncodingReq 0;
BA_ "GenSigTimeoutTime_ECM" SG_ 100 ControlEncodingReq 0;
BA_ "GenSigTimeoutTime_EVCU2" SG_ 100 ControlEncodingReq 0;
BA_ "GenSigTimeoutTime_GNMM" SG_ 100 ControlEncodingReq 0;
BA_ "GenSigTimeoutTime_HCP" SG_ 100 ControlEncodingReq 0;
BA_ "GenSigTimeoutTime_IPC" SG_ 100 ControlEncodingReq 0;
BA_ "GenSigTimeoutTime_RFHM" SG_ 100 ControlEncodingReq 0;
BA_ "GenSigTimeoutTime_SGW" SG_ 100 ControlEncodingReq 0;
BA_ "GenSigTimeoutTime_TCM" SG_ 100 ControlEncodingReq 0;
BA_ "GenSigTimeoutTime_AGSM" SG_ 100 f1_1 0;
BA_ "GenSigTimeoutTime_BSM" SG_ 100 f1_1 0;
BA_ "GenSigTimeoutTime_CADM" SG_ 100 f1_1 0;
BA_ "GenSigTimeoutTime_DMSM" SG_ 100 f1_1 0;
BA_ "GenSigTimeoutTime_DTCM" SG_ 100 f1_1 0;
BA_ "GenSigTimeoutTime_ECM" SG_ 100 f1_1 0;
BA_ "GenSigTimeoutTime_EVCU2" SG_ 100 f1_1 0;
BA_ "GenSigTimeoutTime_GNMM" SG_ 100 f1_1 0;
BA_ "GenSigTimeoutTime_HCP" SG_ 100 f1_1 0;
BA_ "GenSigTimeoutTime_IPC" SG_ 100 f1_1 0;
BA_ "GenSigTimeoutTime_RFHM" SG_ 100 f1_1 0;
BA_ "GenSigTimeoutTime_SGW" SG_ 100 f1_1 0;
BA_ "GenSigTimeoutTime_TCM" SG_ 100 f1_1 0;
BA_ "GenSigTimeoutTime_AGSM" SG_ 100 f1_2 0;
BA_ "GenSigTimeoutTime_BSM" SG_ 100 f1_2 0;
BA_ "GenSigTimeoutTime_CADM" SG_ 100 f1_2 0;
BA_ "GenSigTimeoutTime_DMSM" SG_ 100 f1_2 0;
BA_ "GenSigTimeoutTime_DTCM" SG_ 100 f1_2 0;
BA_ "GenSigTimeoutTime_ECM" SG_ 100 f1_2 0;
BA_ "GenSigTimeoutTime_EVCU2" SG_ 100 f1_2 0;
BA_ "GenSigTimeoutTime_GNMM" SG_ 100 f1_2 0;
BA_ "GenSigTimeoutTime_HCP" SG_ 100 f1_2 0;
BA_ "GenSigTimeoutTime_IPC" SG_ 100 f1_2 0;
BA_ "GenSigTimeoutTime_RFHM" SG_ 100 f1_2 0;
BA_ "GenSigTimeoutTime_SGW" SG_ 100 f1_2 0;
BA_ "GenSigTimeoutTime_TCM" SG_ 100 f1_2 0;
BA_ "GenSigTimeoutTime_AGSM" SG_ 100 rnd_1 0;
BA_ "GenSigTimeoutTime_BSM" SG_ 100 rnd_1 0;
BA_ "GenSigTimeoutTime_CADM" SG_ 100 rnd_1 0;
BA_ "GenSigTimeoutTime_DMSM" SG_ 100 rnd_1 0;
BA_ "GenSigTimeoutTime_DTCM" SG_ 100 rnd_1 0;
BA_ "GenSigTimeoutTime_ECM" SG_ 100 rnd_1 0;
BA_ "GenSigTimeoutTime_EVCU2" SG_ 100 rnd_1 0;
BA_ "GenSigTimeoutTime_GNMM" SG_ 100 rnd_1 0;
BA_ "GenSigTimeoutTime_HCP" SG_ 100 rnd_1 0;
BA_ "GenSigTimeoutTime_IPC" SG_ 100 rnd_1 0;
BA_ "GenSigTimeoutTime_RFHM" SG_ 100 rnd_1 0;
BA_ "GenSigTimeoutTime_SGW" SG_ 100 rnd_1 0;
BA_ "GenSigTimeoutTime_TCM" SG_ 100 rnd_1 0;
BA_ "GenSigTimeoutTime_AGSM" SG_ 100 rnd_2 0;
BA_ "GenSigTimeoutTime_BSM" SG_ 100 rnd_2 0;
BA_ "GenSigTimeoutTime_CADM" SG_ 100 rnd_2 0;
BA_ "GenSigTimeoutTime_DMSM" SG_ 100 rnd_2 0;
BA_ "GenSigTimeoutTime_DTCM" SG_ 100 rnd_2 0;
BA_ "GenSigTimeoutTime_ECM" SG_ 100 rnd_2 0;
BA_ "GenSigTimeoutTime_EVCU2" SG_ 100 rnd_2 0;
BA_ "GenSigTimeoutTime_GNMM" SG_ 100 rnd_2 0;
BA_ "GenSigTimeoutTime_HCP" SG_ 100 rnd_2 0;
BA_ "GenSigTimeoutTime_IPC" SG_ 100 rnd_2 0;
BA_ "GenSigTimeoutTime_RFHM" SG_ 100 rnd_2 0;
BA_ "GenSigTimeoutTime_SGW" SG_ 100 rnd_2 0;
BA_ "GenSigTimeoutTime_TCM" SG_ 100 rnd_2 0;
BA_ "GenSigTimeoutTime_AGSM" SG_ 100 rnd_3 0;
BA_ "GenSigTimeoutTime_BSM" SG_ 100 rnd_3 0;
BA_ "GenSigTimeoutTime_CADM" SG_ 100 rnd_3 0;
BA_ "GenSigTimeoutTime_DMSM" SG_ 100 rnd_3 0;
BA_ "GenSigTimeoutTime_DTCM" SG_ 100 rnd_3 0;
BA_ "GenSigTimeoutTime_ECM" SG_ 100 rnd_3 0;
BA_ "GenSigTimeoutTime_EVCU2" SG_ 100 rnd_3 0;
BA_ "GenSigTimeoutTime_GNMM" SG_ 100 rnd_3 0;
BA_ "GenSigTimeoutTime_HCP" SG_ 100 rnd_3 0;
BA_ "GenSigTimeoutTime_IPC" SG_ 100 rnd_3 0;
BA_ "GenSigTimeoutTime_RFHM" SG_ 100 rnd_3 0;
BA_ "GenSigTimeoutTime_SGW" SG_ 100 rnd_3 0;
BA_ "GenSigTimeoutTime_TCM" SG_ 100 rnd_3 0;
BA_ "GenSigTimeoutTime_AGSM" SG_ 100 rnd_4 0;
BA_ "GenSigTimeoutTime_BSM" SG_ 100 rnd_4 0;
BA_ "GenSigTimeoutTime_CADM" SG_ 100 rnd_4 0;
BA_ "GenSigTimeoutTime_DMSM" SG_ 100 rnd_4 0;
BA_ "GenSigTimeoutTime_DTCM" SG_ 100 rnd_4 0;
BA_ "GenSigTimeoutTime_ECM" SG_ 100 rnd_4 0;
BA_ "GenSigTimeoutTime_EVCU2" SG_ 100 rnd_4 0;
BA_ "GenSigTimeoutTime_GNMM" SG_ 100 rnd_4 0;
BA_ "GenSigTimeoutTime_HCP" SG_ 100 rnd_4 0;
BA_ "GenSigTimeoutTime_IPC" SG_ 100 rnd_4 0;
BA_ "GenSigTimeoutTime_RFHM" SG_ 100 rnd_4 0;
BA_ "GenSigTimeoutTime_SGW" SG_ 100 rnd_4 0;
BA_ "GenSigTimeoutTime_TCM" SG_ 100 rnd_4 0;
BA_ "GenSigSendType" SG_ 104 ControlEncodingRsp 1;
BA_ "GenSigTimeoutTime_AGSM" SG_ 104 ControlEncodingRsp 0;
BA_ "GenSigTimeoutTime_BCM" SG_ 104 ControlEncodingRsp 0;
BA_ "GenSigTimeoutTime_BSM" SG_ 104 ControlEncodingRsp 0;
BA_ "GenSigTimeoutTime_CADM" SG_ 104 ControlEncodingRsp 0;
BA_ "GenSigTimeoutTime_DMSM" SG_ 104 ControlEncodingRsp 0;
BA_ "GenSigTimeoutTime_DTCM" SG_ 104 ControlEncodingRsp 0;
BA_ "GenSigTimeoutTime_GNMM" SG_ 104 ControlEncodingRsp 0;
BA_ "GenSigTimeoutTime_HCP" SG_ 104 ControlEncodingRsp 0;
BA_ "GenSigTimeoutTime_IPC" SG_ 104 ControlEncodingRsp 0;
BA_ "GenSigTimeoutTime_RFHM" SG_ 104 ControlEncodingRsp 0;
BA_ "GenSigTimeoutTime_SGW" SG_ 104 ControlEncodingRsp 0;
BA_ "GenSigTimeoutTime_TCM" SG_ 104 ControlEncodingRsp 0;
BA_ "GenSigTimeoutTime_AGSM" SG_ 104 ImmoParkReq 0;
BA_ "GenSigTimeoutTime_BCM" SG_ 104 ImmoParkReq 0;
BA_ "GenSigTimeoutTime_BSM" SG_ 104 ImmoParkReq 0;
BA_ "GenSigTimeoutTime_CADM" SG_ 104 ImmoParkReq 0;
BA_ "GenSigTimeoutTime_DMSM" SG_ 104 ImmoParkReq 0;
BA_ "GenSigTimeoutTime_DTCM" SG_ 104 ImmoParkReq 0;
BA_ "GenSigTimeoutTime_ECM" SG_ 104 ImmoParkReq 0;
BA_ "GenSigTimeoutTime_GNMM" SG_ 104 ImmoParkReq 0;
BA_ "GenSigTimeoutTime_HCP" SG_ 104 ImmoParkReq 0;
BA_ "GenSigTimeoutTime_IPC" SG_ 104 ImmoParkReq 0;
BA_ "GenSigTimeoutTime_RFHM" SG_ 104 ImmoParkReq 0;
BA_ "GenSigTimeoutTime_SGW" SG_ 104 ImmoParkReq 0;
BA_ "GenSigTimeoutTime_TCM" SG_ 104 ImmoParkReq 0;
BA_ "GenSigTimeoutTime_AGSM" SG_ 104 MKKey_3 0;
BA_ "GenSigTimeoutTime_BCM" SG_ 104 MKKey_3 0;
BA_ "GenSigTimeoutTime_BSM" SG_ 104 MKKey_3 0;
BA_ "GenSigTimeoutTime_CADM" SG_ 104 MKKey_3 0;
BA_ "GenSigTimeoutTime_DMSM" SG_ 104 MKKey_3 0;
BA_ "GenSigTimeoutTime_DTCM" SG_ 104 MKKey_3 0;
BA_ "GenSigTimeoutTime_GNMM" SG_ 104 MKKey_3 0;
BA_ "GenSigTimeoutTime_HCP" SG_ 104 MKKey_3 0;
BA_ "GenSigTimeoutTime_IPC" SG_ 104 MKKey_3 0;
BA_ "GenSigTimeoutTime_RFHM" SG_ 104 MKKey_3 0;
BA_ "GenSigTimeoutTime_SGW" SG_ 104 MKKey_3 0;
BA_ "GenSigTimeoutTime_TCM" SG_ 104 MKKey_3 0;
BA_ "GenSigTimeoutTime_AGSM" SG_ 104 MKKey_4 0;
BA_ "GenSigTimeoutTime_BCM" SG_ 104 MKKey_4 0;
BA_ "GenSigTimeoutTime_BSM" SG_ 104 MKKey_4 0;
BA_ "GenSigTimeoutTime_CADM" SG_ 104 MKKey_4 0;
BA_ "GenSigTimeoutTime_DMSM" SG_ 104 MKKey_4 0;
BA_ "GenSigTimeoutTime_DTCM" SG_ 104 MKKey_4 0;
BA_ "GenSigTimeoutTime_GNMM" SG_ 104 MKKey_4 0;
BA_ "GenSigTimeoutTime_HCP" SG_ 104 MKKey_4 0;
BA_ "GenSigTimeoutTime_IPC" SG_ 104 MKKey_4 0;
BA_ "GenSigTimeoutTime_RFHM" SG_ 104 MKKey_4 0;
BA_ "GenSigTimeoutTime_SGW" SG_ 104 MKKey_4 0;
BA_ "GenSigTimeoutTime_TCM" SG_ 104 MKKey_4 0;
BA_ "GenSigTimeoutTime_AGSM" SG_ 104 MKKey_5 0;
BA_ "GenSigTimeoutTime_BCM" SG_ 104 MKKey_5 0;
BA_ "GenSigTimeoutTime_BSM" SG_ 104 MKKey_5 0;
BA_ "GenSigTimeoutTime_CADM" SG_ 104 MKKey_5 0;
BA_ "GenSigTimeoutTime_DMSM" SG_ 104 MKKey_5 0;
BA_ "GenSigTimeoutTime_DTCM" SG_ 104 MKKey_5 0;
BA_ "GenSigTimeoutTime_GNMM" SG_ 104 MKKey_5 0;
BA_ "GenSigTimeoutTime_HCP" SG_ 104 MKKey_5 0;
BA_ "GenSigTimeoutTime_IPC" SG_ 104 MKKey_5 0;
BA_ "GenSigTimeoutTime_RFHM" SG_ 104 MKKey_5 0;
BA_ "GenSigTimeoutTime_SGW" SG_ 104 MKKey_5 0;
BA_ "GenSigTimeoutTime_TCM" SG_ 104 MKKey_5 0;
BA_ "GenSigTimeoutTime_AGSM" SG_ 104 MKKey_6 0;
BA_ "GenSigTimeoutTime_BCM" SG_ 104 MKKey_6 0;
BA_ "GenSigTimeoutTime_BSM" SG_ 104 MKKey_6 0;
BA_ "GenSigTimeoutTime_CADM" SG_ 104 MKKey_6 0;
BA_ "GenSigTimeoutTime_DMSM" SG_ 104 MKKey_6 0;
BA_ "GenSigTimeoutTime_DTCM" SG_ 104 MKKey_6 0;
BA_ "GenSigTimeoutTime_GNMM" SG_ 104 MKKey_6 0;
BA_ "GenSigTimeoutTime_HCP" SG_ 104 MKKey_6 0;
BA_ "GenSigTimeoutTime_IPC" SG_ 104 MKKey_6 0;
BA_ "GenSigTimeoutTime_RFHM" SG_ 104 MKKey_6 0;
BA_ "GenSigTimeoutTime_SGW" SG_ 104 MKKey_6 0;
BA_ "GenSigTimeoutTime_TCM" SG_ 104 MKKey_6 0;
BA_ "GenSigTimeoutTime_AGSM" SG_ 104 MKKey1org21 0;
BA_ "GenSigTimeoutTime_BCM" SG_ 104 MKKey1org21 0;
BA_ "GenSigTimeoutTime_BSM" SG_ 104 MKKey1org21 0;
BA_ "GenSigTimeoutTime_CADM" SG_ 104 MKKey1org21 0;
BA_ "GenSigTimeoutTime_DMSM" SG_ 104 MKKey1org21 0;
BA_ "GenSigTimeoutTime_DTCM" SG_ 104 MKKey1org21 0;
BA_ "GenSigTimeoutTime_GNMM" SG_ 104 MKKey1org21 0;
BA_ "GenSigTimeoutTime_HCP" SG_ 104 MKKey1org21 0;
BA_ "GenSigTimeoutTime_IPC" SG_ 104 MKKey1org21 0;
BA_ "GenSigTimeoutTime_RFHM" SG_ 104 MKKey1org21 0;
BA_ "GenSigTimeoutTime_SGW" SG_ 104 MKKey1org21 0;
BA_ "GenSigTimeoutTime_TCM" SG_ 104 MKKey1org21 0;
BA_ "GenSigTimeoutTime_AGSM" SG_ 104 MKKey2org22 0;
BA_ "GenSigTimeoutTime_BCM" SG_ 104 MKKey2org22 0;
BA_ "GenSigTimeoutTime_BSM" SG_ 104 MKKey2org22 0;
BA_ "GenSigTimeoutTime_CADM" SG_ 104 MKKey2org22 0;
BA_ "GenSigTimeoutTime_DMSM" SG_ 104 MKKey2org22 0;
BA_ "GenSigTimeoutTime_DTCM" SG_ 104 MKKey2org22 0;
BA_ "GenSigTimeoutTime_GNMM" SG_ 104 MKKey2org22 0;
BA_ "GenSigTimeoutTime_HCP" SG_ 104 MKKey2org22 0;
BA_ "GenSigTimeoutTime_IPC" SG_ 104 MKKey2org22 0;
BA_ "GenSigTimeoutTime_RFHM" SG_ 104 MKKey2org22 0;
BA_ "GenSigTimeoutTime_SGW" SG_ 104 MKKey2org22 0;
BA_ "GenSigTimeoutTime_TCM" SG_ 104 MKKey2org22 0;
BA_ "GenSigTimeoutTime_AGSM" SG_ 1626 CRC_IMPACTINFO 0;
BA_ "GenSigTimeoutTime_BCM" SG_ 1626 CRC_IMPACTINFO 0;
BA_ "GenSigTimeoutTime_BSM" SG_ 1626 CRC_IMPACTINFO 0;
BA_ "GenSigTimeoutTime_CADM" SG_ 1626 CRC_IMPACTINFO 0;
BA_ "GenSigTimeoutTime_DTCM" SG_ 1626 CRC_IMPACTINFO 0;
BA_ "GenSigTimeoutTime_ECM" SG_ 1626 CRC_IMPACTINFO 0;
BA_ "GenSigTimeoutTime_EVCU2" SG_ 1626 CRC_IMPACTINFO 0;
BA_ "GenSigTimeoutTime_GNMM" SG_ 1626 CRC_IMPACTINFO 0;
BA_ "GenSigTimeoutTime_IPC" SG_ 1626 CRC_IMPACTINFO 0;
BA_ "GenSigTimeoutTime_RFHM" SG_ 1626 CRC_IMPACTINFO 0;
BA_ "GenSigTimeoutTime_SGW" SG_ 1626 CRC_IMPACTINFO 0;
BA_ "GenSigTimeoutTime_TCM" SG_ 1626 CRC_IMPACTINFO 0;
BA_ "GenSigSendType" SG_ 1626 IMPACTCommand 5;
BA_ "GenSigTimeoutTime_AGSM" SG_ 1626 IMPACTCommand 0;
BA_ "GenSigTimeoutTime_BCM" SG_ 1626 IMPACTCommand 0;
BA_ "GenSigTimeoutTime_BSM" SG_ 1626 IMPACTCommand 0;
BA_ "GenSigTimeoutTime_CADM" SG_ 1626 IMPACTCommand 0;
BA_ "GenSigTimeoutTime_DTCM" SG_ 1626 IMPACTCommand 0;
BA_ "GenSigTimeoutTime_GNMM" SG_ 1626 IMPACTCommand 0;
BA_ "GenSigTimeoutTime_HCP" SG_ 1626 IMPACTCommand 0;
BA_ "GenSigTimeoutTime_IPC" SG_ 1626 IMPACTCommand 0;
BA_ "GenSigTimeoutTime_RFHM" SG_ 1626 IMPACTCommand 0;
BA_ "GenSigTimeoutTime_SGW" SG_ 1626 IMPACTCommand 0;
BA_ "GenSigTimeoutTime_TCM" SG_ 1626 IMPACTCommand 0;
BA_ "GenSigStartValue" SG_ 1626 IMPACTConfirm 1;
BA_ "GenSigInactiveValue" SG_ 1626 IMPACTConfirm 1;
BA_ "GenSigSendType" SG_ 1626 IMPACTConfirm 5;
BA_ "GenSigTimeoutTime_AGSM" SG_ 1626 IMPACTConfirm 0;
BA_ "GenSigTimeoutTime_BCM" SG_ 1626 IMPACTConfirm 0;
BA_ "GenSigTimeoutTime_BSM" SG_ 1626 IMPACTConfirm 0;
BA_ "GenSigTimeoutTime_CADM" SG_ 1626 IMPACTConfirm 0;
BA_ "GenSigTimeoutTime_DTCM" SG_ 1626 IMPACTConfirm 0;
BA_ "GenSigTimeoutTime_GNMM" SG_ 1626 IMPACTConfirm 0;
BA_ "GenSigTimeoutTime_HCP" SG_ 1626 IMPACTConfirm 0;
BA_ "GenSigTimeoutTime_IPC" SG_ 1626 IMPACTConfirm 0;
BA_ "GenSigTimeoutTime_RFHM" SG_ 1626 IMPACTConfirm 0;
BA_ "GenSigTimeoutTime_SGW" SG_ 1626 IMPACTConfirm 0;
BA_ "GenSigTimeoutTime_TCM" SG_ 1626 IMPACTConfirm 0;
BA_ "GenSigTimeoutTime_AGSM" SG_ 1626 IMPACTThreshold 0;
BA_ "GenSigTimeoutTime_BCM" SG_ 1626 IMPACTThreshold 0;
BA_ "GenSigTimeoutTime_BSM" SG_ 1626 IMPACTThreshold 0;
BA_ "GenSigTimeoutTime_CADM" SG_ 1626 IMPACTThreshold 0;
BA_ "GenSigTimeoutTime_DMSM" SG_ 1626 IMPACTThreshold 0;
BA_ "GenSigTimeoutTime_DTCM" SG_ 1626 IMPACTThreshold 0;
BA_ "GenSigTimeoutTime_EVCU2" SG_ 1626 IMPACTThreshold 0;
BA_ "GenSigTimeoutTime_GNMM" SG_ 1626 IMPACTThreshold 0;
BA_ "GenSigTimeoutTime_HCP" SG_ 1626 IMPACTThreshold 0;
BA_ "GenSigTimeoutTime_IPC" SG_ 1626 IMPACTThreshold 0;
BA_ "GenSigTimeoutTime_RFHM" SG_ 1626 IMPACTThreshold 0;
BA_ "GenSigTimeoutTime_SGW" SG_ 1626 IMPACTThreshold 0;
BA_ "GenSigTimeoutTime_TCM" SG_ 1626 IMPACTThreshold 0;
BA_ "GenSigTimeoutTime_AGSM" SG_ 1626 MessageCounter_IMPACTINFO 0;
BA_ "GenSigTimeoutTime_BCM" SG_ 1626 MessageCounter_IMPACTINFO 0;
BA_ "GenSigTimeoutTime_BSM" SG_ 1626 MessageCounter_IMPACTINFO 0;
BA_ "GenSigTimeoutTime_CADM" SG_ 1626 MessageCounter_IMPACTINFO 0;
BA_ "GenSigTimeoutTime_DTCM" SG_ 1626 MessageCounter_IMPACTINFO 0;
BA_ "GenSigTimeoutTime_ECM" SG_ 1626 MessageCounter_IMPACTINFO 0;
BA_ "GenSigTimeoutTime_EVCU2" SG_ 1626 MessageCounter_IMPACTINFO 0;
BA_ "GenSigTimeoutTime_GNMM" SG_ 1626 MessageCounter_IMPACTINFO 0;
BA_ "GenSigTimeoutTime_IPC" SG_ 1626 MessageCounter_IMPACTINFO 0;
BA_ "GenSigTimeoutTime_RFHM" SG_ 1626 MessageCounter_IMPACTINFO 0;
BA_ "GenSigTimeoutTime_SGW" SG_ 1626 MessageCounter_IMPACTINFO 0;
BA_ "GenSigTimeoutTime_TCM" SG_ 1626 MessageCounter_IMPACTINFO 0;
BA_ "GenSigTimeoutTime_AGSM" SG_ 1829 CRC_IPC1 0;
BA_ "GenSigTimeoutTime_DTCM" SG_ 1829 CRC_IPC1 0;
BA_ "GenSigTimeoutTime_EVCU2" SG_ 1829 CRC_IPC1 0;
BA_ "GenSigTimeoutTime_GNMM" SG_ 1829 CRC_IPC1 0;
BA_ "GenSigTimeoutTime_HCP" SG_ 1829 CRC_IPC1 0;
BA_ "GenSigTimeoutTime_IPC" SG_ 1829 CRC_IPC1 0;
BA_ "GenSigTimeoutTime_RFHM" SG_ 1829 CRC_IPC1 0;
BA_ "GenSigTimeoutTime_SGW" SG_ 1829 CRC_IPC1 0;
BA_ "GenSigTimeoutTime_TCM" SG_ 1829 CRC_IPC1 0;
BA_ "GenSigTimeoutTime_AGSM" SG_ 1829 InstantaneousFuelConsumption1 0;
BA_ "GenSigTimeoutTime_BCM" SG_ 1829 InstantaneousFuelConsumption1 0;
BA_ "GenSigTimeoutTime_BSM" SG_ 1829 InstantaneousFuelConsumption1 0;
BA_ "GenSigTimeoutTime_CADM" SG_ 1829 InstantaneousFuelConsumption1 0;
BA_ "GenSigTimeoutTime_DMSM" SG_ 1829 InstantaneousFuelConsumption1 0;
BA_ "GenSigTimeoutTime_DTCM" SG_ 1829 InstantaneousFuelConsumption1 0;
BA_ "GenSigTimeoutTime_ECM" SG_ 1829 InstantaneousFuelConsumption1 0;
BA_ "GenSigTimeoutTime_EVCU2" SG_ 1829 InstantaneousFuelConsumption1 0;
BA_ "GenSigTimeoutTime_GNMM" SG_ 1829 InstantaneousFuelConsumption1 0;
BA_ "GenSigTimeoutTime_HCP" SG_ 1829 InstantaneousFuelConsumption1 0;
BA_ "GenSigTimeoutTime_IPC" SG_ 1829 InstantaneousFuelConsumption1 0;
BA_ "GenSigTimeoutTime_RFHM" SG_ 1829 InstantaneousFuelConsumption1 0;
BA_ "GenSigTimeoutTime_TCM" SG_ 1829 InstantaneousFuelConsumption1 0;
BA_ "GenSigTimeoutTime_AGSM" SG_ 1829 InstantaneousFuelConsumption2 0;
BA_ "GenSigTimeoutTime_BCM" SG_ 1829 InstantaneousFuelConsumption2 0;
BA_ "GenSigTimeoutTime_BSM" SG_ 1829 InstantaneousFuelConsumption2 0;
BA_ "GenSigTimeoutTime_CADM" SG_ 1829 InstantaneousFuelConsumption2 0;
BA_ "GenSigTimeoutTime_DMSM" SG_ 1829 InstantaneousFuelConsumption2 0;
BA_ "GenSigTimeoutTime_DTCM" SG_ 1829 InstantaneousFuelConsumption2 0;
BA_ "GenSigTimeoutTime_ECM" SG_ 1829 InstantaneousFuelConsumption2 0;
BA_ "GenSigTimeoutTime_EVCU2" SG_ 1829 InstantaneousFuelConsumption2 0;
BA_ "GenSigTimeoutTime_GNMM" SG_ 1829 InstantaneousFuelConsumption2 0;
BA_ "GenSigTimeoutTime_HCP" SG_ 1829 InstantaneousFuelConsumption2 0;
BA_ "GenSigTimeoutTime_IPC" SG_ 1829 InstantaneousFuelConsumption2 0;
BA_ "GenSigTimeoutTime_RFHM" SG_ 1829 InstantaneousFuelConsumption2 0;
BA_ "GenSigTimeoutTime_TCM" SG_ 1829 InstantaneousFuelConsumption2 0;
BA_ "GenSigTimeoutTime_AGSM" SG_ 1829 InstantaneousFuelConsumption3 0;
BA_ "GenSigTimeoutTime_BCM" SG_ 1829 InstantaneousFuelConsumption3 0;
BA_ "GenSigTimeoutTime_BSM" SG_ 1829 InstantaneousFuelConsumption3 0;
BA_ "GenSigTimeoutTime_CADM" SG_ 1829 InstantaneousFuelConsumption3 0;
BA_ "GenSigTimeoutTime_DMSM" SG_ 1829 InstantaneousFuelConsumption3 0;
BA_ "GenSigTimeoutTime_DTCM" SG_ 1829 InstantaneousFuelConsumption3 0;
BA_ "GenSigTimeoutTime_ECM" SG_ 1829 InstantaneousFuelConsumption3 0;
BA_ "GenSigTimeoutTime_EVCU2" SG_ 1829 InstantaneousFuelConsumption3 0;
BA_ "GenSigTimeoutTime_GNMM" SG_ 1829 InstantaneousFuelConsumption3 0;
BA_ "GenSigTimeoutTime_HCP" SG_ 1829 InstantaneousFuelConsumption3 0;
BA_ "GenSigTimeoutTime_IPC" SG_ 1829 InstantaneousFuelConsumption3 0;
BA_ "GenSigTimeoutTime_RFHM" SG_ 1829 InstantaneousFuelConsumption3 0;
BA_ "GenSigTimeoutTime_TCM" SG_ 1829 InstantaneousFuelConsumption3 0;
BA_ "GenSigTimeoutTime_AGSM" SG_ 1829 MessageCounter_IPC1 0;
BA_ "GenSigTimeoutTime_DTCM" SG_ 1829 MessageCounter_IPC1 0;
BA_ "GenSigTimeoutTime_EVCU2" SG_ 1829 MessageCounter_IPC1 0;
BA_ "GenSigTimeoutTime_GNMM" SG_ 1829 MessageCounter_IPC1 0;
BA_ "GenSigTimeoutTime_HCP" SG_ 1829 MessageCounter_IPC1 0;
BA_ "GenSigTimeoutTime_IPC" SG_ 1829 MessageCounter_IPC1 0;
BA_ "GenSigTimeoutTime_RFHM" SG_ 1829 MessageCounter_IPC1 0;
BA_ "GenSigTimeoutTime_SGW" SG_ 1829 MessageCounter_IPC1 0;
BA_ "GenSigTimeoutTime_TCM" SG_ 1829 MessageCounter_IPC1 0;
BA_ "GenSigSendType" SG_ 1829 Trailer_Trp_Rst 3;
BA_ "GenSigTimeoutTime_AGSM" SG_ 1829 Trailer_Trp_Rst 0;
BA_ "GenSigTimeoutTime_BSM" SG_ 1829 Trailer_Trp_Rst 0;
BA_ "GenSigTimeoutTime_CADM" SG_ 1829 Trailer_Trp_Rst 0;
BA_ "GenSigTimeoutTime_DMSM" SG_ 1829 Trailer_Trp_Rst 0;
BA_ "GenSigTimeoutTime_DTCM" SG_ 1829 Trailer_Trp_Rst 0;
BA_ "GenSigTimeoutTime_ECM" SG_ 1829 Trailer_Trp_Rst 0;
BA_ "GenSigTimeoutTime_EVCU2" SG_ 1829 Trailer_Trp_Rst 0;
BA_ "GenSigTimeoutTime_GNMM" SG_ 1829 Trailer_Trp_Rst 0;
BA_ "GenSigTimeoutTime_HCP" SG_ 1829 Trailer_Trp_Rst 0;
BA_ "GenSigTimeoutTime_IPC" SG_ 1829 Trailer_Trp_Rst 0;
BA_ "GenSigTimeoutTime_RFHM" SG_ 1829 Trailer_Trp_Rst 0;
BA_ "GenSigTimeoutTime_SGW" SG_ 1829 Trailer_Trp_Rst 0;
BA_ "GenSigTimeoutTime_TCM" SG_ 1829 Trailer_Trp_Rst 0;
BA_ "GenSigStartValue" SG_ 1441 DTE_Ave_Fuel_Econ 1023;
BA_ "GenSigSendType" SG_ 1441 DTE_Ave_Fuel_Econ 3;
BA_ "GenSigTimeoutTime_AGSM" SG_ 1441 DTE_Ave_Fuel_Econ 0;
BA_ "GenSigTimeoutTime_BCM" SG_ 1441 DTE_Ave_Fuel_Econ 0;
BA_ "GenSigTimeoutTime_BSM" SG_ 1441 DTE_Ave_Fuel_Econ 0;
BA_ "GenSigTimeoutTime_CADM" SG_ 1441 DTE_Ave_Fuel_Econ 0;
BA_ "GenSigTimeoutTime_DMSM" SG_ 1441 DTE_Ave_Fuel_Econ 0;
BA_ "GenSigTimeoutTime_DTCM" SG_ 1441 DTE_Ave_Fuel_Econ 0;
BA_ "GenSigTimeoutTime_ECM" SG_ 1441 DTE_Ave_Fuel_Econ 0;
BA_ "GenSigTimeoutTime_EVCU2" SG_ 1441 DTE_Ave_Fuel_Econ 0;
BA_ "GenSigTimeoutTime_GNMM" SG_ 1441 DTE_Ave_Fuel_Econ 0;
BA_ "GenSigTimeoutTime_HCP" SG_ 1441 DTE_Ave_Fuel_Econ 0;
BA_ "GenSigTimeoutTime_IPC" SG_ 1441 DTE_Ave_Fuel_Econ 0;
BA_ "GenSigTimeoutTime_RFHM" SG_ 1441 DTE_Ave_Fuel_Econ 0;
BA_ "GenSigTimeoutTime_SGW" SG_ 1441 DTE_Ave_Fuel_Econ 0;
BA_ "GenSigTimeoutTime_TCM" SG_ 1441 DTE_Ave_Fuel_Econ 0;
BA_ "GenSigTimeoutTime_AGSM" SG_ 1455 A_EV_Kilometers 0;
BA_ "GenSigTimeoutTime_BCM" SG_ 1455 A_EV_Kilometers 0;
BA_ "GenSigTimeoutTime_BSM" SG_ 1455 A_EV_Kilometers 0;
BA_ "GenSigTimeoutTime_CADM" SG_ 1455 A_EV_Kilometers 0;
BA_ "GenSigTimeoutTime_DMSM" SG_ 1455 A_EV_Kilometers 0;
BA_ "GenSigTimeoutTime_DTCM" SG_ 1455 A_EV_Kilometers 0;
BA_ "GenSigTimeoutTime_ECM" SG_ 1455 A_EV_Kilometers 0;
BA_ "GenSigTimeoutTime_EVCU2" SG_ 1455 A_EV_Kilometers 0;
BA_ "GenSigTimeoutTime_GNMM" SG_ 1455 A_EV_Kilometers 0;
BA_ "GenSigTimeoutTime_HCP" SG_ 1455 A_EV_Kilometers 0;
BA_ "GenSigTimeoutTime_IPC" SG_ 1455 A_EV_Kilometers 0;
BA_ "GenSigTimeoutTime_RFHM" SG_ 1455 A_EV_Kilometers 0;
BA_ "GenSigTimeoutTime_TCM" SG_ 1455 A_EV_Kilometers 0;
BA_ "GenSigTimeoutTime_AGSM" SG_ 1455 A_EV_Miles 0;
BA_ "GenSigTimeoutTime_BCM" SG_ 1455 A_EV_Miles 0;
BA_ "GenSigTimeoutTime_BSM" SG_ 1455 A_EV_Miles 0;
BA_ "GenSigTimeoutTime_CADM" SG_ 1455 A_EV_Miles 0;
BA_ "GenSigTimeoutTime_DMSM" SG_ 1455 A_EV_Miles 0;
BA_ "GenSigTimeoutTime_DTCM" SG_ 1455 A_EV_Miles 0;
BA_ "GenSigTimeoutTime_ECM" SG_ 1455 A_EV_Miles 0;
BA_ "GenSigTimeoutTime_EVCU2" SG_ 1455 A_EV_Miles 0;
BA_ "GenSigTimeoutTime_GNMM" SG_ 1455 A_EV_Miles 0;
BA_ "GenSigTimeoutTime_HCP" SG_ 1455 A_EV_Miles 0;
BA_ "GenSigTimeoutTime_IPC" SG_ 1455 A_EV_Miles 0;
BA_ "GenSigTimeoutTime_RFHM" SG_ 1455 A_EV_Miles 0;
BA_ "GenSigTimeoutTime_TCM" SG_ 1455 A_EV_Miles 0;
BA_ "GenSigTimeoutTime_AGSM" SG_ 1455 A_Hybrid_Kilometers 0;
BA_ "GenSigTimeoutTime_BCM" SG_ 1455 A_Hybrid_Kilometers 0;
BA_ "GenSigTimeoutTime_BSM" SG_ 1455 A_Hybrid_Kilometers 0;
BA_ "GenSigTimeoutTime_CADM" SG_ 1455 A_Hybrid_Kilometers 0;
BA_ "GenSigTimeoutTime_DMSM" SG_ 1455 A_Hybrid_Kilometers 0;
BA_ "GenSigTimeoutTime_DTCM" SG_ 1455 A_Hybrid_Kilometers 0;
BA_ "GenSigTimeoutTime_ECM" SG_ 1455 A_Hybrid_Kilometers 0;
BA_ "GenSigTimeoutTime_EVCU2" SG_ 1455 A_Hybrid_Kilometers 0;
BA_ "GenSigTimeoutTime_GNMM" SG_ 1455 A_Hybrid_Kilometers 0;
BA_ "GenSigTimeoutTime_HCP" SG_ 1455 A_Hybrid_Kilometers 0;
BA_ "GenSigTimeoutTime_IPC" SG_ 1455 A_Hybrid_Kilometers 0;
BA_ "GenSigTimeoutTime_RFHM" SG_ 1455 A_Hybrid_Kilometers 0;
BA_ "GenSigTimeoutTime_TCM" SG_ 1455 A_Hybrid_Kilometers 0;
BA_ "GenSigTimeoutTime_AGSM" SG_ 1455 A_Hybrid_Miles 0;
BA_ "GenSigTimeoutTime_BCM" SG_ 1455 A_Hybrid_Miles 0;
BA_ "GenSigTimeoutTime_BSM" SG_ 1455 A_Hybrid_Miles 0;
BA_ "GenSigTimeoutTime_CADM" SG_ 1455 A_Hybrid_Miles 0;
BA_ "GenSigTimeoutTime_DMSM" SG_ 1455 A_Hybrid_Miles 0;
BA_ "GenSigTimeoutTime_DTCM" SG_ 1455 A_Hybrid_Miles 0;
BA_ "GenSigTimeoutTime_ECM" SG_ 1455 A_Hybrid_Miles 0;
BA_ "GenSigTimeoutTime_EVCU2" SG_ 1455 A_Hybrid_Miles 0;
BA_ "GenSigTimeoutTime_GNMM" SG_ 1455 A_Hybrid_Miles 0;
BA_ "GenSigTimeoutTime_HCP" SG_ 1455 A_Hybrid_Miles 0;
BA_ "GenSigTimeoutTime_IPC" SG_ 1455 A_Hybrid_Miles 0;
BA_ "GenSigTimeoutTime_RFHM" SG_ 1455 A_Hybrid_Miles 0;
BA_ "GenSigTimeoutTime_TCM" SG_ 1455 A_Hybrid_Miles 0;
BA_ "GenSigStartValue" SG_ 1455 AudioMenuPopup 1;
BA_ "GenSigSendType" SG_ 1455 AudioMenuPopup 3;
BA_ "GenSigTimeoutTime_AGSM" SG_ 1455 AudioMenuPopup 0;
BA_ "GenSigTimeoutTime_BCM" SG_ 1455 AudioMenuPopup 0;
BA_ "GenSigTimeoutTime_BSM" SG_ 1455 AudioMenuPopup 0;
BA_ "GenSigTimeoutTime_CADM" SG_ 1455 AudioMenuPopup 0;
BA_ "GenSigTimeoutTime_DMSM" SG_ 1455 AudioMenuPopup 0;
BA_ "GenSigTimeoutTime_DTCM" SG_ 1455 AudioMenuPopup 0;
BA_ "GenSigTimeoutTime_ECM" SG_ 1455 AudioMenuPopup 0;
BA_ "GenSigTimeoutTime_EVCU2" SG_ 1455 AudioMenuPopup 0;
BA_ "GenSigTimeoutTime_GNMM" SG_ 1455 AudioMenuPopup 0;
BA_ "GenSigTimeoutTime_HCP" SG_ 1455 AudioMenuPopup 0;
BA_ "GenSigTimeoutTime_IPC" SG_ 1455 AudioMenuPopup 0;
BA_ "GenSigTimeoutTime_RFHM" SG_ 1455 AudioMenuPopup 0;
BA_ "GenSigTimeoutTime_TCM" SG_ 1455 AudioMenuPopup 0;
BA_ "GenSigStartValue" SG_ 1455 Avg_Fuel_Econ 1023;
BA_ "GenSigSendType" SG_ 1455 Avg_Fuel_Econ 3;
BA_ "GenSigTimeoutTime_AGSM" SG_ 1455 Avg_Fuel_Econ 0;
BA_ "GenSigTimeoutTime_BCM" SG_ 1455 Avg_Fuel_Econ 0;
BA_ "GenSigTimeoutTime_BSM" SG_ 1455 Avg_Fuel_Econ 0;
BA_ "GenSigTimeoutTime_CADM" SG_ 1455 Avg_Fuel_Econ 0;
BA_ "GenSigTimeoutTime_DMSM" SG_ 1455 Avg_Fuel_Econ 0;
BA_ "GenSigTimeoutTime_DTCM" SG_ 1455 Avg_Fuel_Econ 0;
BA_ "GenSigTimeoutTime_ECM" SG_ 1455 Avg_Fuel_Econ 0;
BA_ "GenSigTimeoutTime_EVCU2" SG_ 1455 Avg_Fuel_Econ 0;
BA_ "GenSigTimeoutTime_GNMM" SG_ 1455 Avg_Fuel_Econ 0;
BA_ "GenSigTimeoutTime_HCP" SG_ 1455 Avg_Fuel_Econ 0;
BA_ "GenSigTimeoutTime_IPC" SG_ 1455 Avg_Fuel_Econ 0;
BA_ "GenSigTimeoutTime_RFHM" SG_ 1455 Avg_Fuel_Econ 0;
BA_ "GenSigTimeoutTime_TCM" SG_ 1455 Avg_Fuel_Econ 0;
BA_ "GenSigStartValue" SG_ 1455 Cluster_In_Audio_Md 1;
BA_ "GenSigSendType" SG_ 1455 Cluster_In_Audio_Md 3;
BA_ "GenSigTimeoutTime_AGSM" SG_ 1455 Cluster_In_Audio_Md 0;
BA_ "GenSigTimeoutTime_BCM" SG_ 1455 Cluster_In_Audio_Md 0;
BA_ "GenSigTimeoutTime_BSM" SG_ 1455 Cluster_In_Audio_Md 0;
BA_ "GenSigTimeoutTime_CADM" SG_ 1455 Cluster_In_Audio_Md 0;
BA_ "GenSigTimeoutTime_DMSM" SG_ 1455 Cluster_In_Audio_Md 0;
BA_ "GenSigTimeoutTime_DTCM" SG_ 1455 Cluster_In_Audio_Md 0;
BA_ "GenSigTimeoutTime_ECM" SG_ 1455 Cluster_In_Audio_Md 0;
BA_ "GenSigTimeoutTime_EVCU2" SG_ 1455 Cluster_In_Audio_Md 0;
BA_ "GenSigTimeoutTime_GNMM" SG_ 1455 Cluster_In_Audio_Md 0;
BA_ "GenSigTimeoutTime_HCP" SG_ 1455 Cluster_In_Audio_Md 0;
BA_ "GenSigTimeoutTime_IPC" SG_ 1455 Cluster_In_Audio_Md 0;
BA_ "GenSigTimeoutTime_RFHM" SG_ 1455 Cluster_In_Audio_Md 0;
BA_ "GenSigTimeoutTime_TCM" SG_ 1455 Cluster_In_Audio_Md 0;
BA_ "GenSigSendType" SG_ 1455 IC_ETM_HUDCustom_Req 3;
BA_ "GenSigTimeoutTime_AGSM" SG_ 1455 IC_ETM_HUDCustom_Req 0;
BA_ "GenSigTimeoutTime_BCM" SG_ 1455 IC_ETM_HUDCustom_Req 0;
BA_ "GenSigTimeoutTime_BSM" SG_ 1455 IC_ETM_HUDCustom_Req 0;
BA_ "GenSigTimeoutTime_CADM" SG_ 1455 IC_ETM_HUDCustom_Req 0;
BA_ "GenSigTimeoutTime_DMSM" SG_ 1455 IC_ETM_HUDCustom_Req 0;
BA_ "GenSigTimeoutTime_DTCM" SG_ 1455 IC_ETM_HUDCustom_Req 0;
BA_ "GenSigTimeoutTime_ECM" SG_ 1455 IC_ETM_HUDCustom_Req 0;
BA_ "GenSigTimeoutTime_EVCU2" SG_ 1455 IC_ETM_HUDCustom_Req 0;
BA_ "GenSigTimeoutTime_GNMM" SG_ 1455 IC_ETM_HUDCustom_Req 0;
BA_ "GenSigTimeoutTime_HCP" SG_ 1455 IC_ETM_HUDCustom_Req 0;
BA_ "GenSigTimeoutTime_IPC" SG_ 1455 IC_ETM_HUDCustom_Req 0;
BA_ "GenSigTimeoutTime_RFHM" SG_ 1455 IC_ETM_HUDCustom_Req 0;
BA_ "GenSigTimeoutTime_TCM" SG_ 1455 IC_ETM_HUDCustom_Req 0;
BA_ "GenSigStartValue" SG_ 1455 IPC_NavigationMap_Req 1;
BA_ "GenSigSendType" SG_ 1455 IPC_NavigationMap_Req 3;
BA_ "GenSigTimeoutTime_AGSM" SG_ 1455 IPC_NavigationMap_Req 0;
BA_ "GenSigTimeoutTime_BCM" SG_ 1455 IPC_NavigationMap_Req 0;
BA_ "GenSigTimeoutTime_BSM" SG_ 1455 IPC_NavigationMap_Req 0;
BA_ "GenSigTimeoutTime_CADM" SG_ 1455 IPC_NavigationMap_Req 0;
BA_ "GenSigTimeoutTime_DMSM" SG_ 1455 IPC_NavigationMap_Req 0;
BA_ "GenSigTimeoutTime_DTCM" SG_ 1455 IPC_NavigationMap_Req 0;
BA_ "GenSigTimeoutTime_ECM" SG_ 1455 IPC_NavigationMap_Req 0;
BA_ "GenSigTimeoutTime_EVCU2" SG_ 1455 IPC_NavigationMap_Req 0;
BA_ "GenSigTimeoutTime_GNMM" SG_ 1455 IPC_NavigationMap_Req 0;
BA_ "GenSigTimeoutTime_HCP" SG_ 1455 IPC_NavigationMap_Req 0;
BA_ "GenSigTimeoutTime_IPC" SG_ 1455 IPC_NavigationMap_Req 0;
BA_ "GenSigTimeoutTime_RFHM" SG_ 1455 IPC_NavigationMap_Req 0;
BA_ "GenSigTimeoutTime_TCM" SG_ 1455 IPC_NavigationMap_Req 0;
BA_ "GenSigStartValue" SG_ 1455 NavigationMapPopUP 1;
BA_ "GenSigSendType" SG_ 1455 NavigationMapPopUP 3;
BA_ "GenSigTimeoutTime_AGSM" SG_ 1455 NavigationMapPopUP 0;
BA_ "GenSigTimeoutTime_BCM" SG_ 1455 NavigationMapPopUP 0;
BA_ "GenSigTimeoutTime_BSM" SG_ 1455 NavigationMapPopUP 0;
BA_ "GenSigTimeoutTime_CADM" SG_ 1455 NavigationMapPopUP 0;
BA_ "GenSigTimeoutTime_DMSM" SG_ 1455 NavigationMapPopUP 0;
BA_ "GenSigTimeoutTime_DTCM" SG_ 1455 NavigationMapPopUP 0;
BA_ "GenSigTimeoutTime_ECM" SG_ 1455 NavigationMapPopUP 0;
BA_ "GenSigTimeoutTime_EVCU2" SG_ 1455 NavigationMapPopUP 0;
BA_ "GenSigTimeoutTime_GNMM" SG_ 1455 NavigationMapPopUP 0;
BA_ "GenSigTimeoutTime_HCP" SG_ 1455 NavigationMapPopUP 0;
BA_ "GenSigTimeoutTime_IPC" SG_ 1455 NavigationMapPopUP 0;
BA_ "GenSigTimeoutTime_RFHM" SG_ 1455 NavigationMapPopUP 0;
BA_ "GenSigTimeoutTime_TCM" SG_ 1455 NavigationMapPopUP 0;
BA_ "GenSigSendType" SG_ 1455 NextNavInstructionPanelTheme 3;
BA_ "GenSigTimeoutTime_AGSM" SG_ 1455 NextNavInstructionPanelTheme 0;
BA_ "GenSigTimeoutTime_BCM" SG_ 1455 NextNavInstructionPanelTheme 0;
BA_ "GenSigTimeoutTime_BSM" SG_ 1455 NextNavInstructionPanelTheme 0;
BA_ "GenSigTimeoutTime_CADM" SG_ 1455 NextNavInstructionPanelTheme 0;
BA_ "GenSigTimeoutTime_DMSM" SG_ 1455 NextNavInstructionPanelTheme 0;
BA_ "GenSigTimeoutTime_DTCM" SG_ 1455 NextNavInstructionPanelTheme 0;
BA_ "GenSigTimeoutTime_ECM" SG_ 1455 NextNavInstructionPanelTheme 0;
BA_ "GenSigTimeoutTime_EVCU2" SG_ 1455 NextNavInstructionPanelTheme 0;
BA_ "GenSigTimeoutTime_GNMM" SG_ 1455 NextNavInstructionPanelTheme 0;
BA_ "GenSigTimeoutTime_HCP" SG_ 1455 NextNavInstructionPanelTheme 0;
BA_ "GenSigTimeoutTime_IPC" SG_ 1455 NextNavInstructionPanelTheme 0;
BA_ "GenSigTimeoutTime_RFHM" SG_ 1455 NextNavInstructionPanelTheme 0;
BA_ "GenSigTimeoutTime_TCM" SG_ 1455 NextNavInstructionPanelTheme 0;
BA_ "GenSigTimeoutTime_AGSM" SG_ 1844 B_EV_Kilometers 0;
BA_ "GenSigTimeoutTime_BCM" SG_ 1844 B_EV_Kilometers 0;
BA_ "GenSigTimeoutTime_BSM" SG_ 1844 B_EV_Kilometers 0;
BA_ "GenSigTimeoutTime_CADM" SG_ 1844 B_EV_Kilometers 0;
BA_ "GenSigTimeoutTime_DMSM" SG_ 1844 B_EV_Kilometers 0;
BA_ "GenSigTimeoutTime_DTCM" SG_ 1844 B_EV_Kilometers 0;
BA_ "GenSigTimeoutTime_ECM" SG_ 1844 B_EV_Kilometers 0;
BA_ "GenSigTimeoutTime_EVCU2" SG_ 1844 B_EV_Kilometers 0;
BA_ "GenSigTimeoutTime_GNMM" SG_ 1844 B_EV_Kilometers 0;
BA_ "GenSigTimeoutTime_HCP" SG_ 1844 B_EV_Kilometers 0;
BA_ "GenSigTimeoutTime_IPC" SG_ 1844 B_EV_Kilometers 0;
BA_ "GenSigTimeoutTime_RFHM" SG_ 1844 B_EV_Kilometers 0;
BA_ "GenSigTimeoutTime_TCM" SG_ 1844 B_EV_Kilometers 0;
BA_ "GenSigTimeoutTime_AGSM" SG_ 1844 B_EV_Miles 0;
BA_ "GenSigTimeoutTime_BCM" SG_ 1844 B_EV_Miles 0;
BA_ "GenSigTimeoutTime_BSM" SG_ 1844 B_EV_Miles 0;
BA_ "GenSigTimeoutTime_CADM" SG_ 1844 B_EV_Miles 0;
BA_ "GenSigTimeoutTime_DMSM" SG_ 1844 B_EV_Miles 0;
BA_ "GenSigTimeoutTime_DTCM" SG_ 1844 B_EV_Miles 0;
BA_ "GenSigTimeoutTime_ECM" SG_ 1844 B_EV_Miles 0;
BA_ "GenSigTimeoutTime_EVCU2" SG_ 1844 B_EV_Miles 0;
BA_ "GenSigTimeoutTime_GNMM" SG_ 1844 B_EV_Miles 0;
BA_ "GenSigTimeoutTime_HCP" SG_ 1844 B_EV_Miles 0;
BA_ "GenSigTimeoutTime_IPC" SG_ 1844 B_EV_Miles 0;
BA_ "GenSigTimeoutTime_RFHM" SG_ 1844 B_EV_Miles 0;
BA_ "GenSigTimeoutTime_TCM" SG_ 1844 B_EV_Miles 0;
BA_ "GenSigTimeoutTime_AGSM" SG_ 1844 B_Hybrid_Kilometers 0;
BA_ "GenSigTimeoutTime_BCM" SG_ 1844 B_Hybrid_Kilometers 0;
BA_ "GenSigTimeoutTime_BSM" SG_ 1844 B_Hybrid_Kilometers 0;
BA_ "GenSigTimeoutTime_CADM" SG_ 1844 B_Hybrid_Kilometers 0;
BA_ "GenSigTimeoutTime_DMSM" SG_ 1844 B_Hybrid_Kilometers 0;
BA_ "GenSigTimeoutTime_DTCM" SG_ 1844 B_Hybrid_Kilometers 0;
BA_ "GenSigTimeoutTime_ECM" SG_ 1844 B_Hybrid_Kilometers 0;
BA_ "GenSigTimeoutTime_EVCU2" SG_ 1844 B_Hybrid_Kilometers 0;
BA_ "GenSigTimeoutTime_GNMM" SG_ 1844 B_Hybrid_Kilometers 0;
BA_ "GenSigTimeoutTime_HCP" SG_ 1844 B_Hybrid_Kilometers 0;
BA_ "GenSigTimeoutTime_IPC" SG_ 1844 B_Hybrid_Kilometers 0;
BA_ "GenSigTimeoutTime_RFHM" SG_ 1844 B_Hybrid_Kilometers 0;
BA_ "GenSigTimeoutTime_TCM" SG_ 1844 B_Hybrid_Kilometers 0;
BA_ "GenSigTimeoutTime_AGSM" SG_ 1844 B_Hybrid_Miles 0;
BA_ "GenSigTimeoutTime_BCM" SG_ 1844 B_Hybrid_Miles 0;
BA_ "GenSigTimeoutTime_BSM" SG_ 1844 B_Hybrid_Miles 0;
BA_ "GenSigTimeoutTime_CADM" SG_ 1844 B_Hybrid_Miles 0;
BA_ "GenSigTimeoutTime_DMSM" SG_ 1844 B_Hybrid_Miles 0;
BA_ "GenSigTimeoutTime_DTCM" SG_ 1844 B_Hybrid_Miles 0;
BA_ "GenSigTimeoutTime_ECM" SG_ 1844 B_Hybrid_Miles 0;
BA_ "GenSigTimeoutTime_EVCU2" SG_ 1844 B_Hybrid_Miles 0;
BA_ "GenSigTimeoutTime_GNMM" SG_ 1844 B_Hybrid_Miles 0;
BA_ "GenSigTimeoutTime_HCP" SG_ 1844 B_Hybrid_Miles 0;
BA_ "GenSigTimeoutTime_IPC" SG_ 1844 B_Hybrid_Miles 0;
BA_ "GenSigTimeoutTime_RFHM" SG_ 1844 B_Hybrid_Miles 0;
BA_ "GenSigTimeoutTime_TCM" SG_ 1844 B_Hybrid_Miles 0;
BA_ "GenSigTimeoutTime_AGSM" SG_ 1842 FuelLvlIndicator 0;
BA_ "GenSigTimeoutTime_BCM" SG_ 1842 FuelLvlIndicator 0;
BA_ "GenSigTimeoutTime_BSM" SG_ 1842 FuelLvlIndicator 0;
BA_ "GenSigTimeoutTime_CADM" SG_ 1842 FuelLvlIndicator 0;
BA_ "GenSigTimeoutTime_DMSM" SG_ 1842 FuelLvlIndicator 0;
BA_ "GenSigTimeoutTime_DTCM" SG_ 1842 FuelLvlIndicator 0;
BA_ "GenSigTimeoutTime_ECM" SG_ 1842 FuelLvlIndicator 0;
BA_ "GenSigTimeoutTime_EVCU2" SG_ 1842 FuelLvlIndicator 0;
BA_ "GenSigTimeoutTime_GNMM" SG_ 1842 FuelLvlIndicator 0;
BA_ "GenSigTimeoutTime_HCP" SG_ 1842 FuelLvlIndicator 0;
BA_ "GenSigTimeoutTime_IPC" SG_ 1842 FuelLvlIndicator 0;
BA_ "GenSigTimeoutTime_RFHM" SG_ 1842 FuelLvlIndicator 0;
BA_ "GenSigTimeoutTime_TCM" SG_ 1842 FuelLvlIndicator 0;
BA_ "GenSigStartValue" SG_ 1842 Gas_Range 1023;
BA_ "GenSigSendType" SG_ 1842 Gas_Range 3;
BA_ "GenSigTimeoutTime_AGSM" SG_ 1842 Gas_Range 0;
BA_ "GenSigTimeoutTime_BSM" SG_ 1842 Gas_Range 0;
BA_ "GenSigTimeoutTime_CADM" SG_ 1842 Gas_Range 0;
BA_ "GenSigTimeoutTime_DMSM" SG_ 1842 Gas_Range 0;
BA_ "GenSigTimeoutTime_DTCM" SG_ 1842 Gas_Range 0;
BA_ "GenSigTimeoutTime_ECM" SG_ 1842 Gas_Range 0;
BA_ "GenSigTimeoutTime_EVCU2" SG_ 1842 Gas_Range 0;
BA_ "GenSigTimeoutTime_GNMM" SG_ 1842 Gas_Range 0;
BA_ "GenSigTimeoutTime_HCP" SG_ 1842 Gas_Range 0;
BA_ "GenSigTimeoutTime_IPC" SG_ 1842 Gas_Range 0;
BA_ "GenSigTimeoutTime_RFHM" SG_ 1842 Gas_Range 0;
BA_ "GenSigTimeoutTime_TCM" SG_ 1842 Gas_Range 0;
BA_ "GenSigStartValue" SG_ 1842 Total_Range 2047;
BA_ "GenSigSendType" SG_ 1842 Total_Range 3;
BA_ "GenSigTimeoutTime_AGSM" SG_ 1842 Total_Range 0;
BA_ "GenSigTimeoutTime_BCM" SG_ 1842 Total_Range 0;
BA_ "GenSigTimeoutTime_BSM" SG_ 1842 Total_Range 0;
BA_ "GenSigTimeoutTime_CADM" SG_ 1842 Total_Range 0;
BA_ "GenSigTimeoutTime_DMSM" SG_ 1842 Total_Range 0;
BA_ "GenSigTimeoutTime_DTCM" SG_ 1842 Total_Range 0;
BA_ "GenSigTimeoutTime_ECM" SG_ 1842 Total_Range 0;
BA_ "GenSigTimeoutTime_EVCU2" SG_ 1842 Total_Range 0;
BA_ "GenSigTimeoutTime_GNMM" SG_ 1842 Total_Range 0;
BA_ "GenSigTimeoutTime_HCP" SG_ 1842 Total_Range 0;
BA_ "GenSigTimeoutTime_IPC" SG_ 1842 Total_Range 0;
BA_ "GenSigTimeoutTime_RFHM" SG_ 1842 Total_Range 0;
BA_ "GenSigTimeoutTime_TCM" SG_ 1842 Total_Range 0;
VAL_ 1952 CabinConditioningSts 0 "Default" 1 "Preconditioning will be rejected-not plugged in" 2 "Preconditioning stopped due to SOC" 3 "Preconditioning" 4 "Cabin set point reached" 5 "Preconditioning off " 6 "Preconditioning failed due to other conditions than HV Battery temperature " 7 "Preconditioning fails due to HV battery temperature" 8 "Battery conditioning complete and the HV battery is ok" 9 "Battery Conditioning stopped before complete and the HV battery is not ok  " 15 "SNA";
VAL_ 1952 CabinPreconditionReqSts 0 "DEFAULT" 1 "PRE" 2 "SPR" 3 "PRE_OFF" 4 "PRF" 5 "NOT_OK" 6 "BCC" 7 "BCS" 8 "STOPPED_DUE_TO_SOC" 9 "EJECTED_NOT_PLUGGED_IN" 15 "SNA";
VAL_ 1952 CompressorState 0 "NormalOperation" 1 "DegradedOperation" 2 "Inoperative" 3 "Reserved1" 4 "Reserved2" 5 "Reserved3" 6 "Reserved4" 15 "SNA";
VAL_ 1952 ElecClntHtrInletTemp 255 "SNA";
VAL_ 1952 ElecCoolantHtrPwr 255 "SNA";
VAL_ 1952 FRfShVlvSts 0 "Open" 1 "Closed";
VAL_ 1952 HeaterCoreInletTemp 255 "SNA";
VAL_ 1952 HTAuxPmpMontrngRPM 0 "TRUE" 1 "FALSE" 3 "SNA";
VAL_ 1952 HTAuxPmpRPMAct 255 "SNA";
VAL_ 1952 HTShtOffVlvReq 0 "Open" 1 "Closed";
VAL_ 1952 HVBatCoolantLevelLow_DPT 0 "False" 1 "True" 3 "SNA";
VAL_ 1952 HVBatCritCondT 0 "False" 1 "True";
VAL_ 1952 Sch_PreCondition_Sts 0 "False" 1 "True" 3 "SNA";
VAL_ 1952 SchCond_Time_Till_Dep 127 "SNA";
VAL_ 276 Belt_Slip_Detected 0 "False" 1 "True";
VAL_ 276 BSGMaxTrqDyn 1023 "SNA";
VAL_ 276 BSGMinTrqDyn 1023 "SNA";
VAL_ 276 DriveMode_PopUpRequest 0 "TM0" 1 "TM1" 2 "TM2" 3 "TM3" 4 "TM4" 5 "TM5" 6 "TM6" 7 "TM7" 8 "TM8" 9 "TM9" 10 "TM10" 11 "TM11" 12 "TM12" 13 "TM13" 14 "TM14" 15 "SNA";
VAL_ 276 DriveModeSts_EPT 0 "Drive_Mode_Unavailable" 1 "Eco_Drive" 2 "Sport_Hybrid" 3 "Extend" 4 "ESave" 8 "Electric" 15 "SNA";
VAL_ 276 DriveReady 0 "Default" 1 "Vehicle is allowed to shift out of park or neutral";
VAL_ 276 EngTrqReserveCmd 255 "SNA";
VAL_ 276 HEV_ESS_Mode 0 "EngOff" 1 "IS" 2 "STPA" 3 "EFA" 4 "ETS" 5 "PT" 6 "DFA" 7 "SPPA" 8 "SF" 9 "CT" 15 "SNA";
VAL_ 276 HVBatteryShutOff 0 "Not_Active" 1 "Active";
VAL_ 276 HybCmndEngTorqImmed 4095 "SNA";
VAL_ 276 HybCmndEngTorqPrdtd 4095 "SNA";
VAL_ 276 HybCmndEngTorqRespTyp 0 "Inactive" 1 "PL" 2 "MR" 3 "SNA";
VAL_ 276 HybTransSt 0 "INIT" 1 "Neutral_Stable_State" 2 "EVT_Mode1_Stable_State" 3 "EVT_Mode2_Stable_State" 4 "Gear1_Stable_State" 5 "Gear2_Stable_State" 6 "Gear3_Stable_State" 7 "Gear4_Stable_State" 8 "G1_G2_SP" 9 "G1_G2_TP" 10 "G2_G1_SP" 11 "G2_G1_TP" 12 "G2_G3_SP" 13 "G2_G3_TP" 14 "G3_G2_SP" 15 "G3_G2_TP" 16 "G3_G4_SP" 17 "G3_G4_TP" 18 "G4_G3_SP" 19 "G4_G3_TP" 20 "EVT_M1_Gear1_SP" 21 "EVT_M1_Gear2_SP" 22 "EVT_M2_Gear2_SP" 23 "EVT_M2_Gear3_SP" 24 "EVT_M2_Gear4_SP" 25 "Neutral_EVT_M1_Shift" 26 "Neutral_EVT_M2_Shift" 27 "Shift_Neutral" 28 "EVT_M1_EVT_M2_QS" 29 "EVT_M2_EVT_M1_QS" 30 "EVT_M1_SP" 31 "EVT_M2_SP" 32 "G1_Abort_G1G2_TP" 33 "G2_Abort_G2G3_TP" 34 "G3_Abort_G3G4_TP" 35 "G2_Abort_G2G1_TP" 36 "G3_Abort_G3G2_TP" 37 "G4_Abort_G4G3_TP" 38 "Init_Neut" 39 "M3" 40 "NeutToM3" 41 "M1ToM2_PwrOnC2CSpdPhs" 42 "M1ToM2_PwrOnC2CTorqPhs" 43 "M2ToM1_PwrOffC2CSpdPhs" 44 "M2ToM1_PwrOffC2CTorqPhs" 45 "M1ToM3_PwrOnC2CSpdPhs" 46 "M1ToM3_PwrOnC2CTorqPhs" 47 "M3ToM1_PwrOffC2CSpdPhs" 48 "M3ToM1_PwrOffC2CTorqPhs" 49 "M3ToG4" 50 "G2ToG4_PwrOnC2CSpdPhs" 51 "G2ToG4_PwrOnC2CTorqPhs" 52 "G4ToG2_PwrOffC2CSpdPhs" 53 "G4ToG2_PwrOffC2CTorqPhs" 54 "M1Abort_FromM1ToM2_C2CSpdPhs" 55 "M1Abort_FromM1ToM2_C2CTorqPhs" 56 "M1Abort_FromM1ToM3_C2CSpdPhs" 57 "M1Abort_FromM1ToM3_C2CTorqPhs" 58 "M2Abort_FromM2ToM1_C2CSpdPhs" 59 "M2Abort_FromM2ToM1_C2CTorqPhs" 60 "M3Abort" 61 "M3Abort_FromM3ToM1_C2CSpdPhs" 62 "M3Abort_FromM3ToM1_C2CTorqPhs" 63 "INV" 64 "G2Abort_FromG2ToG4_C2CSpdPhs" 65 "G2Abort_FromG2ToG4_C2CTorqPhs" 66 "G4Abort_FromG4ToG2_C2CSpdPhs" 67 "G4Abort_FromG4ToG2_C2CTorqPhs";
VAL_ 276 InputSpdRaw 4095 "SNA";
VAL_ 276 PropulsionSystemActive 0 "Not_Active" 1 "Active";
VAL_ 276 RegenTarget 4095 "SNA";
VAL_ 269 BSGActualTorque 1023 "SNA";
VAL_ 269 BSGChrgIdleSpeedTarget 8191 "SNA";
VAL_ 269 CODE_CLR_HCP 0 "Not Clear" 1 "Clear";
VAL_ 269 HybridEngineMaxTorqAllowed 4095 "SNA";
VAL_ 269 REPRGD_PFC_CLR_HCP 0 "Do Nothing" 1 "Set Incomplete";
VAL_ 1033 BattPowerUse_DisplayV 0 "Valid" 1 "Not_Valid";
VAL_ 1033 ElectricTrqMult4Pedal 255 "SNA";
VAL_ 1033 HCPMaxEngRPM 255 "SNA";
VAL_ 1033 Hybrid_AGS2Position 127 "SNA";
VAL_ 1033 Hybrid_AGSPosition 127 "SNA";
VAL_ 1033 Hybrid_EVT_ModeSts 0 "Hybrid Mode" 1 "EVT Mode";
VAL_ 1033 HybridEmissionsMalfunction 0 "Not_Active" 1 "Active";
VAL_ 1033 IdleCLoopTrq 1023 "SNA";
VAL_ 1033 Motor1PowerUse_DisplayV 0 "Valid" 1 "Not_Valid";
VAL_ 1033 Motor2PowerUse_DisplayV 0 "Valid" 1 "Not_Valid";
VAL_ 1033 MotorsPowerUse_DisplayV 0 "Valid" 1 "Not_Valid";
VAL_ 1033 PT_WorkSite_Invtr_Sts_HCP 0 "Not_Active" 1 "Active" 3 "SNA";
VAL_ 1033 Smartload_Actv 0 "Inactive" 1 "Active" 3 "SNA";
VAL_ 1956 MotorA_InverterState 0 "NORMAL_PWR_STAGE_OFF" 1 "NORMAL_PWR_STAGE_ON" 2 "PWR_STAGE_ON_SHUTDWN_PNDING" 3 "ACTIVE_DISCHARGE" 4 "INVERTER_FAULTED";
VAL_ 1956 MotorB_InverterState 0 "NORMAL_PWR_STAGE_OFF" 1 "NORMAL_PWR_STAGE_ON" 2 "PWR_STAGE_ON_SHUTDWN_PNDING" 3 "ACTIVE_DISCHARGE" 4 "INVERTER_FAULTED";
VAL_ 1956 Warning_DCDCPerformance_DPT 0 "Normal" 1 "Warning";
VAL_ 1956 Warning_DCDCTemp_DPT 0 "Normal" 1 "Warning";
VAL_ 1956 Warning_InverterA_Overtemp 0 "Normal" 1 "Warning";
VAL_ 1956 Warning_InverterB_Overtemp 0 "Normal" 1 "Warning";
VAL_ 1956 Warning_MotorA_Overtemp 0 "Normal" 1 "Warning";
VAL_ 1956 Warning_MotorB_Overtemp 0 "Normal" 1 "Warning";
VAL_ 1853 APM_CtrlSts_Fbk 0 "IDLE" 1 "Buck_CV_voltage" 2 "Buck_CC_current_control" 3 "APM_Temporary_Fault" 4 "Buck_Special" 6 "PreCharge" 7 "DisCharge" 8 "OFF" 9 "Derating" 10 "APM_Critical_Fault" 15 "SNA";
VAL_ 1853 APM_FailureReason 0 "No_Failure" 1 "Fail_high_voltage_at_HV" 2 "Fail_low_voltage_at_HV" 3 "Fail_high_voltage_at_LV" 4 "Fail_low_voltage_at_LV" 5 "Fail_high_PCB_temperature" 6 "Fail_high_DCB_temperature" 7 "Fail_high_cur_at_LV" 8 "Fail_high_cur_at_HV" 9 "Fail_short_circ_at_LV" 10 "Fail_short_circ_at_HV" 11 "Fail_open_circ_at_LV" 12 "Fail_open_circ_at_HV" 13 "Fail_init_failure" 14 "Fail_wake_up_issue" 15 "Fail_internal_hardware" 16 "Fail_bat_feed_low" 17 "Fail_bat_feed_high" 18 "Fail_Aux_OV" 19 "Fail_Aux_UV" 20 "Fail_HVIL_fault" 21 "Fail_LOC_with_HCP" 22 "Fail_LOC_with_BPCM" 23 "Fail_cont_not_closed" 24 "Fail_SBC_fault" 25 "Memory_Fail" 26 "Implausible_data_from_HCP" 27 "Implausible_data_from_BPCM" 28 "CAN_bus_off" 29 "Fail_temp_diff_is_high" 30 "Fail_high_voltage_diff_is_high" 31 "Fail_for_other_reason" 32 "LOC_ORC" 33 "Implausble_data_ORC" 63 "SNA";
VAL_ 1853 APM_OutputPower 1023 "SNA";
VAL_ 1032 AirflowRequest 127 "SNA";
VAL_ 1032 LTR_PumpFlowRequest 127 "SNA";
VAL_ 1032 RadiatorFanSts 127 "SNA";
VAL_ 752 CurrBattFailStatus 0 "Fail_not_present" 1 "Fail_present";
VAL_ 752 IBS3_Error_Internal 0 "NO_ERROR" 1 "ERROR";
VAL_ 752 IBS3_Ibatt 65535 "SNA";
VAL_ 752 IBS3_SOF_V_Accuracy 0 "Inaccurate" 1 "Accurate";
VAL_ 752 IBS3_SOF_VC 127 "SNA";
VAL_ 752 IBS3_Vbatt 511 "SNA";
VAL_ 752 RsErrIBS3 0 "NO_ERROR" 1 "ERROR";
VAL_ 752 VoltBattFailStatus 0 "Fail_not_present" 1 "Fail_present";
VAL_ 754 CurrBattFailStatus_2 0 "Fail_not_present" 1 "Fail_present";
VAL_ 754 IBS3_Error_Internal_2 0 "NO_ERROR" 1 "ERROR";
VAL_ 754 RsErrIBS3_2 0 "NO_ERROR" 1 "ERROR";
VAL_ 754 VoltBattFailStatus_2 0 "Fail_not_present" 1 "Fail_present";
VAL_ 1955 IBS3_FLAG_DISCONNECT 0 "No_Disconnect" 1 "Disconnect";
VAL_ 1955 IBS3_FLAG_DISCONNECT_ADAS 0 "NOT_DISCONNECTED" 1 "DISCONNECTED_DETECTED" 2 "not_used" 3 "SNA";
VAL_ 1955 IBS3_FLAG_DISCONNECT_ADAS_2 0 "NOT_DISCONNECTED" 1 "DISCONNECTED_DETECTED" 2 "not_used" 3 "SNA";
VAL_ 1955 IBS3_IBS_ADAS_OK 0 "unknown" 1 "OK" 2 "NOT_OK" 3 "SNA";
VAL_ 1955 IBS3_IBS_ADAS_OK_2 0 "unknown" 1 "OK" 2 "NOT_OK" 3 "SNA";
VAL_ 1955 IBS3_Q_received 65535 "SNA";
VAL_ 1955 IBS3_Q_released 65535 "SNA";
VAL_ 1955 IBS3_R_Batt 255 "SNA";
VAL_ 1955 IBS3_R_Batt_25 255 "SNA";
VAL_ 1955 IBS3_SOC 127 "SNA";
VAL_ 1955 IBS3_SOC_Accuracy 0 "Inaccurate" 1 "Accurate";
VAL_ 1955 IBS3_SOF_Q 255 "SNA";
VAL_ 1955 IBS3_SOF_Q_Accuracy 0 "Inaccurate" 1 "Accurate";
VAL_ 1955 IBS3_SOH_COR 127 "SNA";
VAL_ 1955 IBS3_SOH_COR_Accuracy 0 "Inaccurate" 1 "Accurate";
VAL_ 1955 IBS3_SOH_Q 127 "SNA";
VAL_ 1955 IBS3_SOH_Q_Accuracy 0 "Inaccurate" 1 "Accurate";
VAL_ 1955 IBS3_SOH_SUL 127 "SNA";
VAL_ 1955 IBS3_SOH_SUL_Accuracy 0 "Inaccurate" 1 "Accurate";
VAL_ 1955 IBS3_T_BATT 255 "SNA";
VAL_ 1955 IBS3_TempFailStatus 0 "Fail_not_present" 1 "Fail_present";
VAL_ 1955 IBS3_Tm_Lst_Reset_Days 4095 "SNA";
VAL_ 1955 IBS3_Tm_Lst_Reset_Sec 65535 "SNA";
VAL_ 100 ControlEncodingReq 5 "ControlEncoding_ENQ" 6 "ControlEncoding_ACK" 21 "ControlEncoding_NACK" 132 "ControlEncoding_EOTp" 133 "ControlEncoding_ENQp" 134 "ControlEncoding_ACK1p" 135 "ControlEncoding_ACK2p";
VAL_ 100 f1_1 0 "Val1_f1_1" 81 "Val5_f1_1" 119 "Val2_f1_1" 145 "Val3_f1_1" 159 "Val4_f1_1";
VAL_ 100 f1_2 0 "Val1_f1_2" 5 "Val2_f1_2" 13 "Val4_f1_2" 14 "Val3_f1_2" 15 "Val5_f1_2";
VAL_ 100 rnd_1 0 "Val1_rnd_1" 58 "Val2_rnd_1" 59 "Val3_rnd_1" 60 "Val4_rnd_1" 61 "Val5_rnd_1" 62 "Val6_rnd_1" 63 "Val7_rnd_1" 64 "Val8_rnd_1" 65 "Val9_rnd_1" 66 "ValA_rnd_1" 67 "ValB_rnd_1" 68 "ValC_rnd_1" 69 "ValD_rnd_1" 70 "ValE_rnd_1" 71 "ValF_rnd_1";
VAL_ 100 rnd_2 0 "Val1_rnd_2" 26 "Val3_rnd_2" 43 "Val5_rnd_2" 79 "Val2_rnd_2" 168 "Val4_rnd_2";
VAL_ 100 rnd_3 0 "Val1_rnd_3" 19 "Val3_rnd_3" 21 "Val5_rnd_3" 32 "Val4_rnd_3" 129 "Val2_rnd_3";
VAL_ 100 rnd_4 0 "Val1_rnd_4" 170 "Val5_rnd_4" 203 "Val2_rnd_4" 221 "Val3_rnd_4" 238 "Val4_rnd_4";
VAL_ 104 ImmoParkReq 0 "None" 1 "Request Park";
VAL_ 104 MKKey_3 36 "FIX__MKKey_3";
VAL_ 104 MKKey_4 214 "FIX__MKKey_4";
VAL_ 104 MKKey_5 1 "FIX__MKKey_5";
VAL_ 104 MKKey_6 77 "FIX__MKKey_6";
VAL_ 104 MKKey1org21 84 "FIX__MKKey_1";
VAL_ 104 MKKey2org22 85 "FIX__MKKey_2";
VAL_ 1626 IMPACTCommand 0 "Do_Not_Actuate" 1 "Actuate";
VAL_ 1626 IMPACTConfirm 0 "Actuate" 1 "Do_Not_Actuate";
VAL_ 1626 IMPACTThreshold 0 "Threshold_Not_Met" 1 "Threshold_Met";
VAL_ 1829 InstantaneousFuelConsumption1 15 "SNA";
VAL_ 1829 InstantaneousFuelConsumption2 15 "SNA";
VAL_ 1829 InstantaneousFuelConsumption3 15 "SNA";
VAL_ 1829 Trailer_Trp_Rst 0 "False" 1 "True";
VAL_ 1441 DTE_Ave_Fuel_Econ 1023 "SNA";
VAL_ 1455 A_EV_Kilometers 16777215 "SNA";
VAL_ 1455 A_EV_Miles 16777215 "SNA";
VAL_ 1455 A_Hybrid_Kilometers 16777215 "SNA";
VAL_ 1455 A_Hybrid_Miles 16777215 "SNA";
VAL_ 1455 AudioMenuPopup 0 "Not_Active" 1 "Active";
VAL_ 1455 Avg_Fuel_Econ 1023 "SNA";
VAL_ 1455 Cluster_In_Audio_Md 0 "Not_Active" 1 "Active";
VAL_ 1455 IC_ETM_HUDCustom_Req 0 "Default" 1 "ETM Settings Being Active work by User" 2 "ETM Settings Saved by Cutomer" 3 "SNA";
VAL_ 1455 IPC_NavigationMap_Req 0 "Send_Nav_Map" 1 "Not_Active" 2 "Disable_Projection";
VAL_ 1455 NavigationMapPopUP 0 "Active" 1 "NotActive";
VAL_ 1455 NextNavInstructionPanelTheme 0 "Analog" 1 "Digital" 15 "SNA";
VAL_ 1844 B_EV_Kilometers 16777215 "SNA";
VAL_ 1844 B_EV_Miles 16777215 "SNA";
VAL_ 1844 B_Hybrid_Kilometers 16777215 "SNA";
VAL_ 1844 B_Hybrid_Miles 16777215 "SNA";
VAL_ 1842 Gas_Range 1023 "SNA";
VAL_ 1842 Total_Range 2047 "SNA";
