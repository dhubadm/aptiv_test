VERSION ""

NS_ :

BS_:

BU_: AGSM BCM BSM CADM DMSM DTCM ECM EVCU2 GNMM HCP IPC RFHM SGW TCM
BO_ 271 ENGINE_HYBD_FD_1: 64 ECM
 SG_ AccPos : 343|8@0+ (0.392157,0) [0|100] "%" HCP
 SG_ AccPosV : 214|1@0+ (1,0) [0|1] "" HCP
 SG_ Cam_Exh_1_Locked : 231|1@0+ (1,0) [0|0] "-" Vector__XXX
 SG_ Cam_Exh_2_Locked : 230|1@0+ (1,0) [0|0] "-" Vector__XXX
 SG_ Cam_Int_1_Locked : 229|1@0+ (1,0) [0|0] "-" Vector__XXX
 SG_ Cam_Int_2_Locked : 228|1@0+ (1,0) [0|0] "-" Vector__XXX
 SG_ CmndFlyWheelTorqPotential : 99|12@0+ (0.32,-300.16) [-300.16|1008] "Nm" HCP
 SG_ CmndFlyWheelTorqPrdtd : 115|12@0+ (0.32,-300.16) [-300.16|1008] "Nm" HCP
 SG_ CmndFlyWheelTorqRespTyp : 165|2@0+ (1,0) [0|0] "-" HCP
 SG_ Crank_Locked : 247|1@0+ (1,0) [0|0] "-" Vector__XXX
 SG_ Crank_Maturing_Fault : 246|1@0+ (1,0) [0|0] "-" Vector__XXX
 SG_ CRC_ENGINE_HYBD_FD_1 : 447|8@0+ (1,0) [0|255] "-" HCP,TCM
 SG_ CylOff : 245|1@0+ (1,0) [0|0] "-" HCP
 SG_ DrvrIntndedFlyWheelTorq : 131|12@0+ (0.32,-300.16) [-300.16|1008] "Nm" HCP
 SG_ DrvrIntndedFlyWheelTorqRaw : 147|12@0+ (0.32,-300.16) [-300.16|1008] "Nm" HCP
 SG_ DrvrIntndedFlyWheelTorqRawV : 181|1@0+ (1,0) [0|0] "-" HCP
 SG_ DrvrIntndedFlyWheelTorqV : 180|1@0+ (1,0) [0|0] "-" HCP
 SG_ ECM_Crank_Phase : 372|3@0+ (1,0) [0|7] "-" HCP
 SG_ ECMReq_Remedial_Stop : 135|2@0+ (1,0) [0|0] "-" EVCU2
 SG_ ECU_A2D_Failure : 244|1@0+ (1,0) [0|0] "-" HCP
 SG_ EngActStdyStTorq : 259|12@0+ (0.32,-300.16) [-300.16|1008] "Nm" HCP
 SG_ EngActStdyStTorqV : 263|1@0+ (1,0) [0|0] "-" HCP
 SG_ EngActuatorsStat : 133|2@0+ (1,0) [0|0] "-" HCP
 SG_ EngAirFlwStdyStTorq : 275|12@0+ (0.32,-300.16) [-300.16|1008] "Nm" HCP
 SG_ EngAirFlwStdyStTorqV : 262|1@0+ (1,0) [0|0] "-" HCP
 SG_ EngCmbstnCmnd : 199|1@0+ (1,0) [0|0] "-" HCP
 SG_ EngCylDeactEnCondMet : 261|1@0+ (1,0) [0|0] "-" HCP
 SG_ EngCylDeactMd : 151|2@0+ (1,0) [0|0] "-" HCP
 SG_ EngDFCO_Allw : 260|1@0+ (1,0) [0|0] "-" HCP
 SG_ EngDFCO_Req : 279|1@0+ (1,0) [0|0] "-" HCP
 SG_ EngDFCO_St : 278|1@0+ (1,0) [0|0] "-" HCP
 SG_ Engine_Sync_720 : 277|1@0+ (1,0) [0|0] "-" Vector__XXX
 SG_ EngOffRecom : 276|1@0+ (1,0) [0|0] "-" HCP
 SG_ EngRqStTyp : 103|4@0+ (1,0) [0|0] "-" HCP
 SG_ EngRunCrnkAct : 295|1@0+ (1,0) [0|0] "-" HCP
 SG_ EngSysFld : 294|1@0+ (1,0) [0|0] "-" HCP
 SG_ EngTrqReserveReq : 351|8@0+ (0.32,0) [0|81.28] "Nm" HCP
 SG_ ESS_Engine_State_EE : 119|4@0+ (1,0) [0|0] "-" EVCU2,HCP
 SG_ ETRQ_Mode : 362|3@0+ (1,0) [0|5] "-" HCP
 SG_ Feedback_HCP : 293|1@0+ (1,0) [0|0] "-" HCP
 SG_ HybActEngTorqRespTyp : 149|2@0+ (1,0) [0|0] "-" HCP
 SG_ MaxOffEngTorqCap : 163|12@0+ (0.32,-300.16) [-300.16|1008] "Nm" HCP
 SG_ MaxPrdtdEngTorqCap : 179|12@0+ (0.32,-300.16) [-300.16|1008] "Nm" HCP
 SG_ MaxPrdtdEngTorqCapV : 198|1@0+ (1,0) [0|0] "-" HCP
 SG_ MessageCounter_ENGINE_HYBD_FD_1 : 435|4@0+ (1,0) [0|15] "-" HCP,TCM
 SG_ MinAirFlowMinSparkTorqCap : 195|12@0+ (0.32,-300.16) [-300.16|1008] "Nm" HCP
 SG_ MinAirFlowMinSparkTorqCapV : 197|1@0+ (1,0) [0|0] "-" HCP
 SG_ MinEngTorqCap : 211|12@0+ (0.32,-300.16) [-300.16|1008] "Nm" HCP
 SG_ MinEngTorqCapV : 196|1@0+ (1,0) [0|0] "-" HCP
 SG_ MinImmedEngTorqCap : 227|12@0+ (0.32,-300.16) [-300.16|1008] "Nm" HCP
 SG_ MinImmedEngTorqCapV : 215|1@0+ (1,0) [0|0] "-" HCP
 SG_ MinPrdtdEngRunTorqCap : 243|12@0+ (0.32,-300.16) [-300.16|1008] "Nm" HCP
 SG_ MinPrdtdEngRunTorqCapV : 213|1@0+ (1,0) [0|0] "-" HCP
 SG_ PT_BrakePdlPosn : 383|8@0+ (0.4,0) [0|101.6] "%" HCP
 SG_ PT_BrkPedDscrtInpStat : 292|1@0+ (1,0) [0|0] "-" HCP
 SG_ PT_BrkPedDscrtInpStatV : 311|1@0+ (1,0) [0|0] "-" HCP
 SG_ PT_CrnkAct : 310|1@0+ (1,0) [0|0] "-" HCP
 SG_ PTCrnkAbrted : 309|1@0+ (1,0) [0|0] "-" HCP
 SG_ Sum_FW_ID_Fst : 367|5@0+ (1,0) [0|30] "-" HCP
 SG_ Sum_FW_ID_Slw : 327|5@0+ (1,0) [0|30] "-" HCP
 SG_ T_max_FW : 291|12@0+ (0.32,-300.16) [-300.16|1008] "Nm" HCP
 SG_ T_min_FW : 307|12@0+ (0.32,-300.16) [-300.16|1008] "Nm" HCP
 SG_ TLC_LRN_Rq : 322|1@0+ (1,0) [0|0] "-" HCP

BO_ 1035 ENGINE_HYBD_FD_3: 32 ECM
 SG_ AGSposn : 134|7@0+ (1,0) [0|100] "%" HCP
 SG_ CRC_ENGINE_HYBD_FD_3 : 191|8@0+ (1,0) [0|255] "-" BSM,EVCU2,HCP
 SG_ ECM_AirflowRequest : 87|7@0+ (1,0) [0|127] "%" EVCU2
 SG_ ECM_WorkSite_Invtr_Sts : 181|2@0+ (1,0) [0|3] "-" HCP
 SG_ EngCltTmp : 167|8@0+ (1,-40) [-40|214] "°C" EVCU2,HCP
 SG_ EngCltTmpV : 69|1@0+ (1,0) [0|1] "" EVCU2,HCP
 SG_ EngHalfCylSpdMaxLim : 20|13@0+ (1,0) [0|8160] "rpm" HCP
 SG_ EngHalfCylSpdMinLim : 36|13@0+ (1,0) [0|8160] "rpm" HCP
 SG_ EngOutofFuel : 151|1@0+ (1,0) [0|0] "-" EVCU2,HCP
 SG_ EngSpd : 7|16@0+ (0.125,0) [0|8160] "rpm" HCP
 SG_ EngSpdStat : 38|2@0+ (1,0) [0|0] "-" HCP
 SG_ LTR_PumpSpeedAct : 142|7@0+ (1,0) [0|100] "%" HCP,SGW
 SG_ MaxEngSpdCap : 52|13@0+ (1,0) [0|8160] "rpm" HCP
 SG_ MessageCounter_ENGINE_HYBD_FD_3 : 179|4@0+ (1,0) [0|15] "-" BSM,EVCU2,HCP
 SG_ MinEngSpdCap : 68|13@0+ (1,0) [0|8160] "rpm" HCP
 SG_ RadFanReq : 158|7@0+ (1,0) [0|100] "%" HCP
 SG_ ServiceHybSys : 55|1@0+ (1,0) [0|0] "-" HCP

BO_ 1328 ENGINE_HYBD_FD_4: 32 ECM
 SG_ CatHtgStateActive : 20|1@0+ (1,0) [0|0] "-" HCP
 SG_ CRC_ENGINE_HYBD_FD_4 : 191|8@0+ (1,0) [0|255] "-" HCP
 SG_ EngTorqACCCapability : 79|8@0+ (0.32,0) [0|81.28] "Nm" HCP
 SG_ EngTorqCapbltyEngOpMd : 21|1@0+ (1,0) [0|0] "-" HCP
 SG_ EngTorqCapbltyFrmCntr : 7|4@0+ (1,0) [0|15] "-" HCP
 SG_ EngTorqCapbltyMaxOffTorq : 3|12@0+ (0.32,-300.16) [-300.16|1008] "Nm" HCP
 SG_ EngTorqCapbltyMaxTorq : 19|12@0+ (0.32,-300.16) [-300.16|1008] "Nm" HCP
 SG_ EngTorqCapbltyMinRunTorq : 35|12@0+ (0.32,-300.16) [-300.16|1008] "Nm" HCP
 SG_ EngTorqCapbltyMinTorq : 51|12@0+ (0.32,-300.16) [-300.16|1008] "Nm" HCP
 SG_ EngTorqCapbltyRefEngSpd : 71|8@0+ (32,0) [0|8160] "rpm" HCP
 SG_ MessageCounter_ENGINE_HYBD_FD_4 : 179|4@0+ (1,0) [0|15] "-" HCP

BO_ 287 ENGINE_SIMULATOR1: 32 EVCU2
 SG_ WED_STATUS : 90|3@0+ (1,0) [0|7] "" BSM

BO_ 264 EPS_FD_1: 32 BCM
 SG_ CRC_EPS1 : 191|8@0+ (1,0) [0|255] "-" BSM,DMSM,DTCM,ECM,TCM
 SG_ ElectricSteeringFailSts : 37|1@0+ (1,0) [0|1] "-" DTCM
 SG_ EngineFanRequestActivation : 38|1@0+ (1,0) [0|1] "-" ECM
 SG_ LwsAngle : 7|16@0+ (0.1,-720) [-720|720] "°" BSM,DMSM,DTCM,ECM,EVCU2,IPC,SGW,TCM
 SG_ LwsAngleType : 52|2@0+ (1,0) [0|2] "-" BSM,IPC
 SG_ LwsCalibration : 36|1@0+ (1,0) [0|1] "-" BSM,IPC
 SG_ LwsSpeed : 19|12@0+ (1,-2000) [-2000|2094] "°/s" ECM,EVCU2,IPC
 SG_ MessageCounter_EPS1 : 179|4@0+ (1,0) [0|15] "-" BSM,DMSM,DTCM,ECM,TCM

BO_ 1056 EPS_FD_2: 32 BCM
 SG_ CRC_EPS2 : 191|8@0+ (1,0) [0|255] "0" IPC
 SG_ EPS_Warn_Disp_Rq : 87|3@0+ (1,0) [0|3] "" ECM,IPC,SGW
 SG_ MessageCounter_EPS2 : 179|4@0+ (1,0) [0|15] "0" IPC

BO_ 1460 FOTA_MASTER: 32 SGW
 SG_ CADM_Big_ECU_Package : 3|1@0+ (1,0) [0|1] "" CADM
 SG_ FOTA_Install_Type : 21|2@0+ (1,0) [0|3] "" ECM,EVCU2
 SG_ FOTA_Installation_Status : 23|2@0+ (1,0) [0|3] "" EVCU2,RFHM
 SG_ FOTA_Purge : 13|1@0+ (1,0) [0|1] "" CADM
 SG_ FOTA_Status : 7|4@0+ (1,0) [0|15] "" BCM,BSM,CADM,ECM,IPC,RFHM,TCM
 SG_ Safe_State : 0|1@0+ (1,0) [0|1] "" CADM
 SG_ WakeUpECM : 14|1@0+ (1,0) [0|1] "" BCM

BO_ 1846 FOTA_RSP_CADM: 32 CADM
 SG_ Big_ECU_Ready_CADM : 3|2@0+ (1,0) [0|3] "" SGW
 SG_ Download_Status_CADM : 7|2@0+ (1,0) [0|3] "" SGW
 SG_ Update_Status_CADM : 5|2@0+ (1,0) [0|3] "" SGW

BO_ 525 GLOB_NAV_FD: 64 GNMM
 SG_ Altitude_RMSE : 143|8@0+ (2,0) [0|506] "cm" CADM
 SG_ CRC_GLOB_NAV : 447|8@0+ (1,0) [0|255] "-" BCM,CADM
 SG_ GNMM_Health : 7|4@0+ (1,0) [0|6] "" BCM,CADM
 SG_ Heading_Angle : 127|16@0+ (0.01,0) [0|360] "deg" CADM
 SG_ Lat_GNMM : 407|32@0+ (5E-08,-90) [-90|124.7483647] "deg" CADM
 SG_ LatAcceleration_GNMM : 19|12@0+ (0.02,-40.96) [-40.96|40.92] "m/s2" CADM
 SG_ LateralVelocity_GNMM : 181|14@0+ (0.01,-81.92) [-81.92|81.9] "m/s" CADM
 SG_ Latitude_RMSE : 103|8@0+ (2,0) [0|506] "cm" CADM
 SG_ Long_GNMM : 327|32@0+ (1E-07,-180) [-180|249.4967294] "deg" CADM
 SG_ LongAcceleration_GNMM : 3|12@0+ (0.02,-40.96) [-40.96|40.92] "m/s2" CADM
 SG_ Longitude_RMSE : 111|8@0+ (2,0) [0|506] "cm" CADM
 SG_ LongitudinalVelocity_GNMM : 213|14@0+ (0.01,-81.92) [-81.92|81.9] "m/s" CADM
 SG_ MessageCounter_GLOB_NAV : 435|4@0+ (1,0) [0|15] "-" BCM,CADM
 SG_ Pitch_RMSE : 159|8@0+ (2,0) [0|506] "deg" CADM
 SG_ PitchRate_GNMM : 83|12@0+ (0.08,-163.84) [-163.84|163.68] "deg/s" CADM
 SG_ Roll_RMSE : 151|8@0+ (2,0) [0|506] "deg" CADM
 SG_ RollRate_GNMM : 67|12@0+ (0.08,-163.84) [-163.84|163.68] "deg/s" CADM
 SG_ VerticalAcceleration_GNMM : 35|12@0+ (0.02,-40.96) [-40.96|40.92] "m/s2" CADM
 SG_ VerticalVelocity_GNMM : 197|14@0+ (0.01,-81.92) [-81.92|81.9] "m/s" CADM
 SG_ YawRate_GNMM : 166|15@0+ (0.01,-163.83) [-163.83|163.83] "deg/s" CADM
 SG_ YawRate_RMSE : 119|8@0+ (2,0) [0|506] "deg" CADM

BO_ 1487 HCP_CHARGING_STAT: 64 EVCU2
 SG_ Chargeport_Lock_Status : 7|2@0+ (1,0) [0|3] "" SGW
 SG_ Cooperative_Status : 66|3@0+ (1,0) [0|7] "" SGW
 SG_ Energy_to_Battery : 9|9@0+ (0.1,0) [0|51.1] "kW" SGW
 SG_ Est_Range_FullCharge : 16|11@0+ (1,0) [0|2047] "km" SGW
 SG_ EV_Charge_Current : 44|11@0+ (0.1,0) [0|204.70] "Amp" SGW
 SG_ EVSE_Power : 37|9@0+ (0.1,0) [0|51.1] "kW" SGW
 SG_ Lv1_EstChargeTime_80 : 63|13@0+ (1,0) [0|8191] "Min" SGW
 SG_ Lv2_EstChargeTime_80 : 79|13@0+ (1,0) [0|8191] "Min" SGW
 SG_ Total_Battery_Capacity : 5|12@0+ (0.1,0) [0|409.5] "kWh" SGW

BO_ 266 HVBATTERY1: 32 HCP
 SG_ HVBatCellVoltage_Max : 36|13@0+ (0.001,0) [0|5] "Volts" SGW
 SG_ HVBatCellVoltage_Min : 108|13@0+ (0.001,0) [0|5] "Volts" SGW
 SG_ HVBatCellVoltage_NumMax : 71|4@0+ (1,0) [0|15] "Volts" SGW
 SG_ HVBatContactorSts : 23|3@0+ (1,0) [0|0] "-" BCM
 SG_ HVBatModuleVoltage_NumMax : 124|5@0+ (1,0) [0|31] "-" SGW
 SG_ HVBatModuleVoltage_NumMin : 132|5@0+ (1,0) [0|31] "-" SGW
 SG_ HVBatteryCurrent : 5|14@0+ (0.1,-512.1) [-512|512] "Amp" ECM,SGW
 SG_ HVBatteryVoltage : 67|12@0+ (0.1,180) [180|511] "Volts" SGW
 SG_ IsolationSts_HVBattery : 38|2@0+ (1,0) [0|0] "-" SGW
 SG_ IsolationSts_HVPowertrain : 54|2@0+ (1,0) [0|0] "-" SGW

BO_ 1027 HVBATTERY2: 32 EVCU2
 SG_ CRC_HVBATTERY2 : 191|8@0+ (1,0) [0|255] "-" BSM,IPC
 SG_ HVBatteryMILRequest : 7|1@0+ (1,0) [0|0] "-" ECM,IPC,SGW
 SG_ MessageCounter_HVBATTERY2 : 179|4@0+ (1,0) [0|15] "-" BSM,IPC

BO_ 1834 HVBATTERY5: 32 EVCU2
 SG_ HVBattery_RealTimeClock : 7|32@0+ (1,0) [0|4294967294] "sec" ECM
 SG_ HVBattery_RealTimeClockV : 36|1@0+ (1,0) [0|0] "-" ECM

BO_ 1049 HYBRID_DISPLAY: 32 EVCU2
 SG_ BatteryPowerUsage : 55|8@0+ (1,-125) [-125|130] "kW" SGW
 SG_ BatteryPowerUsageV : 65|1@0+ (1,0) [0|0] "" SGW
 SG_ BatteryPowerUse_Display : 111|8@0+ (1,-125) [-125|130] "kW" SGW
 SG_ BatteryPowerUse_DisplayV : 138|1@0+ (1,0) [0|1] "-" SGW
 SG_ ChargeSystemFault_DPT : 142|1@0+ (1,0) [0|1] "-" IPC,SGW
 SG_ ChargeSystemSts_DPT : 7|3@0+ (1,0) [0|6] "-" BCM,IPC,SGW
 SG_ ChargingLevelForDisplay : 166|4@0+ (1,0) [0|14] "" IPC,SGW
 SG_ CRC_HYBRID_DISPLAY : 191|8@0+ (1,0) [0|255] "-" BCM,CADM,IPC
 SG_ EstimatedRange : 127|8@0+ (1,0) [0|254] "km" SGW
 SG_ FOTA_Schedule_Conflict : 143|1@0+ (1,0) [0|0] "" SGW
 SG_ HCP_EVServiceLampOn : 20|2@0+ (1,0) [0|2] "-" IPC,SGW
 SG_ HVACPowerUse_Display : 134|7@0+ (1,0) [0|127] "kW" SGW
 SG_ HVACPowerUse_DisplayV : 140|1@0+ (1,0) [0|1] "-" SGW
 SG_ HVBatterySOC_Display : 119|8@0+ (0.3922,0) [0|100] "%" BCM,IPC,SGW
 SG_ HVBatterySOC_DisplayV : 141|1@0+ (1,0) [0|1] "-" IPC,SGW
 SG_ HybridEfficiencyCoach : 87|8@0+ (1,-100) [-100|100] "%" SGW
 SG_ HybridEfficiencyCoachV : 67|1@0+ (1,0) [0|1] "-" SGW
 SG_ HybridMILRequest : 135|1@0+ (1,0) [0|1] "-" ECM,SGW
 SG_ HybridOutputPower : 63|8@0+ (1,-100) [-100|100] "%" IPC,SGW
 SG_ HybridOutputPowerV : 66|1@0+ (1,0) [0|1] "-" IPC,SGW
 SG_ Lv1_EstChargeTime : 4|13@0+ (1,0) [0|8190] "min" IPC,SGW
 SG_ Lv2_EstChargeTime : 18|11@0+ (1,0) [0|2046] "min" IPC,SGW
 SG_ MessageCounter_HYBRID_DISPLAY : 179|4@0+ (1,0) [0|15] "-" BCM,CADM,IPC
 SG_ OnePedal_Drive_Sts : 169|2@0+ (1,0) [0|3] "-" IPC
 SG_ PlugAndChargeSts : 144|1@0+ (1,0) [0|1] "" Vector__XXX
 SG_ PopUpMessage1 : 23|1@0+ (1,0) [0|1] "-" IPC,SGW
 SG_ PopUpMessage10 : 70|1@0+ (1,0) [0|1] "-" IPC
 SG_ PopUpMessage11 : 71|1@0+ (1,0) [0|1] "-" IPC
 SG_ PopUpMessage12 : 147|2@0+ (1,0) [0|3] "-" IPC
 SG_ PopUpMessage2 : 34|1@0+ (1,0) [0|1] "-" IPC
 SG_ PopUpMessage3 : 35|1@0+ (1,0) [0|1] "-" IPC
 SG_ PopUpMessage4 : 36|1@0+ (1,0) [0|1] "-" IPC
 SG_ PopUpMessage5 : 37|1@0+ (1,0) [0|1] "-" IPC
 SG_ PopUpMessage6 : 38|1@0+ (1,0) [0|1] "-" IPC
 SG_ PopUpMessage7 : 39|1@0+ (1,0) [0|1] "-" IPC
 SG_ PopUpMessage9 : 69|1@0+ (1,0) [0|1] "-" IPC,SGW
 SG_ RefrigerantPressure : 64|9@0+ (0.1,0) [0|40] "bar" BCM
 SG_ Regen_Status : 172|3@0+ (1,0) [0|7] "-" IPC

BO_ 1044 HYBRID_DISPLAY2: 64 EVCU2
 SG_ DischargingSysStatus : 66|2@0+ (0,0) [0|0] "" EVCU2,RFHM
 SG_ PnC_Failure : 67|1@0+ (1,0) [0|1] "" Vector__XXX
 SG_ PnC_Reattepmt_Failure : 68|1@0+ (1,0) [0|1] "" IPC

BO_TX_BU_ 1027 : EVCU2,HCP;
BO_TX_BU_ 1049 : EVCU2,HCP;
CM_ SG_ 271 AccPos "Accelerator Effective Position";
CM_ SG_ 271 AccPosV "Accelerator Effective Position Validity";
CM_ SG_ 271 Cam_Exh_1_Locked "Indicates the camshaft driver has locked the camshaft position (exhaust cam bank 1)";
CM_ SG_ 271 Cam_Exh_2_Locked "Indicates the camshaft driver has locked the camshaft position (exhaust cam bank 2)";
CM_ SG_ 271 Cam_Int_1_Locked "Indicates the camshaft driver has locked the camshaft position (intake cam bank 1)";
CM_ SG_ 271 Cam_Int_2_Locked "Indicates the camshaft driver has locked the camshaft position (intake cam bank 2)";
CM_ SG_ 271 CmndFlyWheelTorqPotential "Commanded Flywheel Torque Potential";
CM_ SG_ 271 CmndFlyWheelTorqPrdtd "Commanded Flywheel Torque: Predicted Torque";
CM_ SG_ 271 CmndFlyWheelTorqRespTyp "Commanded Flywheel Torque Response Type";
CM_ SG_ 271 Crank_Locked "Indicates that the crankshaft has locked its position";
CM_ SG_ 271 Crank_Maturing_Fault "Indicates ECM is maturing a crank fault diagnostic";
CM_ SG_ 271 CRC_ENGINE_HYBD_FD_1 "CRC according to SAE J1850 standard at each frame transmission.";
CM_ SG_ 271 CylOff "Cylinder off due to misfire";
CM_ SG_ 271 DrvrIntndedFlyWheelTorq "Driver Intended Flywheel Torque";
CM_ SG_ 271 DrvrIntndedFlyWheelTorqRaw "Driver Intended Flywheel Torque Raw";
CM_ SG_ 271 DrvrIntndedFlyWheelTorqRawV "Driver Intended Flywheel Torque Raw Validity";
CM_ SG_ 271 DrvrIntndedFlyWheelTorqV "Driver Intended Flywheel Torque Validity";
CM_ SG_ 271 ECM_Crank_Phase "BSG applications between the ECM and HCP";
CM_ SG_ 271 ECMReq_Remedial_Stop "Engine Stop Request";
CM_ SG_ 271 ECU_A2D_Failure "AVD Failure Flag";
CM_ SG_ 271 EngActStdyStTorq "Engine actual steady state torque (current conditions)";
CM_ SG_ 271 EngActStdyStTorqV "Engine actual steady state torque validity; Invalid = [1]";
CM_ SG_ 271 EngActuatorsStat "Engine Actuator Status for Autostop";
CM_ SG_ 271 EngAirFlwStdyStTorq "Engine airflow steady state torque (potential)";
CM_ SG_ 271 EngAirFlwStdyStTorqV "Engine airflow steady state torque validity; Invalid = [1]";
CM_ SG_ 271 EngCmbstnCmnd "Engine combustion commanded";
CM_ SG_ 271 EngCylDeactEnCondMet "Engine cylinder deactivation enable conditions met";
CM_ SG_ 271 EngCylDeactMd "Engine Cylinder Deactivation Mode";
CM_ SG_ 271 EngDFCO_Allw "Engine deceleration fuel cut off allowed";
CM_ SG_ 271 EngDFCO_Req "Engine deceleration fuel cut off requested";
CM_ SG_ 271 EngDFCO_St "Engine deceleration fuel cut off state";
CM_ SG_ 271 Engine_Sync_720 "Indicates that the crank and cams have synchronized";
CM_ SG_ 271 EngOffRecom "Engine off recommendation";
CM_ SG_ 271 EngRqStTyp "Engine requested start type";
CM_ SG_ 271 EngRunCrnkAct "ECM run crank terminal status, 1=active";
CM_ SG_ 271 EngSysFld "Engine System Failed";
CM_ SG_ 271 EngTrqReserveReq "Engine Torque Reserve Request";
CM_ SG_ 271 ESS_Engine_State_EE "ESS Engine State";
CM_ SG_ 271 ETRQ_Mode "Enumeration of combustion torque mode";
CM_ SG_ 271 Feedback_HCP "Indication that the ECM is receiving valid data from the HCP. 0 - False; 1 - True.";
CM_ SG_ 271 HybActEngTorqRespTyp "Hybrid Actual Engine Torque Response Type";
CM_ SG_ 271 MaxOffEngTorqCap "Capacity Max-off";
CM_ SG_ 271 MaxPrdtdEngTorqCap "Maximum predicted engine torque capacity";
CM_ SG_ 271 MaxPrdtdEngTorqCapV "Maximum predicted engine torque capacity validity; Invalid = [1]";
CM_ SG_ 271 MessageCounter_ENGINE_HYBD_FD_1 "This signal is a counter used for safety checks strategies. This counter is incremented of 1 (one) unit at each frame transmission.";
CM_ SG_ 271 MinAirFlowMinSparkTorqCap "Engine Torque capacity at minimum air flow and  minimum spark";
CM_ SG_ 271 MinAirFlowMinSparkTorqCapV "Engine Torque capacity at minimum air flow and  minimum spark validity; Invalid = [1]";
CM_ SG_ 271 MinEngTorqCap "Minimum engine torque capacity (min air flow, fuel off)";
CM_ SG_ 271 MinEngTorqCapV "Minimum engine torque capacity validity; Invalid = [1]";
CM_ SG_ 271 MinImmedEngTorqCap "Minimum immediate engine torque capacity (current air flow, minimum spark)";
CM_ SG_ 271 MinImmedEngTorqCapV "Minimum immediate engine torque capacity validity; Invalid = [1]";
CM_ SG_ 271 MinPrdtdEngRunTorqCap "Minimum predicted engine run torque capacity (minimum air flow, MBT spark)";
CM_ SG_ 271 MinPrdtdEngRunTorqCapV "Minimum predicted engine run torque capacity validity; Invalid = [1]";
CM_ SG_ 271 PT_BrakePdlPosn "Brake pedal travel sensor 0-100% (0 = upstop)";
CM_ SG_ 271 PT_BrkPedDscrtInpStat "Powertrain brake pedal discrete input status";
CM_ SG_ 271 PT_BrkPedDscrtInpStatV "Powertrain brake pedal discrete input status validity; Invalid = [1]";
CM_ SG_ 271 PT_CrnkAct "Powertrain crank active";
CM_ SG_ 271 PTCrnkAbrted "Powertrain crank aborted";
CM_ SG_ 271 Sum_FW_ID_Fst "Enumeration of system controlling combustion fast path";
CM_ SG_ 271 Sum_FW_ID_Slw "Enumeration of system controlling combustion slow path";
CM_ SG_ 271 T_max_FW "T_max_FW";
CM_ SG_ 271 T_min_FW "T_min_FW";
CM_ SG_ 271 TLC_LRN_Rq "TLC learning request";
CM_ SG_ 1035 AGSposn ".";
CM_ SG_ 1035 CRC_ENGINE_HYBD_FD_3 "CRC according to SAE J1850 standard at each frame transmission.";
CM_ SG_ 1035 ECM_AirflowRequest "ECM Air Flow Request to the hybrid controller combining AGS and Fan requests";
CM_ SG_ 1035 ECM_WorkSite_Invtr_Sts "ECM 2KW Inverter support status";
CM_ SG_ 1035 EngCltTmp "Engine Coolant Temp";
CM_ SG_ 1035 EngCltTmpV "Engine Coolant Temperature Validity";
CM_ SG_ 1035 EngHalfCylSpdMaxLim "Engine Half Cylinder Speed Maximum Limit";
CM_ SG_ 1035 EngHalfCylSpdMinLim "Engine Half Cylinder Speed Minimum Limit";
CM_ SG_ 1035 EngOutofFuel "Engine System Failed (limp home = 1)";
CM_ SG_ 1035 EngSpd "Engine speed";
CM_ SG_ 1035 EngSpdStat "Engine speed status";
CM_ SG_ 1035 LTR_PumpSpeedAct "Low temperature radiator pump actual flow speed";
CM_ SG_ 1035 MaxEngSpdCap "Maximum Engine Speed Capacity";
CM_ SG_ 1035 MessageCounter_ENGINE_HYBD_FD_3 "This signal is a counter used for safety checks strategies. This counter is incremented of 1 (one) unit at each frame transmission.";
CM_ SG_ 1035 MinEngSpdCap "Minimum Engine Speed Capacity";
CM_ SG_ 1035 RadFanReq "Radiator Fan request";
CM_ SG_ 1035 ServiceHybSys "Service Hybrid system; True = [1]";
CM_ SG_ 1328 CatHtgStateActive "Catalysator Heating Status Request, 0- no request, 1 - request";
CM_ SG_ 1328 CRC_ENGINE_HYBD_FD_4 "CRC according to SAE J1850 standard at each frame transmission.";
CM_ SG_ 1328 EngTorqACCCapability "Eng Trq to be subtracted from the entire capability curve on the HCP side";
CM_ SG_ 1328 EngTorqCapbltyEngOpMd "Engine operating mode [0] = non-MDS, [1] = MDS";
CM_ SG_ 1328 EngTorqCapbltyFrmCntr "Engine Torque Capability: Frame Counter (4 bit)";
CM_ SG_ 1328 EngTorqCapbltyMaxOffTorq "Capability Max-off";
CM_ SG_ 1328 EngTorqCapbltyMaxTorq "Engine torque capability: maximum torque";
CM_ SG_ 1328 EngTorqCapbltyMinRunTorq "Engine torque capability: minimum run torque (fuel on)";
CM_ SG_ 1328 EngTorqCapbltyMinTorq "Engine torque capability: minimum torque (fuel off)";
CM_ SG_ 1328 EngTorqCapbltyRefEngSpd "Engine torque capability: reference engine speed";
CM_ SG_ 1328 MessageCounter_ENGINE_HYBD_FD_4 "This signal is a counter used for safety checks strategies. This counter is incremented of 1 (one) unit at each frame transmission.";
CM_ SG_ 287 WED_STATUS "WED Status";
CM_ SG_ 264 CRC_EPS1 "CRC according to SAE J1850 standard at each frame transmission.";
CM_ SG_ 264 ElectricSteeringFailSts "It indicates if system EPS has an internal fault.";
CM_ SG_ 264 EngineFanRequestActivation "This signal is used to activate the cooling fun by the electric power steering.";
CM_ SG_ 264 LwsAngle "This signal indicates the steering angle value, counterclockwise positive.";
CM_ SG_ 264 LwsAngleType "This signal indicates whether the angle sensor is absolute (all the possible turns/degrees) or not absolute (relative, torque only, etc.).";
CM_ SG_ 264 LwsCalibration "This signal indicates if the sensor has been calibrated and therefore the steering angle value is exported over Can.";
CM_ SG_ 264 LwsSpeed "This signal indicates the steering speed value, counterclockwise positive.";
CM_ SG_ 264 MessageCounter_EPS1 "This signal is a counter used for safety checks strategies. This counter is incremented of 1 (one) unit at each frame transmission.";
CM_ SG_ 1056 CRC_EPS2 "CRC according to SAE J1850 standard at each frame transmission.";
CM_ SG_ 1056 EPS_Warn_Disp_Rq "Electric Power Steering Warning Display Request";
CM_ SG_ 1056 MessageCounter_EPS2 "This signal is a counter used for safety checks strategies. This counter is incremented of 1 (one) unit at each frame transmission.";
CM_ SG_ 1460 CADM_Big_ECU_Package "CADM_Big_ECU_Package";
CM_ SG_ 1460 FOTA_Install_Type "Type of FOTA Installation";
CM_ SG_ 1460 FOTA_Installation_Status "FOTA Installation Status";
CM_ SG_ 1460 FOTA_Purge "Target ECUs to Purge Downloaded FOTA Images";
CM_ SG_ 1460 FOTA_Status "FOTA_Status";
CM_ SG_ 1460 Safe_State "Safe_State";
CM_ SG_ 1460 WakeUpECM "When signal active BCM wakes up ECM through hardwire";
CM_ SG_ 1846 Big_ECU_Ready_CADM "Big_ECU_Ready_CADM";
CM_ SG_ 1846 Download_Status_CADM "Download_Status_CADM";
CM_ SG_ 1846 Update_Status_CADM "Update_Status_CADM";
CM_ SG_ 525 Altitude_RMSE "Altitude_RMSE";
CM_ SG_ 525 CRC_GLOB_NAV "CRC according to SAE J1850 standard at each frame transmission.";
CM_ SG_ 525 GNMM_Health "Reported capability of GNMM to provide positioning and acceleration data";
CM_ SG_ 525 Heading_Angle "Heading Angle";
CM_ SG_ 525 Lat_GNMM "Latitude decimal degrees, positive North of the equator";
CM_ SG_ 525 LatAcceleration_GNMM "Lateral Acceleration Value from the GNMM";
CM_ SG_ 525 LateralVelocity_GNMM "Lateral Velocity";
CM_ SG_ 525 Latitude_RMSE "RMS error for Latitude";
CM_ SG_ 525 Long_GNMM "Longitude decimal degrees, positive East of the prime meridian";
CM_ SG_ 525 LongAcceleration_GNMM "Longitudinal Acceleration Value from the GNMM";
CM_ SG_ 525 Longitude_RMSE "RMS error for Longitude";
CM_ SG_ 525 LongitudinalVelocity_GNMM "Longitudinal Velocity";
CM_ SG_ 525 MessageCounter_GLOB_NAV "This signal is a counter used for safety checks strategies. This counter is incremented of 1 (one) unit at each frame transmission.";
CM_ SG_ 525 Pitch_RMSE "Pitch_RMSE";
CM_ SG_ 525 PitchRate_GNMM "Pitch Rate Value from the GNMM";
CM_ SG_ 525 Roll_RMSE "Roll_RMSE";
CM_ SG_ 525 RollRate_GNMM "Roll Rate Value from the GNMM";
CM_ SG_ 525 VerticalAcceleration_GNMM "Vertical Acceleration Value from the GNMM";
CM_ SG_ 525 VerticalVelocity_GNMM "Vertical Velocity";
CM_ SG_ 525 YawRate_GNMM "Yaw Rate Value from the GNMM";
CM_ SG_ 525 YawRate_RMSE "RMS error for YawRate";
CM_ SG_ 1487 Chargeport_Lock_Status "Charge Port Lock Status";
CM_ SG_ 1487 Cooperative_Status "Cooperative charging status";
CM_ SG_ 1487 Energy_to_Battery "HV Battery Charging Energy Rate";
CM_ SG_ 1487 Est_Range_FullCharge "Estimated Range at 100% SOC";
CM_ SG_ 1487 EV_Charge_Current "HV Charging Current Draw from EVSE";
CM_ SG_ 1487 EVSE_Power "EVSE Power available";
CM_ SG_ 1487 Lv1_EstChargeTime_80 "Estimated time to charge to 80% on Level 1";
CM_ SG_ 1487 Lv2_EstChargeTime_80 "Estimated time to charge to 80% on Level 2";
CM_ SG_ 1487 Total_Battery_Capacity "Total Battery capacity in kWh";
CM_ SG_ 266 HVBatCellVoltage_Max "Max cell voltage";
CM_ SG_ 266 HVBatCellVoltage_Min "Min cell voltage";
CM_ SG_ 266 HVBatCellVoltage_NumMax "Cell number - maximum voltage";
CM_ SG_ 266 HVBatContactorSts "HV Battery pack contactor state";
CM_ SG_ 266 HVBatModuleVoltage_NumMax "Module number - maximum voltage; Enumeration  0 = Module 1 ...31 = Module 32.";
CM_ SG_ 266 HVBatModuleVoltage_NumMin "Module number - Minimum voltage; Enumeration  0 = Module 1, ...31 = Module 32.";
CM_ SG_ 266 HVBatteryCurrent "High voltage Battery pack current...";
CM_ SG_ 266 HVBatteryVoltage "High voltage battery pack voltage";
CM_ SG_ 266 IsolationSts_HVBattery "High voltage battery pack Isolation state";
CM_ SG_ 266 IsolationSts_HVPowertrain "Powertrain High voltage Isolation state";
CM_ SG_ 1027 CRC_HVBATTERY2 "CRC according to SAE J1850 standard at each frame transmission.";
CM_ SG_ 1027 HVBatteryMILRequest "MIL Lamp request from BPCM.";
CM_ SG_ 1027 MessageCounter_HVBATTERY2 "This signal is a counter used for safety checks strategies. This counter is incremented of 1 (one) unit at each frame transmission.";
CM_ SG_ 1834 HVBattery_RealTimeClock "32 bit Real Time Clock";
CM_ SG_ 1834 HVBattery_RealTimeClockV "-";
CM_ SG_ 1049 BatteryPowerUsage "None";
CM_ SG_ 1049 BatteryPowerUse_Display "Battery power usage for HMI, in KW";
CM_ SG_ 1049 BatteryPowerUse_DisplayV "Validity bit for signal BatPwrUsageDisp, 0=Valid";
CM_ SG_ 1049 ChargeSystemFault_DPT "Charging System Fault status";
CM_ SG_ 1049 ChargeSystemSts_DPT "Charging System status";
CM_ SG_ 1049 ChargingLevelForDisplay "Charging level and type for display";
CM_ SG_ 1049 CRC_HYBRID_DISPLAY "CRC according to SAE J1850 standard at each frame transmission.";
CM_ SG_ 1049 EstimatedRange "Estimated electric range sent to HMI";
CM_ SG_ 1049 FOTA_Schedule_Conflict "Scheduled FOTA Installation conflicts present";
CM_ SG_ 1049 HCP_EVServiceLampOn "HEV service lamp request";
CM_ SG_ 1049 HVACPowerUse_Display "HVAC power usage for HMI, in KW";
CM_ SG_ 1049 HVACPowerUse_DisplayV "Validity bit for signal HVACPwrUsageDisp, 0=Valid";
CM_ SG_ 1049 HVBatterySOC_Display "High voltage battery state of charge";
CM_ SG_ 1049 HVBatterySOC_DisplayV "High voltage battery state of charge validity: invalid = [1]";
CM_ SG_ 1049 HybridEfficiencyCoach "Percentage output acceleration & deceleration to support Efficiency Coaching HMI";
CM_ SG_ 1049 HybridEfficiencyCoachV "Acceleration & deceleration to support Efficiency Coaching validtiy, 0 = Valid, 1 = Invalid";
CM_ SG_ 1049 HybridMILRequest "MIL on request from the HCP";
CM_ SG_ 1049 HybridOutputPower "Percentage output power from HCP for HMI";
CM_ SG_ 1049 HybridOutputPowerV "Percentage output power from HCP for HMI validity, 0 = Valid, 1 = Invalid";
CM_ SG_ 1049 Lv1_EstChargeTime "Estimated Time to charge on Level 1";
CM_ SG_ 1049 Lv2_EstChargeTime "Estimated Time to charge on Level 2";
CM_ SG_ 1049 MessageCounter_HYBRID_DISPLAY "This signal is a counter used for safety checks strategies. This counter is incremented of 1 (one) unit at each frame transmission.";
CM_ SG_ 1049 OnePedal_Drive_Sts "Status of the OnePedal Drive feature (OnePedal_Drive_sts on is creep Off)";
CM_ SG_ 1049 PlugAndChargeSts "EVCU Confirmation of Plug and Change status";
CM_ SG_ 1049 PopUpMessage1 "Vehicle speed may be limited; True = [1]";
CM_ SG_ 1049 PopUpMessage10 "High Voltage Functionalities rejected due to Hood Open; True = [1]";
CM_ SG_ 1049 PopUpMessage11 "Charge port door open; True = [1]";
CM_ SG_ 1049 PopUpMessage12 "Display message for Max Regen feature";
CM_ SG_ 1049 PopUpMessage2 "Plug in vehicle to keep battery warm; True = [1]";
CM_ SG_ 1049 PopUpMessage3 "Remote start canceled - hv battery temperature; True = [1]";
CM_ SG_ 1049 PopUpMessage4 "Turn on vehicle to use climate controls; True = [1]";
CM_ SG_ 1049 PopUpMessage5 "Please check plug status before driving; True = [1]";
CM_ SG_ 1049 PopUpMessage6 "There may be a problem with the charging unit; True = [1]";
CM_ SG_ 1049 PopUpMessage7 "Please leave key in run - battery conditioning needed; True = [1]";
CM_ SG_ 1049 PopUpMessage9 "Stop safely. Vehicle will shut off soon; True = [1]";
CM_ SG_ 1049 RefrigerantPressure "Refrigerant pressure (R134a or R1234YF)";
CM_ SG_ 1049 Regen_Status "Level of regeneration(negative torque)";
CM_ SG_ 1044 DischargingSysStatus "Vehicle to Load/Vehicle - Discharging system status";
CM_ SG_ 1044 PnC_Failure "A Plug and Charge failure has been detected";
CM_ SG_ 1044 PnC_Reattepmt_Failure "The maximum number of authentication retry attempts has been reached";

BA_DEF_ SG_ "GenSigStartValue" INT 0 2147483647;
BA_DEF_ SG_ "GenSigInactiveValue" INT 0 2147483647;
BA_DEF_ SG_ "GenSigSendType" ENUM "NotUsed","OnWrite","OnWriteWithRepetition","OnChange","OnChangeWithRepetition","IfActive","IfActiveWithRepetition","NoSigSendType";
BA_DEF_ SG_ "SystemSignalLongSymbol" STRING ;
BA_DEF_ SG_ "GenSigTimeoutTime_AGSM" INT 0 65535;
BA_DEF_ SG_ "GenSigTimeoutTime_BCM" INT 0 65535;
BA_DEF_ SG_ "GenSigTimeoutTime_BSM" INT 0 65535;
BA_DEF_ SG_ "GenSigTimeoutTime_CADM" INT 0 65535;
BA_DEF_ SG_ "GenSigTimeoutTime_DMSM" INT 0 65535;
BA_DEF_ SG_ "GenSigTimeoutTime_DTCM" INT 0 65535;
BA_DEF_ SG_ "GenSigTimeoutTime_ECM" INT 0 65535;
BA_DEF_ SG_ "GenSigTimeoutTime_EVCU2" INT 0 65535;
BA_DEF_ SG_ "GenSigTimeoutTime_GNMM" INT 0 65535;
BA_DEF_ SG_ "GenSigTimeoutTime_HCP" INT 0 65535;
BA_DEF_ SG_ "GenSigTimeoutTime_IPC" INT 0 65535;
BA_DEF_ SG_ "GenSigTimeoutTime_RFHM" INT 0 65535;
BA_DEF_ SG_ "GenSigTimeoutTime_SGW" INT 0 65535;
BA_DEF_ SG_ "GenSigTimeoutTime_TCM" INT 0 65535;
BA_DEF_ BO_ "DiagRequest" ENUM "No","Yes";
BA_DEF_ BO_ "Type" ENUM "P","C","PE","COC","PE_Cntrl","E","E_Cntrl","OC","S","BAF","DC","EM","MM","ISO-TP","-";
BA_DEF_ BO_ "DiagResponse" ENUM "No","Yes";
BA_DEF_ BO_ "NmMessage" ENUM "No","Yes";
BA_DEF_ BO_ "GenMsgSendType" ENUM "Cyclic","NotUsed","NotUsed","NotUsed","NotUsed","NotUsed","NotUsed","NotUsed","NoMsgSendType";
BA_DEF_ BO_ "GenMsgNrOfRepetition" INT 0 255;
BA_DEF_ BO_ "GenMsgILSupport" ENUM "No","Yes";
BA_DEF_ BO_ "GenMsgStartDelayTime" INT 0 65535;
BA_DEF_ BO_ "GenMsgCycleTimeFast" INT 0 65535;
BA_DEF_ BO_ "GenMsgCycleTime" INT 0 65535;
BA_DEF_ BO_ "GenMsgDelayTime" INT 0 65535;
BA_DEF_ BO_ "NmAsrMessage" ENUM "No","Yes";
BA_DEF_ BO_ "DiagState" ENUM "No","Yes";
BA_DEF_ BO_ "DiagConnection" HEX 0 65535;
BA_DEF_ BO_ "VFrameFormat" ENUM "StandardCAN","ExtendedCAN","reserved","reserved","reserved","reserved","reserved","reserved","reserved","reserved","reserved","reserved","reserved","reserved","StandardCAN_FD","ExtendedCAN_FD";
BA_DEF_ BO_ "CANFD_BRS" ENUM "No","Yes";
BA_DEF_DEF_ "DiagRequest" "No";
BA_DEF_DEF_ "Type" "-";
BA_DEF_DEF_ "DiagResponse" "No";
BA_DEF_DEF_ "NmMessage" "No";
BA_DEF_DEF_ "GenMsgSendType" "NoMsgSendType";
BA_DEF_DEF_ "GenMsgNrOfRepetition" 0;
BA_DEF_DEF_ "GenMsgILSupport" "No";
BA_DEF_DEF_ "GenMsgStartDelayTime" 0;
BA_DEF_DEF_ "GenMsgCycleTimeFast" 0;
BA_DEF_DEF_ "GenMsgCycleTime" 0;
BA_DEF_DEF_ "GenMsgDelayTime" 0;
BA_DEF_DEF_ "NmAsrMessage" "No";
BA_DEF_DEF_ "DiagState" "No";
BA_DEF_DEF_ "DiagConnection" 0;
BA_DEF_DEF_ "VFrameFormat" "StandardCAN_FD";
BA_DEF_DEF_ "CANFD_BRS" "No";
BA_DEF_DEF_ "GenSigStartValue" 0;
BA_DEF_DEF_ "GenSigInactiveValue" 0;
BA_DEF_DEF_ "GenSigSendType" "NoSigSendType";
BA_DEF_DEF_ "SystemSignalLongSymbol" "";
BA_DEF_DEF_ "GenSigTimeoutTime_AGSM" 2500;
BA_DEF_DEF_ "GenSigTimeoutTime_BCM" 2500;
BA_DEF_DEF_ "GenSigTimeoutTime_BSM" 2500;
BA_DEF_DEF_ "GenSigTimeoutTime_CADM" 2500;
BA_DEF_DEF_ "GenSigTimeoutTime_DMSM" 2500;
BA_DEF_DEF_ "GenSigTimeoutTime_DTCM" 2500;
BA_DEF_DEF_ "GenSigTimeoutTime_ECM" 2500;
BA_DEF_DEF_ "GenSigTimeoutTime_EVCU2" 2500;
BA_DEF_DEF_ "GenSigTimeoutTime_GNMM" 2500;
BA_DEF_DEF_ "GenSigTimeoutTime_HCP" 2500;
BA_DEF_DEF_ "GenSigTimeoutTime_IPC" 2500;
BA_DEF_DEF_ "GenSigTimeoutTime_RFHM" 2500;
BA_DEF_DEF_ "GenSigTimeoutTime_SGW" 2500;
BA_DEF_DEF_ "GenSigTimeoutTime_TCM" 2500;
BA_ "Type" BO_ 271 1;
BA_ "GenMsgSendType" BO_ 271 0;
BA_ "GenMsgILSupport" BO_ 271 1;
BA_ "GenMsgCycleTime" BO_ 271 10;
BA_ "CANFD_BRS" BO_ 271 1;
BA_ "Type" BO_ 1035 1;
BA_ "GenMsgSendType" BO_ 1035 0;
BA_ "GenMsgILSupport" BO_ 1035 1;
BA_ "GenMsgCycleTime" BO_ 1035 100;
BA_ "CANFD_BRS" BO_ 1035 1;
BA_ "Type" BO_ 1328 1;
BA_ "GenMsgSendType" BO_ 1328 0;
BA_ "GenMsgILSupport" BO_ 1328 1;
BA_ "GenMsgCycleTime" BO_ 1328 200;
BA_ "CANFD_BRS" BO_ 1328 1;
BA_ "Type" BO_ 287 1;
BA_ "GenMsgSendType" BO_ 287 0;
BA_ "GenMsgILSupport" BO_ 287 1;
BA_ "GenMsgCycleTime" BO_ 287 10;
BA_ "CANFD_BRS" BO_ 287 1;
BA_ "Type" BO_ 264 1;
BA_ "GenMsgSendType" BO_ 264 0;
BA_ "GenMsgILSupport" BO_ 264 1;
BA_ "GenMsgStartDelayTime" BO_ 264 5;
BA_ "GenMsgCycleTime" BO_ 264 10;
BA_ "CANFD_BRS" BO_ 264 1;
BA_ "Type" BO_ 1056 1;
BA_ "GenMsgSendType" BO_ 1056 0;
BA_ "GenMsgILSupport" BO_ 1056 1;
BA_ "GenMsgStartDelayTime" BO_ 1056 70;
BA_ "GenMsgCycleTime" BO_ 1056 100;
BA_ "CANFD_BRS" BO_ 1056 1;
BA_ "Type" BO_ 1460 3;
BA_ "GenMsgSendType" BO_ 1460 0;
BA_ "GenMsgILSupport" BO_ 1460 1;
BA_ "GenMsgCycleTime" BO_ 1460 1000;
BA_ "GenMsgDelayTime" BO_ 1460 20;
BA_ "CANFD_BRS" BO_ 1460 1;
BA_ "Type" BO_ 1846 1;
BA_ "GenMsgSendType" BO_ 1846 0;
BA_ "GenMsgNrOfRepetition" BO_ 1846 2;
BA_ "GenMsgILSupport" BO_ 1846 1;
BA_ "GenMsgCycleTimeFast" BO_ 1846 20;
BA_ "GenMsgCycleTime" BO_ 1846 1000;
BA_ "GenMsgDelayTime" BO_ 1846 20;
BA_ "CANFD_BRS" BO_ 1846 1;
BA_ "Type" BO_ 525 1;
BA_ "GenMsgSendType" BO_ 525 0;
BA_ "GenMsgNrOfRepetition" BO_ 525 2;
BA_ "GenMsgILSupport" BO_ 525 1;
BA_ "GenMsgCycleTimeFast" BO_ 525 20;
BA_ "GenMsgCycleTime" BO_ 525 20;
BA_ "GenMsgDelayTime" BO_ 525 20;
BA_ "CANFD_BRS" BO_ 525 1;
BA_ "Type" BO_ 1487 1;
BA_ "GenMsgSendType" BO_ 1487 0;
BA_ "GenMsgILSupport" BO_ 1487 1;
BA_ "GenMsgCycleTime" BO_ 1487 1000;
BA_ "GenMsgDelayTime" BO_ 1487 20;
BA_ "CANFD_BRS" BO_ 1487 1;
BA_ "Type" BO_ 266 1;
BA_ "GenMsgSendType" BO_ 266 0;
BA_ "GenMsgILSupport" BO_ 266 1;
BA_ "GenMsgCycleTime" BO_ 266 10;
BA_ "CANFD_BRS" BO_ 266 1;
BA_ "Type" BO_ 1027 1;
BA_ "GenMsgSendType" BO_ 1027 0;
BA_ "GenMsgILSupport" BO_ 1027 1;
BA_ "GenMsgCycleTime" BO_ 1027 100;
BA_ "CANFD_BRS" BO_ 1027 1;
BA_ "Type" BO_ 1834 1;
BA_ "GenMsgSendType" BO_ 1834 0;
BA_ "GenMsgILSupport" BO_ 1834 1;
BA_ "GenMsgCycleTime" BO_ 1834 1000;
BA_ "CANFD_BRS" BO_ 1834 1;
BA_ "Type" BO_ 1049 1;
BA_ "GenMsgSendType" BO_ 1049 0;
BA_ "GenMsgILSupport" BO_ 1049 1;
BA_ "GenMsgCycleTime" BO_ 1049 100;
BA_ "CANFD_BRS" BO_ 1049 1;
BA_ "Type" BO_ 1044 1;
BA_ "GenMsgSendType" BO_ 1044 0;
BA_ "GenMsgILSupport" BO_ 1044 1;
BA_ "GenMsgCycleTime" BO_ 1044 100;
BA_ "GenMsgDelayTime" BO_ 1044 20;
BA_ "CANFD_BRS" BO_ 1044 1;
BA_ "GenSigTimeoutTime_AGSM" SG_ 271 AccPos 0;
BA_ "GenSigTimeoutTime_BCM" SG_ 271 AccPos 0;
BA_ "GenSigTimeoutTime_BSM" SG_ 271 AccPos 0;
BA_ "GenSigTimeoutTime_CADM" SG_ 271 AccPos 0;
BA_ "GenSigTimeoutTime_DMSM" SG_ 271 AccPos 0;
BA_ "GenSigTimeoutTime_DTCM" SG_ 271 AccPos 0;
BA_ "GenSigTimeoutTime_ECM" SG_ 271 AccPos 0;
BA_ "GenSigTimeoutTime_EVCU2" SG_ 271 AccPos 0;
BA_ "GenSigTimeoutTime_GNMM" SG_ 271 AccPos 0;
BA_ "GenSigTimeoutTime_IPC" SG_ 271 AccPos 0;
BA_ "GenSigTimeoutTime_RFHM" SG_ 271 AccPos 0;
BA_ "GenSigTimeoutTime_SGW" SG_ 271 AccPos 0;
BA_ "GenSigTimeoutTime_TCM" SG_ 271 AccPos 0;
BA_ "GenSigTimeoutTime_AGSM" SG_ 271 AccPosV 0;
BA_ "GenSigTimeoutTime_BCM" SG_ 271 AccPosV 0;
BA_ "GenSigTimeoutTime_BSM" SG_ 271 AccPosV 0;
BA_ "GenSigTimeoutTime_CADM" SG_ 271 AccPosV 0;
BA_ "GenSigTimeoutTime_DMSM" SG_ 271 AccPosV 0;
BA_ "GenSigTimeoutTime_DTCM" SG_ 271 AccPosV 0;
BA_ "GenSigTimeoutTime_ECM" SG_ 271 AccPosV 0;
BA_ "GenSigTimeoutTime_EVCU2" SG_ 271 AccPosV 0;
BA_ "GenSigTimeoutTime_GNMM" SG_ 271 AccPosV 0;
BA_ "GenSigTimeoutTime_IPC" SG_ 271 AccPosV 0;
BA_ "GenSigTimeoutTime_RFHM" SG_ 271 AccPosV 0;
BA_ "GenSigTimeoutTime_SGW" SG_ 271 AccPosV 0;
BA_ "GenSigTimeoutTime_TCM" SG_ 271 AccPosV 0;
BA_ "GenSigTimeoutTime_AGSM" SG_ 271 Cam_Exh_1_Locked 0;
BA_ "GenSigTimeoutTime_BCM" SG_ 271 Cam_Exh_1_Locked 0;
BA_ "GenSigTimeoutTime_BSM" SG_ 271 Cam_Exh_1_Locked 0;
BA_ "GenSigTimeoutTime_CADM" SG_ 271 Cam_Exh_1_Locked 0;
BA_ "GenSigTimeoutTime_DMSM" SG_ 271 Cam_Exh_1_Locked 0;
BA_ "GenSigTimeoutTime_DTCM" SG_ 271 Cam_Exh_1_Locked 0;
BA_ "GenSigTimeoutTime_ECM" SG_ 271 Cam_Exh_1_Locked 0;
BA_ "GenSigTimeoutTime_EVCU2" SG_ 271 Cam_Exh_1_Locked 0;
BA_ "GenSigTimeoutTime_GNMM" SG_ 271 Cam_Exh_1_Locked 0;
BA_ "GenSigTimeoutTime_HCP" SG_ 271 Cam_Exh_1_Locked 0;
BA_ "GenSigTimeoutTime_IPC" SG_ 271 Cam_Exh_1_Locked 0;
BA_ "GenSigTimeoutTime_RFHM" SG_ 271 Cam_Exh_1_Locked 0;
BA_ "GenSigTimeoutTime_SGW" SG_ 271 Cam_Exh_1_Locked 0;
BA_ "GenSigTimeoutTime_TCM" SG_ 271 Cam_Exh_1_Locked 0;
BA_ "GenSigTimeoutTime_AGSM" SG_ 271 Cam_Exh_2_Locked 0;
BA_ "GenSigTimeoutTime_BCM" SG_ 271 Cam_Exh_2_Locked 0;
BA_ "GenSigTimeoutTime_BSM" SG_ 271 Cam_Exh_2_Locked 0;
BA_ "GenSigTimeoutTime_CADM" SG_ 271 Cam_Exh_2_Locked 0;
BA_ "GenSigTimeoutTime_DMSM" SG_ 271 Cam_Exh_2_Locked 0;
BA_ "GenSigTimeoutTime_DTCM" SG_ 271 Cam_Exh_2_Locked 0;
BA_ "GenSigTimeoutTime_ECM" SG_ 271 Cam_Exh_2_Locked 0;
BA_ "GenSigTimeoutTime_EVCU2" SG_ 271 Cam_Exh_2_Locked 0;
BA_ "GenSigTimeoutTime_GNMM" SG_ 271 Cam_Exh_2_Locked 0;
BA_ "GenSigTimeoutTime_HCP" SG_ 271 Cam_Exh_2_Locked 0;
BA_ "GenSigTimeoutTime_IPC" SG_ 271 Cam_Exh_2_Locked 0;
BA_ "GenSigTimeoutTime_RFHM" SG_ 271 Cam_Exh_2_Locked 0;
BA_ "GenSigTimeoutTime_SGW" SG_ 271 Cam_Exh_2_Locked 0;
BA_ "GenSigTimeoutTime_TCM" SG_ 271 Cam_Exh_2_Locked 0;
BA_ "GenSigTimeoutTime_AGSM" SG_ 271 Cam_Int_1_Locked 0;
BA_ "GenSigTimeoutTime_BCM" SG_ 271 Cam_Int_1_Locked 0;
BA_ "GenSigTimeoutTime_BSM" SG_ 271 Cam_Int_1_Locked 0;
BA_ "GenSigTimeoutTime_CADM" SG_ 271 Cam_Int_1_Locked 0;
BA_ "GenSigTimeoutTime_DMSM" SG_ 271 Cam_Int_1_Locked 0;
BA_ "GenSigTimeoutTime_DTCM" SG_ 271 Cam_Int_1_Locked 0;
BA_ "GenSigTimeoutTime_ECM" SG_ 271 Cam_Int_1_Locked 0;
BA_ "GenSigTimeoutTime_EVCU2" SG_ 271 Cam_Int_1_Locked 0;
BA_ "GenSigTimeoutTime_GNMM" SG_ 271 Cam_Int_1_Locked 0;
BA_ "GenSigTimeoutTime_HCP" SG_ 271 Cam_Int_1_Locked 0;
BA_ "GenSigTimeoutTime_IPC" SG_ 271 Cam_Int_1_Locked 0;
BA_ "GenSigTimeoutTime_RFHM" SG_ 271 Cam_Int_1_Locked 0;
BA_ "GenSigTimeoutTime_SGW" SG_ 271 Cam_Int_1_Locked 0;
BA_ "GenSigTimeoutTime_TCM" SG_ 271 Cam_Int_1_Locked 0;
BA_ "GenSigTimeoutTime_AGSM" SG_ 271 Cam_Int_2_Locked 0;
BA_ "GenSigTimeoutTime_BCM" SG_ 271 Cam_Int_2_Locked 0;
BA_ "GenSigTimeoutTime_BSM" SG_ 271 Cam_Int_2_Locked 0;
BA_ "GenSigTimeoutTime_CADM" SG_ 271 Cam_Int_2_Locked 0;
BA_ "GenSigTimeoutTime_DMSM" SG_ 271 Cam_Int_2_Locked 0;
BA_ "GenSigTimeoutTime_DTCM" SG_ 271 Cam_Int_2_Locked 0;
BA_ "GenSigTimeoutTime_ECM" SG_ 271 Cam_Int_2_Locked 0;
BA_ "GenSigTimeoutTime_EVCU2" SG_ 271 Cam_Int_2_Locked 0;
BA_ "GenSigTimeoutTime_GNMM" SG_ 271 Cam_Int_2_Locked 0;
BA_ "GenSigTimeoutTime_HCP" SG_ 271 Cam_Int_2_Locked 0;
BA_ "GenSigTimeoutTime_IPC" SG_ 271 Cam_Int_2_Locked 0;
BA_ "GenSigTimeoutTime_RFHM" SG_ 271 Cam_Int_2_Locked 0;
BA_ "GenSigTimeoutTime_SGW" SG_ 271 Cam_Int_2_Locked 0;
BA_ "GenSigTimeoutTime_TCM" SG_ 271 Cam_Int_2_Locked 0;
BA_ "GenSigStartValue" SG_ 271 CmndFlyWheelTorqPotential 938;
BA_ "GenSigTimeoutTime_AGSM" SG_ 271 CmndFlyWheelTorqPotential 0;
BA_ "GenSigTimeoutTime_BCM" SG_ 271 CmndFlyWheelTorqPotential 0;
BA_ "GenSigTimeoutTime_BSM" SG_ 271 CmndFlyWheelTorqPotential 0;
BA_ "GenSigTimeoutTime_CADM" SG_ 271 CmndFlyWheelTorqPotential 0;
BA_ "GenSigTimeoutTime_DMSM" SG_ 271 CmndFlyWheelTorqPotential 0;
BA_ "GenSigTimeoutTime_DTCM" SG_ 271 CmndFlyWheelTorqPotential 0;
BA_ "GenSigTimeoutTime_ECM" SG_ 271 CmndFlyWheelTorqPotential 0;
BA_ "GenSigTimeoutTime_EVCU2" SG_ 271 CmndFlyWheelTorqPotential 0;
BA_ "GenSigTimeoutTime_GNMM" SG_ 271 CmndFlyWheelTorqPotential 0;
BA_ "GenSigTimeoutTime_IPC" SG_ 271 CmndFlyWheelTorqPotential 0;
BA_ "GenSigTimeoutTime_RFHM" SG_ 271 CmndFlyWheelTorqPotential 0;
BA_ "GenSigTimeoutTime_SGW" SG_ 271 CmndFlyWheelTorqPotential 0;
BA_ "GenSigTimeoutTime_TCM" SG_ 271 CmndFlyWheelTorqPotential 0;
BA_ "GenSigStartValue" SG_ 271 CmndFlyWheelTorqPrdtd 938;
BA_ "GenSigTimeoutTime_AGSM" SG_ 271 CmndFlyWheelTorqPrdtd 0;
BA_ "GenSigTimeoutTime_BCM" SG_ 271 CmndFlyWheelTorqPrdtd 0;
BA_ "GenSigTimeoutTime_BSM" SG_ 271 CmndFlyWheelTorqPrdtd 0;
BA_ "GenSigTimeoutTime_CADM" SG_ 271 CmndFlyWheelTorqPrdtd 0;
BA_ "GenSigTimeoutTime_DMSM" SG_ 271 CmndFlyWheelTorqPrdtd 0;
BA_ "GenSigTimeoutTime_DTCM" SG_ 271 CmndFlyWheelTorqPrdtd 0;
BA_ "GenSigTimeoutTime_ECM" SG_ 271 CmndFlyWheelTorqPrdtd 0;
BA_ "GenSigTimeoutTime_EVCU2" SG_ 271 CmndFlyWheelTorqPrdtd 0;
BA_ "GenSigTimeoutTime_GNMM" SG_ 271 CmndFlyWheelTorqPrdtd 0;
BA_ "GenSigTimeoutTime_IPC" SG_ 271 CmndFlyWheelTorqPrdtd 0;
BA_ "GenSigTimeoutTime_RFHM" SG_ 271 CmndFlyWheelTorqPrdtd 0;
BA_ "GenSigTimeoutTime_SGW" SG_ 271 CmndFlyWheelTorqPrdtd 0;
BA_ "GenSigTimeoutTime_TCM" SG_ 271 CmndFlyWheelTorqPrdtd 0;
BA_ "GenSigTimeoutTime_AGSM" SG_ 271 CmndFlyWheelTorqRespTyp 0;
BA_ "GenSigTimeoutTime_BCM" SG_ 271 CmndFlyWheelTorqRespTyp 0;
BA_ "GenSigTimeoutTime_BSM" SG_ 271 CmndFlyWheelTorqRespTyp 0;
BA_ "GenSigTimeoutTime_CADM" SG_ 271 CmndFlyWheelTorqRespTyp 0;
BA_ "GenSigTimeoutTime_DMSM" SG_ 271 CmndFlyWheelTorqRespTyp 0;
BA_ "GenSigTimeoutTime_DTCM" SG_ 271 CmndFlyWheelTorqRespTyp 0;
BA_ "GenSigTimeoutTime_ECM" SG_ 271 CmndFlyWheelTorqRespTyp 0;
BA_ "GenSigTimeoutTime_EVCU2" SG_ 271 CmndFlyWheelTorqRespTyp 0;
BA_ "GenSigTimeoutTime_GNMM" SG_ 271 CmndFlyWheelTorqRespTyp 0;
BA_ "GenSigTimeoutTime_IPC" SG_ 271 CmndFlyWheelTorqRespTyp 0;
BA_ "GenSigTimeoutTime_RFHM" SG_ 271 CmndFlyWheelTorqRespTyp 0;
BA_ "GenSigTimeoutTime_SGW" SG_ 271 CmndFlyWheelTorqRespTyp 0;
BA_ "GenSigTimeoutTime_TCM" SG_ 271 CmndFlyWheelTorqRespTyp 0;
BA_ "GenSigTimeoutTime_AGSM" SG_ 271 Crank_Locked 0;
BA_ "GenSigTimeoutTime_BCM" SG_ 271 Crank_Locked 0;
BA_ "GenSigTimeoutTime_BSM" SG_ 271 Crank_Locked 0;
BA_ "GenSigTimeoutTime_CADM" SG_ 271 Crank_Locked 0;
BA_ "GenSigTimeoutTime_DMSM" SG_ 271 Crank_Locked 0;
BA_ "GenSigTimeoutTime_DTCM" SG_ 271 Crank_Locked 0;
BA_ "GenSigTimeoutTime_ECM" SG_ 271 Crank_Locked 0;
BA_ "GenSigTimeoutTime_EVCU2" SG_ 271 Crank_Locked 0;
BA_ "GenSigTimeoutTime_GNMM" SG_ 271 Crank_Locked 0;
BA_ "GenSigTimeoutTime_HCP" SG_ 271 Crank_Locked 0;
BA_ "GenSigTimeoutTime_IPC" SG_ 271 Crank_Locked 0;
BA_ "GenSigTimeoutTime_RFHM" SG_ 271 Crank_Locked 0;
BA_ "GenSigTimeoutTime_SGW" SG_ 271 Crank_Locked 0;
BA_ "GenSigTimeoutTime_TCM" SG_ 271 Crank_Locked 0;
BA_ "GenSigTimeoutTime_AGSM" SG_ 271 Crank_Maturing_Fault 0;
BA_ "GenSigTimeoutTime_BCM" SG_ 271 Crank_Maturing_Fault 0;
BA_ "GenSigTimeoutTime_BSM" SG_ 271 Crank_Maturing_Fault 0;
BA_ "GenSigTimeoutTime_CADM" SG_ 271 Crank_Maturing_Fault 0;
BA_ "GenSigTimeoutTime_DMSM" SG_ 271 Crank_Maturing_Fault 0;
BA_ "GenSigTimeoutTime_DTCM" SG_ 271 Crank_Maturing_Fault 0;
BA_ "GenSigTimeoutTime_ECM" SG_ 271 Crank_Maturing_Fault 0;
BA_ "GenSigTimeoutTime_EVCU2" SG_ 271 Crank_Maturing_Fault 0;
BA_ "GenSigTimeoutTime_GNMM" SG_ 271 Crank_Maturing_Fault 0;
BA_ "GenSigTimeoutTime_HCP" SG_ 271 Crank_Maturing_Fault 0;
BA_ "GenSigTimeoutTime_IPC" SG_ 271 Crank_Maturing_Fault 0;
BA_ "GenSigTimeoutTime_RFHM" SG_ 271 Crank_Maturing_Fault 0;
BA_ "GenSigTimeoutTime_SGW" SG_ 271 Crank_Maturing_Fault 0;
BA_ "GenSigTimeoutTime_TCM" SG_ 271 Crank_Maturing_Fault 0;
BA_ "GenSigTimeoutTime_AGSM" SG_ 271 CRC_ENGINE_HYBD_FD_1 0;
BA_ "GenSigTimeoutTime_BCM" SG_ 271 CRC_ENGINE_HYBD_FD_1 0;
BA_ "GenSigTimeoutTime_BSM" SG_ 271 CRC_ENGINE_HYBD_FD_1 0;
BA_ "GenSigTimeoutTime_CADM" SG_ 271 CRC_ENGINE_HYBD_FD_1 0;
BA_ "GenSigTimeoutTime_DMSM" SG_ 271 CRC_ENGINE_HYBD_FD_1 0;
BA_ "GenSigTimeoutTime_DTCM" SG_ 271 CRC_ENGINE_HYBD_FD_1 0;
BA_ "GenSigTimeoutTime_ECM" SG_ 271 CRC_ENGINE_HYBD_FD_1 0;
BA_ "GenSigTimeoutTime_EVCU2" SG_ 271 CRC_ENGINE_HYBD_FD_1 0;
BA_ "GenSigTimeoutTime_GNMM" SG_ 271 CRC_ENGINE_HYBD_FD_1 0;
BA_ "GenSigTimeoutTime_IPC" SG_ 271 CRC_ENGINE_HYBD_FD_1 0;
BA_ "GenSigTimeoutTime_RFHM" SG_ 271 CRC_ENGINE_HYBD_FD_1 0;
BA_ "GenSigTimeoutTime_SGW" SG_ 271 CRC_ENGINE_HYBD_FD_1 0;
BA_ "GenSigTimeoutTime_AGSM" SG_ 271 CylOff 0;
BA_ "GenSigTimeoutTime_BCM" SG_ 271 CylOff 0;
BA_ "GenSigTimeoutTime_BSM" SG_ 271 CylOff 0;
BA_ "GenSigTimeoutTime_CADM" SG_ 271 CylOff 0;
BA_ "GenSigTimeoutTime_DMSM" SG_ 271 CylOff 0;
BA_ "GenSigTimeoutTime_DTCM" SG_ 271 CylOff 0;
BA_ "GenSigTimeoutTime_ECM" SG_ 271 CylOff 0;
BA_ "GenSigTimeoutTime_EVCU2" SG_ 271 CylOff 0;
BA_ "GenSigTimeoutTime_GNMM" SG_ 271 CylOff 0;
BA_ "GenSigTimeoutTime_IPC" SG_ 271 CylOff 0;
BA_ "GenSigTimeoutTime_RFHM" SG_ 271 CylOff 0;
BA_ "GenSigTimeoutTime_SGW" SG_ 271 CylOff 0;
BA_ "GenSigTimeoutTime_TCM" SG_ 271 CylOff 0;
BA_ "GenSigStartValue" SG_ 271 DrvrIntndedFlyWheelTorq 938;
BA_ "GenSigTimeoutTime_AGSM" SG_ 271 DrvrIntndedFlyWheelTorq 0;
BA_ "GenSigTimeoutTime_BCM" SG_ 271 DrvrIntndedFlyWheelTorq 0;
BA_ "GenSigTimeoutTime_BSM" SG_ 271 DrvrIntndedFlyWheelTorq 0;
BA_ "GenSigTimeoutTime_CADM" SG_ 271 DrvrIntndedFlyWheelTorq 0;
BA_ "GenSigTimeoutTime_DMSM" SG_ 271 DrvrIntndedFlyWheelTorq 0;
BA_ "GenSigTimeoutTime_DTCM" SG_ 271 DrvrIntndedFlyWheelTorq 0;
BA_ "GenSigTimeoutTime_ECM" SG_ 271 DrvrIntndedFlyWheelTorq 0;
BA_ "GenSigTimeoutTime_EVCU2" SG_ 271 DrvrIntndedFlyWheelTorq 0;
BA_ "GenSigTimeoutTime_GNMM" SG_ 271 DrvrIntndedFlyWheelTorq 0;
BA_ "GenSigTimeoutTime_IPC" SG_ 271 DrvrIntndedFlyWheelTorq 0;
BA_ "GenSigTimeoutTime_RFHM" SG_ 271 DrvrIntndedFlyWheelTorq 0;
BA_ "GenSigTimeoutTime_SGW" SG_ 271 DrvrIntndedFlyWheelTorq 0;
BA_ "GenSigTimeoutTime_TCM" SG_ 271 DrvrIntndedFlyWheelTorq 0;
BA_ "GenSigStartValue" SG_ 271 DrvrIntndedFlyWheelTorqRaw 938;
BA_ "GenSigTimeoutTime_AGSM" SG_ 271 DrvrIntndedFlyWheelTorqRaw 0;
BA_ "GenSigTimeoutTime_BCM" SG_ 271 DrvrIntndedFlyWheelTorqRaw 0;
BA_ "GenSigTimeoutTime_BSM" SG_ 271 DrvrIntndedFlyWheelTorqRaw 0;
BA_ "GenSigTimeoutTime_CADM" SG_ 271 DrvrIntndedFlyWheelTorqRaw 0;
BA_ "GenSigTimeoutTime_DMSM" SG_ 271 DrvrIntndedFlyWheelTorqRaw 0;
BA_ "GenSigTimeoutTime_DTCM" SG_ 271 DrvrIntndedFlyWheelTorqRaw 0;
BA_ "GenSigTimeoutTime_ECM" SG_ 271 DrvrIntndedFlyWheelTorqRaw 0;
BA_ "GenSigTimeoutTime_EVCU2" SG_ 271 DrvrIntndedFlyWheelTorqRaw 0;
BA_ "GenSigTimeoutTime_GNMM" SG_ 271 DrvrIntndedFlyWheelTorqRaw 0;
BA_ "GenSigTimeoutTime_IPC" SG_ 271 DrvrIntndedFlyWheelTorqRaw 0;
BA_ "GenSigTimeoutTime_RFHM" SG_ 271 DrvrIntndedFlyWheelTorqRaw 0;
BA_ "GenSigTimeoutTime_SGW" SG_ 271 DrvrIntndedFlyWheelTorqRaw 0;
BA_ "GenSigTimeoutTime_TCM" SG_ 271 DrvrIntndedFlyWheelTorqRaw 0;
BA_ "GenSigTimeoutTime_AGSM" SG_ 271 DrvrIntndedFlyWheelTorqRawV 0;
BA_ "GenSigTimeoutTime_BCM" SG_ 271 DrvrIntndedFlyWheelTorqRawV 0;
BA_ "GenSigTimeoutTime_BSM" SG_ 271 DrvrIntndedFlyWheelTorqRawV 0;
BA_ "GenSigTimeoutTime_CADM" SG_ 271 DrvrIntndedFlyWheelTorqRawV 0;
BA_ "GenSigTimeoutTime_DMSM" SG_ 271 DrvrIntndedFlyWheelTorqRawV 0;
BA_ "GenSigTimeoutTime_DTCM" SG_ 271 DrvrIntndedFlyWheelTorqRawV 0;
BA_ "GenSigTimeoutTime_ECM" SG_ 271 DrvrIntndedFlyWheelTorqRawV 0;
BA_ "GenSigTimeoutTime_EVCU2" SG_ 271 DrvrIntndedFlyWheelTorqRawV 0;
BA_ "GenSigTimeoutTime_GNMM" SG_ 271 DrvrIntndedFlyWheelTorqRawV 0;
BA_ "GenSigTimeoutTime_IPC" SG_ 271 DrvrIntndedFlyWheelTorqRawV 0;
BA_ "GenSigTimeoutTime_RFHM" SG_ 271 DrvrIntndedFlyWheelTorqRawV 0;
BA_ "GenSigTimeoutTime_SGW" SG_ 271 DrvrIntndedFlyWheelTorqRawV 0;
BA_ "GenSigTimeoutTime_TCM" SG_ 271 DrvrIntndedFlyWheelTorqRawV 0;
BA_ "GenSigTimeoutTime_AGSM" SG_ 271 DrvrIntndedFlyWheelTorqV 0;
BA_ "GenSigTimeoutTime_BCM" SG_ 271 DrvrIntndedFlyWheelTorqV 0;
BA_ "GenSigTimeoutTime_BSM" SG_ 271 DrvrIntndedFlyWheelTorqV 0;
BA_ "GenSigTimeoutTime_CADM" SG_ 271 DrvrIntndedFlyWheelTorqV 0;
BA_ "GenSigTimeoutTime_DMSM" SG_ 271 DrvrIntndedFlyWheelTorqV 0;
BA_ "GenSigTimeoutTime_DTCM" SG_ 271 DrvrIntndedFlyWheelTorqV 0;
BA_ "GenSigTimeoutTime_ECM" SG_ 271 DrvrIntndedFlyWheelTorqV 0;
BA_ "GenSigTimeoutTime_EVCU2" SG_ 271 DrvrIntndedFlyWheelTorqV 0;
BA_ "GenSigTimeoutTime_GNMM" SG_ 271 DrvrIntndedFlyWheelTorqV 0;
BA_ "GenSigTimeoutTime_IPC" SG_ 271 DrvrIntndedFlyWheelTorqV 0;
BA_ "GenSigTimeoutTime_RFHM" SG_ 271 DrvrIntndedFlyWheelTorqV 0;
BA_ "GenSigTimeoutTime_SGW" SG_ 271 DrvrIntndedFlyWheelTorqV 0;
BA_ "GenSigTimeoutTime_TCM" SG_ 271 DrvrIntndedFlyWheelTorqV 0;
BA_ "GenSigTimeoutTime_AGSM" SG_ 271 ECM_Crank_Phase 0;
BA_ "GenSigTimeoutTime_BCM" SG_ 271 ECM_Crank_Phase 0;
BA_ "GenSigTimeoutTime_BSM" SG_ 271 ECM_Crank_Phase 0;
BA_ "GenSigTimeoutTime_CADM" SG_ 271 ECM_Crank_Phase 0;
BA_ "GenSigTimeoutTime_DMSM" SG_ 271 ECM_Crank_Phase 0;
BA_ "GenSigTimeoutTime_DTCM" SG_ 271 ECM_Crank_Phase 0;
BA_ "GenSigTimeoutTime_ECM" SG_ 271 ECM_Crank_Phase 0;
BA_ "GenSigTimeoutTime_EVCU2" SG_ 271 ECM_Crank_Phase 0;
BA_ "GenSigTimeoutTime_GNMM" SG_ 271 ECM_Crank_Phase 0;
BA_ "GenSigTimeoutTime_IPC" SG_ 271 ECM_Crank_Phase 0;
BA_ "GenSigTimeoutTime_RFHM" SG_ 271 ECM_Crank_Phase 0;
BA_ "GenSigTimeoutTime_SGW" SG_ 271 ECM_Crank_Phase 0;
BA_ "GenSigTimeoutTime_TCM" SG_ 271 ECM_Crank_Phase 0;
BA_ "GenSigTimeoutTime_AGSM" SG_ 271 ECMReq_Remedial_Stop 0;
BA_ "GenSigTimeoutTime_BCM" SG_ 271 ECMReq_Remedial_Stop 0;
BA_ "GenSigTimeoutTime_BSM" SG_ 271 ECMReq_Remedial_Stop 0;
BA_ "GenSigTimeoutTime_CADM" SG_ 271 ECMReq_Remedial_Stop 0;
BA_ "GenSigTimeoutTime_DMSM" SG_ 271 ECMReq_Remedial_Stop 0;
BA_ "GenSigTimeoutTime_DTCM" SG_ 271 ECMReq_Remedial_Stop 0;
BA_ "GenSigTimeoutTime_ECM" SG_ 271 ECMReq_Remedial_Stop 0;
BA_ "GenSigTimeoutTime_GNMM" SG_ 271 ECMReq_Remedial_Stop 0;
BA_ "GenSigTimeoutTime_HCP" SG_ 271 ECMReq_Remedial_Stop 0;
BA_ "GenSigTimeoutTime_IPC" SG_ 271 ECMReq_Remedial_Stop 0;
BA_ "GenSigTimeoutTime_RFHM" SG_ 271 ECMReq_Remedial_Stop 0;
BA_ "GenSigTimeoutTime_SGW" SG_ 271 ECMReq_Remedial_Stop 0;
BA_ "GenSigTimeoutTime_TCM" SG_ 271 ECMReq_Remedial_Stop 0;
BA_ "GenSigTimeoutTime_AGSM" SG_ 271 ECU_A2D_Failure 0;
BA_ "GenSigTimeoutTime_BCM" SG_ 271 ECU_A2D_Failure 0;
BA_ "GenSigTimeoutTime_BSM" SG_ 271 ECU_A2D_Failure 0;
BA_ "GenSigTimeoutTime_CADM" SG_ 271 ECU_A2D_Failure 0;
BA_ "GenSigTimeoutTime_DMSM" SG_ 271 ECU_A2D_Failure 0;
BA_ "GenSigTimeoutTime_DTCM" SG_ 271 ECU_A2D_Failure 0;
BA_ "GenSigTimeoutTime_ECM" SG_ 271 ECU_A2D_Failure 0;
BA_ "GenSigTimeoutTime_EVCU2" SG_ 271 ECU_A2D_Failure 0;
BA_ "GenSigTimeoutTime_GNMM" SG_ 271 ECU_A2D_Failure 0;
BA_ "GenSigTimeoutTime_IPC" SG_ 271 ECU_A2D_Failure 0;
BA_ "GenSigTimeoutTime_RFHM" SG_ 271 ECU_A2D_Failure 0;
BA_ "GenSigTimeoutTime_SGW" SG_ 271 ECU_A2D_Failure 0;
BA_ "GenSigTimeoutTime_TCM" SG_ 271 ECU_A2D_Failure 0;
BA_ "GenSigStartValue" SG_ 271 EngActStdyStTorq 938;
BA_ "GenSigTimeoutTime_AGSM" SG_ 271 EngActStdyStTorq 0;
BA_ "GenSigTimeoutTime_BCM" SG_ 271 EngActStdyStTorq 0;
BA_ "GenSigTimeoutTime_BSM" SG_ 271 EngActStdyStTorq 0;
BA_ "GenSigTimeoutTime_CADM" SG_ 271 EngActStdyStTorq 0;
BA_ "GenSigTimeoutTime_DMSM" SG_ 271 EngActStdyStTorq 0;
BA_ "GenSigTimeoutTime_DTCM" SG_ 271 EngActStdyStTorq 0;
BA_ "GenSigTimeoutTime_ECM" SG_ 271 EngActStdyStTorq 0;
BA_ "GenSigTimeoutTime_EVCU2" SG_ 271 EngActStdyStTorq 0;
BA_ "GenSigTimeoutTime_GNMM" SG_ 271 EngActStdyStTorq 0;
BA_ "GenSigTimeoutTime_IPC" SG_ 271 EngActStdyStTorq 0;
BA_ "GenSigTimeoutTime_RFHM" SG_ 271 EngActStdyStTorq 0;
BA_ "GenSigTimeoutTime_SGW" SG_ 271 EngActStdyStTorq 0;
BA_ "GenSigTimeoutTime_TCM" SG_ 271 EngActStdyStTorq 0;
BA_ "GenSigTimeoutTime_AGSM" SG_ 271 EngActStdyStTorqV 0;
BA_ "GenSigTimeoutTime_BCM" SG_ 271 EngActStdyStTorqV 0;
BA_ "GenSigTimeoutTime_BSM" SG_ 271 EngActStdyStTorqV 0;
BA_ "GenSigTimeoutTime_CADM" SG_ 271 EngActStdyStTorqV 0;
BA_ "GenSigTimeoutTime_DMSM" SG_ 271 EngActStdyStTorqV 0;
BA_ "GenSigTimeoutTime_DTCM" SG_ 271 EngActStdyStTorqV 0;
BA_ "GenSigTimeoutTime_ECM" SG_ 271 EngActStdyStTorqV 0;
BA_ "GenSigTimeoutTime_EVCU2" SG_ 271 EngActStdyStTorqV 0;
BA_ "GenSigTimeoutTime_GNMM" SG_ 271 EngActStdyStTorqV 0;
BA_ "GenSigTimeoutTime_IPC" SG_ 271 EngActStdyStTorqV 0;
BA_ "GenSigTimeoutTime_RFHM" SG_ 271 EngActStdyStTorqV 0;
BA_ "GenSigTimeoutTime_SGW" SG_ 271 EngActStdyStTorqV 0;
BA_ "GenSigTimeoutTime_TCM" SG_ 271 EngActStdyStTorqV 0;
BA_ "GenSigTimeoutTime_AGSM" SG_ 271 EngActuatorsStat 0;
BA_ "GenSigTimeoutTime_BCM" SG_ 271 EngActuatorsStat 0;
BA_ "GenSigTimeoutTime_BSM" SG_ 271 EngActuatorsStat 0;
BA_ "GenSigTimeoutTime_CADM" SG_ 271 EngActuatorsStat 0;
BA_ "GenSigTimeoutTime_DMSM" SG_ 271 EngActuatorsStat 0;
BA_ "GenSigTimeoutTime_DTCM" SG_ 271 EngActuatorsStat 0;
BA_ "GenSigTimeoutTime_ECM" SG_ 271 EngActuatorsStat 0;
BA_ "GenSigTimeoutTime_EVCU2" SG_ 271 EngActuatorsStat 0;
BA_ "GenSigTimeoutTime_GNMM" SG_ 271 EngActuatorsStat 0;
BA_ "GenSigTimeoutTime_IPC" SG_ 271 EngActuatorsStat 0;
BA_ "GenSigTimeoutTime_RFHM" SG_ 271 EngActuatorsStat 0;
BA_ "GenSigTimeoutTime_SGW" SG_ 271 EngActuatorsStat 0;
BA_ "GenSigTimeoutTime_TCM" SG_ 271 EngActuatorsStat 0;
BA_ "GenSigStartValue" SG_ 271 EngAirFlwStdyStTorq 938;
BA_ "GenSigTimeoutTime_AGSM" SG_ 271 EngAirFlwStdyStTorq 0;
BA_ "GenSigTimeoutTime_BCM" SG_ 271 EngAirFlwStdyStTorq 0;
BA_ "GenSigTimeoutTime_BSM" SG_ 271 EngAirFlwStdyStTorq 0;
BA_ "GenSigTimeoutTime_CADM" SG_ 271 EngAirFlwStdyStTorq 0;
BA_ "GenSigTimeoutTime_DMSM" SG_ 271 EngAirFlwStdyStTorq 0;
BA_ "GenSigTimeoutTime_DTCM" SG_ 271 EngAirFlwStdyStTorq 0;
BA_ "GenSigTimeoutTime_ECM" SG_ 271 EngAirFlwStdyStTorq 0;
BA_ "GenSigTimeoutTime_EVCU2" SG_ 271 EngAirFlwStdyStTorq 0;
BA_ "GenSigTimeoutTime_GNMM" SG_ 271 EngAirFlwStdyStTorq 0;
BA_ "GenSigTimeoutTime_IPC" SG_ 271 EngAirFlwStdyStTorq 0;
BA_ "GenSigTimeoutTime_RFHM" SG_ 271 EngAirFlwStdyStTorq 0;
BA_ "GenSigTimeoutTime_SGW" SG_ 271 EngAirFlwStdyStTorq 0;
BA_ "GenSigTimeoutTime_TCM" SG_ 271 EngAirFlwStdyStTorq 0;
BA_ "GenSigTimeoutTime_AGSM" SG_ 271 EngAirFlwStdyStTorqV 0;
BA_ "GenSigTimeoutTime_BCM" SG_ 271 EngAirFlwStdyStTorqV 0;
BA_ "GenSigTimeoutTime_BSM" SG_ 271 EngAirFlwStdyStTorqV 0;
BA_ "GenSigTimeoutTime_CADM" SG_ 271 EngAirFlwStdyStTorqV 0;
BA_ "GenSigTimeoutTime_DMSM" SG_ 271 EngAirFlwStdyStTorqV 0;
BA_ "GenSigTimeoutTime_DTCM" SG_ 271 EngAirFlwStdyStTorqV 0;
BA_ "GenSigTimeoutTime_ECM" SG_ 271 EngAirFlwStdyStTorqV 0;
BA_ "GenSigTimeoutTime_EVCU2" SG_ 271 EngAirFlwStdyStTorqV 0;
BA_ "GenSigTimeoutTime_GNMM" SG_ 271 EngAirFlwStdyStTorqV 0;
BA_ "GenSigTimeoutTime_IPC" SG_ 271 EngAirFlwStdyStTorqV 0;
BA_ "GenSigTimeoutTime_RFHM" SG_ 271 EngAirFlwStdyStTorqV 0;
BA_ "GenSigTimeoutTime_SGW" SG_ 271 EngAirFlwStdyStTorqV 0;
BA_ "GenSigTimeoutTime_TCM" SG_ 271 EngAirFlwStdyStTorqV 0;
BA_ "GenSigTimeoutTime_AGSM" SG_ 271 EngCmbstnCmnd 0;
BA_ "GenSigTimeoutTime_BCM" SG_ 271 EngCmbstnCmnd 0;
BA_ "GenSigTimeoutTime_BSM" SG_ 271 EngCmbstnCmnd 0;
BA_ "GenSigTimeoutTime_CADM" SG_ 271 EngCmbstnCmnd 0;
BA_ "GenSigTimeoutTime_DMSM" SG_ 271 EngCmbstnCmnd 0;
BA_ "GenSigTimeoutTime_DTCM" SG_ 271 EngCmbstnCmnd 0;
BA_ "GenSigTimeoutTime_ECM" SG_ 271 EngCmbstnCmnd 0;
BA_ "GenSigTimeoutTime_EVCU2" SG_ 271 EngCmbstnCmnd 0;
BA_ "GenSigTimeoutTime_GNMM" SG_ 271 EngCmbstnCmnd 0;
BA_ "GenSigTimeoutTime_IPC" SG_ 271 EngCmbstnCmnd 0;
BA_ "GenSigTimeoutTime_RFHM" SG_ 271 EngCmbstnCmnd 0;
BA_ "GenSigTimeoutTime_SGW" SG_ 271 EngCmbstnCmnd 0;
BA_ "GenSigTimeoutTime_TCM" SG_ 271 EngCmbstnCmnd 0;
BA_ "GenSigTimeoutTime_AGSM" SG_ 271 EngCylDeactEnCondMet 0;
BA_ "GenSigTimeoutTime_BCM" SG_ 271 EngCylDeactEnCondMet 0;
BA_ "GenSigTimeoutTime_BSM" SG_ 271 EngCylDeactEnCondMet 0;
BA_ "GenSigTimeoutTime_CADM" SG_ 271 EngCylDeactEnCondMet 0;
BA_ "GenSigTimeoutTime_DMSM" SG_ 271 EngCylDeactEnCondMet 0;
BA_ "GenSigTimeoutTime_DTCM" SG_ 271 EngCylDeactEnCondMet 0;
BA_ "GenSigTimeoutTime_ECM" SG_ 271 EngCylDeactEnCondMet 0;
BA_ "GenSigTimeoutTime_EVCU2" SG_ 271 EngCylDeactEnCondMet 0;
BA_ "GenSigTimeoutTime_GNMM" SG_ 271 EngCylDeactEnCondMet 0;
BA_ "GenSigTimeoutTime_IPC" SG_ 271 EngCylDeactEnCondMet 0;
BA_ "GenSigTimeoutTime_RFHM" SG_ 271 EngCylDeactEnCondMet 0;
BA_ "GenSigTimeoutTime_SGW" SG_ 271 EngCylDeactEnCondMet 0;
BA_ "GenSigTimeoutTime_TCM" SG_ 271 EngCylDeactEnCondMet 0;
BA_ "GenSigTimeoutTime_AGSM" SG_ 271 EngCylDeactMd 0;
BA_ "GenSigTimeoutTime_BCM" SG_ 271 EngCylDeactMd 0;
BA_ "GenSigTimeoutTime_BSM" SG_ 271 EngCylDeactMd 0;
BA_ "GenSigTimeoutTime_CADM" SG_ 271 EngCylDeactMd 0;
BA_ "GenSigTimeoutTime_DMSM" SG_ 271 EngCylDeactMd 0;
BA_ "GenSigTimeoutTime_DTCM" SG_ 271 EngCylDeactMd 0;
BA_ "GenSigTimeoutTime_ECM" SG_ 271 EngCylDeactMd 0;
BA_ "GenSigTimeoutTime_EVCU2" SG_ 271 EngCylDeactMd 0;
BA_ "GenSigTimeoutTime_GNMM" SG_ 271 EngCylDeactMd 0;
BA_ "GenSigTimeoutTime_IPC" SG_ 271 EngCylDeactMd 0;
BA_ "GenSigTimeoutTime_RFHM" SG_ 271 EngCylDeactMd 0;
BA_ "GenSigTimeoutTime_SGW" SG_ 271 EngCylDeactMd 0;
BA_ "GenSigTimeoutTime_TCM" SG_ 271 EngCylDeactMd 0;
BA_ "GenSigTimeoutTime_AGSM" SG_ 271 EngDFCO_Allw 0;
BA_ "GenSigTimeoutTime_BCM" SG_ 271 EngDFCO_Allw 0;
BA_ "GenSigTimeoutTime_BSM" SG_ 271 EngDFCO_Allw 0;
BA_ "GenSigTimeoutTime_CADM" SG_ 271 EngDFCO_Allw 0;
BA_ "GenSigTimeoutTime_DMSM" SG_ 271 EngDFCO_Allw 0;
BA_ "GenSigTimeoutTime_DTCM" SG_ 271 EngDFCO_Allw 0;
BA_ "GenSigTimeoutTime_ECM" SG_ 271 EngDFCO_Allw 0;
BA_ "GenSigTimeoutTime_EVCU2" SG_ 271 EngDFCO_Allw 0;
BA_ "GenSigTimeoutTime_GNMM" SG_ 271 EngDFCO_Allw 0;
BA_ "GenSigTimeoutTime_IPC" SG_ 271 EngDFCO_Allw 0;
BA_ "GenSigTimeoutTime_RFHM" SG_ 271 EngDFCO_Allw 0;
BA_ "GenSigTimeoutTime_SGW" SG_ 271 EngDFCO_Allw 0;
BA_ "GenSigTimeoutTime_TCM" SG_ 271 EngDFCO_Allw 0;
BA_ "GenSigTimeoutTime_AGSM" SG_ 271 EngDFCO_Req 0;
BA_ "GenSigTimeoutTime_BCM" SG_ 271 EngDFCO_Req 0;
BA_ "GenSigTimeoutTime_BSM" SG_ 271 EngDFCO_Req 0;
BA_ "GenSigTimeoutTime_CADM" SG_ 271 EngDFCO_Req 0;
BA_ "GenSigTimeoutTime_DMSM" SG_ 271 EngDFCO_Req 0;
BA_ "GenSigTimeoutTime_DTCM" SG_ 271 EngDFCO_Req 0;
BA_ "GenSigTimeoutTime_ECM" SG_ 271 EngDFCO_Req 0;
BA_ "GenSigTimeoutTime_EVCU2" SG_ 271 EngDFCO_Req 0;
BA_ "GenSigTimeoutTime_GNMM" SG_ 271 EngDFCO_Req 0;
BA_ "GenSigTimeoutTime_IPC" SG_ 271 EngDFCO_Req 0;
BA_ "GenSigTimeoutTime_RFHM" SG_ 271 EngDFCO_Req 0;
BA_ "GenSigTimeoutTime_SGW" SG_ 271 EngDFCO_Req 0;
BA_ "GenSigTimeoutTime_TCM" SG_ 271 EngDFCO_Req 0;
BA_ "GenSigTimeoutTime_AGSM" SG_ 271 EngDFCO_St 0;
BA_ "GenSigTimeoutTime_BCM" SG_ 271 EngDFCO_St 0;
BA_ "GenSigTimeoutTime_BSM" SG_ 271 EngDFCO_St 0;
BA_ "GenSigTimeoutTime_CADM" SG_ 271 EngDFCO_St 0;
BA_ "GenSigTimeoutTime_DMSM" SG_ 271 EngDFCO_St 0;
BA_ "GenSigTimeoutTime_DTCM" SG_ 271 EngDFCO_St 0;
BA_ "GenSigTimeoutTime_ECM" SG_ 271 EngDFCO_St 0;
BA_ "GenSigTimeoutTime_EVCU2" SG_ 271 EngDFCO_St 0;
BA_ "GenSigTimeoutTime_GNMM" SG_ 271 EngDFCO_St 0;
BA_ "GenSigTimeoutTime_IPC" SG_ 271 EngDFCO_St 0;
BA_ "GenSigTimeoutTime_RFHM" SG_ 271 EngDFCO_St 0;
BA_ "GenSigTimeoutTime_SGW" SG_ 271 EngDFCO_St 0;
BA_ "GenSigTimeoutTime_TCM" SG_ 271 EngDFCO_St 0;
BA_ "GenSigTimeoutTime_AGSM" SG_ 271 Engine_Sync_720 0;
BA_ "GenSigTimeoutTime_BCM" SG_ 271 Engine_Sync_720 0;
BA_ "GenSigTimeoutTime_BSM" SG_ 271 Engine_Sync_720 0;
BA_ "GenSigTimeoutTime_CADM" SG_ 271 Engine_Sync_720 0;
BA_ "GenSigTimeoutTime_DMSM" SG_ 271 Engine_Sync_720 0;
BA_ "GenSigTimeoutTime_DTCM" SG_ 271 Engine_Sync_720 0;
BA_ "GenSigTimeoutTime_ECM" SG_ 271 Engine_Sync_720 0;
BA_ "GenSigTimeoutTime_EVCU2" SG_ 271 Engine_Sync_720 0;
BA_ "GenSigTimeoutTime_GNMM" SG_ 271 Engine_Sync_720 0;
BA_ "GenSigTimeoutTime_HCP" SG_ 271 Engine_Sync_720 0;
BA_ "GenSigTimeoutTime_IPC" SG_ 271 Engine_Sync_720 0;
BA_ "GenSigTimeoutTime_RFHM" SG_ 271 Engine_Sync_720 0;
BA_ "GenSigTimeoutTime_SGW" SG_ 271 Engine_Sync_720 0;
BA_ "GenSigTimeoutTime_TCM" SG_ 271 Engine_Sync_720 0;
BA_ "GenSigTimeoutTime_AGSM" SG_ 271 EngOffRecom 0;
BA_ "GenSigTimeoutTime_BCM" SG_ 271 EngOffRecom 0;
BA_ "GenSigTimeoutTime_BSM" SG_ 271 EngOffRecom 0;
BA_ "GenSigTimeoutTime_CADM" SG_ 271 EngOffRecom 0;
BA_ "GenSigTimeoutTime_DMSM" SG_ 271 EngOffRecom 0;
BA_ "GenSigTimeoutTime_DTCM" SG_ 271 EngOffRecom 0;
BA_ "GenSigTimeoutTime_ECM" SG_ 271 EngOffRecom 0;
BA_ "GenSigTimeoutTime_EVCU2" SG_ 271 EngOffRecom 0;
BA_ "GenSigTimeoutTime_GNMM" SG_ 271 EngOffRecom 0;
BA_ "GenSigTimeoutTime_IPC" SG_ 271 EngOffRecom 0;
BA_ "GenSigTimeoutTime_RFHM" SG_ 271 EngOffRecom 0;
BA_ "GenSigTimeoutTime_SGW" SG_ 271 EngOffRecom 0;
BA_ "GenSigTimeoutTime_TCM" SG_ 271 EngOffRecom 0;
BA_ "GenSigTimeoutTime_AGSM" SG_ 271 EngRqStTyp 0;
BA_ "GenSigTimeoutTime_BCM" SG_ 271 EngRqStTyp 0;
BA_ "GenSigTimeoutTime_BSM" SG_ 271 EngRqStTyp 0;
BA_ "GenSigTimeoutTime_CADM" SG_ 271 EngRqStTyp 0;
BA_ "GenSigTimeoutTime_DMSM" SG_ 271 EngRqStTyp 0;
BA_ "GenSigTimeoutTime_DTCM" SG_ 271 EngRqStTyp 0;
BA_ "GenSigTimeoutTime_ECM" SG_ 271 EngRqStTyp 0;
BA_ "GenSigTimeoutTime_EVCU2" SG_ 271 EngRqStTyp 0;
BA_ "GenSigTimeoutTime_GNMM" SG_ 271 EngRqStTyp 0;
BA_ "GenSigTimeoutTime_IPC" SG_ 271 EngRqStTyp 0;
BA_ "GenSigTimeoutTime_RFHM" SG_ 271 EngRqStTyp 0;
BA_ "GenSigTimeoutTime_SGW" SG_ 271 EngRqStTyp 0;
BA_ "GenSigTimeoutTime_TCM" SG_ 271 EngRqStTyp 0;
BA_ "GenSigTimeoutTime_AGSM" SG_ 271 EngRunCrnkAct 0;
BA_ "GenSigTimeoutTime_BCM" SG_ 271 EngRunCrnkAct 0;
BA_ "GenSigTimeoutTime_BSM" SG_ 271 EngRunCrnkAct 0;
BA_ "GenSigTimeoutTime_CADM" SG_ 271 EngRunCrnkAct 0;
BA_ "GenSigTimeoutTime_DMSM" SG_ 271 EngRunCrnkAct 0;
BA_ "GenSigTimeoutTime_DTCM" SG_ 271 EngRunCrnkAct 0;
BA_ "GenSigTimeoutTime_ECM" SG_ 271 EngRunCrnkAct 0;
BA_ "GenSigTimeoutTime_EVCU2" SG_ 271 EngRunCrnkAct 0;
BA_ "GenSigTimeoutTime_GNMM" SG_ 271 EngRunCrnkAct 0;
BA_ "GenSigTimeoutTime_IPC" SG_ 271 EngRunCrnkAct 0;
BA_ "GenSigTimeoutTime_RFHM" SG_ 271 EngRunCrnkAct 0;
BA_ "GenSigTimeoutTime_SGW" SG_ 271 EngRunCrnkAct 0;
BA_ "GenSigTimeoutTime_TCM" SG_ 271 EngRunCrnkAct 0;
BA_ "GenSigTimeoutTime_AGSM" SG_ 271 EngSysFld 0;
BA_ "GenSigTimeoutTime_BCM" SG_ 271 EngSysFld 0;
BA_ "GenSigTimeoutTime_BSM" SG_ 271 EngSysFld 0;
BA_ "GenSigTimeoutTime_CADM" SG_ 271 EngSysFld 0;
BA_ "GenSigTimeoutTime_DMSM" SG_ 271 EngSysFld 0;
BA_ "GenSigTimeoutTime_DTCM" SG_ 271 EngSysFld 0;
BA_ "GenSigTimeoutTime_ECM" SG_ 271 EngSysFld 0;
BA_ "GenSigTimeoutTime_EVCU2" SG_ 271 EngSysFld 0;
BA_ "GenSigTimeoutTime_GNMM" SG_ 271 EngSysFld 0;
BA_ "GenSigTimeoutTime_IPC" SG_ 271 EngSysFld 0;
BA_ "GenSigTimeoutTime_RFHM" SG_ 271 EngSysFld 0;
BA_ "GenSigTimeoutTime_SGW" SG_ 271 EngSysFld 0;
BA_ "GenSigTimeoutTime_TCM" SG_ 271 EngSysFld 0;
BA_ "GenSigTimeoutTime_AGSM" SG_ 271 EngTrqReserveReq 0;
BA_ "GenSigTimeoutTime_BCM" SG_ 271 EngTrqReserveReq 0;
BA_ "GenSigTimeoutTime_BSM" SG_ 271 EngTrqReserveReq 0;
BA_ "GenSigTimeoutTime_CADM" SG_ 271 EngTrqReserveReq 0;
BA_ "GenSigTimeoutTime_DMSM" SG_ 271 EngTrqReserveReq 0;
BA_ "GenSigTimeoutTime_DTCM" SG_ 271 EngTrqReserveReq 0;
BA_ "GenSigTimeoutTime_ECM" SG_ 271 EngTrqReserveReq 0;
BA_ "GenSigTimeoutTime_EVCU2" SG_ 271 EngTrqReserveReq 0;
BA_ "GenSigTimeoutTime_GNMM" SG_ 271 EngTrqReserveReq 0;
BA_ "GenSigTimeoutTime_IPC" SG_ 271 EngTrqReserveReq 0;
BA_ "GenSigTimeoutTime_RFHM" SG_ 271 EngTrqReserveReq 0;
BA_ "GenSigTimeoutTime_SGW" SG_ 271 EngTrqReserveReq 0;
BA_ "GenSigTimeoutTime_TCM" SG_ 271 EngTrqReserveReq 0;
BA_ "GenSigStartValue" SG_ 271 ESS_Engine_State_EE 15;
BA_ "GenSigTimeoutTime_AGSM" SG_ 271 ESS_Engine_State_EE 0;
BA_ "GenSigTimeoutTime_BCM" SG_ 271 ESS_Engine_State_EE 0;
BA_ "GenSigTimeoutTime_BSM" SG_ 271 ESS_Engine_State_EE 0;
BA_ "GenSigTimeoutTime_CADM" SG_ 271 ESS_Engine_State_EE 0;
BA_ "GenSigTimeoutTime_DMSM" SG_ 271 ESS_Engine_State_EE 0;
BA_ "GenSigTimeoutTime_DTCM" SG_ 271 ESS_Engine_State_EE 0;
BA_ "GenSigTimeoutTime_ECM" SG_ 271 ESS_Engine_State_EE 0;
BA_ "GenSigTimeoutTime_GNMM" SG_ 271 ESS_Engine_State_EE 0;
BA_ "GenSigTimeoutTime_IPC" SG_ 271 ESS_Engine_State_EE 0;
BA_ "GenSigTimeoutTime_RFHM" SG_ 271 ESS_Engine_State_EE 0;
BA_ "GenSigTimeoutTime_SGW" SG_ 271 ESS_Engine_State_EE 0;
BA_ "GenSigTimeoutTime_TCM" SG_ 271 ESS_Engine_State_EE 0;
BA_ "GenSigTimeoutTime_AGSM" SG_ 271 ETRQ_Mode 0;
BA_ "GenSigTimeoutTime_BCM" SG_ 271 ETRQ_Mode 0;
BA_ "GenSigTimeoutTime_BSM" SG_ 271 ETRQ_Mode 0;
BA_ "GenSigTimeoutTime_CADM" SG_ 271 ETRQ_Mode 0;
BA_ "GenSigTimeoutTime_DMSM" SG_ 271 ETRQ_Mode 0;
BA_ "GenSigTimeoutTime_DTCM" SG_ 271 ETRQ_Mode 0;
BA_ "GenSigTimeoutTime_ECM" SG_ 271 ETRQ_Mode 0;
BA_ "GenSigTimeoutTime_EVCU2" SG_ 271 ETRQ_Mode 0;
BA_ "GenSigTimeoutTime_GNMM" SG_ 271 ETRQ_Mode 0;
BA_ "GenSigTimeoutTime_IPC" SG_ 271 ETRQ_Mode 0;
BA_ "GenSigTimeoutTime_RFHM" SG_ 271 ETRQ_Mode 0;
BA_ "GenSigTimeoutTime_SGW" SG_ 271 ETRQ_Mode 0;
BA_ "GenSigTimeoutTime_TCM" SG_ 271 ETRQ_Mode 0;
BA_ "GenSigTimeoutTime_AGSM" SG_ 271 Feedback_HCP 0;
BA_ "GenSigTimeoutTime_BCM" SG_ 271 Feedback_HCP 0;
BA_ "GenSigTimeoutTime_BSM" SG_ 271 Feedback_HCP 0;
BA_ "GenSigTimeoutTime_CADM" SG_ 271 Feedback_HCP 0;
BA_ "GenSigTimeoutTime_DMSM" SG_ 271 Feedback_HCP 0;
BA_ "GenSigTimeoutTime_DTCM" SG_ 271 Feedback_HCP 0;
BA_ "GenSigTimeoutTime_ECM" SG_ 271 Feedback_HCP 0;
BA_ "GenSigTimeoutTime_EVCU2" SG_ 271 Feedback_HCP 0;
BA_ "GenSigTimeoutTime_GNMM" SG_ 271 Feedback_HCP 0;
BA_ "GenSigTimeoutTime_IPC" SG_ 271 Feedback_HCP 0;
BA_ "GenSigTimeoutTime_RFHM" SG_ 271 Feedback_HCP 0;
BA_ "GenSigTimeoutTime_SGW" SG_ 271 Feedback_HCP 0;
BA_ "GenSigTimeoutTime_TCM" SG_ 271 Feedback_HCP 0;
BA_ "GenSigTimeoutTime_AGSM" SG_ 271 HybActEngTorqRespTyp 0;
BA_ "GenSigTimeoutTime_BCM" SG_ 271 HybActEngTorqRespTyp 0;
BA_ "GenSigTimeoutTime_BSM" SG_ 271 HybActEngTorqRespTyp 0;
BA_ "GenSigTimeoutTime_CADM" SG_ 271 HybActEngTorqRespTyp 0;
BA_ "GenSigTimeoutTime_DMSM" SG_ 271 HybActEngTorqRespTyp 0;
BA_ "GenSigTimeoutTime_DTCM" SG_ 271 HybActEngTorqRespTyp 0;
BA_ "GenSigTimeoutTime_ECM" SG_ 271 HybActEngTorqRespTyp 0;
BA_ "GenSigTimeoutTime_EVCU2" SG_ 271 HybActEngTorqRespTyp 0;
BA_ "GenSigTimeoutTime_GNMM" SG_ 271 HybActEngTorqRespTyp 0;
BA_ "GenSigTimeoutTime_IPC" SG_ 271 HybActEngTorqRespTyp 0;
BA_ "GenSigTimeoutTime_RFHM" SG_ 271 HybActEngTorqRespTyp 0;
BA_ "GenSigTimeoutTime_SGW" SG_ 271 HybActEngTorqRespTyp 0;
BA_ "GenSigTimeoutTime_TCM" SG_ 271 HybActEngTorqRespTyp 0;
BA_ "GenSigStartValue" SG_ 271 MaxOffEngTorqCap 938;
BA_ "GenSigTimeoutTime_AGSM" SG_ 271 MaxOffEngTorqCap 0;
BA_ "GenSigTimeoutTime_BCM" SG_ 271 MaxOffEngTorqCap 0;
BA_ "GenSigTimeoutTime_BSM" SG_ 271 MaxOffEngTorqCap 0;
BA_ "GenSigTimeoutTime_CADM" SG_ 271 MaxOffEngTorqCap 0;
BA_ "GenSigTimeoutTime_DMSM" SG_ 271 MaxOffEngTorqCap 0;
BA_ "GenSigTimeoutTime_DTCM" SG_ 271 MaxOffEngTorqCap 0;
BA_ "GenSigTimeoutTime_ECM" SG_ 271 MaxOffEngTorqCap 0;
BA_ "GenSigTimeoutTime_EVCU2" SG_ 271 MaxOffEngTorqCap 0;
BA_ "GenSigTimeoutTime_GNMM" SG_ 271 MaxOffEngTorqCap 0;
BA_ "GenSigTimeoutTime_IPC" SG_ 271 MaxOffEngTorqCap 0;
BA_ "GenSigTimeoutTime_RFHM" SG_ 271 MaxOffEngTorqCap 0;
BA_ "GenSigTimeoutTime_SGW" SG_ 271 MaxOffEngTorqCap 0;
BA_ "GenSigTimeoutTime_TCM" SG_ 271 MaxOffEngTorqCap 0;
BA_ "GenSigStartValue" SG_ 271 MaxPrdtdEngTorqCap 938;
BA_ "GenSigTimeoutTime_AGSM" SG_ 271 MaxPrdtdEngTorqCap 0;
BA_ "GenSigTimeoutTime_BCM" SG_ 271 MaxPrdtdEngTorqCap 0;
BA_ "GenSigTimeoutTime_BSM" SG_ 271 MaxPrdtdEngTorqCap 0;
BA_ "GenSigTimeoutTime_CADM" SG_ 271 MaxPrdtdEngTorqCap 0;
BA_ "GenSigTimeoutTime_DMSM" SG_ 271 MaxPrdtdEngTorqCap 0;
BA_ "GenSigTimeoutTime_DTCM" SG_ 271 MaxPrdtdEngTorqCap 0;
BA_ "GenSigTimeoutTime_ECM" SG_ 271 MaxPrdtdEngTorqCap 0;
BA_ "GenSigTimeoutTime_EVCU2" SG_ 271 MaxPrdtdEngTorqCap 0;
BA_ "GenSigTimeoutTime_GNMM" SG_ 271 MaxPrdtdEngTorqCap 0;
BA_ "GenSigTimeoutTime_IPC" SG_ 271 MaxPrdtdEngTorqCap 0;
BA_ "GenSigTimeoutTime_RFHM" SG_ 271 MaxPrdtdEngTorqCap 0;
BA_ "GenSigTimeoutTime_SGW" SG_ 271 MaxPrdtdEngTorqCap 0;
BA_ "GenSigTimeoutTime_TCM" SG_ 271 MaxPrdtdEngTorqCap 0;
BA_ "GenSigTimeoutTime_AGSM" SG_ 271 MaxPrdtdEngTorqCapV 0;
BA_ "GenSigTimeoutTime_BCM" SG_ 271 MaxPrdtdEngTorqCapV 0;
BA_ "GenSigTimeoutTime_BSM" SG_ 271 MaxPrdtdEngTorqCapV 0;
BA_ "GenSigTimeoutTime_CADM" SG_ 271 MaxPrdtdEngTorqCapV 0;
BA_ "GenSigTimeoutTime_DMSM" SG_ 271 MaxPrdtdEngTorqCapV 0;
BA_ "GenSigTimeoutTime_DTCM" SG_ 271 MaxPrdtdEngTorqCapV 0;
BA_ "GenSigTimeoutTime_ECM" SG_ 271 MaxPrdtdEngTorqCapV 0;
BA_ "GenSigTimeoutTime_EVCU2" SG_ 271 MaxPrdtdEngTorqCapV 0;
BA_ "GenSigTimeoutTime_GNMM" SG_ 271 MaxPrdtdEngTorqCapV 0;
BA_ "GenSigTimeoutTime_IPC" SG_ 271 MaxPrdtdEngTorqCapV 0;
BA_ "GenSigTimeoutTime_RFHM" SG_ 271 MaxPrdtdEngTorqCapV 0;
BA_ "GenSigTimeoutTime_SGW" SG_ 271 MaxPrdtdEngTorqCapV 0;
BA_ "GenSigTimeoutTime_TCM" SG_ 271 MaxPrdtdEngTorqCapV 0;
BA_ "GenSigTimeoutTime_AGSM" SG_ 271 MessageCounter_ENGINE_HYBD_FD_1 0;
BA_ "GenSigTimeoutTime_BCM" SG_ 271 MessageCounter_ENGINE_HYBD_FD_1 0;
BA_ "GenSigTimeoutTime_BSM" SG_ 271 MessageCounter_ENGINE_HYBD_FD_1 0;
BA_ "GenSigTimeoutTime_CADM" SG_ 271 MessageCounter_ENGINE_HYBD_FD_1 0;
BA_ "GenSigTimeoutTime_DMSM" SG_ 271 MessageCounter_ENGINE_HYBD_FD_1 0;
BA_ "GenSigTimeoutTime_DTCM" SG_ 271 MessageCounter_ENGINE_HYBD_FD_1 0;
BA_ "GenSigTimeoutTime_ECM" SG_ 271 MessageCounter_ENGINE_HYBD_FD_1 0;
BA_ "GenSigTimeoutTime_EVCU2" SG_ 271 MessageCounter_ENGINE_HYBD_FD_1 0;
BA_ "GenSigTimeoutTime_GNMM" SG_ 271 MessageCounter_ENGINE_HYBD_FD_1 0;
BA_ "GenSigTimeoutTime_IPC" SG_ 271 MessageCounter_ENGINE_HYBD_FD_1 0;
BA_ "GenSigTimeoutTime_RFHM" SG_ 271 MessageCounter_ENGINE_HYBD_FD_1 0;
BA_ "GenSigTimeoutTime_SGW" SG_ 271 MessageCounter_ENGINE_HYBD_FD_1 0;
BA_ "GenSigStartValue" SG_ 271 MinAirFlowMinSparkTorqCap 938;
BA_ "GenSigTimeoutTime_AGSM" SG_ 271 MinAirFlowMinSparkTorqCap 0;
BA_ "GenSigTimeoutTime_BCM" SG_ 271 MinAirFlowMinSparkTorqCap 0;
BA_ "GenSigTimeoutTime_BSM" SG_ 271 MinAirFlowMinSparkTorqCap 0;
BA_ "GenSigTimeoutTime_CADM" SG_ 271 MinAirFlowMinSparkTorqCap 0;
BA_ "GenSigTimeoutTime_DMSM" SG_ 271 MinAirFlowMinSparkTorqCap 0;
BA_ "GenSigTimeoutTime_DTCM" SG_ 271 MinAirFlowMinSparkTorqCap 0;
BA_ "GenSigTimeoutTime_ECM" SG_ 271 MinAirFlowMinSparkTorqCap 0;
BA_ "GenSigTimeoutTime_EVCU2" SG_ 271 MinAirFlowMinSparkTorqCap 0;
BA_ "GenSigTimeoutTime_GNMM" SG_ 271 MinAirFlowMinSparkTorqCap 0;
BA_ "GenSigTimeoutTime_IPC" SG_ 271 MinAirFlowMinSparkTorqCap 0;
BA_ "GenSigTimeoutTime_RFHM" SG_ 271 MinAirFlowMinSparkTorqCap 0;
BA_ "GenSigTimeoutTime_SGW" SG_ 271 MinAirFlowMinSparkTorqCap 0;
BA_ "GenSigTimeoutTime_TCM" SG_ 271 MinAirFlowMinSparkTorqCap 0;
BA_ "GenSigTimeoutTime_AGSM" SG_ 271 MinAirFlowMinSparkTorqCapV 0;
BA_ "GenSigTimeoutTime_BCM" SG_ 271 MinAirFlowMinSparkTorqCapV 0;
BA_ "GenSigTimeoutTime_BSM" SG_ 271 MinAirFlowMinSparkTorqCapV 0;
BA_ "GenSigTimeoutTime_CADM" SG_ 271 MinAirFlowMinSparkTorqCapV 0;
BA_ "GenSigTimeoutTime_DMSM" SG_ 271 MinAirFlowMinSparkTorqCapV 0;
BA_ "GenSigTimeoutTime_DTCM" SG_ 271 MinAirFlowMinSparkTorqCapV 0;
BA_ "GenSigTimeoutTime_ECM" SG_ 271 MinAirFlowMinSparkTorqCapV 0;
BA_ "GenSigTimeoutTime_EVCU2" SG_ 271 MinAirFlowMinSparkTorqCapV 0;
BA_ "GenSigTimeoutTime_GNMM" SG_ 271 MinAirFlowMinSparkTorqCapV 0;
BA_ "GenSigTimeoutTime_IPC" SG_ 271 MinAirFlowMinSparkTorqCapV 0;
BA_ "GenSigTimeoutTime_RFHM" SG_ 271 MinAirFlowMinSparkTorqCapV 0;
BA_ "GenSigTimeoutTime_SGW" SG_ 271 MinAirFlowMinSparkTorqCapV 0;
BA_ "GenSigTimeoutTime_TCM" SG_ 271 MinAirFlowMinSparkTorqCapV 0;
BA_ "GenSigStartValue" SG_ 271 MinEngTorqCap 938;
BA_ "GenSigTimeoutTime_AGSM" SG_ 271 MinEngTorqCap 0;
BA_ "GenSigTimeoutTime_BCM" SG_ 271 MinEngTorqCap 0;
BA_ "GenSigTimeoutTime_BSM" SG_ 271 MinEngTorqCap 0;
BA_ "GenSigTimeoutTime_CADM" SG_ 271 MinEngTorqCap 0;
BA_ "GenSigTimeoutTime_DMSM" SG_ 271 MinEngTorqCap 0;
BA_ "GenSigTimeoutTime_DTCM" SG_ 271 MinEngTorqCap 0;
BA_ "GenSigTimeoutTime_ECM" SG_ 271 MinEngTorqCap 0;
BA_ "GenSigTimeoutTime_EVCU2" SG_ 271 MinEngTorqCap 0;
BA_ "GenSigTimeoutTime_GNMM" SG_ 271 MinEngTorqCap 0;
BA_ "GenSigTimeoutTime_IPC" SG_ 271 MinEngTorqCap 0;
BA_ "GenSigTimeoutTime_RFHM" SG_ 271 MinEngTorqCap 0;
BA_ "GenSigTimeoutTime_SGW" SG_ 271 MinEngTorqCap 0;
BA_ "GenSigTimeoutTime_TCM" SG_ 271 MinEngTorqCap 0;
BA_ "GenSigTimeoutTime_AGSM" SG_ 271 MinEngTorqCapV 0;
BA_ "GenSigTimeoutTime_BCM" SG_ 271 MinEngTorqCapV 0;
BA_ "GenSigTimeoutTime_BSM" SG_ 271 MinEngTorqCapV 0;
BA_ "GenSigTimeoutTime_CADM" SG_ 271 MinEngTorqCapV 0;
BA_ "GenSigTimeoutTime_DMSM" SG_ 271 MinEngTorqCapV 0;
BA_ "GenSigTimeoutTime_DTCM" SG_ 271 MinEngTorqCapV 0;
BA_ "GenSigTimeoutTime_ECM" SG_ 271 MinEngTorqCapV 0;
BA_ "GenSigTimeoutTime_EVCU2" SG_ 271 MinEngTorqCapV 0;
BA_ "GenSigTimeoutTime_GNMM" SG_ 271 MinEngTorqCapV 0;
BA_ "GenSigTimeoutTime_IPC" SG_ 271 MinEngTorqCapV 0;
BA_ "GenSigTimeoutTime_RFHM" SG_ 271 MinEngTorqCapV 0;
BA_ "GenSigTimeoutTime_SGW" SG_ 271 MinEngTorqCapV 0;
BA_ "GenSigTimeoutTime_TCM" SG_ 271 MinEngTorqCapV 0;
BA_ "GenSigStartValue" SG_ 271 MinImmedEngTorqCap 938;
BA_ "GenSigTimeoutTime_AGSM" SG_ 271 MinImmedEngTorqCap 0;
BA_ "GenSigTimeoutTime_BCM" SG_ 271 MinImmedEngTorqCap 0;
BA_ "GenSigTimeoutTime_BSM" SG_ 271 MinImmedEngTorqCap 0;
BA_ "GenSigTimeoutTime_CADM" SG_ 271 MinImmedEngTorqCap 0;
BA_ "GenSigTimeoutTime_DMSM" SG_ 271 MinImmedEngTorqCap 0;
BA_ "GenSigTimeoutTime_DTCM" SG_ 271 MinImmedEngTorqCap 0;
BA_ "GenSigTimeoutTime_ECM" SG_ 271 MinImmedEngTorqCap 0;
BA_ "GenSigTimeoutTime_EVCU2" SG_ 271 MinImmedEngTorqCap 0;
BA_ "GenSigTimeoutTime_GNMM" SG_ 271 MinImmedEngTorqCap 0;
BA_ "GenSigTimeoutTime_IPC" SG_ 271 MinImmedEngTorqCap 0;
BA_ "GenSigTimeoutTime_RFHM" SG_ 271 MinImmedEngTorqCap 0;
BA_ "GenSigTimeoutTime_SGW" SG_ 271 MinImmedEngTorqCap 0;
BA_ "GenSigTimeoutTime_TCM" SG_ 271 MinImmedEngTorqCap 0;
BA_ "GenSigTimeoutTime_AGSM" SG_ 271 MinImmedEngTorqCapV 0;
BA_ "GenSigTimeoutTime_BCM" SG_ 271 MinImmedEngTorqCapV 0;
BA_ "GenSigTimeoutTime_BSM" SG_ 271 MinImmedEngTorqCapV 0;
BA_ "GenSigTimeoutTime_CADM" SG_ 271 MinImmedEngTorqCapV 0;
BA_ "GenSigTimeoutTime_DMSM" SG_ 271 MinImmedEngTorqCapV 0;
BA_ "GenSigTimeoutTime_DTCM" SG_ 271 MinImmedEngTorqCapV 0;
BA_ "GenSigTimeoutTime_ECM" SG_ 271 MinImmedEngTorqCapV 0;
BA_ "GenSigTimeoutTime_EVCU2" SG_ 271 MinImmedEngTorqCapV 0;
BA_ "GenSigTimeoutTime_GNMM" SG_ 271 MinImmedEngTorqCapV 0;
BA_ "GenSigTimeoutTime_IPC" SG_ 271 MinImmedEngTorqCapV 0;
BA_ "GenSigTimeoutTime_RFHM" SG_ 271 MinImmedEngTorqCapV 0;
BA_ "GenSigTimeoutTime_SGW" SG_ 271 MinImmedEngTorqCapV 0;
BA_ "GenSigTimeoutTime_TCM" SG_ 271 MinImmedEngTorqCapV 0;
BA_ "GenSigStartValue" SG_ 271 MinPrdtdEngRunTorqCap 938;
BA_ "GenSigTimeoutTime_AGSM" SG_ 271 MinPrdtdEngRunTorqCap 0;
BA_ "GenSigTimeoutTime_BCM" SG_ 271 MinPrdtdEngRunTorqCap 0;
BA_ "GenSigTimeoutTime_BSM" SG_ 271 MinPrdtdEngRunTorqCap 0;
BA_ "GenSigTimeoutTime_CADM" SG_ 271 MinPrdtdEngRunTorqCap 0;
BA_ "GenSigTimeoutTime_DMSM" SG_ 271 MinPrdtdEngRunTorqCap 0;
BA_ "GenSigTimeoutTime_DTCM" SG_ 271 MinPrdtdEngRunTorqCap 0;
BA_ "GenSigTimeoutTime_ECM" SG_ 271 MinPrdtdEngRunTorqCap 0;
BA_ "GenSigTimeoutTime_EVCU2" SG_ 271 MinPrdtdEngRunTorqCap 0;
BA_ "GenSigTimeoutTime_GNMM" SG_ 271 MinPrdtdEngRunTorqCap 0;
BA_ "GenSigTimeoutTime_IPC" SG_ 271 MinPrdtdEngRunTorqCap 0;
BA_ "GenSigTimeoutTime_RFHM" SG_ 271 MinPrdtdEngRunTorqCap 0;
BA_ "GenSigTimeoutTime_SGW" SG_ 271 MinPrdtdEngRunTorqCap 0;
BA_ "GenSigTimeoutTime_TCM" SG_ 271 MinPrdtdEngRunTorqCap 0;
BA_ "GenSigTimeoutTime_AGSM" SG_ 271 MinPrdtdEngRunTorqCapV 0;
BA_ "GenSigTimeoutTime_BCM" SG_ 271 MinPrdtdEngRunTorqCapV 0;
BA_ "GenSigTimeoutTime_BSM" SG_ 271 MinPrdtdEngRunTorqCapV 0;
BA_ "GenSigTimeoutTime_CADM" SG_ 271 MinPrdtdEngRunTorqCapV 0;
BA_ "GenSigTimeoutTime_DMSM" SG_ 271 MinPrdtdEngRunTorqCapV 0;
BA_ "GenSigTimeoutTime_DTCM" SG_ 271 MinPrdtdEngRunTorqCapV 0;
BA_ "GenSigTimeoutTime_ECM" SG_ 271 MinPrdtdEngRunTorqCapV 0;
BA_ "GenSigTimeoutTime_EVCU2" SG_ 271 MinPrdtdEngRunTorqCapV 0;
BA_ "GenSigTimeoutTime_GNMM" SG_ 271 MinPrdtdEngRunTorqCapV 0;
BA_ "GenSigTimeoutTime_IPC" SG_ 271 MinPrdtdEngRunTorqCapV 0;
BA_ "GenSigTimeoutTime_RFHM" SG_ 271 MinPrdtdEngRunTorqCapV 0;
BA_ "GenSigTimeoutTime_SGW" SG_ 271 MinPrdtdEngRunTorqCapV 0;
BA_ "GenSigTimeoutTime_TCM" SG_ 271 MinPrdtdEngRunTorqCapV 0;
BA_ "GenSigTimeoutTime_AGSM" SG_ 271 PT_BrakePdlPosn 0;
BA_ "GenSigTimeoutTime_BCM" SG_ 271 PT_BrakePdlPosn 0;
BA_ "GenSigTimeoutTime_BSM" SG_ 271 PT_BrakePdlPosn 0;
BA_ "GenSigTimeoutTime_CADM" SG_ 271 PT_BrakePdlPosn 0;
BA_ "GenSigTimeoutTime_DMSM" SG_ 271 PT_BrakePdlPosn 0;
BA_ "GenSigTimeoutTime_DTCM" SG_ 271 PT_BrakePdlPosn 0;
BA_ "GenSigTimeoutTime_ECM" SG_ 271 PT_BrakePdlPosn 0;
BA_ "GenSigTimeoutTime_EVCU2" SG_ 271 PT_BrakePdlPosn 0;
BA_ "GenSigTimeoutTime_GNMM" SG_ 271 PT_BrakePdlPosn 0;
BA_ "GenSigTimeoutTime_IPC" SG_ 271 PT_BrakePdlPosn 0;
BA_ "GenSigTimeoutTime_RFHM" SG_ 271 PT_BrakePdlPosn 0;
BA_ "GenSigTimeoutTime_SGW" SG_ 271 PT_BrakePdlPosn 0;
BA_ "GenSigTimeoutTime_TCM" SG_ 271 PT_BrakePdlPosn 0;
BA_ "GenSigTimeoutTime_AGSM" SG_ 271 PT_BrkPedDscrtInpStat 0;
BA_ "GenSigTimeoutTime_BCM" SG_ 271 PT_BrkPedDscrtInpStat 0;
BA_ "GenSigTimeoutTime_BSM" SG_ 271 PT_BrkPedDscrtInpStat 0;
BA_ "GenSigTimeoutTime_CADM" SG_ 271 PT_BrkPedDscrtInpStat 0;
BA_ "GenSigTimeoutTime_DMSM" SG_ 271 PT_BrkPedDscrtInpStat 0;
BA_ "GenSigTimeoutTime_DTCM" SG_ 271 PT_BrkPedDscrtInpStat 0;
BA_ "GenSigTimeoutTime_ECM" SG_ 271 PT_BrkPedDscrtInpStat 0;
BA_ "GenSigTimeoutTime_EVCU2" SG_ 271 PT_BrkPedDscrtInpStat 0;
BA_ "GenSigTimeoutTime_GNMM" SG_ 271 PT_BrkPedDscrtInpStat 0;
BA_ "GenSigTimeoutTime_IPC" SG_ 271 PT_BrkPedDscrtInpStat 0;
BA_ "GenSigTimeoutTime_RFHM" SG_ 271 PT_BrkPedDscrtInpStat 0;
BA_ "GenSigTimeoutTime_SGW" SG_ 271 PT_BrkPedDscrtInpStat 0;
BA_ "GenSigTimeoutTime_TCM" SG_ 271 PT_BrkPedDscrtInpStat 0;
BA_ "GenSigTimeoutTime_AGSM" SG_ 271 PT_BrkPedDscrtInpStatV 0;
BA_ "GenSigTimeoutTime_BCM" SG_ 271 PT_BrkPedDscrtInpStatV 0;
BA_ "GenSigTimeoutTime_BSM" SG_ 271 PT_BrkPedDscrtInpStatV 0;
BA_ "GenSigTimeoutTime_CADM" SG_ 271 PT_BrkPedDscrtInpStatV 0;
BA_ "GenSigTimeoutTime_DMSM" SG_ 271 PT_BrkPedDscrtInpStatV 0;
BA_ "GenSigTimeoutTime_DTCM" SG_ 271 PT_BrkPedDscrtInpStatV 0;
BA_ "GenSigTimeoutTime_ECM" SG_ 271 PT_BrkPedDscrtInpStatV 0;
BA_ "GenSigTimeoutTime_EVCU2" SG_ 271 PT_BrkPedDscrtInpStatV 0;
BA_ "GenSigTimeoutTime_GNMM" SG_ 271 PT_BrkPedDscrtInpStatV 0;
BA_ "GenSigTimeoutTime_IPC" SG_ 271 PT_BrkPedDscrtInpStatV 0;
BA_ "GenSigTimeoutTime_RFHM" SG_ 271 PT_BrkPedDscrtInpStatV 0;
BA_ "GenSigTimeoutTime_SGW" SG_ 271 PT_BrkPedDscrtInpStatV 0;
BA_ "GenSigTimeoutTime_TCM" SG_ 271 PT_BrkPedDscrtInpStatV 0;
BA_ "GenSigTimeoutTime_AGSM" SG_ 271 PT_CrnkAct 0;
BA_ "GenSigTimeoutTime_BCM" SG_ 271 PT_CrnkAct 0;
BA_ "GenSigTimeoutTime_BSM" SG_ 271 PT_CrnkAct 0;
BA_ "GenSigTimeoutTime_CADM" SG_ 271 PT_CrnkAct 0;
BA_ "GenSigTimeoutTime_DMSM" SG_ 271 PT_CrnkAct 0;
BA_ "GenSigTimeoutTime_DTCM" SG_ 271 PT_CrnkAct 0;
BA_ "GenSigTimeoutTime_ECM" SG_ 271 PT_CrnkAct 0;
BA_ "GenSigTimeoutTime_EVCU2" SG_ 271 PT_CrnkAct 0;
BA_ "GenSigTimeoutTime_GNMM" SG_ 271 PT_CrnkAct 0;
BA_ "GenSigTimeoutTime_IPC" SG_ 271 PT_CrnkAct 0;
BA_ "GenSigTimeoutTime_RFHM" SG_ 271 PT_CrnkAct 0;
BA_ "GenSigTimeoutTime_SGW" SG_ 271 PT_CrnkAct 0;
BA_ "GenSigTimeoutTime_TCM" SG_ 271 PT_CrnkAct 0;
BA_ "GenSigTimeoutTime_AGSM" SG_ 271 PTCrnkAbrted 0;
BA_ "GenSigTimeoutTime_BCM" SG_ 271 PTCrnkAbrted 0;
BA_ "GenSigTimeoutTime_BSM" SG_ 271 PTCrnkAbrted 0;
BA_ "GenSigTimeoutTime_CADM" SG_ 271 PTCrnkAbrted 0;
BA_ "GenSigTimeoutTime_DMSM" SG_ 271 PTCrnkAbrted 0;
BA_ "GenSigTimeoutTime_DTCM" SG_ 271 PTCrnkAbrted 0;
BA_ "GenSigTimeoutTime_ECM" SG_ 271 PTCrnkAbrted 0;
BA_ "GenSigTimeoutTime_EVCU2" SG_ 271 PTCrnkAbrted 0;
BA_ "GenSigTimeoutTime_GNMM" SG_ 271 PTCrnkAbrted 0;
BA_ "GenSigTimeoutTime_IPC" SG_ 271 PTCrnkAbrted 0;
BA_ "GenSigTimeoutTime_RFHM" SG_ 271 PTCrnkAbrted 0;
BA_ "GenSigTimeoutTime_SGW" SG_ 271 PTCrnkAbrted 0;
BA_ "GenSigTimeoutTime_TCM" SG_ 271 PTCrnkAbrted 0;
BA_ "GenSigStartValue" SG_ 271 Sum_FW_ID_Fst 1;
BA_ "GenSigTimeoutTime_AGSM" SG_ 271 Sum_FW_ID_Fst 0;
BA_ "GenSigTimeoutTime_BCM" SG_ 271 Sum_FW_ID_Fst 0;
BA_ "GenSigTimeoutTime_BSM" SG_ 271 Sum_FW_ID_Fst 0;
BA_ "GenSigTimeoutTime_CADM" SG_ 271 Sum_FW_ID_Fst 0;
BA_ "GenSigTimeoutTime_DMSM" SG_ 271 Sum_FW_ID_Fst 0;
BA_ "GenSigTimeoutTime_DTCM" SG_ 271 Sum_FW_ID_Fst 0;
BA_ "GenSigTimeoutTime_ECM" SG_ 271 Sum_FW_ID_Fst 0;
BA_ "GenSigTimeoutTime_EVCU2" SG_ 271 Sum_FW_ID_Fst 0;
BA_ "GenSigTimeoutTime_GNMM" SG_ 271 Sum_FW_ID_Fst 0;
BA_ "GenSigTimeoutTime_IPC" SG_ 271 Sum_FW_ID_Fst 0;
BA_ "GenSigTimeoutTime_RFHM" SG_ 271 Sum_FW_ID_Fst 0;
BA_ "GenSigTimeoutTime_SGW" SG_ 271 Sum_FW_ID_Fst 0;
BA_ "GenSigTimeoutTime_TCM" SG_ 271 Sum_FW_ID_Fst 0;
BA_ "GenSigStartValue" SG_ 271 Sum_FW_ID_Slw 1;
BA_ "GenSigTimeoutTime_AGSM" SG_ 271 Sum_FW_ID_Slw 0;
BA_ "GenSigTimeoutTime_BCM" SG_ 271 Sum_FW_ID_Slw 0;
BA_ "GenSigTimeoutTime_BSM" SG_ 271 Sum_FW_ID_Slw 0;
BA_ "GenSigTimeoutTime_CADM" SG_ 271 Sum_FW_ID_Slw 0;
BA_ "GenSigTimeoutTime_DMSM" SG_ 271 Sum_FW_ID_Slw 0;
BA_ "GenSigTimeoutTime_DTCM" SG_ 271 Sum_FW_ID_Slw 0;
BA_ "GenSigTimeoutTime_ECM" SG_ 271 Sum_FW_ID_Slw 0;
BA_ "GenSigTimeoutTime_EVCU2" SG_ 271 Sum_FW_ID_Slw 0;
BA_ "GenSigTimeoutTime_GNMM" SG_ 271 Sum_FW_ID_Slw 0;
BA_ "GenSigTimeoutTime_IPC" SG_ 271 Sum_FW_ID_Slw 0;
BA_ "GenSigTimeoutTime_RFHM" SG_ 271 Sum_FW_ID_Slw 0;
BA_ "GenSigTimeoutTime_SGW" SG_ 271 Sum_FW_ID_Slw 0;
BA_ "GenSigTimeoutTime_TCM" SG_ 271 Sum_FW_ID_Slw 0;
BA_ "GenSigStartValue" SG_ 271 T_max_FW 938;
BA_ "GenSigTimeoutTime_AGSM" SG_ 271 T_max_FW 0;
BA_ "GenSigTimeoutTime_BCM" SG_ 271 T_max_FW 0;
BA_ "GenSigTimeoutTime_BSM" SG_ 271 T_max_FW 0;
BA_ "GenSigTimeoutTime_CADM" SG_ 271 T_max_FW 0;
BA_ "GenSigTimeoutTime_DMSM" SG_ 271 T_max_FW 0;
BA_ "GenSigTimeoutTime_DTCM" SG_ 271 T_max_FW 0;
BA_ "GenSigTimeoutTime_ECM" SG_ 271 T_max_FW 0;
BA_ "GenSigTimeoutTime_EVCU2" SG_ 271 T_max_FW 0;
BA_ "GenSigTimeoutTime_GNMM" SG_ 271 T_max_FW 0;
BA_ "GenSigTimeoutTime_IPC" SG_ 271 T_max_FW 0;
BA_ "GenSigTimeoutTime_RFHM" SG_ 271 T_max_FW 0;
BA_ "GenSigTimeoutTime_SGW" SG_ 271 T_max_FW 0;
BA_ "GenSigTimeoutTime_TCM" SG_ 271 T_max_FW 0;
BA_ "GenSigStartValue" SG_ 271 T_min_FW 938;
BA_ "GenSigTimeoutTime_AGSM" SG_ 271 T_min_FW 0;
BA_ "GenSigTimeoutTime_BCM" SG_ 271 T_min_FW 0;
BA_ "GenSigTimeoutTime_BSM" SG_ 271 T_min_FW 0;
BA_ "GenSigTimeoutTime_CADM" SG_ 271 T_min_FW 0;
BA_ "GenSigTimeoutTime_DMSM" SG_ 271 T_min_FW 0;
BA_ "GenSigTimeoutTime_DTCM" SG_ 271 T_min_FW 0;
BA_ "GenSigTimeoutTime_ECM" SG_ 271 T_min_FW 0;
BA_ "GenSigTimeoutTime_EVCU2" SG_ 271 T_min_FW 0;
BA_ "GenSigTimeoutTime_GNMM" SG_ 271 T_min_FW 0;
BA_ "GenSigTimeoutTime_IPC" SG_ 271 T_min_FW 0;
BA_ "GenSigTimeoutTime_RFHM" SG_ 271 T_min_FW 0;
BA_ "GenSigTimeoutTime_SGW" SG_ 271 T_min_FW 0;
BA_ "GenSigTimeoutTime_TCM" SG_ 271 T_min_FW 0;
BA_ "GenSigTimeoutTime_AGSM" SG_ 271 TLC_LRN_Rq 0;
BA_ "GenSigTimeoutTime_BCM" SG_ 271 TLC_LRN_Rq 0;
BA_ "GenSigTimeoutTime_BSM" SG_ 271 TLC_LRN_Rq 0;
BA_ "GenSigTimeoutTime_CADM" SG_ 271 TLC_LRN_Rq 0;
BA_ "GenSigTimeoutTime_DMSM" SG_ 271 TLC_LRN_Rq 0;
BA_ "GenSigTimeoutTime_DTCM" SG_ 271 TLC_LRN_Rq 0;
BA_ "GenSigTimeoutTime_ECM" SG_ 271 TLC_LRN_Rq 0;
BA_ "GenSigTimeoutTime_EVCU2" SG_ 271 TLC_LRN_Rq 0;
BA_ "GenSigTimeoutTime_GNMM" SG_ 271 TLC_LRN_Rq 0;
BA_ "GenSigTimeoutTime_IPC" SG_ 271 TLC_LRN_Rq 0;
BA_ "GenSigTimeoutTime_RFHM" SG_ 271 TLC_LRN_Rq 0;
BA_ "GenSigTimeoutTime_SGW" SG_ 271 TLC_LRN_Rq 0;
BA_ "GenSigTimeoutTime_TCM" SG_ 271 TLC_LRN_Rq 0;
BA_ "GenSigTimeoutTime_AGSM" SG_ 1035 AGSposn 0;
BA_ "GenSigTimeoutTime_BCM" SG_ 1035 AGSposn 0;
BA_ "GenSigTimeoutTime_BSM" SG_ 1035 AGSposn 0;
BA_ "GenSigTimeoutTime_CADM" SG_ 1035 AGSposn 0;
BA_ "GenSigTimeoutTime_DMSM" SG_ 1035 AGSposn 0;
BA_ "GenSigTimeoutTime_DTCM" SG_ 1035 AGSposn 0;
BA_ "GenSigTimeoutTime_ECM" SG_ 1035 AGSposn 0;
BA_ "GenSigTimeoutTime_EVCU2" SG_ 1035 AGSposn 0;
BA_ "GenSigTimeoutTime_GNMM" SG_ 1035 AGSposn 0;
BA_ "GenSigTimeoutTime_IPC" SG_ 1035 AGSposn 0;
BA_ "GenSigTimeoutTime_RFHM" SG_ 1035 AGSposn 0;
BA_ "GenSigTimeoutTime_SGW" SG_ 1035 AGSposn 0;
BA_ "GenSigTimeoutTime_TCM" SG_ 1035 AGSposn 0;
BA_ "GenSigTimeoutTime_AGSM" SG_ 1035 CRC_ENGINE_HYBD_FD_3 0;
BA_ "GenSigTimeoutTime_BCM" SG_ 1035 CRC_ENGINE_HYBD_FD_3 0;
BA_ "GenSigTimeoutTime_CADM" SG_ 1035 CRC_ENGINE_HYBD_FD_3 0;
BA_ "GenSigTimeoutTime_DMSM" SG_ 1035 CRC_ENGINE_HYBD_FD_3 0;
BA_ "GenSigTimeoutTime_DTCM" SG_ 1035 CRC_ENGINE_HYBD_FD_3 0;
BA_ "GenSigTimeoutTime_ECM" SG_ 1035 CRC_ENGINE_HYBD_FD_3 0;
BA_ "GenSigTimeoutTime_GNMM" SG_ 1035 CRC_ENGINE_HYBD_FD_3 0;
BA_ "GenSigTimeoutTime_IPC" SG_ 1035 CRC_ENGINE_HYBD_FD_3 0;
BA_ "GenSigTimeoutTime_RFHM" SG_ 1035 CRC_ENGINE_HYBD_FD_3 0;
BA_ "GenSigTimeoutTime_SGW" SG_ 1035 CRC_ENGINE_HYBD_FD_3 0;
BA_ "GenSigTimeoutTime_TCM" SG_ 1035 CRC_ENGINE_HYBD_FD_3 0;
BA_ "GenSigTimeoutTime_AGSM" SG_ 1035 ECM_AirflowRequest 0;
BA_ "GenSigTimeoutTime_BCM" SG_ 1035 ECM_AirflowRequest 0;
BA_ "GenSigTimeoutTime_BSM" SG_ 1035 ECM_AirflowRequest 0;
BA_ "GenSigTimeoutTime_CADM" SG_ 1035 ECM_AirflowRequest 0;
BA_ "GenSigTimeoutTime_DMSM" SG_ 1035 ECM_AirflowRequest 0;
BA_ "GenSigTimeoutTime_DTCM" SG_ 1035 ECM_AirflowRequest 0;
BA_ "GenSigTimeoutTime_ECM" SG_ 1035 ECM_AirflowRequest 0;
BA_ "GenSigTimeoutTime_GNMM" SG_ 1035 ECM_AirflowRequest 0;
BA_ "GenSigTimeoutTime_HCP" SG_ 1035 ECM_AirflowRequest 0;
BA_ "GenSigTimeoutTime_IPC" SG_ 1035 ECM_AirflowRequest 0;
BA_ "GenSigTimeoutTime_RFHM" SG_ 1035 ECM_AirflowRequest 0;
BA_ "GenSigTimeoutTime_SGW" SG_ 1035 ECM_AirflowRequest 0;
BA_ "GenSigTimeoutTime_TCM" SG_ 1035 ECM_AirflowRequest 0;
BA_ "GenSigTimeoutTime_AGSM" SG_ 1035 ECM_WorkSite_Invtr_Sts 0;
BA_ "GenSigTimeoutTime_BCM" SG_ 1035 ECM_WorkSite_Invtr_Sts 0;
BA_ "GenSigTimeoutTime_BSM" SG_ 1035 ECM_WorkSite_Invtr_Sts 0;
BA_ "GenSigTimeoutTime_CADM" SG_ 1035 ECM_WorkSite_Invtr_Sts 0;
BA_ "GenSigTimeoutTime_DMSM" SG_ 1035 ECM_WorkSite_Invtr_Sts 0;
BA_ "GenSigTimeoutTime_DTCM" SG_ 1035 ECM_WorkSite_Invtr_Sts 0;
BA_ "GenSigTimeoutTime_ECM" SG_ 1035 ECM_WorkSite_Invtr_Sts 0;
BA_ "GenSigTimeoutTime_EVCU2" SG_ 1035 ECM_WorkSite_Invtr_Sts 0;
BA_ "GenSigTimeoutTime_GNMM" SG_ 1035 ECM_WorkSite_Invtr_Sts 0;
BA_ "GenSigTimeoutTime_IPC" SG_ 1035 ECM_WorkSite_Invtr_Sts 0;
BA_ "GenSigTimeoutTime_RFHM" SG_ 1035 ECM_WorkSite_Invtr_Sts 0;
BA_ "GenSigTimeoutTime_SGW" SG_ 1035 ECM_WorkSite_Invtr_Sts 0;
BA_ "GenSigTimeoutTime_TCM" SG_ 1035 ECM_WorkSite_Invtr_Sts 0;
BA_ "GenSigStartValue" SG_ 1035 EngCltTmp 255;
BA_ "GenSigTimeoutTime_AGSM" SG_ 1035 EngCltTmp 0;
BA_ "GenSigTimeoutTime_BCM" SG_ 1035 EngCltTmp 0;
BA_ "GenSigTimeoutTime_BSM" SG_ 1035 EngCltTmp 0;
BA_ "GenSigTimeoutTime_CADM" SG_ 1035 EngCltTmp 0;
BA_ "GenSigTimeoutTime_DMSM" SG_ 1035 EngCltTmp 0;
BA_ "GenSigTimeoutTime_DTCM" SG_ 1035 EngCltTmp 0;
BA_ "GenSigTimeoutTime_ECM" SG_ 1035 EngCltTmp 0;
BA_ "GenSigTimeoutTime_GNMM" SG_ 1035 EngCltTmp 0;
BA_ "GenSigTimeoutTime_IPC" SG_ 1035 EngCltTmp 0;
BA_ "GenSigTimeoutTime_RFHM" SG_ 1035 EngCltTmp 0;
BA_ "GenSigTimeoutTime_SGW" SG_ 1035 EngCltTmp 0;
BA_ "GenSigTimeoutTime_TCM" SG_ 1035 EngCltTmp 0;
BA_ "GenSigTimeoutTime_AGSM" SG_ 1035 EngCltTmpV 0;
BA_ "GenSigTimeoutTime_BCM" SG_ 1035 EngCltTmpV 0;
BA_ "GenSigTimeoutTime_BSM" SG_ 1035 EngCltTmpV 0;
BA_ "GenSigTimeoutTime_CADM" SG_ 1035 EngCltTmpV 0;
BA_ "GenSigTimeoutTime_DMSM" SG_ 1035 EngCltTmpV 0;
BA_ "GenSigTimeoutTime_DTCM" SG_ 1035 EngCltTmpV 0;
BA_ "GenSigTimeoutTime_ECM" SG_ 1035 EngCltTmpV 0;
BA_ "GenSigTimeoutTime_GNMM" SG_ 1035 EngCltTmpV 0;
BA_ "GenSigTimeoutTime_IPC" SG_ 1035 EngCltTmpV 0;
BA_ "GenSigTimeoutTime_RFHM" SG_ 1035 EngCltTmpV 0;
BA_ "GenSigTimeoutTime_SGW" SG_ 1035 EngCltTmpV 0;
BA_ "GenSigTimeoutTime_TCM" SG_ 1035 EngCltTmpV 0;
BA_ "GenSigTimeoutTime_AGSM" SG_ 1035 EngHalfCylSpdMaxLim 0;
BA_ "GenSigTimeoutTime_BCM" SG_ 1035 EngHalfCylSpdMaxLim 0;
BA_ "GenSigTimeoutTime_BSM" SG_ 1035 EngHalfCylSpdMaxLim 0;
BA_ "GenSigTimeoutTime_CADM" SG_ 1035 EngHalfCylSpdMaxLim 0;
BA_ "GenSigTimeoutTime_DMSM" SG_ 1035 EngHalfCylSpdMaxLim 0;
BA_ "GenSigTimeoutTime_DTCM" SG_ 1035 EngHalfCylSpdMaxLim 0;
BA_ "GenSigTimeoutTime_ECM" SG_ 1035 EngHalfCylSpdMaxLim 0;
BA_ "GenSigTimeoutTime_EVCU2" SG_ 1035 EngHalfCylSpdMaxLim 0;
BA_ "GenSigTimeoutTime_GNMM" SG_ 1035 EngHalfCylSpdMaxLim 0;
BA_ "GenSigTimeoutTime_IPC" SG_ 1035 EngHalfCylSpdMaxLim 0;
BA_ "GenSigTimeoutTime_RFHM" SG_ 1035 EngHalfCylSpdMaxLim 0;
BA_ "GenSigTimeoutTime_SGW" SG_ 1035 EngHalfCylSpdMaxLim 0;
BA_ "GenSigTimeoutTime_TCM" SG_ 1035 EngHalfCylSpdMaxLim 0;
BA_ "GenSigTimeoutTime_AGSM" SG_ 1035 EngHalfCylSpdMinLim 0;
BA_ "GenSigTimeoutTime_BCM" SG_ 1035 EngHalfCylSpdMinLim 0;
BA_ "GenSigTimeoutTime_BSM" SG_ 1035 EngHalfCylSpdMinLim 0;
BA_ "GenSigTimeoutTime_CADM" SG_ 1035 EngHalfCylSpdMinLim 0;
BA_ "GenSigTimeoutTime_DMSM" SG_ 1035 EngHalfCylSpdMinLim 0;
BA_ "GenSigTimeoutTime_DTCM" SG_ 1035 EngHalfCylSpdMinLim 0;
BA_ "GenSigTimeoutTime_ECM" SG_ 1035 EngHalfCylSpdMinLim 0;
BA_ "GenSigTimeoutTime_EVCU2" SG_ 1035 EngHalfCylSpdMinLim 0;
BA_ "GenSigTimeoutTime_GNMM" SG_ 1035 EngHalfCylSpdMinLim 0;
BA_ "GenSigTimeoutTime_IPC" SG_ 1035 EngHalfCylSpdMinLim 0;
BA_ "GenSigTimeoutTime_RFHM" SG_ 1035 EngHalfCylSpdMinLim 0;
BA_ "GenSigTimeoutTime_SGW" SG_ 1035 EngHalfCylSpdMinLim 0;
BA_ "GenSigTimeoutTime_TCM" SG_ 1035 EngHalfCylSpdMinLim 0;
BA_ "GenSigTimeoutTime_AGSM" SG_ 1035 EngOutofFuel 0;
BA_ "GenSigTimeoutTime_BCM" SG_ 1035 EngOutofFuel 0;
BA_ "GenSigTimeoutTime_BSM" SG_ 1035 EngOutofFuel 0;
BA_ "GenSigTimeoutTime_CADM" SG_ 1035 EngOutofFuel 0;
BA_ "GenSigTimeoutTime_DMSM" SG_ 1035 EngOutofFuel 0;
BA_ "GenSigTimeoutTime_DTCM" SG_ 1035 EngOutofFuel 0;
BA_ "GenSigTimeoutTime_ECM" SG_ 1035 EngOutofFuel 0;
BA_ "GenSigTimeoutTime_GNMM" SG_ 1035 EngOutofFuel 0;
BA_ "GenSigTimeoutTime_IPC" SG_ 1035 EngOutofFuel 0;
BA_ "GenSigTimeoutTime_RFHM" SG_ 1035 EngOutofFuel 0;
BA_ "GenSigTimeoutTime_SGW" SG_ 1035 EngOutofFuel 0;
BA_ "GenSigTimeoutTime_TCM" SG_ 1035 EngOutofFuel 0;
BA_ "GenSigTimeoutTime_AGSM" SG_ 1035 EngSpd 0;
BA_ "GenSigTimeoutTime_BCM" SG_ 1035 EngSpd 0;
BA_ "GenSigTimeoutTime_BSM" SG_ 1035 EngSpd 0;
BA_ "GenSigTimeoutTime_CADM" SG_ 1035 EngSpd 0;
BA_ "GenSigTimeoutTime_DMSM" SG_ 1035 EngSpd 0;
BA_ "GenSigTimeoutTime_DTCM" SG_ 1035 EngSpd 0;
BA_ "GenSigTimeoutTime_ECM" SG_ 1035 EngSpd 0;
BA_ "GenSigTimeoutTime_EVCU2" SG_ 1035 EngSpd 0;
BA_ "GenSigTimeoutTime_GNMM" SG_ 1035 EngSpd 0;
BA_ "GenSigTimeoutTime_IPC" SG_ 1035 EngSpd 0;
BA_ "GenSigTimeoutTime_RFHM" SG_ 1035 EngSpd 0;
BA_ "GenSigTimeoutTime_SGW" SG_ 1035 EngSpd 0;
BA_ "GenSigTimeoutTime_TCM" SG_ 1035 EngSpd 0;
BA_ "GenSigTimeoutTime_AGSM" SG_ 1035 EngSpdStat 0;
BA_ "GenSigTimeoutTime_BCM" SG_ 1035 EngSpdStat 0;
BA_ "GenSigTimeoutTime_BSM" SG_ 1035 EngSpdStat 0;
BA_ "GenSigTimeoutTime_CADM" SG_ 1035 EngSpdStat 0;
BA_ "GenSigTimeoutTime_DMSM" SG_ 1035 EngSpdStat 0;
BA_ "GenSigTimeoutTime_DTCM" SG_ 1035 EngSpdStat 0;
BA_ "GenSigTimeoutTime_ECM" SG_ 1035 EngSpdStat 0;
BA_ "GenSigTimeoutTime_EVCU2" SG_ 1035 EngSpdStat 0;
BA_ "GenSigTimeoutTime_GNMM" SG_ 1035 EngSpdStat 0;
BA_ "GenSigTimeoutTime_IPC" SG_ 1035 EngSpdStat 0;
BA_ "GenSigTimeoutTime_RFHM" SG_ 1035 EngSpdStat 0;
BA_ "GenSigTimeoutTime_SGW" SG_ 1035 EngSpdStat 0;
BA_ "GenSigTimeoutTime_TCM" SG_ 1035 EngSpdStat 0;
BA_ "GenSigTimeoutTime_AGSM" SG_ 1035 LTR_PumpSpeedAct 0;
BA_ "GenSigTimeoutTime_BCM" SG_ 1035 LTR_PumpSpeedAct 0;
BA_ "GenSigTimeoutTime_BSM" SG_ 1035 LTR_PumpSpeedAct 0;
BA_ "GenSigTimeoutTime_CADM" SG_ 1035 LTR_PumpSpeedAct 0;
BA_ "GenSigTimeoutTime_DMSM" SG_ 1035 LTR_PumpSpeedAct 0;
BA_ "GenSigTimeoutTime_DTCM" SG_ 1035 LTR_PumpSpeedAct 0;
BA_ "GenSigTimeoutTime_ECM" SG_ 1035 LTR_PumpSpeedAct 0;
BA_ "GenSigTimeoutTime_EVCU2" SG_ 1035 LTR_PumpSpeedAct 0;
BA_ "GenSigTimeoutTime_GNMM" SG_ 1035 LTR_PumpSpeedAct 0;
BA_ "GenSigTimeoutTime_IPC" SG_ 1035 LTR_PumpSpeedAct 0;
BA_ "GenSigTimeoutTime_RFHM" SG_ 1035 LTR_PumpSpeedAct 0;
BA_ "GenSigTimeoutTime_TCM" SG_ 1035 LTR_PumpSpeedAct 0;
BA_ "GenSigTimeoutTime_AGSM" SG_ 1035 MaxEngSpdCap 0;
BA_ "GenSigTimeoutTime_BCM" SG_ 1035 MaxEngSpdCap 0;
BA_ "GenSigTimeoutTime_BSM" SG_ 1035 MaxEngSpdCap 0;
BA_ "GenSigTimeoutTime_CADM" SG_ 1035 MaxEngSpdCap 0;
BA_ "GenSigTimeoutTime_DMSM" SG_ 1035 MaxEngSpdCap 0;
BA_ "GenSigTimeoutTime_DTCM" SG_ 1035 MaxEngSpdCap 0;
BA_ "GenSigTimeoutTime_ECM" SG_ 1035 MaxEngSpdCap 0;
BA_ "GenSigTimeoutTime_EVCU2" SG_ 1035 MaxEngSpdCap 0;
BA_ "GenSigTimeoutTime_GNMM" SG_ 1035 MaxEngSpdCap 0;
BA_ "GenSigTimeoutTime_IPC" SG_ 1035 MaxEngSpdCap 0;
BA_ "GenSigTimeoutTime_RFHM" SG_ 1035 MaxEngSpdCap 0;
BA_ "GenSigTimeoutTime_SGW" SG_ 1035 MaxEngSpdCap 0;
BA_ "GenSigTimeoutTime_TCM" SG_ 1035 MaxEngSpdCap 0;
BA_ "GenSigTimeoutTime_AGSM" SG_ 1035 MessageCounter_ENGINE_HYBD_FD_3 0;
BA_ "GenSigTimeoutTime_BCM" SG_ 1035 MessageCounter_ENGINE_HYBD_FD_3 0;
BA_ "GenSigTimeoutTime_CADM" SG_ 1035 MessageCounter_ENGINE_HYBD_FD_3 0;
BA_ "GenSigTimeoutTime_DMSM" SG_ 1035 MessageCounter_ENGINE_HYBD_FD_3 0;
BA_ "GenSigTimeoutTime_DTCM" SG_ 1035 MessageCounter_ENGINE_HYBD_FD_3 0;
BA_ "GenSigTimeoutTime_ECM" SG_ 1035 MessageCounter_ENGINE_HYBD_FD_3 0;
BA_ "GenSigTimeoutTime_GNMM" SG_ 1035 MessageCounter_ENGINE_HYBD_FD_3 0;
BA_ "GenSigTimeoutTime_IPC" SG_ 1035 MessageCounter_ENGINE_HYBD_FD_3 0;
BA_ "GenSigTimeoutTime_RFHM" SG_ 1035 MessageCounter_ENGINE_HYBD_FD_3 0;
BA_ "GenSigTimeoutTime_SGW" SG_ 1035 MessageCounter_ENGINE_HYBD_FD_3 0;
BA_ "GenSigTimeoutTime_TCM" SG_ 1035 MessageCounter_ENGINE_HYBD_FD_3 0;
BA_ "GenSigTimeoutTime_AGSM" SG_ 1035 MinEngSpdCap 0;
BA_ "GenSigTimeoutTime_BCM" SG_ 1035 MinEngSpdCap 0;
BA_ "GenSigTimeoutTime_BSM" SG_ 1035 MinEngSpdCap 0;
BA_ "GenSigTimeoutTime_CADM" SG_ 1035 MinEngSpdCap 0;
BA_ "GenSigTimeoutTime_DMSM" SG_ 1035 MinEngSpdCap 0;
BA_ "GenSigTimeoutTime_DTCM" SG_ 1035 MinEngSpdCap 0;
BA_ "GenSigTimeoutTime_ECM" SG_ 1035 MinEngSpdCap 0;
BA_ "GenSigTimeoutTime_EVCU2" SG_ 1035 MinEngSpdCap 0;
BA_ "GenSigTimeoutTime_GNMM" SG_ 1035 MinEngSpdCap 0;
BA_ "GenSigTimeoutTime_IPC" SG_ 1035 MinEngSpdCap 0;
BA_ "GenSigTimeoutTime_RFHM" SG_ 1035 MinEngSpdCap 0;
BA_ "GenSigTimeoutTime_SGW" SG_ 1035 MinEngSpdCap 0;
BA_ "GenSigTimeoutTime_TCM" SG_ 1035 MinEngSpdCap 0;
BA_ "GenSigTimeoutTime_AGSM" SG_ 1035 RadFanReq 0;
BA_ "GenSigTimeoutTime_BCM" SG_ 1035 RadFanReq 0;
BA_ "GenSigTimeoutTime_BSM" SG_ 1035 RadFanReq 0;
BA_ "GenSigTimeoutTime_CADM" SG_ 1035 RadFanReq 0;
BA_ "GenSigTimeoutTime_DMSM" SG_ 1035 RadFanReq 0;
BA_ "GenSigTimeoutTime_DTCM" SG_ 1035 RadFanReq 0;
BA_ "GenSigTimeoutTime_ECM" SG_ 1035 RadFanReq 0;
BA_ "GenSigTimeoutTime_EVCU2" SG_ 1035 RadFanReq 0;
BA_ "GenSigTimeoutTime_GNMM" SG_ 1035 RadFanReq 0;
BA_ "GenSigTimeoutTime_IPC" SG_ 1035 RadFanReq 0;
BA_ "GenSigTimeoutTime_RFHM" SG_ 1035 RadFanReq 0;
BA_ "GenSigTimeoutTime_SGW" SG_ 1035 RadFanReq 0;
BA_ "GenSigTimeoutTime_TCM" SG_ 1035 RadFanReq 0;
BA_ "GenSigTimeoutTime_AGSM" SG_ 1035 ServiceHybSys 0;
BA_ "GenSigTimeoutTime_BCM" SG_ 1035 ServiceHybSys 0;
BA_ "GenSigTimeoutTime_BSM" SG_ 1035 ServiceHybSys 0;
BA_ "GenSigTimeoutTime_CADM" SG_ 1035 ServiceHybSys 0;
BA_ "GenSigTimeoutTime_DMSM" SG_ 1035 ServiceHybSys 0;
BA_ "GenSigTimeoutTime_DTCM" SG_ 1035 ServiceHybSys 0;
BA_ "GenSigTimeoutTime_ECM" SG_ 1035 ServiceHybSys 0;
BA_ "GenSigTimeoutTime_EVCU2" SG_ 1035 ServiceHybSys 0;
BA_ "GenSigTimeoutTime_GNMM" SG_ 1035 ServiceHybSys 0;
BA_ "GenSigTimeoutTime_IPC" SG_ 1035 ServiceHybSys 0;
BA_ "GenSigTimeoutTime_RFHM" SG_ 1035 ServiceHybSys 0;
BA_ "GenSigTimeoutTime_SGW" SG_ 1035 ServiceHybSys 0;
BA_ "GenSigTimeoutTime_TCM" SG_ 1035 ServiceHybSys 0;
BA_ "GenSigTimeoutTime_AGSM" SG_ 1328 CatHtgStateActive 0;
BA_ "GenSigTimeoutTime_BCM" SG_ 1328 CatHtgStateActive 0;
BA_ "GenSigTimeoutTime_BSM" SG_ 1328 CatHtgStateActive 0;
BA_ "GenSigTimeoutTime_CADM" SG_ 1328 CatHtgStateActive 0;
BA_ "GenSigTimeoutTime_DMSM" SG_ 1328 CatHtgStateActive 0;
BA_ "GenSigTimeoutTime_DTCM" SG_ 1328 CatHtgStateActive 0;
BA_ "GenSigTimeoutTime_ECM" SG_ 1328 CatHtgStateActive 0;
BA_ "GenSigTimeoutTime_EVCU2" SG_ 1328 CatHtgStateActive 0;
BA_ "GenSigTimeoutTime_GNMM" SG_ 1328 CatHtgStateActive 0;
BA_ "GenSigTimeoutTime_IPC" SG_ 1328 CatHtgStateActive 0;
BA_ "GenSigTimeoutTime_RFHM" SG_ 1328 CatHtgStateActive 0;
BA_ "GenSigTimeoutTime_SGW" SG_ 1328 CatHtgStateActive 0;
BA_ "GenSigTimeoutTime_TCM" SG_ 1328 CatHtgStateActive 0;
BA_ "GenSigTimeoutTime_AGSM" SG_ 1328 CRC_ENGINE_HYBD_FD_4 0;
BA_ "GenSigTimeoutTime_BCM" SG_ 1328 CRC_ENGINE_HYBD_FD_4 0;
BA_ "GenSigTimeoutTime_BSM" SG_ 1328 CRC_ENGINE_HYBD_FD_4 0;
BA_ "GenSigTimeoutTime_CADM" SG_ 1328 CRC_ENGINE_HYBD_FD_4 0;
BA_ "GenSigTimeoutTime_DMSM" SG_ 1328 CRC_ENGINE_HYBD_FD_4 0;
BA_ "GenSigTimeoutTime_DTCM" SG_ 1328 CRC_ENGINE_HYBD_FD_4 0;
BA_ "GenSigTimeoutTime_ECM" SG_ 1328 CRC_ENGINE_HYBD_FD_4 0;
BA_ "GenSigTimeoutTime_EVCU2" SG_ 1328 CRC_ENGINE_HYBD_FD_4 0;
BA_ "GenSigTimeoutTime_GNMM" SG_ 1328 CRC_ENGINE_HYBD_FD_4 0;
BA_ "GenSigTimeoutTime_IPC" SG_ 1328 CRC_ENGINE_HYBD_FD_4 0;
BA_ "GenSigTimeoutTime_RFHM" SG_ 1328 CRC_ENGINE_HYBD_FD_4 0;
BA_ "GenSigTimeoutTime_SGW" SG_ 1328 CRC_ENGINE_HYBD_FD_4 0;
BA_ "GenSigTimeoutTime_TCM" SG_ 1328 CRC_ENGINE_HYBD_FD_4 0;
BA_ "GenSigTimeoutTime_AGSM" SG_ 1328 EngTorqACCCapability 0;
BA_ "GenSigTimeoutTime_BCM" SG_ 1328 EngTorqACCCapability 0;
BA_ "GenSigTimeoutTime_BSM" SG_ 1328 EngTorqACCCapability 0;
BA_ "GenSigTimeoutTime_CADM" SG_ 1328 EngTorqACCCapability 0;
BA_ "GenSigTimeoutTime_DMSM" SG_ 1328 EngTorqACCCapability 0;
BA_ "GenSigTimeoutTime_DTCM" SG_ 1328 EngTorqACCCapability 0;
BA_ "GenSigTimeoutTime_ECM" SG_ 1328 EngTorqACCCapability 0;
BA_ "GenSigTimeoutTime_EVCU2" SG_ 1328 EngTorqACCCapability 0;
BA_ "GenSigTimeoutTime_GNMM" SG_ 1328 EngTorqACCCapability 0;
BA_ "GenSigTimeoutTime_IPC" SG_ 1328 EngTorqACCCapability 0;
BA_ "GenSigTimeoutTime_RFHM" SG_ 1328 EngTorqACCCapability 0;
BA_ "GenSigTimeoutTime_SGW" SG_ 1328 EngTorqACCCapability 0;
BA_ "GenSigTimeoutTime_TCM" SG_ 1328 EngTorqACCCapability 0;
BA_ "GenSigTimeoutTime_AGSM" SG_ 1328 EngTorqCapbltyEngOpMd 0;
BA_ "GenSigTimeoutTime_BCM" SG_ 1328 EngTorqCapbltyEngOpMd 0;
BA_ "GenSigTimeoutTime_BSM" SG_ 1328 EngTorqCapbltyEngOpMd 0;
BA_ "GenSigTimeoutTime_CADM" SG_ 1328 EngTorqCapbltyEngOpMd 0;
BA_ "GenSigTimeoutTime_DMSM" SG_ 1328 EngTorqCapbltyEngOpMd 0;
BA_ "GenSigTimeoutTime_DTCM" SG_ 1328 EngTorqCapbltyEngOpMd 0;
BA_ "GenSigTimeoutTime_ECM" SG_ 1328 EngTorqCapbltyEngOpMd 0;
BA_ "GenSigTimeoutTime_EVCU2" SG_ 1328 EngTorqCapbltyEngOpMd 0;
BA_ "GenSigTimeoutTime_GNMM" SG_ 1328 EngTorqCapbltyEngOpMd 0;
BA_ "GenSigTimeoutTime_IPC" SG_ 1328 EngTorqCapbltyEngOpMd 0;
BA_ "GenSigTimeoutTime_RFHM" SG_ 1328 EngTorqCapbltyEngOpMd 0;
BA_ "GenSigTimeoutTime_SGW" SG_ 1328 EngTorqCapbltyEngOpMd 0;
BA_ "GenSigTimeoutTime_TCM" SG_ 1328 EngTorqCapbltyEngOpMd 0;
BA_ "GenSigTimeoutTime_AGSM" SG_ 1328 EngTorqCapbltyFrmCntr 0;
BA_ "GenSigTimeoutTime_BCM" SG_ 1328 EngTorqCapbltyFrmCntr 0;
BA_ "GenSigTimeoutTime_BSM" SG_ 1328 EngTorqCapbltyFrmCntr 0;
BA_ "GenSigTimeoutTime_CADM" SG_ 1328 EngTorqCapbltyFrmCntr 0;
BA_ "GenSigTimeoutTime_DMSM" SG_ 1328 EngTorqCapbltyFrmCntr 0;
BA_ "GenSigTimeoutTime_DTCM" SG_ 1328 EngTorqCapbltyFrmCntr 0;
BA_ "GenSigTimeoutTime_ECM" SG_ 1328 EngTorqCapbltyFrmCntr 0;
BA_ "GenSigTimeoutTime_EVCU2" SG_ 1328 EngTorqCapbltyFrmCntr 0;
BA_ "GenSigTimeoutTime_GNMM" SG_ 1328 EngTorqCapbltyFrmCntr 0;
BA_ "GenSigTimeoutTime_IPC" SG_ 1328 EngTorqCapbltyFrmCntr 0;
BA_ "GenSigTimeoutTime_RFHM" SG_ 1328 EngTorqCapbltyFrmCntr 0;
BA_ "GenSigTimeoutTime_SGW" SG_ 1328 EngTorqCapbltyFrmCntr 0;
BA_ "GenSigTimeoutTime_TCM" SG_ 1328 EngTorqCapbltyFrmCntr 0;
BA_ "GenSigTimeoutTime_AGSM" SG_ 1328 EngTorqCapbltyMaxOffTorq 0;
BA_ "GenSigTimeoutTime_BCM" SG_ 1328 EngTorqCapbltyMaxOffTorq 0;
BA_ "GenSigTimeoutTime_BSM" SG_ 1328 EngTorqCapbltyMaxOffTorq 0;
BA_ "GenSigTimeoutTime_CADM" SG_ 1328 EngTorqCapbltyMaxOffTorq 0;
BA_ "GenSigTimeoutTime_DMSM" SG_ 1328 EngTorqCapbltyMaxOffTorq 0;
BA_ "GenSigTimeoutTime_DTCM" SG_ 1328 EngTorqCapbltyMaxOffTorq 0;
BA_ "GenSigTimeoutTime_ECM" SG_ 1328 EngTorqCapbltyMaxOffTorq 0;
BA_ "GenSigTimeoutTime_EVCU2" SG_ 1328 EngTorqCapbltyMaxOffTorq 0;
BA_ "GenSigTimeoutTime_GNMM" SG_ 1328 EngTorqCapbltyMaxOffTorq 0;
BA_ "GenSigTimeoutTime_IPC" SG_ 1328 EngTorqCapbltyMaxOffTorq 0;
BA_ "GenSigTimeoutTime_RFHM" SG_ 1328 EngTorqCapbltyMaxOffTorq 0;
BA_ "GenSigTimeoutTime_SGW" SG_ 1328 EngTorqCapbltyMaxOffTorq 0;
BA_ "GenSigTimeoutTime_TCM" SG_ 1328 EngTorqCapbltyMaxOffTorq 0;
BA_ "GenSigStartValue" SG_ 1328 EngTorqCapbltyMaxTorq 938;
BA_ "GenSigTimeoutTime_AGSM" SG_ 1328 EngTorqCapbltyMaxTorq 0;
BA_ "GenSigTimeoutTime_BCM" SG_ 1328 EngTorqCapbltyMaxTorq 0;
BA_ "GenSigTimeoutTime_BSM" SG_ 1328 EngTorqCapbltyMaxTorq 0;
BA_ "GenSigTimeoutTime_CADM" SG_ 1328 EngTorqCapbltyMaxTorq 0;
BA_ "GenSigTimeoutTime_DMSM" SG_ 1328 EngTorqCapbltyMaxTorq 0;
BA_ "GenSigTimeoutTime_DTCM" SG_ 1328 EngTorqCapbltyMaxTorq 0;
BA_ "GenSigTimeoutTime_ECM" SG_ 1328 EngTorqCapbltyMaxTorq 0;
BA_ "GenSigTimeoutTime_EVCU2" SG_ 1328 EngTorqCapbltyMaxTorq 0;
BA_ "GenSigTimeoutTime_GNMM" SG_ 1328 EngTorqCapbltyMaxTorq 0;
BA_ "GenSigTimeoutTime_IPC" SG_ 1328 EngTorqCapbltyMaxTorq 0;
BA_ "GenSigTimeoutTime_RFHM" SG_ 1328 EngTorqCapbltyMaxTorq 0;
BA_ "GenSigTimeoutTime_SGW" SG_ 1328 EngTorqCapbltyMaxTorq 0;
BA_ "GenSigTimeoutTime_TCM" SG_ 1328 EngTorqCapbltyMaxTorq 0;
BA_ "GenSigStartValue" SG_ 1328 EngTorqCapbltyMinRunTorq 938;
BA_ "GenSigTimeoutTime_AGSM" SG_ 1328 EngTorqCapbltyMinRunTorq 0;
BA_ "GenSigTimeoutTime_BCM" SG_ 1328 EngTorqCapbltyMinRunTorq 0;
BA_ "GenSigTimeoutTime_BSM" SG_ 1328 EngTorqCapbltyMinRunTorq 0;
BA_ "GenSigTimeoutTime_CADM" SG_ 1328 EngTorqCapbltyMinRunTorq 0;
BA_ "GenSigTimeoutTime_DMSM" SG_ 1328 EngTorqCapbltyMinRunTorq 0;
BA_ "GenSigTimeoutTime_DTCM" SG_ 1328 EngTorqCapbltyMinRunTorq 0;
BA_ "GenSigTimeoutTime_ECM" SG_ 1328 EngTorqCapbltyMinRunTorq 0;
BA_ "GenSigTimeoutTime_EVCU2" SG_ 1328 EngTorqCapbltyMinRunTorq 0;
BA_ "GenSigTimeoutTime_GNMM" SG_ 1328 EngTorqCapbltyMinRunTorq 0;
BA_ "GenSigTimeoutTime_IPC" SG_ 1328 EngTorqCapbltyMinRunTorq 0;
BA_ "GenSigTimeoutTime_RFHM" SG_ 1328 EngTorqCapbltyMinRunTorq 0;
BA_ "GenSigTimeoutTime_SGW" SG_ 1328 EngTorqCapbltyMinRunTorq 0;
BA_ "GenSigTimeoutTime_TCM" SG_ 1328 EngTorqCapbltyMinRunTorq 0;
BA_ "GenSigStartValue" SG_ 1328 EngTorqCapbltyMinTorq 938;
BA_ "GenSigTimeoutTime_AGSM" SG_ 1328 EngTorqCapbltyMinTorq 0;
BA_ "GenSigTimeoutTime_BCM" SG_ 1328 EngTorqCapbltyMinTorq 0;
BA_ "GenSigTimeoutTime_BSM" SG_ 1328 EngTorqCapbltyMinTorq 0;
BA_ "GenSigTimeoutTime_CADM" SG_ 1328 EngTorqCapbltyMinTorq 0;
BA_ "GenSigTimeoutTime_DMSM" SG_ 1328 EngTorqCapbltyMinTorq 0;
BA_ "GenSigTimeoutTime_DTCM" SG_ 1328 EngTorqCapbltyMinTorq 0;
BA_ "GenSigTimeoutTime_ECM" SG_ 1328 EngTorqCapbltyMinTorq 0;
BA_ "GenSigTimeoutTime_EVCU2" SG_ 1328 EngTorqCapbltyMinTorq 0;
BA_ "GenSigTimeoutTime_GNMM" SG_ 1328 EngTorqCapbltyMinTorq 0;
BA_ "GenSigTimeoutTime_IPC" SG_ 1328 EngTorqCapbltyMinTorq 0;
BA_ "GenSigTimeoutTime_RFHM" SG_ 1328 EngTorqCapbltyMinTorq 0;
BA_ "GenSigTimeoutTime_SGW" SG_ 1328 EngTorqCapbltyMinTorq 0;
BA_ "GenSigTimeoutTime_TCM" SG_ 1328 EngTorqCapbltyMinTorq 0;
BA_ "GenSigTimeoutTime_AGSM" SG_ 1328 EngTorqCapbltyRefEngSpd 0;
BA_ "GenSigTimeoutTime_BCM" SG_ 1328 EngTorqCapbltyRefEngSpd 0;
BA_ "GenSigTimeoutTime_BSM" SG_ 1328 EngTorqCapbltyRefEngSpd 0;
BA_ "GenSigTimeoutTime_CADM" SG_ 1328 EngTorqCapbltyRefEngSpd 0;
BA_ "GenSigTimeoutTime_DMSM" SG_ 1328 EngTorqCapbltyRefEngSpd 0;
BA_ "GenSigTimeoutTime_DTCM" SG_ 1328 EngTorqCapbltyRefEngSpd 0;
BA_ "GenSigTimeoutTime_ECM" SG_ 1328 EngTorqCapbltyRefEngSpd 0;
BA_ "GenSigTimeoutTime_EVCU2" SG_ 1328 EngTorqCapbltyRefEngSpd 0;
BA_ "GenSigTimeoutTime_GNMM" SG_ 1328 EngTorqCapbltyRefEngSpd 0;
BA_ "GenSigTimeoutTime_IPC" SG_ 1328 EngTorqCapbltyRefEngSpd 0;
BA_ "GenSigTimeoutTime_RFHM" SG_ 1328 EngTorqCapbltyRefEngSpd 0;
BA_ "GenSigTimeoutTime_SGW" SG_ 1328 EngTorqCapbltyRefEngSpd 0;
BA_ "GenSigTimeoutTime_TCM" SG_ 1328 EngTorqCapbltyRefEngSpd 0;
BA_ "GenSigTimeoutTime_AGSM" SG_ 1328 MessageCounter_ENGINE_HYBD_FD_4 0;
BA_ "GenSigTimeoutTime_BCM" SG_ 1328 MessageCounter_ENGINE_HYBD_FD_4 0;
BA_ "GenSigTimeoutTime_BSM" SG_ 1328 MessageCounter_ENGINE_HYBD_FD_4 0;
BA_ "GenSigTimeoutTime_CADM" SG_ 1328 MessageCounter_ENGINE_HYBD_FD_4 0;
BA_ "GenSigTimeoutTime_DMSM" SG_ 1328 MessageCounter_ENGINE_HYBD_FD_4 0;
BA_ "GenSigTimeoutTime_DTCM" SG_ 1328 MessageCounter_ENGINE_HYBD_FD_4 0;
BA_ "GenSigTimeoutTime_ECM" SG_ 1328 MessageCounter_ENGINE_HYBD_FD_4 0;
BA_ "GenSigTimeoutTime_EVCU2" SG_ 1328 MessageCounter_ENGINE_HYBD_FD_4 0;
BA_ "GenSigTimeoutTime_GNMM" SG_ 1328 MessageCounter_ENGINE_HYBD_FD_4 0;
BA_ "GenSigTimeoutTime_IPC" SG_ 1328 MessageCounter_ENGINE_HYBD_FD_4 0;
BA_ "GenSigTimeoutTime_RFHM" SG_ 1328 MessageCounter_ENGINE_HYBD_FD_4 0;
BA_ "GenSigTimeoutTime_SGW" SG_ 1328 MessageCounter_ENGINE_HYBD_FD_4 0;
BA_ "GenSigTimeoutTime_TCM" SG_ 1328 MessageCounter_ENGINE_HYBD_FD_4 0;
BA_ "GenSigTimeoutTime_AGSM" SG_ 287 WED_STATUS 0;
BA_ "GenSigTimeoutTime_BCM" SG_ 287 WED_STATUS 0;
BA_ "GenSigTimeoutTime_CADM" SG_ 287 WED_STATUS 0;
BA_ "GenSigTimeoutTime_DMSM" SG_ 287 WED_STATUS 0;
BA_ "GenSigTimeoutTime_DTCM" SG_ 287 WED_STATUS 0;
BA_ "GenSigTimeoutTime_ECM" SG_ 287 WED_STATUS 0;
BA_ "GenSigTimeoutTime_EVCU2" SG_ 287 WED_STATUS 0;
BA_ "GenSigTimeoutTime_GNMM" SG_ 287 WED_STATUS 0;
BA_ "GenSigTimeoutTime_HCP" SG_ 287 WED_STATUS 0;
BA_ "GenSigTimeoutTime_IPC" SG_ 287 WED_STATUS 0;
BA_ "GenSigTimeoutTime_RFHM" SG_ 287 WED_STATUS 0;
BA_ "GenSigTimeoutTime_SGW" SG_ 287 WED_STATUS 0;
BA_ "GenSigTimeoutTime_TCM" SG_ 287 WED_STATUS 0;
BA_ "GenSigTimeoutTime_AGSM" SG_ 264 CRC_EPS1 0;
BA_ "GenSigTimeoutTime_BCM" SG_ 264 CRC_EPS1 0;
BA_ "GenSigTimeoutTime_CADM" SG_ 264 CRC_EPS1 0;
BA_ "GenSigTimeoutTime_EVCU2" SG_ 264 CRC_EPS1 0;
BA_ "GenSigTimeoutTime_GNMM" SG_ 264 CRC_EPS1 0;
BA_ "GenSigTimeoutTime_HCP" SG_ 264 CRC_EPS1 0;
BA_ "GenSigTimeoutTime_IPC" SG_ 264 CRC_EPS1 0;
BA_ "GenSigTimeoutTime_RFHM" SG_ 264 CRC_EPS1 0;
BA_ "GenSigTimeoutTime_SGW" SG_ 264 CRC_EPS1 0;
BA_ "GenSigTimeoutTime_AGSM" SG_ 264 ElectricSteeringFailSts 0;
BA_ "GenSigTimeoutTime_BCM" SG_ 264 ElectricSteeringFailSts 0;
BA_ "GenSigTimeoutTime_BSM" SG_ 264 ElectricSteeringFailSts 0;
BA_ "GenSigTimeoutTime_CADM" SG_ 264 ElectricSteeringFailSts 0;
BA_ "GenSigTimeoutTime_DMSM" SG_ 264 ElectricSteeringFailSts 0;
BA_ "GenSigTimeoutTime_ECM" SG_ 264 ElectricSteeringFailSts 0;
BA_ "GenSigTimeoutTime_EVCU2" SG_ 264 ElectricSteeringFailSts 0;
BA_ "GenSigTimeoutTime_GNMM" SG_ 264 ElectricSteeringFailSts 0;
BA_ "GenSigTimeoutTime_HCP" SG_ 264 ElectricSteeringFailSts 0;
BA_ "GenSigTimeoutTime_IPC" SG_ 264 ElectricSteeringFailSts 0;
BA_ "GenSigTimeoutTime_RFHM" SG_ 264 ElectricSteeringFailSts 0;
BA_ "GenSigTimeoutTime_SGW" SG_ 264 ElectricSteeringFailSts 0;
BA_ "GenSigTimeoutTime_TCM" SG_ 264 ElectricSteeringFailSts 0;
BA_ "GenSigTimeoutTime_AGSM" SG_ 264 EngineFanRequestActivation 0;
BA_ "GenSigTimeoutTime_BCM" SG_ 264 EngineFanRequestActivation 0;
BA_ "GenSigTimeoutTime_BSM" SG_ 264 EngineFanRequestActivation 0;
BA_ "GenSigTimeoutTime_CADM" SG_ 264 EngineFanRequestActivation 0;
BA_ "GenSigTimeoutTime_DMSM" SG_ 264 EngineFanRequestActivation 0;
BA_ "GenSigTimeoutTime_DTCM" SG_ 264 EngineFanRequestActivation 0;
BA_ "GenSigTimeoutTime_EVCU2" SG_ 264 EngineFanRequestActivation 0;
BA_ "GenSigTimeoutTime_GNMM" SG_ 264 EngineFanRequestActivation 0;
BA_ "GenSigTimeoutTime_HCP" SG_ 264 EngineFanRequestActivation 0;
BA_ "GenSigTimeoutTime_IPC" SG_ 264 EngineFanRequestActivation 0;
BA_ "GenSigTimeoutTime_RFHM" SG_ 264 EngineFanRequestActivation 0;
BA_ "GenSigTimeoutTime_SGW" SG_ 264 EngineFanRequestActivation 0;
BA_ "GenSigTimeoutTime_TCM" SG_ 264 EngineFanRequestActivation 0;
BA_ "GenSigTimeoutTime_AGSM" SG_ 264 LwsAngle 0;
BA_ "GenSigTimeoutTime_BCM" SG_ 264 LwsAngle 0;
BA_ "GenSigTimeoutTime_CADM" SG_ 264 LwsAngle 0;
BA_ "GenSigTimeoutTime_GNMM" SG_ 264 LwsAngle 0;
BA_ "GenSigTimeoutTime_HCP" SG_ 264 LwsAngle 0;
BA_ "GenSigTimeoutTime_RFHM" SG_ 264 LwsAngle 0;
BA_ "GenSigTimeoutTime_AGSM" SG_ 264 LwsAngleType 0;
BA_ "GenSigTimeoutTime_BCM" SG_ 264 LwsAngleType 0;
BA_ "GenSigTimeoutTime_CADM" SG_ 264 LwsAngleType 0;
BA_ "GenSigTimeoutTime_DMSM" SG_ 264 LwsAngleType 0;
BA_ "GenSigTimeoutTime_DTCM" SG_ 264 LwsAngleType 0;
BA_ "GenSigTimeoutTime_ECM" SG_ 264 LwsAngleType 0;
BA_ "GenSigTimeoutTime_EVCU2" SG_ 264 LwsAngleType 0;
BA_ "GenSigTimeoutTime_GNMM" SG_ 264 LwsAngleType 0;
BA_ "GenSigTimeoutTime_HCP" SG_ 264 LwsAngleType 0;
BA_ "GenSigTimeoutTime_RFHM" SG_ 264 LwsAngleType 0;
BA_ "GenSigTimeoutTime_SGW" SG_ 264 LwsAngleType 0;
BA_ "GenSigTimeoutTime_TCM" SG_ 264 LwsAngleType 0;
BA_ "GenSigTimeoutTime_AGSM" SG_ 264 LwsCalibration 0;
BA_ "GenSigTimeoutTime_BCM" SG_ 264 LwsCalibration 0;
BA_ "GenSigTimeoutTime_CADM" SG_ 264 LwsCalibration 0;
BA_ "GenSigTimeoutTime_DMSM" SG_ 264 LwsCalibration 0;
BA_ "GenSigTimeoutTime_DTCM" SG_ 264 LwsCalibration 0;
BA_ "GenSigTimeoutTime_ECM" SG_ 264 LwsCalibration 0;
BA_ "GenSigTimeoutTime_EVCU2" SG_ 264 LwsCalibration 0;
BA_ "GenSigTimeoutTime_GNMM" SG_ 264 LwsCalibration 0;
BA_ "GenSigTimeoutTime_HCP" SG_ 264 LwsCalibration 0;
BA_ "GenSigTimeoutTime_RFHM" SG_ 264 LwsCalibration 0;
BA_ "GenSigTimeoutTime_SGW" SG_ 264 LwsCalibration 0;
BA_ "GenSigTimeoutTime_TCM" SG_ 264 LwsCalibration 0;
BA_ "GenSigTimeoutTime_AGSM" SG_ 264 LwsSpeed 0;
BA_ "GenSigTimeoutTime_BCM" SG_ 264 LwsSpeed 0;
BA_ "GenSigTimeoutTime_BSM" SG_ 264 LwsSpeed 0;
BA_ "GenSigTimeoutTime_CADM" SG_ 264 LwsSpeed 0;
BA_ "GenSigTimeoutTime_DMSM" SG_ 264 LwsSpeed 0;
BA_ "GenSigTimeoutTime_DTCM" SG_ 264 LwsSpeed 0;
BA_ "GenSigTimeoutTime_GNMM" SG_ 264 LwsSpeed 0;
BA_ "GenSigTimeoutTime_HCP" SG_ 264 LwsSpeed 0;
BA_ "GenSigTimeoutTime_RFHM" SG_ 264 LwsSpeed 0;
BA_ "GenSigTimeoutTime_SGW" SG_ 264 LwsSpeed 0;
BA_ "GenSigTimeoutTime_TCM" SG_ 264 LwsSpeed 0;
BA_ "GenSigTimeoutTime_AGSM" SG_ 264 MessageCounter_EPS1 0;
BA_ "GenSigTimeoutTime_BCM" SG_ 264 MessageCounter_EPS1 0;
BA_ "GenSigTimeoutTime_CADM" SG_ 264 MessageCounter_EPS1 0;
BA_ "GenSigTimeoutTime_EVCU2" SG_ 264 MessageCounter_EPS1 0;
BA_ "GenSigTimeoutTime_GNMM" SG_ 264 MessageCounter_EPS1 0;
BA_ "GenSigTimeoutTime_HCP" SG_ 264 MessageCounter_EPS1 0;
BA_ "GenSigTimeoutTime_IPC" SG_ 264 MessageCounter_EPS1 0;
BA_ "GenSigTimeoutTime_RFHM" SG_ 264 MessageCounter_EPS1 0;
BA_ "GenSigTimeoutTime_SGW" SG_ 264 MessageCounter_EPS1 0;
BA_ "GenSigTimeoutTime_AGSM" SG_ 1056 CRC_EPS2 0;
BA_ "GenSigTimeoutTime_BCM" SG_ 1056 CRC_EPS2 0;
BA_ "GenSigTimeoutTime_BSM" SG_ 1056 CRC_EPS2 0;
BA_ "GenSigTimeoutTime_CADM" SG_ 1056 CRC_EPS2 0;
BA_ "GenSigTimeoutTime_DMSM" SG_ 1056 CRC_EPS2 0;
BA_ "GenSigTimeoutTime_DTCM" SG_ 1056 CRC_EPS2 0;
BA_ "GenSigTimeoutTime_ECM" SG_ 1056 CRC_EPS2 0;
BA_ "GenSigTimeoutTime_EVCU2" SG_ 1056 CRC_EPS2 0;
BA_ "GenSigTimeoutTime_GNMM" SG_ 1056 CRC_EPS2 0;
BA_ "GenSigTimeoutTime_HCP" SG_ 1056 CRC_EPS2 0;
BA_ "GenSigTimeoutTime_RFHM" SG_ 1056 CRC_EPS2 0;
BA_ "GenSigTimeoutTime_SGW" SG_ 1056 CRC_EPS2 0;
BA_ "GenSigTimeoutTime_TCM" SG_ 1056 CRC_EPS2 0;
BA_ "GenSigTimeoutTime_AGSM" SG_ 1056 EPS_Warn_Disp_Rq 0;
BA_ "GenSigTimeoutTime_BCM" SG_ 1056 EPS_Warn_Disp_Rq 0;
BA_ "GenSigTimeoutTime_BSM" SG_ 1056 EPS_Warn_Disp_Rq 0;
BA_ "GenSigTimeoutTime_CADM" SG_ 1056 EPS_Warn_Disp_Rq 0;
BA_ "GenSigTimeoutTime_DMSM" SG_ 1056 EPS_Warn_Disp_Rq 0;
BA_ "GenSigTimeoutTime_DTCM" SG_ 1056 EPS_Warn_Disp_Rq 0;
BA_ "GenSigTimeoutTime_EVCU2" SG_ 1056 EPS_Warn_Disp_Rq 0;
BA_ "GenSigTimeoutTime_GNMM" SG_ 1056 EPS_Warn_Disp_Rq 0;
BA_ "GenSigTimeoutTime_HCP" SG_ 1056 EPS_Warn_Disp_Rq 0;
BA_ "GenSigTimeoutTime_RFHM" SG_ 1056 EPS_Warn_Disp_Rq 0;
BA_ "GenSigTimeoutTime_TCM" SG_ 1056 EPS_Warn_Disp_Rq 0;
BA_ "GenSigTimeoutTime_AGSM" SG_ 1056 MessageCounter_EPS2 0;
BA_ "GenSigTimeoutTime_BCM" SG_ 1056 MessageCounter_EPS2 0;
BA_ "GenSigTimeoutTime_BSM" SG_ 1056 MessageCounter_EPS2 0;
BA_ "GenSigTimeoutTime_CADM" SG_ 1056 MessageCounter_EPS2 0;
BA_ "GenSigTimeoutTime_DMSM" SG_ 1056 MessageCounter_EPS2 0;
BA_ "GenSigTimeoutTime_DTCM" SG_ 1056 MessageCounter_EPS2 0;
BA_ "GenSigTimeoutTime_ECM" SG_ 1056 MessageCounter_EPS2 0;
BA_ "GenSigTimeoutTime_EVCU2" SG_ 1056 MessageCounter_EPS2 0;
BA_ "GenSigTimeoutTime_GNMM" SG_ 1056 MessageCounter_EPS2 0;
BA_ "GenSigTimeoutTime_HCP" SG_ 1056 MessageCounter_EPS2 0;
BA_ "GenSigTimeoutTime_RFHM" SG_ 1056 MessageCounter_EPS2 0;
BA_ "GenSigTimeoutTime_SGW" SG_ 1056 MessageCounter_EPS2 0;
BA_ "GenSigTimeoutTime_TCM" SG_ 1056 MessageCounter_EPS2 0;
BA_ "GenSigSendType" SG_ 1460 CADM_Big_ECU_Package 3;
BA_ "GenSigTimeoutTime_AGSM" SG_ 1460 CADM_Big_ECU_Package 0;
BA_ "GenSigTimeoutTime_BCM" SG_ 1460 CADM_Big_ECU_Package 0;
BA_ "GenSigTimeoutTime_BSM" SG_ 1460 CADM_Big_ECU_Package 0;
BA_ "GenSigTimeoutTime_DMSM" SG_ 1460 CADM_Big_ECU_Package 0;
BA_ "GenSigTimeoutTime_DTCM" SG_ 1460 CADM_Big_ECU_Package 0;
BA_ "GenSigTimeoutTime_ECM" SG_ 1460 CADM_Big_ECU_Package 0;
BA_ "GenSigTimeoutTime_EVCU2" SG_ 1460 CADM_Big_ECU_Package 0;
BA_ "GenSigTimeoutTime_GNMM" SG_ 1460 CADM_Big_ECU_Package 0;
BA_ "GenSigTimeoutTime_HCP" SG_ 1460 CADM_Big_ECU_Package 0;
BA_ "GenSigTimeoutTime_IPC" SG_ 1460 CADM_Big_ECU_Package 0;
BA_ "GenSigTimeoutTime_RFHM" SG_ 1460 CADM_Big_ECU_Package 0;
BA_ "GenSigTimeoutTime_SGW" SG_ 1460 CADM_Big_ECU_Package 0;
BA_ "GenSigTimeoutTime_TCM" SG_ 1460 CADM_Big_ECU_Package 0;
BA_ "GenSigSendType" SG_ 1460 FOTA_Install_Type 3;
BA_ "GenSigTimeoutTime_AGSM" SG_ 1460 FOTA_Install_Type 0;
BA_ "GenSigTimeoutTime_BCM" SG_ 1460 FOTA_Install_Type 0;
BA_ "GenSigTimeoutTime_BSM" SG_ 1460 FOTA_Install_Type 0;
BA_ "GenSigTimeoutTime_CADM" SG_ 1460 FOTA_Install_Type 0;
BA_ "GenSigTimeoutTime_DMSM" SG_ 1460 FOTA_Install_Type 0;
BA_ "GenSigTimeoutTime_DTCM" SG_ 1460 FOTA_Install_Type 0;
BA_ "GenSigTimeoutTime_GNMM" SG_ 1460 FOTA_Install_Type 0;
BA_ "GenSigTimeoutTime_HCP" SG_ 1460 FOTA_Install_Type 0;
BA_ "GenSigTimeoutTime_IPC" SG_ 1460 FOTA_Install_Type 0;
BA_ "GenSigTimeoutTime_RFHM" SG_ 1460 FOTA_Install_Type 0;
BA_ "GenSigTimeoutTime_SGW" SG_ 1460 FOTA_Install_Type 0;
BA_ "GenSigTimeoutTime_TCM" SG_ 1460 FOTA_Install_Type 0;
BA_ "GenSigSendType" SG_ 1460 FOTA_Installation_Status 3;
BA_ "GenSigTimeoutTime_AGSM" SG_ 1460 FOTA_Installation_Status 0;
BA_ "GenSigTimeoutTime_BCM" SG_ 1460 FOTA_Installation_Status 0;
BA_ "GenSigTimeoutTime_BSM" SG_ 1460 FOTA_Installation_Status 0;
BA_ "GenSigTimeoutTime_CADM" SG_ 1460 FOTA_Installation_Status 0;
BA_ "GenSigTimeoutTime_DMSM" SG_ 1460 FOTA_Installation_Status 0;
BA_ "GenSigTimeoutTime_DTCM" SG_ 1460 FOTA_Installation_Status 0;
BA_ "GenSigTimeoutTime_ECM" SG_ 1460 FOTA_Installation_Status 0;
BA_ "GenSigTimeoutTime_GNMM" SG_ 1460 FOTA_Installation_Status 0;
BA_ "GenSigTimeoutTime_HCP" SG_ 1460 FOTA_Installation_Status 0;
BA_ "GenSigTimeoutTime_IPC" SG_ 1460 FOTA_Installation_Status 0;
BA_ "GenSigTimeoutTime_SGW" SG_ 1460 FOTA_Installation_Status 0;
BA_ "GenSigTimeoutTime_TCM" SG_ 1460 FOTA_Installation_Status 0;
BA_ "GenSigStartValue" SG_ 1460 FOTA_Purge 1;
BA_ "GenSigSendType" SG_ 1460 FOTA_Purge 3;
BA_ "GenSigTimeoutTime_AGSM" SG_ 1460 FOTA_Purge 0;
BA_ "GenSigTimeoutTime_BCM" SG_ 1460 FOTA_Purge 0;
BA_ "GenSigTimeoutTime_BSM" SG_ 1460 FOTA_Purge 0;
BA_ "GenSigTimeoutTime_DMSM" SG_ 1460 FOTA_Purge 0;
BA_ "GenSigTimeoutTime_DTCM" SG_ 1460 FOTA_Purge 0;
BA_ "GenSigTimeoutTime_ECM" SG_ 1460 FOTA_Purge 0;
BA_ "GenSigTimeoutTime_EVCU2" SG_ 1460 FOTA_Purge 0;
BA_ "GenSigTimeoutTime_GNMM" SG_ 1460 FOTA_Purge 0;
BA_ "GenSigTimeoutTime_HCP" SG_ 1460 FOTA_Purge 0;
BA_ "GenSigTimeoutTime_IPC" SG_ 1460 FOTA_Purge 0;
BA_ "GenSigTimeoutTime_RFHM" SG_ 1460 FOTA_Purge 0;
BA_ "GenSigTimeoutTime_SGW" SG_ 1460 FOTA_Purge 0;
BA_ "GenSigTimeoutTime_TCM" SG_ 1460 FOTA_Purge 0;
BA_ "GenSigSendType" SG_ 1460 FOTA_Status 3;
BA_ "GenSigTimeoutTime_AGSM" SG_ 1460 FOTA_Status 0;
BA_ "GenSigTimeoutTime_DMSM" SG_ 1460 FOTA_Status 0;
BA_ "GenSigTimeoutTime_DTCM" SG_ 1460 FOTA_Status 0;
BA_ "GenSigTimeoutTime_EVCU2" SG_ 1460 FOTA_Status 0;
BA_ "GenSigTimeoutTime_GNMM" SG_ 1460 FOTA_Status 0;
BA_ "GenSigTimeoutTime_HCP" SG_ 1460 FOTA_Status 0;
BA_ "GenSigTimeoutTime_SGW" SG_ 1460 FOTA_Status 0;
BA_ "GenSigSendType" SG_ 1460 Safe_State 3;
BA_ "GenSigTimeoutTime_AGSM" SG_ 1460 Safe_State 0;
BA_ "GenSigTimeoutTime_BCM" SG_ 1460 Safe_State 0;
BA_ "GenSigTimeoutTime_BSM" SG_ 1460 Safe_State 0;
BA_ "GenSigTimeoutTime_DMSM" SG_ 1460 Safe_State 0;
BA_ "GenSigTimeoutTime_DTCM" SG_ 1460 Safe_State 0;
BA_ "GenSigTimeoutTime_ECM" SG_ 1460 Safe_State 0;
BA_ "GenSigTimeoutTime_EVCU2" SG_ 1460 Safe_State 0;
BA_ "GenSigTimeoutTime_GNMM" SG_ 1460 Safe_State 0;
BA_ "GenSigTimeoutTime_HCP" SG_ 1460 Safe_State 0;
BA_ "GenSigTimeoutTime_IPC" SG_ 1460 Safe_State 0;
BA_ "GenSigTimeoutTime_RFHM" SG_ 1460 Safe_State 0;
BA_ "GenSigTimeoutTime_SGW" SG_ 1460 Safe_State 0;
BA_ "GenSigTimeoutTime_TCM" SG_ 1460 Safe_State 0;
BA_ "GenSigSendType" SG_ 1460 WakeUpECM 3;
BA_ "GenSigTimeoutTime_AGSM" SG_ 1460 WakeUpECM 0;
BA_ "GenSigTimeoutTime_BSM" SG_ 1460 WakeUpECM 0;
BA_ "GenSigTimeoutTime_CADM" SG_ 1460 WakeUpECM 0;
BA_ "GenSigTimeoutTime_DMSM" SG_ 1460 WakeUpECM 0;
BA_ "GenSigTimeoutTime_DTCM" SG_ 1460 WakeUpECM 0;
BA_ "GenSigTimeoutTime_ECM" SG_ 1460 WakeUpECM 0;
BA_ "GenSigTimeoutTime_EVCU2" SG_ 1460 WakeUpECM 0;
BA_ "GenSigTimeoutTime_GNMM" SG_ 1460 WakeUpECM 0;
BA_ "GenSigTimeoutTime_HCP" SG_ 1460 WakeUpECM 0;
BA_ "GenSigTimeoutTime_IPC" SG_ 1460 WakeUpECM 0;
BA_ "GenSigTimeoutTime_RFHM" SG_ 1460 WakeUpECM 0;
BA_ "GenSigTimeoutTime_SGW" SG_ 1460 WakeUpECM 0;
BA_ "GenSigTimeoutTime_TCM" SG_ 1460 WakeUpECM 0;
BA_ "GenSigTimeoutTime_AGSM" SG_ 1846 Big_ECU_Ready_CADM 0;
BA_ "GenSigTimeoutTime_BCM" SG_ 1846 Big_ECU_Ready_CADM 0;
BA_ "GenSigTimeoutTime_BSM" SG_ 1846 Big_ECU_Ready_CADM 0;
BA_ "GenSigTimeoutTime_CADM" SG_ 1846 Big_ECU_Ready_CADM 0;
BA_ "GenSigTimeoutTime_DMSM" SG_ 1846 Big_ECU_Ready_CADM 0;
BA_ "GenSigTimeoutTime_DTCM" SG_ 1846 Big_ECU_Ready_CADM 0;
BA_ "GenSigTimeoutTime_ECM" SG_ 1846 Big_ECU_Ready_CADM 0;
BA_ "GenSigTimeoutTime_EVCU2" SG_ 1846 Big_ECU_Ready_CADM 0;
BA_ "GenSigTimeoutTime_GNMM" SG_ 1846 Big_ECU_Ready_CADM 0;
BA_ "GenSigTimeoutTime_HCP" SG_ 1846 Big_ECU_Ready_CADM 0;
BA_ "GenSigTimeoutTime_IPC" SG_ 1846 Big_ECU_Ready_CADM 0;
BA_ "GenSigTimeoutTime_RFHM" SG_ 1846 Big_ECU_Ready_CADM 0;
BA_ "GenSigTimeoutTime_TCM" SG_ 1846 Big_ECU_Ready_CADM 0;
BA_ "GenSigTimeoutTime_AGSM" SG_ 1846 Download_Status_CADM 0;
BA_ "GenSigTimeoutTime_BCM" SG_ 1846 Download_Status_CADM 0;
BA_ "GenSigTimeoutTime_BSM" SG_ 1846 Download_Status_CADM 0;
BA_ "GenSigTimeoutTime_CADM" SG_ 1846 Download_Status_CADM 0;
BA_ "GenSigTimeoutTime_DMSM" SG_ 1846 Download_Status_CADM 0;
BA_ "GenSigTimeoutTime_DTCM" SG_ 1846 Download_Status_CADM 0;
BA_ "GenSigTimeoutTime_ECM" SG_ 1846 Download_Status_CADM 0;
BA_ "GenSigTimeoutTime_EVCU2" SG_ 1846 Download_Status_CADM 0;
BA_ "GenSigTimeoutTime_GNMM" SG_ 1846 Download_Status_CADM 0;
BA_ "GenSigTimeoutTime_HCP" SG_ 1846 Download_Status_CADM 0;
BA_ "GenSigTimeoutTime_IPC" SG_ 1846 Download_Status_CADM 0;
BA_ "GenSigTimeoutTime_RFHM" SG_ 1846 Download_Status_CADM 0;
BA_ "GenSigTimeoutTime_TCM" SG_ 1846 Download_Status_CADM 0;
BA_ "GenSigTimeoutTime_AGSM" SG_ 1846 Update_Status_CADM 0;
BA_ "GenSigTimeoutTime_BCM" SG_ 1846 Update_Status_CADM 0;
BA_ "GenSigTimeoutTime_BSM" SG_ 1846 Update_Status_CADM 0;
BA_ "GenSigTimeoutTime_CADM" SG_ 1846 Update_Status_CADM 0;
BA_ "GenSigTimeoutTime_DMSM" SG_ 1846 Update_Status_CADM 0;
BA_ "GenSigTimeoutTime_DTCM" SG_ 1846 Update_Status_CADM 0;
BA_ "GenSigTimeoutTime_ECM" SG_ 1846 Update_Status_CADM 0;
BA_ "GenSigTimeoutTime_EVCU2" SG_ 1846 Update_Status_CADM 0;
BA_ "GenSigTimeoutTime_GNMM" SG_ 1846 Update_Status_CADM 0;
BA_ "GenSigTimeoutTime_HCP" SG_ 1846 Update_Status_CADM 0;
BA_ "GenSigTimeoutTime_IPC" SG_ 1846 Update_Status_CADM 0;
BA_ "GenSigTimeoutTime_RFHM" SG_ 1846 Update_Status_CADM 0;
BA_ "GenSigTimeoutTime_TCM" SG_ 1846 Update_Status_CADM 0;
BA_ "GenSigStartValue" SG_ 525 Altitude_RMSE 255;
BA_ "GenSigTimeoutTime_AGSM" SG_ 525 Altitude_RMSE 0;
BA_ "GenSigTimeoutTime_BCM" SG_ 525 Altitude_RMSE 0;
BA_ "GenSigTimeoutTime_BSM" SG_ 525 Altitude_RMSE 0;
BA_ "GenSigTimeoutTime_DMSM" SG_ 525 Altitude_RMSE 0;
BA_ "GenSigTimeoutTime_DTCM" SG_ 525 Altitude_RMSE 0;
BA_ "GenSigTimeoutTime_ECM" SG_ 525 Altitude_RMSE 0;
BA_ "GenSigTimeoutTime_EVCU2" SG_ 525 Altitude_RMSE 0;
BA_ "GenSigTimeoutTime_GNMM" SG_ 525 Altitude_RMSE 0;
BA_ "GenSigTimeoutTime_HCP" SG_ 525 Altitude_RMSE 0;
BA_ "GenSigTimeoutTime_IPC" SG_ 525 Altitude_RMSE 0;
BA_ "GenSigTimeoutTime_RFHM" SG_ 525 Altitude_RMSE 0;
BA_ "GenSigTimeoutTime_SGW" SG_ 525 Altitude_RMSE 0;
BA_ "GenSigTimeoutTime_TCM" SG_ 525 Altitude_RMSE 0;
BA_ "GenSigTimeoutTime_AGSM" SG_ 525 CRC_GLOB_NAV 0;
BA_ "GenSigTimeoutTime_BSM" SG_ 525 CRC_GLOB_NAV 0;
BA_ "GenSigTimeoutTime_DMSM" SG_ 525 CRC_GLOB_NAV 0;
BA_ "GenSigTimeoutTime_DTCM" SG_ 525 CRC_GLOB_NAV 0;
BA_ "GenSigTimeoutTime_ECM" SG_ 525 CRC_GLOB_NAV 0;
BA_ "GenSigTimeoutTime_EVCU2" SG_ 525 CRC_GLOB_NAV 0;
BA_ "GenSigTimeoutTime_GNMM" SG_ 525 CRC_GLOB_NAV 0;
BA_ "GenSigTimeoutTime_HCP" SG_ 525 CRC_GLOB_NAV 0;
BA_ "GenSigTimeoutTime_IPC" SG_ 525 CRC_GLOB_NAV 0;
BA_ "GenSigTimeoutTime_RFHM" SG_ 525 CRC_GLOB_NAV 0;
BA_ "GenSigTimeoutTime_SGW" SG_ 525 CRC_GLOB_NAV 0;
BA_ "GenSigTimeoutTime_TCM" SG_ 525 CRC_GLOB_NAV 0;
BA_ "GenSigTimeoutTime_AGSM" SG_ 525 GNMM_Health 0;
BA_ "GenSigTimeoutTime_BSM" SG_ 525 GNMM_Health 0;
BA_ "GenSigTimeoutTime_DMSM" SG_ 525 GNMM_Health 0;
BA_ "GenSigTimeoutTime_DTCM" SG_ 525 GNMM_Health 0;
BA_ "GenSigTimeoutTime_ECM" SG_ 525 GNMM_Health 0;
BA_ "GenSigTimeoutTime_EVCU2" SG_ 525 GNMM_Health 0;
BA_ "GenSigTimeoutTime_GNMM" SG_ 525 GNMM_Health 0;
BA_ "GenSigTimeoutTime_HCP" SG_ 525 GNMM_Health 0;
BA_ "GenSigTimeoutTime_IPC" SG_ 525 GNMM_Health 0;
BA_ "GenSigTimeoutTime_RFHM" SG_ 525 GNMM_Health 0;
BA_ "GenSigTimeoutTime_SGW" SG_ 525 GNMM_Health 0;
BA_ "GenSigTimeoutTime_TCM" SG_ 525 GNMM_Health 0;
BA_ "GenSigStartValue" SG_ 525 Heading_Angle 65535;
BA_ "GenSigTimeoutTime_AGSM" SG_ 525 Heading_Angle 0;
BA_ "GenSigTimeoutTime_BCM" SG_ 525 Heading_Angle 0;
BA_ "GenSigTimeoutTime_BSM" SG_ 525 Heading_Angle 0;
BA_ "GenSigTimeoutTime_DMSM" SG_ 525 Heading_Angle 0;
BA_ "GenSigTimeoutTime_DTCM" SG_ 525 Heading_Angle 0;
BA_ "GenSigTimeoutTime_ECM" SG_ 525 Heading_Angle 0;
BA_ "GenSigTimeoutTime_EVCU2" SG_ 525 Heading_Angle 0;
BA_ "GenSigTimeoutTime_GNMM" SG_ 525 Heading_Angle 0;
BA_ "GenSigTimeoutTime_HCP" SG_ 525 Heading_Angle 0;
BA_ "GenSigTimeoutTime_IPC" SG_ 525 Heading_Angle 0;
BA_ "GenSigTimeoutTime_RFHM" SG_ 525 Heading_Angle 0;
BA_ "GenSigTimeoutTime_SGW" SG_ 525 Heading_Angle 0;
BA_ "GenSigTimeoutTime_TCM" SG_ 525 Heading_Angle 0;
BA_ "GenSigTimeoutTime_AGSM" SG_ 525 Lat_GNMM 0;
BA_ "GenSigTimeoutTime_BCM" SG_ 525 Lat_GNMM 0;
BA_ "GenSigTimeoutTime_BSM" SG_ 525 Lat_GNMM 0;
BA_ "GenSigTimeoutTime_DMSM" SG_ 525 Lat_GNMM 0;
BA_ "GenSigTimeoutTime_DTCM" SG_ 525 Lat_GNMM 0;
BA_ "GenSigTimeoutTime_ECM" SG_ 525 Lat_GNMM 0;
BA_ "GenSigTimeoutTime_EVCU2" SG_ 525 Lat_GNMM 0;
BA_ "GenSigTimeoutTime_GNMM" SG_ 525 Lat_GNMM 0;
BA_ "GenSigTimeoutTime_HCP" SG_ 525 Lat_GNMM 0;
BA_ "GenSigTimeoutTime_IPC" SG_ 525 Lat_GNMM 0;
BA_ "GenSigTimeoutTime_RFHM" SG_ 525 Lat_GNMM 0;
BA_ "GenSigTimeoutTime_SGW" SG_ 525 Lat_GNMM 0;
BA_ "GenSigTimeoutTime_TCM" SG_ 525 Lat_GNMM 0;
BA_ "GenSigStartValue" SG_ 525 LatAcceleration_GNMM 4095;
BA_ "GenSigTimeoutTime_AGSM" SG_ 525 LatAcceleration_GNMM 0;
BA_ "GenSigTimeoutTime_BCM" SG_ 525 LatAcceleration_GNMM 0;
BA_ "GenSigTimeoutTime_BSM" SG_ 525 LatAcceleration_GNMM 0;
BA_ "GenSigTimeoutTime_DMSM" SG_ 525 LatAcceleration_GNMM 0;
BA_ "GenSigTimeoutTime_DTCM" SG_ 525 LatAcceleration_GNMM 0;
BA_ "GenSigTimeoutTime_ECM" SG_ 525 LatAcceleration_GNMM 0;
BA_ "GenSigTimeoutTime_EVCU2" SG_ 525 LatAcceleration_GNMM 0;
BA_ "GenSigTimeoutTime_GNMM" SG_ 525 LatAcceleration_GNMM 0;
BA_ "GenSigTimeoutTime_HCP" SG_ 525 LatAcceleration_GNMM 0;
BA_ "GenSigTimeoutTime_IPC" SG_ 525 LatAcceleration_GNMM 0;
BA_ "GenSigTimeoutTime_RFHM" SG_ 525 LatAcceleration_GNMM 0;
BA_ "GenSigTimeoutTime_SGW" SG_ 525 LatAcceleration_GNMM 0;
BA_ "GenSigTimeoutTime_TCM" SG_ 525 LatAcceleration_GNMM 0;
BA_ "GenSigStartValue" SG_ 525 LateralVelocity_GNMM 16383;
BA_ "GenSigTimeoutTime_AGSM" SG_ 525 LateralVelocity_GNMM 0;
BA_ "GenSigTimeoutTime_BCM" SG_ 525 LateralVelocity_GNMM 0;
BA_ "GenSigTimeoutTime_BSM" SG_ 525 LateralVelocity_GNMM 0;
BA_ "GenSigTimeoutTime_DMSM" SG_ 525 LateralVelocity_GNMM 0;
BA_ "GenSigTimeoutTime_DTCM" SG_ 525 LateralVelocity_GNMM 0;
BA_ "GenSigTimeoutTime_ECM" SG_ 525 LateralVelocity_GNMM 0;
BA_ "GenSigTimeoutTime_EVCU2" SG_ 525 LateralVelocity_GNMM 0;
BA_ "GenSigTimeoutTime_GNMM" SG_ 525 LateralVelocity_GNMM 0;
BA_ "GenSigTimeoutTime_HCP" SG_ 525 LateralVelocity_GNMM 0;
BA_ "GenSigTimeoutTime_IPC" SG_ 525 LateralVelocity_GNMM 0;
BA_ "GenSigTimeoutTime_RFHM" SG_ 525 LateralVelocity_GNMM 0;
BA_ "GenSigTimeoutTime_SGW" SG_ 525 LateralVelocity_GNMM 0;
BA_ "GenSigTimeoutTime_TCM" SG_ 525 LateralVelocity_GNMM 0;
BA_ "GenSigStartValue" SG_ 525 Latitude_RMSE 255;
BA_ "GenSigTimeoutTime_AGSM" SG_ 525 Latitude_RMSE 0;
BA_ "GenSigTimeoutTime_BCM" SG_ 525 Latitude_RMSE 0;
BA_ "GenSigTimeoutTime_BSM" SG_ 525 Latitude_RMSE 0;
BA_ "GenSigTimeoutTime_DMSM" SG_ 525 Latitude_RMSE 0;
BA_ "GenSigTimeoutTime_DTCM" SG_ 525 Latitude_RMSE 0;
BA_ "GenSigTimeoutTime_ECM" SG_ 525 Latitude_RMSE 0;
BA_ "GenSigTimeoutTime_EVCU2" SG_ 525 Latitude_RMSE 0;
BA_ "GenSigTimeoutTime_GNMM" SG_ 525 Latitude_RMSE 0;
BA_ "GenSigTimeoutTime_HCP" SG_ 525 Latitude_RMSE 0;
BA_ "GenSigTimeoutTime_IPC" SG_ 525 Latitude_RMSE 0;
BA_ "GenSigTimeoutTime_RFHM" SG_ 525 Latitude_RMSE 0;
BA_ "GenSigTimeoutTime_SGW" SG_ 525 Latitude_RMSE 0;
BA_ "GenSigTimeoutTime_TCM" SG_ 525 Latitude_RMSE 0;
BA_ "GenSigTimeoutTime_AGSM" SG_ 525 Long_GNMM 0;
BA_ "GenSigTimeoutTime_BCM" SG_ 525 Long_GNMM 0;
BA_ "GenSigTimeoutTime_BSM" SG_ 525 Long_GNMM 0;
BA_ "GenSigTimeoutTime_DMSM" SG_ 525 Long_GNMM 0;
BA_ "GenSigTimeoutTime_DTCM" SG_ 525 Long_GNMM 0;
BA_ "GenSigTimeoutTime_ECM" SG_ 525 Long_GNMM 0;
BA_ "GenSigTimeoutTime_EVCU2" SG_ 525 Long_GNMM 0;
BA_ "GenSigTimeoutTime_GNMM" SG_ 525 Long_GNMM 0;
BA_ "GenSigTimeoutTime_HCP" SG_ 525 Long_GNMM 0;
BA_ "GenSigTimeoutTime_IPC" SG_ 525 Long_GNMM 0;
BA_ "GenSigTimeoutTime_RFHM" SG_ 525 Long_GNMM 0;
BA_ "GenSigTimeoutTime_SGW" SG_ 525 Long_GNMM 0;
BA_ "GenSigTimeoutTime_TCM" SG_ 525 Long_GNMM 0;
BA_ "GenSigStartValue" SG_ 525 LongAcceleration_GNMM 4095;
BA_ "GenSigTimeoutTime_AGSM" SG_ 525 LongAcceleration_GNMM 0;
BA_ "GenSigTimeoutTime_BCM" SG_ 525 LongAcceleration_GNMM 0;
BA_ "GenSigTimeoutTime_BSM" SG_ 525 LongAcceleration_GNMM 0;
BA_ "GenSigTimeoutTime_DMSM" SG_ 525 LongAcceleration_GNMM 0;
BA_ "GenSigTimeoutTime_DTCM" SG_ 525 LongAcceleration_GNMM 0;
BA_ "GenSigTimeoutTime_ECM" SG_ 525 LongAcceleration_GNMM 0;
BA_ "GenSigTimeoutTime_EVCU2" SG_ 525 LongAcceleration_GNMM 0;
BA_ "GenSigTimeoutTime_GNMM" SG_ 525 LongAcceleration_GNMM 0;
BA_ "GenSigTimeoutTime_HCP" SG_ 525 LongAcceleration_GNMM 0;
BA_ "GenSigTimeoutTime_IPC" SG_ 525 LongAcceleration_GNMM 0;
BA_ "GenSigTimeoutTime_RFHM" SG_ 525 LongAcceleration_GNMM 0;
BA_ "GenSigTimeoutTime_SGW" SG_ 525 LongAcceleration_GNMM 0;
BA_ "GenSigTimeoutTime_TCM" SG_ 525 LongAcceleration_GNMM 0;
BA_ "GenSigStartValue" SG_ 525 Longitude_RMSE 255;
BA_ "GenSigTimeoutTime_AGSM" SG_ 525 Longitude_RMSE 0;
BA_ "GenSigTimeoutTime_BCM" SG_ 525 Longitude_RMSE 0;
BA_ "GenSigTimeoutTime_BSM" SG_ 525 Longitude_RMSE 0;
BA_ "GenSigTimeoutTime_DMSM" SG_ 525 Longitude_RMSE 0;
BA_ "GenSigTimeoutTime_DTCM" SG_ 525 Longitude_RMSE 0;
BA_ "GenSigTimeoutTime_ECM" SG_ 525 Longitude_RMSE 0;
BA_ "GenSigTimeoutTime_EVCU2" SG_ 525 Longitude_RMSE 0;
BA_ "GenSigTimeoutTime_GNMM" SG_ 525 Longitude_RMSE 0;
BA_ "GenSigTimeoutTime_HCP" SG_ 525 Longitude_RMSE 0;
BA_ "GenSigTimeoutTime_IPC" SG_ 525 Longitude_RMSE 0;
BA_ "GenSigTimeoutTime_RFHM" SG_ 525 Longitude_RMSE 0;
BA_ "GenSigTimeoutTime_SGW" SG_ 525 Longitude_RMSE 0;
BA_ "GenSigTimeoutTime_TCM" SG_ 525 Longitude_RMSE 0;
BA_ "GenSigStartValue" SG_ 525 LongitudinalVelocity_GNMM 16383;
BA_ "GenSigTimeoutTime_AGSM" SG_ 525 LongitudinalVelocity_GNMM 0;
BA_ "GenSigTimeoutTime_BCM" SG_ 525 LongitudinalVelocity_GNMM 0;
BA_ "GenSigTimeoutTime_BSM" SG_ 525 LongitudinalVelocity_GNMM 0;
BA_ "GenSigTimeoutTime_DMSM" SG_ 525 LongitudinalVelocity_GNMM 0;
BA_ "GenSigTimeoutTime_DTCM" SG_ 525 LongitudinalVelocity_GNMM 0;
BA_ "GenSigTimeoutTime_ECM" SG_ 525 LongitudinalVelocity_GNMM 0;
BA_ "GenSigTimeoutTime_EVCU2" SG_ 525 LongitudinalVelocity_GNMM 0;
BA_ "GenSigTimeoutTime_GNMM" SG_ 525 LongitudinalVelocity_GNMM 0;
BA_ "GenSigTimeoutTime_HCP" SG_ 525 LongitudinalVelocity_GNMM 0;
BA_ "GenSigTimeoutTime_IPC" SG_ 525 LongitudinalVelocity_GNMM 0;
BA_ "GenSigTimeoutTime_RFHM" SG_ 525 LongitudinalVelocity_GNMM 0;
BA_ "GenSigTimeoutTime_SGW" SG_ 525 LongitudinalVelocity_GNMM 0;
BA_ "GenSigTimeoutTime_TCM" SG_ 525 LongitudinalVelocity_GNMM 0;
BA_ "GenSigTimeoutTime_AGSM" SG_ 525 MessageCounter_GLOB_NAV 0;
BA_ "GenSigTimeoutTime_BSM" SG_ 525 MessageCounter_GLOB_NAV 0;
BA_ "GenSigTimeoutTime_DMSM" SG_ 525 MessageCounter_GLOB_NAV 0;
BA_ "GenSigTimeoutTime_DTCM" SG_ 525 MessageCounter_GLOB_NAV 0;
BA_ "GenSigTimeoutTime_ECM" SG_ 525 MessageCounter_GLOB_NAV 0;
BA_ "GenSigTimeoutTime_EVCU2" SG_ 525 MessageCounter_GLOB_NAV 0;
BA_ "GenSigTimeoutTime_GNMM" SG_ 525 MessageCounter_GLOB_NAV 0;
BA_ "GenSigTimeoutTime_HCP" SG_ 525 MessageCounter_GLOB_NAV 0;
BA_ "GenSigTimeoutTime_IPC" SG_ 525 MessageCounter_GLOB_NAV 0;
BA_ "GenSigTimeoutTime_RFHM" SG_ 525 MessageCounter_GLOB_NAV 0;
BA_ "GenSigTimeoutTime_SGW" SG_ 525 MessageCounter_GLOB_NAV 0;
BA_ "GenSigTimeoutTime_TCM" SG_ 525 MessageCounter_GLOB_NAV 0;
BA_ "GenSigStartValue" SG_ 525 Pitch_RMSE 255;
BA_ "GenSigTimeoutTime_AGSM" SG_ 525 Pitch_RMSE 0;
BA_ "GenSigTimeoutTime_BCM" SG_ 525 Pitch_RMSE 0;
BA_ "GenSigTimeoutTime_BSM" SG_ 525 Pitch_RMSE 0;
BA_ "GenSigTimeoutTime_DMSM" SG_ 525 Pitch_RMSE 0;
BA_ "GenSigTimeoutTime_DTCM" SG_ 525 Pitch_RMSE 0;
BA_ "GenSigTimeoutTime_ECM" SG_ 525 Pitch_RMSE 0;
BA_ "GenSigTimeoutTime_EVCU2" SG_ 525 Pitch_RMSE 0;
BA_ "GenSigTimeoutTime_GNMM" SG_ 525 Pitch_RMSE 0;
BA_ "GenSigTimeoutTime_HCP" SG_ 525 Pitch_RMSE 0;
BA_ "GenSigTimeoutTime_IPC" SG_ 525 Pitch_RMSE 0;
BA_ "GenSigTimeoutTime_RFHM" SG_ 525 Pitch_RMSE 0;
BA_ "GenSigTimeoutTime_SGW" SG_ 525 Pitch_RMSE 0;
BA_ "GenSigTimeoutTime_TCM" SG_ 525 Pitch_RMSE 0;
BA_ "GenSigStartValue" SG_ 525 PitchRate_GNMM 4095;
BA_ "GenSigTimeoutTime_AGSM" SG_ 525 PitchRate_GNMM 0;
BA_ "GenSigTimeoutTime_BCM" SG_ 525 PitchRate_GNMM 0;
BA_ "GenSigTimeoutTime_BSM" SG_ 525 PitchRate_GNMM 0;
BA_ "GenSigTimeoutTime_DMSM" SG_ 525 PitchRate_GNMM 0;
BA_ "GenSigTimeoutTime_DTCM" SG_ 525 PitchRate_GNMM 0;
BA_ "GenSigTimeoutTime_ECM" SG_ 525 PitchRate_GNMM 0;
BA_ "GenSigTimeoutTime_EVCU2" SG_ 525 PitchRate_GNMM 0;
BA_ "GenSigTimeoutTime_GNMM" SG_ 525 PitchRate_GNMM 0;
BA_ "GenSigTimeoutTime_HCP" SG_ 525 PitchRate_GNMM 0;
BA_ "GenSigTimeoutTime_IPC" SG_ 525 PitchRate_GNMM 0;
BA_ "GenSigTimeoutTime_RFHM" SG_ 525 PitchRate_GNMM 0;
BA_ "GenSigTimeoutTime_SGW" SG_ 525 PitchRate_GNMM 0;
BA_ "GenSigTimeoutTime_TCM" SG_ 525 PitchRate_GNMM 0;
BA_ "GenSigStartValue" SG_ 525 Roll_RMSE 255;
BA_ "GenSigTimeoutTime_AGSM" SG_ 525 Roll_RMSE 0;
BA_ "GenSigTimeoutTime_BCM" SG_ 525 Roll_RMSE 0;
BA_ "GenSigTimeoutTime_BSM" SG_ 525 Roll_RMSE 0;
BA_ "GenSigTimeoutTime_DMSM" SG_ 525 Roll_RMSE 0;
BA_ "GenSigTimeoutTime_DTCM" SG_ 525 Roll_RMSE 0;
BA_ "GenSigTimeoutTime_ECM" SG_ 525 Roll_RMSE 0;
BA_ "GenSigTimeoutTime_EVCU2" SG_ 525 Roll_RMSE 0;
BA_ "GenSigTimeoutTime_GNMM" SG_ 525 Roll_RMSE 0;
BA_ "GenSigTimeoutTime_HCP" SG_ 525 Roll_RMSE 0;
BA_ "GenSigTimeoutTime_IPC" SG_ 525 Roll_RMSE 0;
BA_ "GenSigTimeoutTime_RFHM" SG_ 525 Roll_RMSE 0;
BA_ "GenSigTimeoutTime_SGW" SG_ 525 Roll_RMSE 0;
BA_ "GenSigTimeoutTime_TCM" SG_ 525 Roll_RMSE 0;
BA_ "GenSigStartValue" SG_ 525 RollRate_GNMM 4095;
BA_ "GenSigTimeoutTime_AGSM" SG_ 525 RollRate_GNMM 0;
BA_ "GenSigTimeoutTime_BCM" SG_ 525 RollRate_GNMM 0;
BA_ "GenSigTimeoutTime_BSM" SG_ 525 RollRate_GNMM 0;
BA_ "GenSigTimeoutTime_DMSM" SG_ 525 RollRate_GNMM 0;
BA_ "GenSigTimeoutTime_DTCM" SG_ 525 RollRate_GNMM 0;
BA_ "GenSigTimeoutTime_ECM" SG_ 525 RollRate_GNMM 0;
BA_ "GenSigTimeoutTime_EVCU2" SG_ 525 RollRate_GNMM 0;
BA_ "GenSigTimeoutTime_GNMM" SG_ 525 RollRate_GNMM 0;
BA_ "GenSigTimeoutTime_HCP" SG_ 525 RollRate_GNMM 0;
BA_ "GenSigTimeoutTime_IPC" SG_ 525 RollRate_GNMM 0;
BA_ "GenSigTimeoutTime_RFHM" SG_ 525 RollRate_GNMM 0;
BA_ "GenSigTimeoutTime_SGW" SG_ 525 RollRate_GNMM 0;
BA_ "GenSigTimeoutTime_TCM" SG_ 525 RollRate_GNMM 0;
BA_ "GenSigStartValue" SG_ 525 VerticalAcceleration_GNMM 4095;
BA_ "GenSigTimeoutTime_AGSM" SG_ 525 VerticalAcceleration_GNMM 0;
BA_ "GenSigTimeoutTime_BCM" SG_ 525 VerticalAcceleration_GNMM 0;
BA_ "GenSigTimeoutTime_BSM" SG_ 525 VerticalAcceleration_GNMM 0;
BA_ "GenSigTimeoutTime_DMSM" SG_ 525 VerticalAcceleration_GNMM 0;
BA_ "GenSigTimeoutTime_DTCM" SG_ 525 VerticalAcceleration_GNMM 0;
BA_ "GenSigTimeoutTime_ECM" SG_ 525 VerticalAcceleration_GNMM 0;
BA_ "GenSigTimeoutTime_EVCU2" SG_ 525 VerticalAcceleration_GNMM 0;
BA_ "GenSigTimeoutTime_GNMM" SG_ 525 VerticalAcceleration_GNMM 0;
BA_ "GenSigTimeoutTime_HCP" SG_ 525 VerticalAcceleration_GNMM 0;
BA_ "GenSigTimeoutTime_IPC" SG_ 525 VerticalAcceleration_GNMM 0;
BA_ "GenSigTimeoutTime_RFHM" SG_ 525 VerticalAcceleration_GNMM 0;
BA_ "GenSigTimeoutTime_SGW" SG_ 525 VerticalAcceleration_GNMM 0;
BA_ "GenSigTimeoutTime_TCM" SG_ 525 VerticalAcceleration_GNMM 0;
BA_ "GenSigStartValue" SG_ 525 VerticalVelocity_GNMM 16383;
BA_ "GenSigTimeoutTime_AGSM" SG_ 525 VerticalVelocity_GNMM 0;
BA_ "GenSigTimeoutTime_BCM" SG_ 525 VerticalVelocity_GNMM 0;
BA_ "GenSigTimeoutTime_BSM" SG_ 525 VerticalVelocity_GNMM 0;
BA_ "GenSigTimeoutTime_DMSM" SG_ 525 VerticalVelocity_GNMM 0;
BA_ "GenSigTimeoutTime_DTCM" SG_ 525 VerticalVelocity_GNMM 0;
BA_ "GenSigTimeoutTime_ECM" SG_ 525 VerticalVelocity_GNMM 0;
BA_ "GenSigTimeoutTime_EVCU2" SG_ 525 VerticalVelocity_GNMM 0;
BA_ "GenSigTimeoutTime_GNMM" SG_ 525 VerticalVelocity_GNMM 0;
BA_ "GenSigTimeoutTime_HCP" SG_ 525 VerticalVelocity_GNMM 0;
BA_ "GenSigTimeoutTime_IPC" SG_ 525 VerticalVelocity_GNMM 0;
BA_ "GenSigTimeoutTime_RFHM" SG_ 525 VerticalVelocity_GNMM 0;
BA_ "GenSigTimeoutTime_SGW" SG_ 525 VerticalVelocity_GNMM 0;
BA_ "GenSigTimeoutTime_TCM" SG_ 525 VerticalVelocity_GNMM 0;
BA_ "GenSigStartValue" SG_ 525 YawRate_GNMM 32767;
BA_ "GenSigTimeoutTime_AGSM" SG_ 525 YawRate_GNMM 0;
BA_ "GenSigTimeoutTime_BCM" SG_ 525 YawRate_GNMM 0;
BA_ "GenSigTimeoutTime_BSM" SG_ 525 YawRate_GNMM 0;
BA_ "GenSigTimeoutTime_DMSM" SG_ 525 YawRate_GNMM 0;
BA_ "GenSigTimeoutTime_DTCM" SG_ 525 YawRate_GNMM 0;
BA_ "GenSigTimeoutTime_ECM" SG_ 525 YawRate_GNMM 0;
BA_ "GenSigTimeoutTime_EVCU2" SG_ 525 YawRate_GNMM 0;
BA_ "GenSigTimeoutTime_GNMM" SG_ 525 YawRate_GNMM 0;
BA_ "GenSigTimeoutTime_HCP" SG_ 525 YawRate_GNMM 0;
BA_ "GenSigTimeoutTime_IPC" SG_ 525 YawRate_GNMM 0;
BA_ "GenSigTimeoutTime_RFHM" SG_ 525 YawRate_GNMM 0;
BA_ "GenSigTimeoutTime_SGW" SG_ 525 YawRate_GNMM 0;
BA_ "GenSigTimeoutTime_TCM" SG_ 525 YawRate_GNMM 0;
BA_ "GenSigStartValue" SG_ 525 YawRate_RMSE 255;
BA_ "GenSigTimeoutTime_AGSM" SG_ 525 YawRate_RMSE 0;
BA_ "GenSigTimeoutTime_BCM" SG_ 525 YawRate_RMSE 0;
BA_ "GenSigTimeoutTime_BSM" SG_ 525 YawRate_RMSE 0;
BA_ "GenSigTimeoutTime_DMSM" SG_ 525 YawRate_RMSE 0;
BA_ "GenSigTimeoutTime_DTCM" SG_ 525 YawRate_RMSE 0;
BA_ "GenSigTimeoutTime_ECM" SG_ 525 YawRate_RMSE 0;
BA_ "GenSigTimeoutTime_EVCU2" SG_ 525 YawRate_RMSE 0;
BA_ "GenSigTimeoutTime_GNMM" SG_ 525 YawRate_RMSE 0;
BA_ "GenSigTimeoutTime_HCP" SG_ 525 YawRate_RMSE 0;
BA_ "GenSigTimeoutTime_IPC" SG_ 525 YawRate_RMSE 0;
BA_ "GenSigTimeoutTime_RFHM" SG_ 525 YawRate_RMSE 0;
BA_ "GenSigTimeoutTime_SGW" SG_ 525 YawRate_RMSE 0;
BA_ "GenSigTimeoutTime_TCM" SG_ 525 YawRate_RMSE 0;
BA_ "GenSigTimeoutTime_AGSM" SG_ 1487 Chargeport_Lock_Status 0;
BA_ "GenSigTimeoutTime_BCM" SG_ 1487 Chargeport_Lock_Status 0;
BA_ "GenSigTimeoutTime_BSM" SG_ 1487 Chargeport_Lock_Status 0;
BA_ "GenSigTimeoutTime_CADM" SG_ 1487 Chargeport_Lock_Status 0;
BA_ "GenSigTimeoutTime_DMSM" SG_ 1487 Chargeport_Lock_Status 0;
BA_ "GenSigTimeoutTime_DTCM" SG_ 1487 Chargeport_Lock_Status 0;
BA_ "GenSigTimeoutTime_ECM" SG_ 1487 Chargeport_Lock_Status 0;
BA_ "GenSigTimeoutTime_EVCU2" SG_ 1487 Chargeport_Lock_Status 0;
BA_ "GenSigTimeoutTime_GNMM" SG_ 1487 Chargeport_Lock_Status 0;
BA_ "GenSigTimeoutTime_HCP" SG_ 1487 Chargeport_Lock_Status 0;
BA_ "GenSigTimeoutTime_IPC" SG_ 1487 Chargeport_Lock_Status 0;
BA_ "GenSigTimeoutTime_RFHM" SG_ 1487 Chargeport_Lock_Status 0;
BA_ "GenSigTimeoutTime_TCM" SG_ 1487 Chargeport_Lock_Status 0;
BA_ "GenSigTimeoutTime_AGSM" SG_ 1487 Cooperative_Status 0;
BA_ "GenSigTimeoutTime_BCM" SG_ 1487 Cooperative_Status 0;
BA_ "GenSigTimeoutTime_BSM" SG_ 1487 Cooperative_Status 0;
BA_ "GenSigTimeoutTime_CADM" SG_ 1487 Cooperative_Status 0;
BA_ "GenSigTimeoutTime_DMSM" SG_ 1487 Cooperative_Status 0;
BA_ "GenSigTimeoutTime_DTCM" SG_ 1487 Cooperative_Status 0;
BA_ "GenSigTimeoutTime_ECM" SG_ 1487 Cooperative_Status 0;
BA_ "GenSigTimeoutTime_EVCU2" SG_ 1487 Cooperative_Status 0;
BA_ "GenSigTimeoutTime_GNMM" SG_ 1487 Cooperative_Status 0;
BA_ "GenSigTimeoutTime_HCP" SG_ 1487 Cooperative_Status 0;
BA_ "GenSigTimeoutTime_IPC" SG_ 1487 Cooperative_Status 0;
BA_ "GenSigTimeoutTime_RFHM" SG_ 1487 Cooperative_Status 0;
BA_ "GenSigTimeoutTime_TCM" SG_ 1487 Cooperative_Status 0;
BA_ "GenSigTimeoutTime_AGSM" SG_ 1487 Energy_to_Battery 0;
BA_ "GenSigTimeoutTime_BCM" SG_ 1487 Energy_to_Battery 0;
BA_ "GenSigTimeoutTime_BSM" SG_ 1487 Energy_to_Battery 0;
BA_ "GenSigTimeoutTime_CADM" SG_ 1487 Energy_to_Battery 0;
BA_ "GenSigTimeoutTime_DMSM" SG_ 1487 Energy_to_Battery 0;
BA_ "GenSigTimeoutTime_DTCM" SG_ 1487 Energy_to_Battery 0;
BA_ "GenSigTimeoutTime_ECM" SG_ 1487 Energy_to_Battery 0;
BA_ "GenSigTimeoutTime_EVCU2" SG_ 1487 Energy_to_Battery 0;
BA_ "GenSigTimeoutTime_GNMM" SG_ 1487 Energy_to_Battery 0;
BA_ "GenSigTimeoutTime_HCP" SG_ 1487 Energy_to_Battery 0;
BA_ "GenSigTimeoutTime_IPC" SG_ 1487 Energy_to_Battery 0;
BA_ "GenSigTimeoutTime_RFHM" SG_ 1487 Energy_to_Battery 0;
BA_ "GenSigTimeoutTime_TCM" SG_ 1487 Energy_to_Battery 0;
BA_ "GenSigTimeoutTime_AGSM" SG_ 1487 Est_Range_FullCharge 0;
BA_ "GenSigTimeoutTime_BCM" SG_ 1487 Est_Range_FullCharge 0;
BA_ "GenSigTimeoutTime_BSM" SG_ 1487 Est_Range_FullCharge 0;
BA_ "GenSigTimeoutTime_CADM" SG_ 1487 Est_Range_FullCharge 0;
BA_ "GenSigTimeoutTime_DMSM" SG_ 1487 Est_Range_FullCharge 0;
BA_ "GenSigTimeoutTime_DTCM" SG_ 1487 Est_Range_FullCharge 0;
BA_ "GenSigTimeoutTime_ECM" SG_ 1487 Est_Range_FullCharge 0;
BA_ "GenSigTimeoutTime_EVCU2" SG_ 1487 Est_Range_FullCharge 0;
BA_ "GenSigTimeoutTime_GNMM" SG_ 1487 Est_Range_FullCharge 0;
BA_ "GenSigTimeoutTime_HCP" SG_ 1487 Est_Range_FullCharge 0;
BA_ "GenSigTimeoutTime_IPC" SG_ 1487 Est_Range_FullCharge 0;
BA_ "GenSigTimeoutTime_RFHM" SG_ 1487 Est_Range_FullCharge 0;
BA_ "GenSigTimeoutTime_TCM" SG_ 1487 Est_Range_FullCharge 0;
BA_ "GenSigTimeoutTime_AGSM" SG_ 1487 EV_Charge_Current 0;
BA_ "GenSigTimeoutTime_BCM" SG_ 1487 EV_Charge_Current 0;
BA_ "GenSigTimeoutTime_BSM" SG_ 1487 EV_Charge_Current 0;
BA_ "GenSigTimeoutTime_CADM" SG_ 1487 EV_Charge_Current 0;
BA_ "GenSigTimeoutTime_DMSM" SG_ 1487 EV_Charge_Current 0;
BA_ "GenSigTimeoutTime_DTCM" SG_ 1487 EV_Charge_Current 0;
BA_ "GenSigTimeoutTime_ECM" SG_ 1487 EV_Charge_Current 0;
BA_ "GenSigTimeoutTime_EVCU2" SG_ 1487 EV_Charge_Current 0;
BA_ "GenSigTimeoutTime_GNMM" SG_ 1487 EV_Charge_Current 0;
BA_ "GenSigTimeoutTime_HCP" SG_ 1487 EV_Charge_Current 0;
BA_ "GenSigTimeoutTime_IPC" SG_ 1487 EV_Charge_Current 0;
BA_ "GenSigTimeoutTime_RFHM" SG_ 1487 EV_Charge_Current 0;
BA_ "GenSigTimeoutTime_TCM" SG_ 1487 EV_Charge_Current 0;
BA_ "GenSigTimeoutTime_AGSM" SG_ 1487 EVSE_Power 0;
BA_ "GenSigTimeoutTime_BCM" SG_ 1487 EVSE_Power 0;
BA_ "GenSigTimeoutTime_BSM" SG_ 1487 EVSE_Power 0;
BA_ "GenSigTimeoutTime_CADM" SG_ 1487 EVSE_Power 0;
BA_ "GenSigTimeoutTime_DMSM" SG_ 1487 EVSE_Power 0;
BA_ "GenSigTimeoutTime_DTCM" SG_ 1487 EVSE_Power 0;
BA_ "GenSigTimeoutTime_ECM" SG_ 1487 EVSE_Power 0;
BA_ "GenSigTimeoutTime_EVCU2" SG_ 1487 EVSE_Power 0;
BA_ "GenSigTimeoutTime_GNMM" SG_ 1487 EVSE_Power 0;
BA_ "GenSigTimeoutTime_HCP" SG_ 1487 EVSE_Power 0;
BA_ "GenSigTimeoutTime_IPC" SG_ 1487 EVSE_Power 0;
BA_ "GenSigTimeoutTime_RFHM" SG_ 1487 EVSE_Power 0;
BA_ "GenSigTimeoutTime_TCM" SG_ 1487 EVSE_Power 0;
BA_ "GenSigTimeoutTime_AGSM" SG_ 1487 Lv1_EstChargeTime_80 0;
BA_ "GenSigTimeoutTime_BCM" SG_ 1487 Lv1_EstChargeTime_80 0;
BA_ "GenSigTimeoutTime_BSM" SG_ 1487 Lv1_EstChargeTime_80 0;
BA_ "GenSigTimeoutTime_CADM" SG_ 1487 Lv1_EstChargeTime_80 0;
BA_ "GenSigTimeoutTime_DMSM" SG_ 1487 Lv1_EstChargeTime_80 0;
BA_ "GenSigTimeoutTime_DTCM" SG_ 1487 Lv1_EstChargeTime_80 0;
BA_ "GenSigTimeoutTime_ECM" SG_ 1487 Lv1_EstChargeTime_80 0;
BA_ "GenSigTimeoutTime_EVCU2" SG_ 1487 Lv1_EstChargeTime_80 0;
BA_ "GenSigTimeoutTime_GNMM" SG_ 1487 Lv1_EstChargeTime_80 0;
BA_ "GenSigTimeoutTime_HCP" SG_ 1487 Lv1_EstChargeTime_80 0;
BA_ "GenSigTimeoutTime_IPC" SG_ 1487 Lv1_EstChargeTime_80 0;
BA_ "GenSigTimeoutTime_RFHM" SG_ 1487 Lv1_EstChargeTime_80 0;
BA_ "GenSigTimeoutTime_TCM" SG_ 1487 Lv1_EstChargeTime_80 0;
BA_ "GenSigTimeoutTime_AGSM" SG_ 1487 Lv2_EstChargeTime_80 0;
BA_ "GenSigTimeoutTime_BCM" SG_ 1487 Lv2_EstChargeTime_80 0;
BA_ "GenSigTimeoutTime_BSM" SG_ 1487 Lv2_EstChargeTime_80 0;
BA_ "GenSigTimeoutTime_CADM" SG_ 1487 Lv2_EstChargeTime_80 0;
BA_ "GenSigTimeoutTime_DMSM" SG_ 1487 Lv2_EstChargeTime_80 0;
BA_ "GenSigTimeoutTime_DTCM" SG_ 1487 Lv2_EstChargeTime_80 0;
BA_ "GenSigTimeoutTime_ECM" SG_ 1487 Lv2_EstChargeTime_80 0;
BA_ "GenSigTimeoutTime_EVCU2" SG_ 1487 Lv2_EstChargeTime_80 0;
BA_ "GenSigTimeoutTime_GNMM" SG_ 1487 Lv2_EstChargeTime_80 0;
BA_ "GenSigTimeoutTime_HCP" SG_ 1487 Lv2_EstChargeTime_80 0;
BA_ "GenSigTimeoutTime_IPC" SG_ 1487 Lv2_EstChargeTime_80 0;
BA_ "GenSigTimeoutTime_RFHM" SG_ 1487 Lv2_EstChargeTime_80 0;
BA_ "GenSigTimeoutTime_TCM" SG_ 1487 Lv2_EstChargeTime_80 0;
BA_ "GenSigTimeoutTime_AGSM" SG_ 1487 Total_Battery_Capacity 0;
BA_ "GenSigTimeoutTime_BCM" SG_ 1487 Total_Battery_Capacity 0;
BA_ "GenSigTimeoutTime_BSM" SG_ 1487 Total_Battery_Capacity 0;
BA_ "GenSigTimeoutTime_CADM" SG_ 1487 Total_Battery_Capacity 0;
BA_ "GenSigTimeoutTime_DMSM" SG_ 1487 Total_Battery_Capacity 0;
BA_ "GenSigTimeoutTime_DTCM" SG_ 1487 Total_Battery_Capacity 0;
BA_ "GenSigTimeoutTime_ECM" SG_ 1487 Total_Battery_Capacity 0;
BA_ "GenSigTimeoutTime_EVCU2" SG_ 1487 Total_Battery_Capacity 0;
BA_ "GenSigTimeoutTime_GNMM" SG_ 1487 Total_Battery_Capacity 0;
BA_ "GenSigTimeoutTime_HCP" SG_ 1487 Total_Battery_Capacity 0;
BA_ "GenSigTimeoutTime_IPC" SG_ 1487 Total_Battery_Capacity 0;
BA_ "GenSigTimeoutTime_RFHM" SG_ 1487 Total_Battery_Capacity 0;
BA_ "GenSigTimeoutTime_TCM" SG_ 1487 Total_Battery_Capacity 0;
BA_ "GenSigTimeoutTime_AGSM" SG_ 266 HVBatCellVoltage_Max 0;
BA_ "GenSigTimeoutTime_BCM" SG_ 266 HVBatCellVoltage_Max 0;
BA_ "GenSigTimeoutTime_BSM" SG_ 266 HVBatCellVoltage_Max 0;
BA_ "GenSigTimeoutTime_CADM" SG_ 266 HVBatCellVoltage_Max 0;
BA_ "GenSigTimeoutTime_DMSM" SG_ 266 HVBatCellVoltage_Max 0;
BA_ "GenSigTimeoutTime_DTCM" SG_ 266 HVBatCellVoltage_Max 0;
BA_ "GenSigTimeoutTime_ECM" SG_ 266 HVBatCellVoltage_Max 0;
BA_ "GenSigTimeoutTime_EVCU2" SG_ 266 HVBatCellVoltage_Max 0;
BA_ "GenSigTimeoutTime_GNMM" SG_ 266 HVBatCellVoltage_Max 0;
BA_ "GenSigTimeoutTime_HCP" SG_ 266 HVBatCellVoltage_Max 0;
BA_ "GenSigTimeoutTime_IPC" SG_ 266 HVBatCellVoltage_Max 0;
BA_ "GenSigTimeoutTime_RFHM" SG_ 266 HVBatCellVoltage_Max 0;
BA_ "GenSigTimeoutTime_TCM" SG_ 266 HVBatCellVoltage_Max 0;
BA_ "GenSigTimeoutTime_AGSM" SG_ 266 HVBatCellVoltage_Min 0;
BA_ "GenSigTimeoutTime_BCM" SG_ 266 HVBatCellVoltage_Min 0;
BA_ "GenSigTimeoutTime_BSM" SG_ 266 HVBatCellVoltage_Min 0;
BA_ "GenSigTimeoutTime_CADM" SG_ 266 HVBatCellVoltage_Min 0;
BA_ "GenSigTimeoutTime_DMSM" SG_ 266 HVBatCellVoltage_Min 0;
BA_ "GenSigTimeoutTime_DTCM" SG_ 266 HVBatCellVoltage_Min 0;
BA_ "GenSigTimeoutTime_ECM" SG_ 266 HVBatCellVoltage_Min 0;
BA_ "GenSigTimeoutTime_EVCU2" SG_ 266 HVBatCellVoltage_Min 0;
BA_ "GenSigTimeoutTime_GNMM" SG_ 266 HVBatCellVoltage_Min 0;
BA_ "GenSigTimeoutTime_HCP" SG_ 266 HVBatCellVoltage_Min 0;
BA_ "GenSigTimeoutTime_IPC" SG_ 266 HVBatCellVoltage_Min 0;
BA_ "GenSigTimeoutTime_RFHM" SG_ 266 HVBatCellVoltage_Min 0;
BA_ "GenSigTimeoutTime_TCM" SG_ 266 HVBatCellVoltage_Min 0;
BA_ "GenSigTimeoutTime_AGSM" SG_ 266 HVBatCellVoltage_NumMax 0;
BA_ "GenSigTimeoutTime_BCM" SG_ 266 HVBatCellVoltage_NumMax 0;
BA_ "GenSigTimeoutTime_BSM" SG_ 266 HVBatCellVoltage_NumMax 0;
BA_ "GenSigTimeoutTime_CADM" SG_ 266 HVBatCellVoltage_NumMax 0;
BA_ "GenSigTimeoutTime_DMSM" SG_ 266 HVBatCellVoltage_NumMax 0;
BA_ "GenSigTimeoutTime_DTCM" SG_ 266 HVBatCellVoltage_NumMax 0;
BA_ "GenSigTimeoutTime_ECM" SG_ 266 HVBatCellVoltage_NumMax 0;
BA_ "GenSigTimeoutTime_EVCU2" SG_ 266 HVBatCellVoltage_NumMax 0;
BA_ "GenSigTimeoutTime_GNMM" SG_ 266 HVBatCellVoltage_NumMax 0;
BA_ "GenSigTimeoutTime_HCP" SG_ 266 HVBatCellVoltage_NumMax 0;
BA_ "GenSigTimeoutTime_IPC" SG_ 266 HVBatCellVoltage_NumMax 0;
BA_ "GenSigTimeoutTime_RFHM" SG_ 266 HVBatCellVoltage_NumMax 0;
BA_ "GenSigTimeoutTime_TCM" SG_ 266 HVBatCellVoltage_NumMax 0;
BA_ "GenSigTimeoutTime_AGSM" SG_ 266 HVBatContactorSts 0;
BA_ "GenSigTimeoutTime_BSM" SG_ 266 HVBatContactorSts 0;
BA_ "GenSigTimeoutTime_CADM" SG_ 266 HVBatContactorSts 0;
BA_ "GenSigTimeoutTime_DMSM" SG_ 266 HVBatContactorSts 0;
BA_ "GenSigTimeoutTime_DTCM" SG_ 266 HVBatContactorSts 0;
BA_ "GenSigTimeoutTime_ECM" SG_ 266 HVBatContactorSts 0;
BA_ "GenSigTimeoutTime_EVCU2" SG_ 266 HVBatContactorSts 0;
BA_ "GenSigTimeoutTime_GNMM" SG_ 266 HVBatContactorSts 0;
BA_ "GenSigTimeoutTime_HCP" SG_ 266 HVBatContactorSts 0;
BA_ "GenSigTimeoutTime_IPC" SG_ 266 HVBatContactorSts 0;
BA_ "GenSigTimeoutTime_RFHM" SG_ 266 HVBatContactorSts 0;
BA_ "GenSigTimeoutTime_SGW" SG_ 266 HVBatContactorSts 0;
BA_ "GenSigTimeoutTime_TCM" SG_ 266 HVBatContactorSts 0;
BA_ "GenSigTimeoutTime_AGSM" SG_ 266 HVBatModuleVoltage_NumMax 0;
BA_ "GenSigTimeoutTime_BCM" SG_ 266 HVBatModuleVoltage_NumMax 0;
BA_ "GenSigTimeoutTime_BSM" SG_ 266 HVBatModuleVoltage_NumMax 0;
BA_ "GenSigTimeoutTime_CADM" SG_ 266 HVBatModuleVoltage_NumMax 0;
BA_ "GenSigTimeoutTime_DMSM" SG_ 266 HVBatModuleVoltage_NumMax 0;
BA_ "GenSigTimeoutTime_DTCM" SG_ 266 HVBatModuleVoltage_NumMax 0;
BA_ "GenSigTimeoutTime_ECM" SG_ 266 HVBatModuleVoltage_NumMax 0;
BA_ "GenSigTimeoutTime_EVCU2" SG_ 266 HVBatModuleVoltage_NumMax 0;
BA_ "GenSigTimeoutTime_GNMM" SG_ 266 HVBatModuleVoltage_NumMax 0;
BA_ "GenSigTimeoutTime_HCP" SG_ 266 HVBatModuleVoltage_NumMax 0;
BA_ "GenSigTimeoutTime_IPC" SG_ 266 HVBatModuleVoltage_NumMax 0;
BA_ "GenSigTimeoutTime_RFHM" SG_ 266 HVBatModuleVoltage_NumMax 0;
BA_ "GenSigTimeoutTime_TCM" SG_ 266 HVBatModuleVoltage_NumMax 0;
BA_ "GenSigTimeoutTime_AGSM" SG_ 266 HVBatModuleVoltage_NumMin 0;
BA_ "GenSigTimeoutTime_BCM" SG_ 266 HVBatModuleVoltage_NumMin 0;
BA_ "GenSigTimeoutTime_BSM" SG_ 266 HVBatModuleVoltage_NumMin 0;
BA_ "GenSigTimeoutTime_CADM" SG_ 266 HVBatModuleVoltage_NumMin 0;
BA_ "GenSigTimeoutTime_DMSM" SG_ 266 HVBatModuleVoltage_NumMin 0;
BA_ "GenSigTimeoutTime_DTCM" SG_ 266 HVBatModuleVoltage_NumMin 0;
BA_ "GenSigTimeoutTime_ECM" SG_ 266 HVBatModuleVoltage_NumMin 0;
BA_ "GenSigTimeoutTime_EVCU2" SG_ 266 HVBatModuleVoltage_NumMin 0;
BA_ "GenSigTimeoutTime_GNMM" SG_ 266 HVBatModuleVoltage_NumMin 0;
BA_ "GenSigTimeoutTime_HCP" SG_ 266 HVBatModuleVoltage_NumMin 0;
BA_ "GenSigTimeoutTime_IPC" SG_ 266 HVBatModuleVoltage_NumMin 0;
BA_ "GenSigTimeoutTime_RFHM" SG_ 266 HVBatModuleVoltage_NumMin 0;
BA_ "GenSigTimeoutTime_TCM" SG_ 266 HVBatModuleVoltage_NumMin 0;
BA_ "GenSigTimeoutTime_AGSM" SG_ 266 HVBatteryCurrent 0;
BA_ "GenSigTimeoutTime_BCM" SG_ 266 HVBatteryCurrent 0;
BA_ "GenSigTimeoutTime_BSM" SG_ 266 HVBatteryCurrent 0;
BA_ "GenSigTimeoutTime_CADM" SG_ 266 HVBatteryCurrent 0;
BA_ "GenSigTimeoutTime_DMSM" SG_ 266 HVBatteryCurrent 0;
BA_ "GenSigTimeoutTime_DTCM" SG_ 266 HVBatteryCurrent 0;
BA_ "GenSigTimeoutTime_EVCU2" SG_ 266 HVBatteryCurrent 0;
BA_ "GenSigTimeoutTime_GNMM" SG_ 266 HVBatteryCurrent 0;
BA_ "GenSigTimeoutTime_HCP" SG_ 266 HVBatteryCurrent 0;
BA_ "GenSigTimeoutTime_IPC" SG_ 266 HVBatteryCurrent 0;
BA_ "GenSigTimeoutTime_RFHM" SG_ 266 HVBatteryCurrent 0;
BA_ "GenSigTimeoutTime_TCM" SG_ 266 HVBatteryCurrent 0;
BA_ "GenSigTimeoutTime_AGSM" SG_ 266 HVBatteryVoltage 0;
BA_ "GenSigTimeoutTime_BCM" SG_ 266 HVBatteryVoltage 0;
BA_ "GenSigTimeoutTime_BSM" SG_ 266 HVBatteryVoltage 0;
BA_ "GenSigTimeoutTime_CADM" SG_ 266 HVBatteryVoltage 0;
BA_ "GenSigTimeoutTime_DMSM" SG_ 266 HVBatteryVoltage 0;
BA_ "GenSigTimeoutTime_DTCM" SG_ 266 HVBatteryVoltage 0;
BA_ "GenSigTimeoutTime_ECM" SG_ 266 HVBatteryVoltage 0;
BA_ "GenSigTimeoutTime_EVCU2" SG_ 266 HVBatteryVoltage 0;
BA_ "GenSigTimeoutTime_GNMM" SG_ 266 HVBatteryVoltage 0;
BA_ "GenSigTimeoutTime_HCP" SG_ 266 HVBatteryVoltage 0;
BA_ "GenSigTimeoutTime_IPC" SG_ 266 HVBatteryVoltage 0;
BA_ "GenSigTimeoutTime_RFHM" SG_ 266 HVBatteryVoltage 0;
BA_ "GenSigTimeoutTime_TCM" SG_ 266 HVBatteryVoltage 0;
BA_ "GenSigTimeoutTime_AGSM" SG_ 266 IsolationSts_HVBattery 0;
BA_ "GenSigTimeoutTime_BCM" SG_ 266 IsolationSts_HVBattery 0;
BA_ "GenSigTimeoutTime_BSM" SG_ 266 IsolationSts_HVBattery 0;
BA_ "GenSigTimeoutTime_CADM" SG_ 266 IsolationSts_HVBattery 0;
BA_ "GenSigTimeoutTime_DMSM" SG_ 266 IsolationSts_HVBattery 0;
BA_ "GenSigTimeoutTime_DTCM" SG_ 266 IsolationSts_HVBattery 0;
BA_ "GenSigTimeoutTime_ECM" SG_ 266 IsolationSts_HVBattery 0;
BA_ "GenSigTimeoutTime_EVCU2" SG_ 266 IsolationSts_HVBattery 0;
BA_ "GenSigTimeoutTime_GNMM" SG_ 266 IsolationSts_HVBattery 0;
BA_ "GenSigTimeoutTime_HCP" SG_ 266 IsolationSts_HVBattery 0;
BA_ "GenSigTimeoutTime_IPC" SG_ 266 IsolationSts_HVBattery 0;
BA_ "GenSigTimeoutTime_RFHM" SG_ 266 IsolationSts_HVBattery 0;
BA_ "GenSigTimeoutTime_TCM" SG_ 266 IsolationSts_HVBattery 0;
BA_ "GenSigTimeoutTime_AGSM" SG_ 266 IsolationSts_HVPowertrain 0;
BA_ "GenSigTimeoutTime_BCM" SG_ 266 IsolationSts_HVPowertrain 0;
BA_ "GenSigTimeoutTime_BSM" SG_ 266 IsolationSts_HVPowertrain 0;
BA_ "GenSigTimeoutTime_CADM" SG_ 266 IsolationSts_HVPowertrain 0;
BA_ "GenSigTimeoutTime_DMSM" SG_ 266 IsolationSts_HVPowertrain 0;
BA_ "GenSigTimeoutTime_DTCM" SG_ 266 IsolationSts_HVPowertrain 0;
BA_ "GenSigTimeoutTime_ECM" SG_ 266 IsolationSts_HVPowertrain 0;
BA_ "GenSigTimeoutTime_EVCU2" SG_ 266 IsolationSts_HVPowertrain 0;
BA_ "GenSigTimeoutTime_GNMM" SG_ 266 IsolationSts_HVPowertrain 0;
BA_ "GenSigTimeoutTime_HCP" SG_ 266 IsolationSts_HVPowertrain 0;
BA_ "GenSigTimeoutTime_IPC" SG_ 266 IsolationSts_HVPowertrain 0;
BA_ "GenSigTimeoutTime_RFHM" SG_ 266 IsolationSts_HVPowertrain 0;
BA_ "GenSigTimeoutTime_TCM" SG_ 266 IsolationSts_HVPowertrain 0;
BA_ "GenSigTimeoutTime_AGSM" SG_ 1027 CRC_HVBATTERY2 0;
BA_ "GenSigTimeoutTime_BCM" SG_ 1027 CRC_HVBATTERY2 0;
BA_ "GenSigTimeoutTime_CADM" SG_ 1027 CRC_HVBATTERY2 0;
BA_ "GenSigTimeoutTime_DMSM" SG_ 1027 CRC_HVBATTERY2 0;
BA_ "GenSigTimeoutTime_DTCM" SG_ 1027 CRC_HVBATTERY2 0;
BA_ "GenSigTimeoutTime_ECM" SG_ 1027 CRC_HVBATTERY2 0;
BA_ "GenSigTimeoutTime_EVCU2" SG_ 1027 CRC_HVBATTERY2 0;
BA_ "GenSigTimeoutTime_GNMM" SG_ 1027 CRC_HVBATTERY2 0;
BA_ "GenSigTimeoutTime_HCP" SG_ 1027 CRC_HVBATTERY2 0;
BA_ "GenSigTimeoutTime_RFHM" SG_ 1027 CRC_HVBATTERY2 0;
BA_ "GenSigTimeoutTime_SGW" SG_ 1027 CRC_HVBATTERY2 0;
BA_ "GenSigTimeoutTime_TCM" SG_ 1027 CRC_HVBATTERY2 0;
BA_ "GenSigTimeoutTime_AGSM" SG_ 1027 HVBatteryMILRequest 0;
BA_ "GenSigTimeoutTime_BCM" SG_ 1027 HVBatteryMILRequest 0;
BA_ "GenSigTimeoutTime_BSM" SG_ 1027 HVBatteryMILRequest 0;
BA_ "GenSigTimeoutTime_CADM" SG_ 1027 HVBatteryMILRequest 0;
BA_ "GenSigTimeoutTime_DMSM" SG_ 1027 HVBatteryMILRequest 0;
BA_ "GenSigTimeoutTime_DTCM" SG_ 1027 HVBatteryMILRequest 0;
BA_ "GenSigTimeoutTime_EVCU2" SG_ 1027 HVBatteryMILRequest 0;
BA_ "GenSigTimeoutTime_GNMM" SG_ 1027 HVBatteryMILRequest 0;
BA_ "GenSigTimeoutTime_HCP" SG_ 1027 HVBatteryMILRequest 0;
BA_ "GenSigTimeoutTime_RFHM" SG_ 1027 HVBatteryMILRequest 0;
BA_ "GenSigTimeoutTime_TCM" SG_ 1027 HVBatteryMILRequest 0;
BA_ "GenSigTimeoutTime_AGSM" SG_ 1027 MessageCounter_HVBATTERY2 0;
BA_ "GenSigTimeoutTime_BCM" SG_ 1027 MessageCounter_HVBATTERY2 0;
BA_ "GenSigTimeoutTime_CADM" SG_ 1027 MessageCounter_HVBATTERY2 0;
BA_ "GenSigTimeoutTime_DMSM" SG_ 1027 MessageCounter_HVBATTERY2 0;
BA_ "GenSigTimeoutTime_DTCM" SG_ 1027 MessageCounter_HVBATTERY2 0;
BA_ "GenSigTimeoutTime_ECM" SG_ 1027 MessageCounter_HVBATTERY2 0;
BA_ "GenSigTimeoutTime_EVCU2" SG_ 1027 MessageCounter_HVBATTERY2 0;
BA_ "GenSigTimeoutTime_GNMM" SG_ 1027 MessageCounter_HVBATTERY2 0;
BA_ "GenSigTimeoutTime_HCP" SG_ 1027 MessageCounter_HVBATTERY2 0;
BA_ "GenSigTimeoutTime_RFHM" SG_ 1027 MessageCounter_HVBATTERY2 0;
BA_ "GenSigTimeoutTime_SGW" SG_ 1027 MessageCounter_HVBATTERY2 0;
BA_ "GenSigTimeoutTime_TCM" SG_ 1027 MessageCounter_HVBATTERY2 0;
BA_ "GenSigTimeoutTime_AGSM" SG_ 1834 HVBattery_RealTimeClock 0;
BA_ "GenSigTimeoutTime_BCM" SG_ 1834 HVBattery_RealTimeClock 0;
BA_ "GenSigTimeoutTime_BSM" SG_ 1834 HVBattery_RealTimeClock 0;
BA_ "GenSigTimeoutTime_CADM" SG_ 1834 HVBattery_RealTimeClock 0;
BA_ "GenSigTimeoutTime_DMSM" SG_ 1834 HVBattery_RealTimeClock 0;
BA_ "GenSigTimeoutTime_DTCM" SG_ 1834 HVBattery_RealTimeClock 0;
BA_ "GenSigTimeoutTime_EVCU2" SG_ 1834 HVBattery_RealTimeClock 0;
BA_ "GenSigTimeoutTime_GNMM" SG_ 1834 HVBattery_RealTimeClock 0;
BA_ "GenSigTimeoutTime_HCP" SG_ 1834 HVBattery_RealTimeClock 0;
BA_ "GenSigTimeoutTime_IPC" SG_ 1834 HVBattery_RealTimeClock 0;
BA_ "GenSigTimeoutTime_RFHM" SG_ 1834 HVBattery_RealTimeClock 0;
BA_ "GenSigTimeoutTime_SGW" SG_ 1834 HVBattery_RealTimeClock 0;
BA_ "GenSigTimeoutTime_TCM" SG_ 1834 HVBattery_RealTimeClock 0;
BA_ "GenSigTimeoutTime_AGSM" SG_ 1834 HVBattery_RealTimeClockV 0;
BA_ "GenSigTimeoutTime_BCM" SG_ 1834 HVBattery_RealTimeClockV 0;
BA_ "GenSigTimeoutTime_BSM" SG_ 1834 HVBattery_RealTimeClockV 0;
BA_ "GenSigTimeoutTime_CADM" SG_ 1834 HVBattery_RealTimeClockV 0;
BA_ "GenSigTimeoutTime_DMSM" SG_ 1834 HVBattery_RealTimeClockV 0;
BA_ "GenSigTimeoutTime_DTCM" SG_ 1834 HVBattery_RealTimeClockV 0;
BA_ "GenSigTimeoutTime_EVCU2" SG_ 1834 HVBattery_RealTimeClockV 0;
BA_ "GenSigTimeoutTime_GNMM" SG_ 1834 HVBattery_RealTimeClockV 0;
BA_ "GenSigTimeoutTime_HCP" SG_ 1834 HVBattery_RealTimeClockV 0;
BA_ "GenSigTimeoutTime_IPC" SG_ 1834 HVBattery_RealTimeClockV 0;
BA_ "GenSigTimeoutTime_RFHM" SG_ 1834 HVBattery_RealTimeClockV 0;
BA_ "GenSigTimeoutTime_SGW" SG_ 1834 HVBattery_RealTimeClockV 0;
BA_ "GenSigTimeoutTime_TCM" SG_ 1834 HVBattery_RealTimeClockV 0;
BA_ "GenSigTimeoutTime_AGSM" SG_ 1049 BatteryPowerUsage 0;
BA_ "GenSigTimeoutTime_BCM" SG_ 1049 BatteryPowerUsage 0;
BA_ "GenSigTimeoutTime_BSM" SG_ 1049 BatteryPowerUsage 0;
BA_ "GenSigTimeoutTime_CADM" SG_ 1049 BatteryPowerUsage 0;
BA_ "GenSigTimeoutTime_DMSM" SG_ 1049 BatteryPowerUsage 0;
BA_ "GenSigTimeoutTime_DTCM" SG_ 1049 BatteryPowerUsage 0;
BA_ "GenSigTimeoutTime_ECM" SG_ 1049 BatteryPowerUsage 0;
BA_ "GenSigTimeoutTime_EVCU2" SG_ 1049 BatteryPowerUsage 0;
BA_ "GenSigTimeoutTime_GNMM" SG_ 1049 BatteryPowerUsage 0;
BA_ "GenSigTimeoutTime_HCP" SG_ 1049 BatteryPowerUsage 0;
BA_ "GenSigTimeoutTime_IPC" SG_ 1049 BatteryPowerUsage 0;
BA_ "GenSigTimeoutTime_RFHM" SG_ 1049 BatteryPowerUsage 0;
BA_ "GenSigTimeoutTime_TCM" SG_ 1049 BatteryPowerUsage 0;
BA_ "GenSigTimeoutTime_AGSM" SG_ 1049 BatteryPowerUsageV 0;
BA_ "GenSigTimeoutTime_BCM" SG_ 1049 BatteryPowerUsageV 0;
BA_ "GenSigTimeoutTime_BSM" SG_ 1049 BatteryPowerUsageV 0;
BA_ "GenSigTimeoutTime_CADM" SG_ 1049 BatteryPowerUsageV 0;
BA_ "GenSigTimeoutTime_DMSM" SG_ 1049 BatteryPowerUsageV 0;
BA_ "GenSigTimeoutTime_DTCM" SG_ 1049 BatteryPowerUsageV 0;
BA_ "GenSigTimeoutTime_ECM" SG_ 1049 BatteryPowerUsageV 0;
BA_ "GenSigTimeoutTime_EVCU2" SG_ 1049 BatteryPowerUsageV 0;
BA_ "GenSigTimeoutTime_GNMM" SG_ 1049 BatteryPowerUsageV 0;
BA_ "GenSigTimeoutTime_HCP" SG_ 1049 BatteryPowerUsageV 0;
BA_ "GenSigTimeoutTime_IPC" SG_ 1049 BatteryPowerUsageV 0;
BA_ "GenSigTimeoutTime_RFHM" SG_ 1049 BatteryPowerUsageV 0;
BA_ "GenSigTimeoutTime_TCM" SG_ 1049 BatteryPowerUsageV 0;
BA_ "GenSigTimeoutTime_AGSM" SG_ 1049 BatteryPowerUse_Display 0;
BA_ "GenSigTimeoutTime_BCM" SG_ 1049 BatteryPowerUse_Display 0;
BA_ "GenSigTimeoutTime_BSM" SG_ 1049 BatteryPowerUse_Display 0;
BA_ "GenSigTimeoutTime_CADM" SG_ 1049 BatteryPowerUse_Display 0;
BA_ "GenSigTimeoutTime_DMSM" SG_ 1049 BatteryPowerUse_Display 0;
BA_ "GenSigTimeoutTime_DTCM" SG_ 1049 BatteryPowerUse_Display 0;
BA_ "GenSigTimeoutTime_ECM" SG_ 1049 BatteryPowerUse_Display 0;
BA_ "GenSigTimeoutTime_EVCU2" SG_ 1049 BatteryPowerUse_Display 0;
BA_ "GenSigTimeoutTime_GNMM" SG_ 1049 BatteryPowerUse_Display 0;
BA_ "GenSigTimeoutTime_HCP" SG_ 1049 BatteryPowerUse_Display 0;
BA_ "GenSigTimeoutTime_IPC" SG_ 1049 BatteryPowerUse_Display 0;
BA_ "GenSigTimeoutTime_RFHM" SG_ 1049 BatteryPowerUse_Display 0;
BA_ "GenSigTimeoutTime_TCM" SG_ 1049 BatteryPowerUse_Display 0;
BA_ "GenSigTimeoutTime_AGSM" SG_ 1049 BatteryPowerUse_DisplayV 0;
BA_ "GenSigTimeoutTime_BCM" SG_ 1049 BatteryPowerUse_DisplayV 0;
BA_ "GenSigTimeoutTime_BSM" SG_ 1049 BatteryPowerUse_DisplayV 0;
BA_ "GenSigTimeoutTime_CADM" SG_ 1049 BatteryPowerUse_DisplayV 0;
BA_ "GenSigTimeoutTime_DMSM" SG_ 1049 BatteryPowerUse_DisplayV 0;
BA_ "GenSigTimeoutTime_DTCM" SG_ 1049 BatteryPowerUse_DisplayV 0;
BA_ "GenSigTimeoutTime_ECM" SG_ 1049 BatteryPowerUse_DisplayV 0;
BA_ "GenSigTimeoutTime_EVCU2" SG_ 1049 BatteryPowerUse_DisplayV 0;
BA_ "GenSigTimeoutTime_GNMM" SG_ 1049 BatteryPowerUse_DisplayV 0;
BA_ "GenSigTimeoutTime_HCP" SG_ 1049 BatteryPowerUse_DisplayV 0;
BA_ "GenSigTimeoutTime_IPC" SG_ 1049 BatteryPowerUse_DisplayV 0;
BA_ "GenSigTimeoutTime_RFHM" SG_ 1049 BatteryPowerUse_DisplayV 0;
BA_ "GenSigTimeoutTime_TCM" SG_ 1049 BatteryPowerUse_DisplayV 0;
BA_ "GenSigTimeoutTime_AGSM" SG_ 1049 ChargeSystemFault_DPT 0;
BA_ "GenSigTimeoutTime_BCM" SG_ 1049 ChargeSystemFault_DPT 0;
BA_ "GenSigTimeoutTime_BSM" SG_ 1049 ChargeSystemFault_DPT 0;
BA_ "GenSigTimeoutTime_CADM" SG_ 1049 ChargeSystemFault_DPT 0;
BA_ "GenSigTimeoutTime_DMSM" SG_ 1049 ChargeSystemFault_DPT 0;
BA_ "GenSigTimeoutTime_DTCM" SG_ 1049 ChargeSystemFault_DPT 0;
BA_ "GenSigTimeoutTime_ECM" SG_ 1049 ChargeSystemFault_DPT 0;
BA_ "GenSigTimeoutTime_EVCU2" SG_ 1049 ChargeSystemFault_DPT 0;
BA_ "GenSigTimeoutTime_GNMM" SG_ 1049 ChargeSystemFault_DPT 0;
BA_ "GenSigTimeoutTime_HCP" SG_ 1049 ChargeSystemFault_DPT 0;
BA_ "GenSigTimeoutTime_RFHM" SG_ 1049 ChargeSystemFault_DPT 0;
BA_ "GenSigTimeoutTime_TCM" SG_ 1049 ChargeSystemFault_DPT 0;
BA_ "GenSigSendType" SG_ 1049 ChargeSystemSts_DPT 3;
BA_ "GenSigTimeoutTime_AGSM" SG_ 1049 ChargeSystemSts_DPT 0;
BA_ "GenSigTimeoutTime_BSM" SG_ 1049 ChargeSystemSts_DPT 0;
BA_ "GenSigTimeoutTime_CADM" SG_ 1049 ChargeSystemSts_DPT 0;
BA_ "GenSigTimeoutTime_DMSM" SG_ 1049 ChargeSystemSts_DPT 0;
BA_ "GenSigTimeoutTime_DTCM" SG_ 1049 ChargeSystemSts_DPT 0;
BA_ "GenSigTimeoutTime_ECM" SG_ 1049 ChargeSystemSts_DPT 0;
BA_ "GenSigTimeoutTime_EVCU2" SG_ 1049 ChargeSystemSts_DPT 0;
BA_ "GenSigTimeoutTime_GNMM" SG_ 1049 ChargeSystemSts_DPT 0;
BA_ "GenSigTimeoutTime_HCP" SG_ 1049 ChargeSystemSts_DPT 0;
BA_ "GenSigTimeoutTime_RFHM" SG_ 1049 ChargeSystemSts_DPT 0;
BA_ "GenSigTimeoutTime_TCM" SG_ 1049 ChargeSystemSts_DPT 0;
BA_ "GenSigTimeoutTime_AGSM" SG_ 1049 ChargingLevelForDisplay 0;
BA_ "GenSigTimeoutTime_BCM" SG_ 1049 ChargingLevelForDisplay 0;
BA_ "GenSigTimeoutTime_BSM" SG_ 1049 ChargingLevelForDisplay 0;
BA_ "GenSigTimeoutTime_CADM" SG_ 1049 ChargingLevelForDisplay 0;
BA_ "GenSigTimeoutTime_DMSM" SG_ 1049 ChargingLevelForDisplay 0;
BA_ "GenSigTimeoutTime_DTCM" SG_ 1049 ChargingLevelForDisplay 0;
BA_ "GenSigTimeoutTime_ECM" SG_ 1049 ChargingLevelForDisplay 0;
BA_ "GenSigTimeoutTime_EVCU2" SG_ 1049 ChargingLevelForDisplay 0;
BA_ "GenSigTimeoutTime_GNMM" SG_ 1049 ChargingLevelForDisplay 0;
BA_ "GenSigTimeoutTime_HCP" SG_ 1049 ChargingLevelForDisplay 0;
BA_ "GenSigTimeoutTime_RFHM" SG_ 1049 ChargingLevelForDisplay 0;
BA_ "GenSigTimeoutTime_TCM" SG_ 1049 ChargingLevelForDisplay 0;
BA_ "GenSigTimeoutTime_AGSM" SG_ 1049 CRC_HYBRID_DISPLAY 0;
BA_ "GenSigTimeoutTime_BSM" SG_ 1049 CRC_HYBRID_DISPLAY 0;
BA_ "GenSigTimeoutTime_DMSM" SG_ 1049 CRC_HYBRID_DISPLAY 0;
BA_ "GenSigTimeoutTime_DTCM" SG_ 1049 CRC_HYBRID_DISPLAY 0;
BA_ "GenSigTimeoutTime_ECM" SG_ 1049 CRC_HYBRID_DISPLAY 0;
BA_ "GenSigTimeoutTime_EVCU2" SG_ 1049 CRC_HYBRID_DISPLAY 0;
BA_ "GenSigTimeoutTime_GNMM" SG_ 1049 CRC_HYBRID_DISPLAY 0;
BA_ "GenSigTimeoutTime_HCP" SG_ 1049 CRC_HYBRID_DISPLAY 0;
BA_ "GenSigTimeoutTime_RFHM" SG_ 1049 CRC_HYBRID_DISPLAY 0;
BA_ "GenSigTimeoutTime_SGW" SG_ 1049 CRC_HYBRID_DISPLAY 0;
BA_ "GenSigTimeoutTime_TCM" SG_ 1049 CRC_HYBRID_DISPLAY 0;
BA_ "GenSigStartValue" SG_ 1049 EstimatedRange 255;
BA_ "GenSigTimeoutTime_AGSM" SG_ 1049 EstimatedRange 0;
BA_ "GenSigTimeoutTime_BCM" SG_ 1049 EstimatedRange 0;
BA_ "GenSigTimeoutTime_BSM" SG_ 1049 EstimatedRange 0;
BA_ "GenSigTimeoutTime_CADM" SG_ 1049 EstimatedRange 0;
BA_ "GenSigTimeoutTime_DMSM" SG_ 1049 EstimatedRange 0;
BA_ "GenSigTimeoutTime_DTCM" SG_ 1049 EstimatedRange 0;
BA_ "GenSigTimeoutTime_ECM" SG_ 1049 EstimatedRange 0;
BA_ "GenSigTimeoutTime_EVCU2" SG_ 1049 EstimatedRange 0;
BA_ "GenSigTimeoutTime_GNMM" SG_ 1049 EstimatedRange 0;
BA_ "GenSigTimeoutTime_HCP" SG_ 1049 EstimatedRange 0;
BA_ "GenSigTimeoutTime_IPC" SG_ 1049 EstimatedRange 0;
BA_ "GenSigTimeoutTime_RFHM" SG_ 1049 EstimatedRange 0;
BA_ "GenSigTimeoutTime_TCM" SG_ 1049 EstimatedRange 0;
BA_ "GenSigTimeoutTime_AGSM" SG_ 1049 FOTA_Schedule_Conflict 0;
BA_ "GenSigTimeoutTime_BCM" SG_ 1049 FOTA_Schedule_Conflict 0;
BA_ "GenSigTimeoutTime_BSM" SG_ 1049 FOTA_Schedule_Conflict 0;
BA_ "GenSigTimeoutTime_CADM" SG_ 1049 FOTA_Schedule_Conflict 0;
BA_ "GenSigTimeoutTime_DMSM" SG_ 1049 FOTA_Schedule_Conflict 0;
BA_ "GenSigTimeoutTime_DTCM" SG_ 1049 FOTA_Schedule_Conflict 0;
BA_ "GenSigTimeoutTime_ECM" SG_ 1049 FOTA_Schedule_Conflict 0;
BA_ "GenSigTimeoutTime_EVCU2" SG_ 1049 FOTA_Schedule_Conflict 0;
BA_ "GenSigTimeoutTime_GNMM" SG_ 1049 FOTA_Schedule_Conflict 0;
BA_ "GenSigTimeoutTime_HCP" SG_ 1049 FOTA_Schedule_Conflict 0;
BA_ "GenSigTimeoutTime_IPC" SG_ 1049 FOTA_Schedule_Conflict 0;
BA_ "GenSigTimeoutTime_RFHM" SG_ 1049 FOTA_Schedule_Conflict 0;
BA_ "GenSigTimeoutTime_TCM" SG_ 1049 FOTA_Schedule_Conflict 0;
BA_ "GenSigTimeoutTime_AGSM" SG_ 1049 HCP_EVServiceLampOn 0;
BA_ "GenSigTimeoutTime_BCM" SG_ 1049 HCP_EVServiceLampOn 0;
BA_ "GenSigTimeoutTime_BSM" SG_ 1049 HCP_EVServiceLampOn 0;
BA_ "GenSigTimeoutTime_CADM" SG_ 1049 HCP_EVServiceLampOn 0;
BA_ "GenSigTimeoutTime_DMSM" SG_ 1049 HCP_EVServiceLampOn 0;
BA_ "GenSigTimeoutTime_DTCM" SG_ 1049 HCP_EVServiceLampOn 0;
BA_ "GenSigTimeoutTime_ECM" SG_ 1049 HCP_EVServiceLampOn 0;
BA_ "GenSigTimeoutTime_EVCU2" SG_ 1049 HCP_EVServiceLampOn 0;
BA_ "GenSigTimeoutTime_GNMM" SG_ 1049 HCP_EVServiceLampOn 0;
BA_ "GenSigTimeoutTime_HCP" SG_ 1049 HCP_EVServiceLampOn 0;
BA_ "GenSigTimeoutTime_RFHM" SG_ 1049 HCP_EVServiceLampOn 0;
BA_ "GenSigTimeoutTime_TCM" SG_ 1049 HCP_EVServiceLampOn 0;
BA_ "GenSigTimeoutTime_AGSM" SG_ 1049 HVACPowerUse_Display 0;
BA_ "GenSigTimeoutTime_BCM" SG_ 1049 HVACPowerUse_Display 0;
BA_ "GenSigTimeoutTime_BSM" SG_ 1049 HVACPowerUse_Display 0;
BA_ "GenSigTimeoutTime_CADM" SG_ 1049 HVACPowerUse_Display 0;
BA_ "GenSigTimeoutTime_DMSM" SG_ 1049 HVACPowerUse_Display 0;
BA_ "GenSigTimeoutTime_DTCM" SG_ 1049 HVACPowerUse_Display 0;
BA_ "GenSigTimeoutTime_ECM" SG_ 1049 HVACPowerUse_Display 0;
BA_ "GenSigTimeoutTime_EVCU2" SG_ 1049 HVACPowerUse_Display 0;
BA_ "GenSigTimeoutTime_GNMM" SG_ 1049 HVACPowerUse_Display 0;
BA_ "GenSigTimeoutTime_HCP" SG_ 1049 HVACPowerUse_Display 0;
BA_ "GenSigTimeoutTime_IPC" SG_ 1049 HVACPowerUse_Display 0;
BA_ "GenSigTimeoutTime_RFHM" SG_ 1049 HVACPowerUse_Display 0;
BA_ "GenSigTimeoutTime_TCM" SG_ 1049 HVACPowerUse_Display 0;
BA_ "GenSigTimeoutTime_AGSM" SG_ 1049 HVACPowerUse_DisplayV 0;
BA_ "GenSigTimeoutTime_BCM" SG_ 1049 HVACPowerUse_DisplayV 0;
BA_ "GenSigTimeoutTime_BSM" SG_ 1049 HVACPowerUse_DisplayV 0;
BA_ "GenSigTimeoutTime_CADM" SG_ 1049 HVACPowerUse_DisplayV 0;
BA_ "GenSigTimeoutTime_DMSM" SG_ 1049 HVACPowerUse_DisplayV 0;
BA_ "GenSigTimeoutTime_DTCM" SG_ 1049 HVACPowerUse_DisplayV 0;
BA_ "GenSigTimeoutTime_ECM" SG_ 1049 HVACPowerUse_DisplayV 0;
BA_ "GenSigTimeoutTime_EVCU2" SG_ 1049 HVACPowerUse_DisplayV 0;
BA_ "GenSigTimeoutTime_GNMM" SG_ 1049 HVACPowerUse_DisplayV 0;
BA_ "GenSigTimeoutTime_HCP" SG_ 1049 HVACPowerUse_DisplayV 0;
BA_ "GenSigTimeoutTime_IPC" SG_ 1049 HVACPowerUse_DisplayV 0;
BA_ "GenSigTimeoutTime_RFHM" SG_ 1049 HVACPowerUse_DisplayV 0;
BA_ "GenSigTimeoutTime_TCM" SG_ 1049 HVACPowerUse_DisplayV 0;
BA_ "GenSigTimeoutTime_AGSM" SG_ 1049 HVBatterySOC_Display 0;
BA_ "GenSigTimeoutTime_BSM" SG_ 1049 HVBatterySOC_Display 0;
BA_ "GenSigTimeoutTime_CADM" SG_ 1049 HVBatterySOC_Display 0;
BA_ "GenSigTimeoutTime_DMSM" SG_ 1049 HVBatterySOC_Display 0;
BA_ "GenSigTimeoutTime_DTCM" SG_ 1049 HVBatterySOC_Display 0;
BA_ "GenSigTimeoutTime_ECM" SG_ 1049 HVBatterySOC_Display 0;
BA_ "GenSigTimeoutTime_EVCU2" SG_ 1049 HVBatterySOC_Display 0;
BA_ "GenSigTimeoutTime_GNMM" SG_ 1049 HVBatterySOC_Display 0;
BA_ "GenSigTimeoutTime_HCP" SG_ 1049 HVBatterySOC_Display 0;
BA_ "GenSigTimeoutTime_RFHM" SG_ 1049 HVBatterySOC_Display 0;
BA_ "GenSigTimeoutTime_TCM" SG_ 1049 HVBatterySOC_Display 0;
BA_ "GenSigTimeoutTime_AGSM" SG_ 1049 HVBatterySOC_DisplayV 0;
BA_ "GenSigTimeoutTime_BCM" SG_ 1049 HVBatterySOC_DisplayV 0;
BA_ "GenSigTimeoutTime_BSM" SG_ 1049 HVBatterySOC_DisplayV 0;
BA_ "GenSigTimeoutTime_CADM" SG_ 1049 HVBatterySOC_DisplayV 0;
BA_ "GenSigTimeoutTime_DMSM" SG_ 1049 HVBatterySOC_DisplayV 0;
BA_ "GenSigTimeoutTime_DTCM" SG_ 1049 HVBatterySOC_DisplayV 0;
BA_ "GenSigTimeoutTime_ECM" SG_ 1049 HVBatterySOC_DisplayV 0;
BA_ "GenSigTimeoutTime_EVCU2" SG_ 1049 HVBatterySOC_DisplayV 0;
BA_ "GenSigTimeoutTime_GNMM" SG_ 1049 HVBatterySOC_DisplayV 0;
BA_ "GenSigTimeoutTime_HCP" SG_ 1049 HVBatterySOC_DisplayV 0;
BA_ "GenSigTimeoutTime_RFHM" SG_ 1049 HVBatterySOC_DisplayV 0;
BA_ "GenSigTimeoutTime_TCM" SG_ 1049 HVBatterySOC_DisplayV 0;
BA_ "GenSigStartValue" SG_ 1049 HybridEfficiencyCoach 64;
BA_ "GenSigTimeoutTime_AGSM" SG_ 1049 HybridEfficiencyCoach 0;
BA_ "GenSigTimeoutTime_BCM" SG_ 1049 HybridEfficiencyCoach 0;
BA_ "GenSigTimeoutTime_BSM" SG_ 1049 HybridEfficiencyCoach 0;
BA_ "GenSigTimeoutTime_CADM" SG_ 1049 HybridEfficiencyCoach 0;
BA_ "GenSigTimeoutTime_DMSM" SG_ 1049 HybridEfficiencyCoach 0;
BA_ "GenSigTimeoutTime_DTCM" SG_ 1049 HybridEfficiencyCoach 0;
BA_ "GenSigTimeoutTime_ECM" SG_ 1049 HybridEfficiencyCoach 0;
BA_ "GenSigTimeoutTime_EVCU2" SG_ 1049 HybridEfficiencyCoach 0;
BA_ "GenSigTimeoutTime_GNMM" SG_ 1049 HybridEfficiencyCoach 0;
BA_ "GenSigTimeoutTime_HCP" SG_ 1049 HybridEfficiencyCoach 0;
BA_ "GenSigTimeoutTime_IPC" SG_ 1049 HybridEfficiencyCoach 0;
BA_ "GenSigTimeoutTime_RFHM" SG_ 1049 HybridEfficiencyCoach 0;
BA_ "GenSigTimeoutTime_TCM" SG_ 1049 HybridEfficiencyCoach 0;
BA_ "GenSigTimeoutTime_AGSM" SG_ 1049 HybridEfficiencyCoachV 0;
BA_ "GenSigTimeoutTime_BCM" SG_ 1049 HybridEfficiencyCoachV 0;
BA_ "GenSigTimeoutTime_BSM" SG_ 1049 HybridEfficiencyCoachV 0;
BA_ "GenSigTimeoutTime_CADM" SG_ 1049 HybridEfficiencyCoachV 0;
BA_ "GenSigTimeoutTime_DMSM" SG_ 1049 HybridEfficiencyCoachV 0;
BA_ "GenSigTimeoutTime_DTCM" SG_ 1049 HybridEfficiencyCoachV 0;
BA_ "GenSigTimeoutTime_ECM" SG_ 1049 HybridEfficiencyCoachV 0;
BA_ "GenSigTimeoutTime_EVCU2" SG_ 1049 HybridEfficiencyCoachV 0;
BA_ "GenSigTimeoutTime_GNMM" SG_ 1049 HybridEfficiencyCoachV 0;
BA_ "GenSigTimeoutTime_HCP" SG_ 1049 HybridEfficiencyCoachV 0;
BA_ "GenSigTimeoutTime_IPC" SG_ 1049 HybridEfficiencyCoachV 0;
BA_ "GenSigTimeoutTime_RFHM" SG_ 1049 HybridEfficiencyCoachV 0;
BA_ "GenSigTimeoutTime_TCM" SG_ 1049 HybridEfficiencyCoachV 0;
BA_ "GenSigTimeoutTime_AGSM" SG_ 1049 HybridMILRequest 0;
BA_ "GenSigTimeoutTime_BCM" SG_ 1049 HybridMILRequest 0;
BA_ "GenSigTimeoutTime_BSM" SG_ 1049 HybridMILRequest 0;
BA_ "GenSigTimeoutTime_CADM" SG_ 1049 HybridMILRequest 0;
BA_ "GenSigTimeoutTime_DMSM" SG_ 1049 HybridMILRequest 0;
BA_ "GenSigTimeoutTime_DTCM" SG_ 1049 HybridMILRequest 0;
BA_ "GenSigTimeoutTime_EVCU2" SG_ 1049 HybridMILRequest 0;
BA_ "GenSigTimeoutTime_GNMM" SG_ 1049 HybridMILRequest 0;
BA_ "GenSigTimeoutTime_HCP" SG_ 1049 HybridMILRequest 0;
BA_ "GenSigTimeoutTime_IPC" SG_ 1049 HybridMILRequest 0;
BA_ "GenSigTimeoutTime_RFHM" SG_ 1049 HybridMILRequest 0;
BA_ "GenSigTimeoutTime_TCM" SG_ 1049 HybridMILRequest 0;
BA_ "GenSigStartValue" SG_ 1049 HybridOutputPower 64;
BA_ "GenSigTimeoutTime_AGSM" SG_ 1049 HybridOutputPower 0;
BA_ "GenSigTimeoutTime_BCM" SG_ 1049 HybridOutputPower 0;
BA_ "GenSigTimeoutTime_BSM" SG_ 1049 HybridOutputPower 0;
BA_ "GenSigTimeoutTime_CADM" SG_ 1049 HybridOutputPower 0;
BA_ "GenSigTimeoutTime_DMSM" SG_ 1049 HybridOutputPower 0;
BA_ "GenSigTimeoutTime_DTCM" SG_ 1049 HybridOutputPower 0;
BA_ "GenSigTimeoutTime_ECM" SG_ 1049 HybridOutputPower 0;
BA_ "GenSigTimeoutTime_EVCU2" SG_ 1049 HybridOutputPower 0;
BA_ "GenSigTimeoutTime_GNMM" SG_ 1049 HybridOutputPower 0;
BA_ "GenSigTimeoutTime_HCP" SG_ 1049 HybridOutputPower 0;
BA_ "GenSigTimeoutTime_RFHM" SG_ 1049 HybridOutputPower 0;
BA_ "GenSigTimeoutTime_TCM" SG_ 1049 HybridOutputPower 0;
BA_ "GenSigTimeoutTime_AGSM" SG_ 1049 HybridOutputPowerV 0;
BA_ "GenSigTimeoutTime_BCM" SG_ 1049 HybridOutputPowerV 0;
BA_ "GenSigTimeoutTime_BSM" SG_ 1049 HybridOutputPowerV 0;
BA_ "GenSigTimeoutTime_CADM" SG_ 1049 HybridOutputPowerV 0;
BA_ "GenSigTimeoutTime_DMSM" SG_ 1049 HybridOutputPowerV 0;
BA_ "GenSigTimeoutTime_DTCM" SG_ 1049 HybridOutputPowerV 0;
BA_ "GenSigTimeoutTime_ECM" SG_ 1049 HybridOutputPowerV 0;
BA_ "GenSigTimeoutTime_EVCU2" SG_ 1049 HybridOutputPowerV 0;
BA_ "GenSigTimeoutTime_GNMM" SG_ 1049 HybridOutputPowerV 0;
BA_ "GenSigTimeoutTime_HCP" SG_ 1049 HybridOutputPowerV 0;
BA_ "GenSigTimeoutTime_RFHM" SG_ 1049 HybridOutputPowerV 0;
BA_ "GenSigTimeoutTime_TCM" SG_ 1049 HybridOutputPowerV 0;
BA_ "GenSigSendType" SG_ 1049 Lv1_EstChargeTime 3;
BA_ "GenSigTimeoutTime_AGSM" SG_ 1049 Lv1_EstChargeTime 0;
BA_ "GenSigTimeoutTime_BCM" SG_ 1049 Lv1_EstChargeTime 0;
BA_ "GenSigTimeoutTime_BSM" SG_ 1049 Lv1_EstChargeTime 0;
BA_ "GenSigTimeoutTime_CADM" SG_ 1049 Lv1_EstChargeTime 0;
BA_ "GenSigTimeoutTime_DMSM" SG_ 1049 Lv1_EstChargeTime 0;
BA_ "GenSigTimeoutTime_DTCM" SG_ 1049 Lv1_EstChargeTime 0;
BA_ "GenSigTimeoutTime_ECM" SG_ 1049 Lv1_EstChargeTime 0;
BA_ "GenSigTimeoutTime_EVCU2" SG_ 1049 Lv1_EstChargeTime 0;
BA_ "GenSigTimeoutTime_GNMM" SG_ 1049 Lv1_EstChargeTime 0;
BA_ "GenSigTimeoutTime_HCP" SG_ 1049 Lv1_EstChargeTime 0;
BA_ "GenSigTimeoutTime_RFHM" SG_ 1049 Lv1_EstChargeTime 0;
BA_ "GenSigTimeoutTime_TCM" SG_ 1049 Lv1_EstChargeTime 0;
BA_ "GenSigSendType" SG_ 1049 Lv2_EstChargeTime 3;
BA_ "GenSigTimeoutTime_AGSM" SG_ 1049 Lv2_EstChargeTime 0;
BA_ "GenSigTimeoutTime_BCM" SG_ 1049 Lv2_EstChargeTime 0;
BA_ "GenSigTimeoutTime_BSM" SG_ 1049 Lv2_EstChargeTime 0;
BA_ "GenSigTimeoutTime_CADM" SG_ 1049 Lv2_EstChargeTime 0;
BA_ "GenSigTimeoutTime_DMSM" SG_ 1049 Lv2_EstChargeTime 0;
BA_ "GenSigTimeoutTime_DTCM" SG_ 1049 Lv2_EstChargeTime 0;
BA_ "GenSigTimeoutTime_ECM" SG_ 1049 Lv2_EstChargeTime 0;
BA_ "GenSigTimeoutTime_EVCU2" SG_ 1049 Lv2_EstChargeTime 0;
BA_ "GenSigTimeoutTime_GNMM" SG_ 1049 Lv2_EstChargeTime 0;
BA_ "GenSigTimeoutTime_HCP" SG_ 1049 Lv2_EstChargeTime 0;
BA_ "GenSigTimeoutTime_RFHM" SG_ 1049 Lv2_EstChargeTime 0;
BA_ "GenSigTimeoutTime_TCM" SG_ 1049 Lv2_EstChargeTime 0;
BA_ "GenSigTimeoutTime_AGSM" SG_ 1049 MessageCounter_HYBRID_DISPLAY 0;
BA_ "GenSigTimeoutTime_BSM" SG_ 1049 MessageCounter_HYBRID_DISPLAY 0;
BA_ "GenSigTimeoutTime_DMSM" SG_ 1049 MessageCounter_HYBRID_DISPLAY 0;
BA_ "GenSigTimeoutTime_DTCM" SG_ 1049 MessageCounter_HYBRID_DISPLAY 0;
BA_ "GenSigTimeoutTime_ECM" SG_ 1049 MessageCounter_HYBRID_DISPLAY 0;
BA_ "GenSigTimeoutTime_EVCU2" SG_ 1049 MessageCounter_HYBRID_DISPLAY 0;
BA_ "GenSigTimeoutTime_GNMM" SG_ 1049 MessageCounter_HYBRID_DISPLAY 0;
BA_ "GenSigTimeoutTime_HCP" SG_ 1049 MessageCounter_HYBRID_DISPLAY 0;
BA_ "GenSigTimeoutTime_RFHM" SG_ 1049 MessageCounter_HYBRID_DISPLAY 0;
BA_ "GenSigTimeoutTime_SGW" SG_ 1049 MessageCounter_HYBRID_DISPLAY 0;
BA_ "GenSigTimeoutTime_TCM" SG_ 1049 MessageCounter_HYBRID_DISPLAY 0;
BA_ "GenSigTimeoutTime_AGSM" SG_ 1049 OnePedal_Drive_Sts 0;
BA_ "GenSigTimeoutTime_BCM" SG_ 1049 OnePedal_Drive_Sts 0;
BA_ "GenSigTimeoutTime_BSM" SG_ 1049 OnePedal_Drive_Sts 0;
BA_ "GenSigTimeoutTime_CADM" SG_ 1049 OnePedal_Drive_Sts 0;
BA_ "GenSigTimeoutTime_DMSM" SG_ 1049 OnePedal_Drive_Sts 0;
BA_ "GenSigTimeoutTime_DTCM" SG_ 1049 OnePedal_Drive_Sts 0;
BA_ "GenSigTimeoutTime_ECM" SG_ 1049 OnePedal_Drive_Sts 0;
BA_ "GenSigTimeoutTime_EVCU2" SG_ 1049 OnePedal_Drive_Sts 0;
BA_ "GenSigTimeoutTime_GNMM" SG_ 1049 OnePedal_Drive_Sts 0;
BA_ "GenSigTimeoutTime_HCP" SG_ 1049 OnePedal_Drive_Sts 0;
BA_ "GenSigTimeoutTime_RFHM" SG_ 1049 OnePedal_Drive_Sts 0;
BA_ "GenSigTimeoutTime_SGW" SG_ 1049 OnePedal_Drive_Sts 0;
BA_ "GenSigTimeoutTime_TCM" SG_ 1049 OnePedal_Drive_Sts 0;
BA_ "GenSigTimeoutTime_AGSM" SG_ 1049 PlugAndChargeSts 0;
BA_ "GenSigTimeoutTime_BCM" SG_ 1049 PlugAndChargeSts 0;
BA_ "GenSigTimeoutTime_BSM" SG_ 1049 PlugAndChargeSts 0;
BA_ "GenSigTimeoutTime_CADM" SG_ 1049 PlugAndChargeSts 0;
BA_ "GenSigTimeoutTime_DMSM" SG_ 1049 PlugAndChargeSts 0;
BA_ "GenSigTimeoutTime_DTCM" SG_ 1049 PlugAndChargeSts 0;
BA_ "GenSigTimeoutTime_ECM" SG_ 1049 PlugAndChargeSts 0;
BA_ "GenSigTimeoutTime_EVCU2" SG_ 1049 PlugAndChargeSts 0;
BA_ "GenSigTimeoutTime_GNMM" SG_ 1049 PlugAndChargeSts 0;
BA_ "GenSigTimeoutTime_HCP" SG_ 1049 PlugAndChargeSts 0;
BA_ "GenSigTimeoutTime_IPC" SG_ 1049 PlugAndChargeSts 0;
BA_ "GenSigTimeoutTime_RFHM" SG_ 1049 PlugAndChargeSts 0;
BA_ "GenSigTimeoutTime_SGW" SG_ 1049 PlugAndChargeSts 0;
BA_ "GenSigTimeoutTime_TCM" SG_ 1049 PlugAndChargeSts 0;
BA_ "GenSigTimeoutTime_AGSM" SG_ 1049 PopUpMessage1 0;
BA_ "GenSigTimeoutTime_BCM" SG_ 1049 PopUpMessage1 0;
BA_ "GenSigTimeoutTime_BSM" SG_ 1049 PopUpMessage1 0;
BA_ "GenSigTimeoutTime_CADM" SG_ 1049 PopUpMessage1 0;
BA_ "GenSigTimeoutTime_DMSM" SG_ 1049 PopUpMessage1 0;
BA_ "GenSigTimeoutTime_DTCM" SG_ 1049 PopUpMessage1 0;
BA_ "GenSigTimeoutTime_ECM" SG_ 1049 PopUpMessage1 0;
BA_ "GenSigTimeoutTime_EVCU2" SG_ 1049 PopUpMessage1 0;
BA_ "GenSigTimeoutTime_GNMM" SG_ 1049 PopUpMessage1 0;
BA_ "GenSigTimeoutTime_HCP" SG_ 1049 PopUpMessage1 0;
BA_ "GenSigTimeoutTime_RFHM" SG_ 1049 PopUpMessage1 0;
BA_ "GenSigTimeoutTime_TCM" SG_ 1049 PopUpMessage1 0;
BA_ "GenSigTimeoutTime_AGSM" SG_ 1049 PopUpMessage10 0;
BA_ "GenSigTimeoutTime_BCM" SG_ 1049 PopUpMessage10 0;
BA_ "GenSigTimeoutTime_BSM" SG_ 1049 PopUpMessage10 0;
BA_ "GenSigTimeoutTime_CADM" SG_ 1049 PopUpMessage10 0;
BA_ "GenSigTimeoutTime_DMSM" SG_ 1049 PopUpMessage10 0;
BA_ "GenSigTimeoutTime_DTCM" SG_ 1049 PopUpMessage10 0;
BA_ "GenSigTimeoutTime_ECM" SG_ 1049 PopUpMessage10 0;
BA_ "GenSigTimeoutTime_EVCU2" SG_ 1049 PopUpMessage10 0;
BA_ "GenSigTimeoutTime_GNMM" SG_ 1049 PopUpMessage10 0;
BA_ "GenSigTimeoutTime_HCP" SG_ 1049 PopUpMessage10 0;
BA_ "GenSigTimeoutTime_RFHM" SG_ 1049 PopUpMessage10 0;
BA_ "GenSigTimeoutTime_SGW" SG_ 1049 PopUpMessage10 0;
BA_ "GenSigTimeoutTime_TCM" SG_ 1049 PopUpMessage10 0;
BA_ "GenSigTimeoutTime_AGSM" SG_ 1049 PopUpMessage11 0;
BA_ "GenSigTimeoutTime_BCM" SG_ 1049 PopUpMessage11 0;
BA_ "GenSigTimeoutTime_BSM" SG_ 1049 PopUpMessage11 0;
BA_ "GenSigTimeoutTime_CADM" SG_ 1049 PopUpMessage11 0;
BA_ "GenSigTimeoutTime_DMSM" SG_ 1049 PopUpMessage11 0;
BA_ "GenSigTimeoutTime_DTCM" SG_ 1049 PopUpMessage11 0;
BA_ "GenSigTimeoutTime_ECM" SG_ 1049 PopUpMessage11 0;
BA_ "GenSigTimeoutTime_EVCU2" SG_ 1049 PopUpMessage11 0;
BA_ "GenSigTimeoutTime_GNMM" SG_ 1049 PopUpMessage11 0;
BA_ "GenSigTimeoutTime_HCP" SG_ 1049 PopUpMessage11 0;
BA_ "GenSigTimeoutTime_RFHM" SG_ 1049 PopUpMessage11 0;
BA_ "GenSigTimeoutTime_SGW" SG_ 1049 PopUpMessage11 0;
BA_ "GenSigTimeoutTime_TCM" SG_ 1049 PopUpMessage11 0;
BA_ "GenSigTimeoutTime_AGSM" SG_ 1049 PopUpMessage12 0;
BA_ "GenSigTimeoutTime_BCM" SG_ 1049 PopUpMessage12 0;
BA_ "GenSigTimeoutTime_BSM" SG_ 1049 PopUpMessage12 0;
BA_ "GenSigTimeoutTime_CADM" SG_ 1049 PopUpMessage12 0;
BA_ "GenSigTimeoutTime_DMSM" SG_ 1049 PopUpMessage12 0;
BA_ "GenSigTimeoutTime_DTCM" SG_ 1049 PopUpMessage12 0;
BA_ "GenSigTimeoutTime_ECM" SG_ 1049 PopUpMessage12 0;
BA_ "GenSigTimeoutTime_EVCU2" SG_ 1049 PopUpMessage12 0;
BA_ "GenSigTimeoutTime_GNMM" SG_ 1049 PopUpMessage12 0;
BA_ "GenSigTimeoutTime_HCP" SG_ 1049 PopUpMessage12 0;
BA_ "GenSigTimeoutTime_RFHM" SG_ 1049 PopUpMessage12 0;
BA_ "GenSigTimeoutTime_SGW" SG_ 1049 PopUpMessage12 0;
BA_ "GenSigTimeoutTime_TCM" SG_ 1049 PopUpMessage12 0;
BA_ "GenSigTimeoutTime_AGSM" SG_ 1049 PopUpMessage2 0;
BA_ "GenSigTimeoutTime_BCM" SG_ 1049 PopUpMessage2 0;
BA_ "GenSigTimeoutTime_BSM" SG_ 1049 PopUpMessage2 0;
BA_ "GenSigTimeoutTime_CADM" SG_ 1049 PopUpMessage2 0;
BA_ "GenSigTimeoutTime_DMSM" SG_ 1049 PopUpMessage2 0;
BA_ "GenSigTimeoutTime_DTCM" SG_ 1049 PopUpMessage2 0;
BA_ "GenSigTimeoutTime_ECM" SG_ 1049 PopUpMessage2 0;
BA_ "GenSigTimeoutTime_EVCU2" SG_ 1049 PopUpMessage2 0;
BA_ "GenSigTimeoutTime_GNMM" SG_ 1049 PopUpMessage2 0;
BA_ "GenSigTimeoutTime_HCP" SG_ 1049 PopUpMessage2 0;
BA_ "GenSigTimeoutTime_RFHM" SG_ 1049 PopUpMessage2 0;
BA_ "GenSigTimeoutTime_SGW" SG_ 1049 PopUpMessage2 0;
BA_ "GenSigTimeoutTime_TCM" SG_ 1049 PopUpMessage2 0;
BA_ "GenSigTimeoutTime_AGSM" SG_ 1049 PopUpMessage3 0;
BA_ "GenSigTimeoutTime_BCM" SG_ 1049 PopUpMessage3 0;
BA_ "GenSigTimeoutTime_BSM" SG_ 1049 PopUpMessage3 0;
BA_ "GenSigTimeoutTime_CADM" SG_ 1049 PopUpMessage3 0;
BA_ "GenSigTimeoutTime_DMSM" SG_ 1049 PopUpMessage3 0;
BA_ "GenSigTimeoutTime_DTCM" SG_ 1049 PopUpMessage3 0;
BA_ "GenSigTimeoutTime_ECM" SG_ 1049 PopUpMessage3 0;
BA_ "GenSigTimeoutTime_EVCU2" SG_ 1049 PopUpMessage3 0;
BA_ "GenSigTimeoutTime_GNMM" SG_ 1049 PopUpMessage3 0;
BA_ "GenSigTimeoutTime_HCP" SG_ 1049 PopUpMessage3 0;
BA_ "GenSigTimeoutTime_RFHM" SG_ 1049 PopUpMessage3 0;
BA_ "GenSigTimeoutTime_SGW" SG_ 1049 PopUpMessage3 0;
BA_ "GenSigTimeoutTime_TCM" SG_ 1049 PopUpMessage3 0;
BA_ "GenSigTimeoutTime_AGSM" SG_ 1049 PopUpMessage4 0;
BA_ "GenSigTimeoutTime_BCM" SG_ 1049 PopUpMessage4 0;
BA_ "GenSigTimeoutTime_BSM" SG_ 1049 PopUpMessage4 0;
BA_ "GenSigTimeoutTime_CADM" SG_ 1049 PopUpMessage4 0;
BA_ "GenSigTimeoutTime_DMSM" SG_ 1049 PopUpMessage4 0;
BA_ "GenSigTimeoutTime_DTCM" SG_ 1049 PopUpMessage4 0;
BA_ "GenSigTimeoutTime_ECM" SG_ 1049 PopUpMessage4 0;
BA_ "GenSigTimeoutTime_EVCU2" SG_ 1049 PopUpMessage4 0;
BA_ "GenSigTimeoutTime_GNMM" SG_ 1049 PopUpMessage4 0;
BA_ "GenSigTimeoutTime_HCP" SG_ 1049 PopUpMessage4 0;
BA_ "GenSigTimeoutTime_RFHM" SG_ 1049 PopUpMessage4 0;
BA_ "GenSigTimeoutTime_SGW" SG_ 1049 PopUpMessage4 0;
BA_ "GenSigTimeoutTime_TCM" SG_ 1049 PopUpMessage4 0;
BA_ "GenSigTimeoutTime_AGSM" SG_ 1049 PopUpMessage5 0;
BA_ "GenSigTimeoutTime_BCM" SG_ 1049 PopUpMessage5 0;
BA_ "GenSigTimeoutTime_BSM" SG_ 1049 PopUpMessage5 0;
BA_ "GenSigTimeoutTime_CADM" SG_ 1049 PopUpMessage5 0;
BA_ "GenSigTimeoutTime_DMSM" SG_ 1049 PopUpMessage5 0;
BA_ "GenSigTimeoutTime_DTCM" SG_ 1049 PopUpMessage5 0;
BA_ "GenSigTimeoutTime_ECM" SG_ 1049 PopUpMessage5 0;
BA_ "GenSigTimeoutTime_EVCU2" SG_ 1049 PopUpMessage5 0;
BA_ "GenSigTimeoutTime_GNMM" SG_ 1049 PopUpMessage5 0;
BA_ "GenSigTimeoutTime_HCP" SG_ 1049 PopUpMessage5 0;
BA_ "GenSigTimeoutTime_RFHM" SG_ 1049 PopUpMessage5 0;
BA_ "GenSigTimeoutTime_SGW" SG_ 1049 PopUpMessage5 0;
BA_ "GenSigTimeoutTime_TCM" SG_ 1049 PopUpMessage5 0;
BA_ "GenSigTimeoutTime_AGSM" SG_ 1049 PopUpMessage6 0;
BA_ "GenSigTimeoutTime_BCM" SG_ 1049 PopUpMessage6 0;
BA_ "GenSigTimeoutTime_BSM" SG_ 1049 PopUpMessage6 0;
BA_ "GenSigTimeoutTime_CADM" SG_ 1049 PopUpMessage6 0;
BA_ "GenSigTimeoutTime_DMSM" SG_ 1049 PopUpMessage6 0;
BA_ "GenSigTimeoutTime_DTCM" SG_ 1049 PopUpMessage6 0;
BA_ "GenSigTimeoutTime_ECM" SG_ 1049 PopUpMessage6 0;
BA_ "GenSigTimeoutTime_EVCU2" SG_ 1049 PopUpMessage6 0;
BA_ "GenSigTimeoutTime_GNMM" SG_ 1049 PopUpMessage6 0;
BA_ "GenSigTimeoutTime_HCP" SG_ 1049 PopUpMessage6 0;
BA_ "GenSigTimeoutTime_RFHM" SG_ 1049 PopUpMessage6 0;
BA_ "GenSigTimeoutTime_SGW" SG_ 1049 PopUpMessage6 0;
BA_ "GenSigTimeoutTime_TCM" SG_ 1049 PopUpMessage6 0;
BA_ "GenSigTimeoutTime_AGSM" SG_ 1049 PopUpMessage7 0;
BA_ "GenSigTimeoutTime_BCM" SG_ 1049 PopUpMessage7 0;
BA_ "GenSigTimeoutTime_BSM" SG_ 1049 PopUpMessage7 0;
BA_ "GenSigTimeoutTime_CADM" SG_ 1049 PopUpMessage7 0;
BA_ "GenSigTimeoutTime_DMSM" SG_ 1049 PopUpMessage7 0;
BA_ "GenSigTimeoutTime_DTCM" SG_ 1049 PopUpMessage7 0;
BA_ "GenSigTimeoutTime_ECM" SG_ 1049 PopUpMessage7 0;
BA_ "GenSigTimeoutTime_EVCU2" SG_ 1049 PopUpMessage7 0;
BA_ "GenSigTimeoutTime_GNMM" SG_ 1049 PopUpMessage7 0;
BA_ "GenSigTimeoutTime_HCP" SG_ 1049 PopUpMessage7 0;
BA_ "GenSigTimeoutTime_RFHM" SG_ 1049 PopUpMessage7 0;
BA_ "GenSigTimeoutTime_SGW" SG_ 1049 PopUpMessage7 0;
BA_ "GenSigTimeoutTime_TCM" SG_ 1049 PopUpMessage7 0;
BA_ "GenSigTimeoutTime_AGSM" SG_ 1049 PopUpMessage9 0;
BA_ "GenSigTimeoutTime_BCM" SG_ 1049 PopUpMessage9 0;
BA_ "GenSigTimeoutTime_BSM" SG_ 1049 PopUpMessage9 0;
BA_ "GenSigTimeoutTime_CADM" SG_ 1049 PopUpMessage9 0;
BA_ "GenSigTimeoutTime_DMSM" SG_ 1049 PopUpMessage9 0;
BA_ "GenSigTimeoutTime_DTCM" SG_ 1049 PopUpMessage9 0;
BA_ "GenSigTimeoutTime_ECM" SG_ 1049 PopUpMessage9 0;
BA_ "GenSigTimeoutTime_EVCU2" SG_ 1049 PopUpMessage9 0;
BA_ "GenSigTimeoutTime_GNMM" SG_ 1049 PopUpMessage9 0;
BA_ "GenSigTimeoutTime_HCP" SG_ 1049 PopUpMessage9 0;
BA_ "GenSigTimeoutTime_RFHM" SG_ 1049 PopUpMessage9 0;
BA_ "GenSigTimeoutTime_TCM" SG_ 1049 PopUpMessage9 0;
BA_ "GenSigTimeoutTime_AGSM" SG_ 1049 RefrigerantPressure 0;
BA_ "GenSigTimeoutTime_BSM" SG_ 1049 RefrigerantPressure 0;
BA_ "GenSigTimeoutTime_CADM" SG_ 1049 RefrigerantPressure 0;
BA_ "GenSigTimeoutTime_DMSM" SG_ 1049 RefrigerantPressure 0;
BA_ "GenSigTimeoutTime_DTCM" SG_ 1049 RefrigerantPressure 0;
BA_ "GenSigTimeoutTime_ECM" SG_ 1049 RefrigerantPressure 0;
BA_ "GenSigTimeoutTime_EVCU2" SG_ 1049 RefrigerantPressure 0;
BA_ "GenSigTimeoutTime_GNMM" SG_ 1049 RefrigerantPressure 0;
BA_ "GenSigTimeoutTime_HCP" SG_ 1049 RefrigerantPressure 0;
BA_ "GenSigTimeoutTime_IPC" SG_ 1049 RefrigerantPressure 0;
BA_ "GenSigTimeoutTime_RFHM" SG_ 1049 RefrigerantPressure 0;
BA_ "GenSigTimeoutTime_SGW" SG_ 1049 RefrigerantPressure 0;
BA_ "GenSigTimeoutTime_TCM" SG_ 1049 RefrigerantPressure 0;
BA_ "GenSigTimeoutTime_AGSM" SG_ 1049 Regen_Status 0;
BA_ "GenSigTimeoutTime_BCM" SG_ 1049 Regen_Status 0;
BA_ "GenSigTimeoutTime_BSM" SG_ 1049 Regen_Status 0;
BA_ "GenSigTimeoutTime_CADM" SG_ 1049 Regen_Status 0;
BA_ "GenSigTimeoutTime_DMSM" SG_ 1049 Regen_Status 0;
BA_ "GenSigTimeoutTime_DTCM" SG_ 1049 Regen_Status 0;
BA_ "GenSigTimeoutTime_ECM" SG_ 1049 Regen_Status 0;
BA_ "GenSigTimeoutTime_EVCU2" SG_ 1049 Regen_Status 0;
BA_ "GenSigTimeoutTime_GNMM" SG_ 1049 Regen_Status 0;
BA_ "GenSigTimeoutTime_HCP" SG_ 1049 Regen_Status 0;
BA_ "GenSigTimeoutTime_RFHM" SG_ 1049 Regen_Status 0;
BA_ "GenSigTimeoutTime_SGW" SG_ 1049 Regen_Status 0;
BA_ "GenSigTimeoutTime_TCM" SG_ 1049 Regen_Status 0;
BA_ "GenSigTimeoutTime_AGSM" SG_ 1044 DischargingSysStatus 0;
BA_ "GenSigTimeoutTime_BCM" SG_ 1044 DischargingSysStatus 0;
BA_ "GenSigTimeoutTime_BSM" SG_ 1044 DischargingSysStatus 0;
BA_ "GenSigTimeoutTime_CADM" SG_ 1044 DischargingSysStatus 0;
BA_ "GenSigTimeoutTime_DMSM" SG_ 1044 DischargingSysStatus 0;
BA_ "GenSigTimeoutTime_DTCM" SG_ 1044 DischargingSysStatus 0;
BA_ "GenSigTimeoutTime_ECM" SG_ 1044 DischargingSysStatus 0;
BA_ "GenSigTimeoutTime_GNMM" SG_ 1044 DischargingSysStatus 0;
BA_ "GenSigTimeoutTime_HCP" SG_ 1044 DischargingSysStatus 0;
BA_ "GenSigTimeoutTime_IPC" SG_ 1044 DischargingSysStatus 0;
BA_ "GenSigTimeoutTime_SGW" SG_ 1044 DischargingSysStatus 0;
BA_ "GenSigTimeoutTime_TCM" SG_ 1044 DischargingSysStatus 0;
BA_ "GenSigTimeoutTime_AGSM" SG_ 1044 PnC_Failure 0;
BA_ "GenSigTimeoutTime_BCM" SG_ 1044 PnC_Failure 0;
BA_ "GenSigTimeoutTime_BSM" SG_ 1044 PnC_Failure 0;
BA_ "GenSigTimeoutTime_CADM" SG_ 1044 PnC_Failure 0;
BA_ "GenSigTimeoutTime_DMSM" SG_ 1044 PnC_Failure 0;
BA_ "GenSigTimeoutTime_DTCM" SG_ 1044 PnC_Failure 0;
BA_ "GenSigTimeoutTime_ECM" SG_ 1044 PnC_Failure 0;
BA_ "GenSigTimeoutTime_EVCU2" SG_ 1044 PnC_Failure 0;
BA_ "GenSigTimeoutTime_GNMM" SG_ 1044 PnC_Failure 0;
BA_ "GenSigTimeoutTime_HCP" SG_ 1044 PnC_Failure 0;
BA_ "GenSigTimeoutTime_IPC" SG_ 1044 PnC_Failure 0;
BA_ "GenSigTimeoutTime_RFHM" SG_ 1044 PnC_Failure 0;
BA_ "GenSigTimeoutTime_SGW" SG_ 1044 PnC_Failure 0;
BA_ "GenSigTimeoutTime_TCM" SG_ 1044 PnC_Failure 0;
BA_ "GenSigTimeoutTime_AGSM" SG_ 1044 PnC_Reattepmt_Failure 0;
BA_ "GenSigTimeoutTime_BCM" SG_ 1044 PnC_Reattepmt_Failure 0;
BA_ "GenSigTimeoutTime_BSM" SG_ 1044 PnC_Reattepmt_Failure 0;
BA_ "GenSigTimeoutTime_CADM" SG_ 1044 PnC_Reattepmt_Failure 0;
BA_ "GenSigTimeoutTime_DMSM" SG_ 1044 PnC_Reattepmt_Failure 0;
BA_ "GenSigTimeoutTime_DTCM" SG_ 1044 PnC_Reattepmt_Failure 0;
BA_ "GenSigTimeoutTime_ECM" SG_ 1044 PnC_Reattepmt_Failure 0;
BA_ "GenSigTimeoutTime_EVCU2" SG_ 1044 PnC_Reattepmt_Failure 0;
BA_ "GenSigTimeoutTime_GNMM" SG_ 1044 PnC_Reattepmt_Failure 0;
BA_ "GenSigTimeoutTime_HCP" SG_ 1044 PnC_Reattepmt_Failure 0;
BA_ "GenSigTimeoutTime_RFHM" SG_ 1044 PnC_Reattepmt_Failure 0;
BA_ "GenSigTimeoutTime_SGW" SG_ 1044 PnC_Reattepmt_Failure 0;
BA_ "GenSigTimeoutTime_TCM" SG_ 1044 PnC_Reattepmt_Failure 0;
VAL_ 271 AccPosV 0 "False" 1 "True";
VAL_ 271 Cam_Exh_1_Locked 0 "CAM_UNLOCKED" 1 "CAM_LOCKED";
VAL_ 271 Cam_Exh_2_Locked 0 "CAM_UNLOCKED" 1 "CAM_LOCKED";
VAL_ 271 Cam_Int_1_Locked 0 "CAM_UNLOCKED" 1 "CAM_LOCKED";
VAL_ 271 Cam_Int_2_Locked 0 "CAM_UNLOCKED" 1 "CAM_LOCKED";
VAL_ 271 CmndFlyWheelTorqPotential 4095 "SNA";
VAL_ 271 CmndFlyWheelTorqPrdtd 4095 "SNA";
VAL_ 271 CmndFlyWheelTorqRespTyp 0 "Inactive" 1 "PL" 2 "MR";
VAL_ 271 Crank_Locked 0 "NOT_LOCKED" 1 "CRANK_LOCKED";
VAL_ 271 Crank_Maturing_Fault 0 "False" 1 "True";
VAL_ 271 DrvrIntndedFlyWheelTorq 4095 "SNA";
VAL_ 271 DrvrIntndedFlyWheelTorqRaw 4095 "SNA";
VAL_ 271 DrvrIntndedFlyWheelTorqRawV 0 "Vaild" 1 "Not_Vaild";
VAL_ 271 DrvrIntndedFlyWheelTorqV 0 "Vaild" 1 "Not_Vaild";
VAL_ 271 ECM_Crank_Phase 0 "Not_Initialized" 1 "Quadrant_1" 2 "Quadrant_2" 3 "Quadrant_3" 4 "Quadrant_4" 7 "SNA";
VAL_ 271 ECMReq_Remedial_Stop 0 "DEFAULT" 1 "Remedial_Stp_Req" 2 "Remedial_Stp_Req_w_Limp" 3 "SNA";
VAL_ 271 EngActStdyStTorq 4095 "SNA";
VAL_ 271 EngActStdyStTorqV 0 "Valid" 1 "Not_Valid";
VAL_ 271 EngActuatorsStat 0 "ACPP" 1 "SCPP" 2 "ACPA";
VAL_ 271 EngAirFlwStdyStTorq 4095 "SNA";
VAL_ 271 EngAirFlwStdyStTorqV 0 "Valid" 1 "Not_Valid";
VAL_ 271 EngCylDeactMd 0 "CYL_ACT" 1 "DAP" 2 "HTCA" 3 "RAP";
VAL_ 271 Engine_Sync_720 0 "NOT_SYNCED" 1 "SYNC_720_ACHIEVED";
VAL_ 271 EngRqStTyp 0 "N_RQ" 1 "KS_NORM" 2 "KS_LP" 3 "KS_LPB" 4 "KS_GEN" 5 "AS_SM" 6 "AS_NORM" 7 "AS_AGG" 8 "AS_GEN" 9 "CT" 15 "SNA";
VAL_ 271 EngTrqReserveReq 255 "SNA";
VAL_ 271 ESS_Engine_State_EE 1 "ENS_STOPPED" 2 "ENS_RQ_ST" 3 "ENS_RUN" 4 "ENS_STOP_PEND" 5 "ENS_ST_PRTCT" 6 "ENS_ST_INH" 7 "ENS_DSBL" 8 "ENS_IHB_LATCH" 9 "ENS_ST" 10 "KEY_START" 11 "CHANGED_MIND" 12 "KEY_TORQUE_START" 13 "ENS_DISARM_RUN" 15 "SNA";
VAL_ 271 ETRQ_Mode 7 "SNA";
VAL_ 271 HybActEngTorqRespTyp 0 "Inactive" 1 "Pleasability_Limited" 2 "Maximum_Range";
VAL_ 271 MaxOffEngTorqCap 4095 "SNA";
VAL_ 271 MaxPrdtdEngTorqCap 4095 "SNA";
VAL_ 271 MaxPrdtdEngTorqCapV 0 "Valid" 1 "Not_Valid";
VAL_ 271 MinAirFlowMinSparkTorqCap 4095 "SNA";
VAL_ 271 MinEngTorqCap 4095 "SNA";
VAL_ 271 MinEngTorqCapV 0 "Valid" 1 "Not_Valid";
VAL_ 271 MinImmedEngTorqCap 4095 "SNA";
VAL_ 271 MinImmedEngTorqCapV 0 "Valid" 1 "Not_Valid";
VAL_ 271 MinPrdtdEngRunTorqCap 4095 "SNA";
VAL_ 271 MinPrdtdEngRunTorqCapV 0 "Valid" 1 "Not_Valid";
VAL_ 271 PT_BrakePdlPosn 255 "SNA";
VAL_ 271 PT_BrkPedDscrtInpStatV 0 "Valid" 1 "Not_Valid";
VAL_ 271 Sum_FW_ID_Fst 31 "SNA";
VAL_ 271 Sum_FW_ID_Slw 31 "SNA";
VAL_ 271 T_max_FW 4095 "SNA";
VAL_ 271 T_min_FW 4095 "SNA";
VAL_ 1035 AGSposn 127 "SNA";
VAL_ 1035 ECM_AirflowRequest 127 "SNA";
VAL_ 1035 ECM_WorkSite_Invtr_Sts 0 "NOT_ACTIVE" 1 "ACTIVE" 3 "SNA";
VAL_ 1035 EngCltTmp 255 "SNA";
VAL_ 1035 EngCltTmpV 0 "False" 1 "True";
VAL_ 1035 EngHalfCylSpdMaxLim 8191 "SNA";
VAL_ 1035 EngHalfCylSpdMinLim 8191 "SNA";
VAL_ 1035 EngSpdStat 0 "NOR_OPR" 1 "DEG_OPR" 3 "SNA";
VAL_ 1035 LTR_PumpSpeedAct 127 "SNA";
VAL_ 1035 RadFanReq 127 "SNA";
VAL_ 1328 EngTorqACCCapability 255 "SNA";
VAL_ 1328 EngTorqCapbltyMaxOffTorq 4095 "SNA";
VAL_ 1328 EngTorqCapbltyMaxTorq 4095 "SNA";
VAL_ 1328 EngTorqCapbltyMinRunTorq 4095 "SNA";
VAL_ 1328 EngTorqCapbltyMinTorq 4095 "SNA";
VAL_ 287 WED_STATUS 0 "ENGAGED" 1 "ENGAGING" 2 "NOT_AVAILABLE" 3 "DISENGAGING" 4 "DISENGAGED" 5 "STUCK_OPEN" 6 "STUCK_CLOSE" 7 "SNA";
VAL_ 264 ElectricSteeringFailSts 0 "Fail_Not_Present" 1 "Fail_Present";
VAL_ 264 EngineFanRequestActivation 0 "False" 1 "True";
VAL_ 264 LwsAngle 65535 "SNA";
VAL_ 264 LwsAngleType 0 "Absolute" 1 "Relative" 3 "SNA";
VAL_ 264 LwsCalibration 0 "Not_calibrated" 1 "Calibrated";
VAL_ 264 LwsSpeed 4095 "SNA";
VAL_ 1056 EPS_Warn_Disp_Rq 0 "EPS function active OK" 1 "Warning - Service power steering ERR" 2 "Warning - Power steering-over temp ERR2" 3 "Service Required - High Priority SERV_HI" 7 "SNA";
VAL_ 1460 CADM_Big_ECU_Package 0 "No Package" 1 "Package Available";
VAL_ 1460 FOTA_Install_Type 0 "No FOTA" 1 "FOTA Now" 2 "FOTA Schedule" 3 "FOTA Cancelled";
VAL_ 1460 FOTA_Installation_Status 0 "Default" 1 "Installation_Started" 2 "Installation_Complete" 3 "Reserved";
VAL_ 1460 FOTA_Purge 0 "Do_Not_Purge" 1 "Purge";
VAL_ 1460 FOTA_Status 0 "No FOTA Event" 1 "Downloading Package from Backend" 2 "Passing Images to Big Target ECUs" 3 "Waiting for HMI Acceptance" 4 "Installing FOTA Updated" 5 "Successful FOTA Update" 6 "FOTA Failure Rollback Successful" 7 "FOTA Failure Complete" 8 "Build Vehicle Library" 9 "Check Campaign Availability" 10 "Check Download Conditions" 11 "Validate Vehicle Package" 12 "Double Check Manifest" 13 "Initiate Authenticated Diagnostic session" 14 "Ready_State" 15 "Rollback";
VAL_ 1460 Safe_State 0 "Not Safe State" 1 "Safe State";
VAL_ 1460 WakeUpECM 0 "Not_Active" 1 "Active";
VAL_ 1846 Big_ECU_Ready_CADM 0 "Not Ready" 1 "Ready for Transfer" 2 "ECU ID not Downloaded" 3 "Ready for Install";
VAL_ 1846 Download_Status_CADM 0 "Not Downloading" 1 "Download in Progress" 2 "Download Completed" 3 "Fault Download Failed";
VAL_ 1846 Update_Status_CADM 0 "Not Updating" 1 "Update in Progress" 2 "Update Completed" 3 "Fault Update Failed";
VAL_ 525 Altitude_RMSE 254 "OutOfRange" 255 "SNA";
VAL_ 525 GNMM_Health 0 "Not_Avail" 1 "Avail_full_capacity" 2 "Primary_IMU_NA" 3 "GPS_GNSS_NA" 4 "Correction_Data_NA" 7 "SNA";
VAL_ 525 Heading_Angle 65535 "SNA";
VAL_ 525 Lat_GNMM 4294967295 "SNA";
VAL_ 525 LatAcceleration_GNMM 4095 "SNA";
VAL_ 525 LateralVelocity_GNMM 16383 "SNA";
VAL_ 525 Latitude_RMSE 254 "OutOfRange" 255 "SNA";
VAL_ 525 Long_GNMM 4294967295 "SNA";
VAL_ 525 LongAcceleration_GNMM 4095 "SNA";
VAL_ 525 Longitude_RMSE 254 "OutOfRange" 255 "SNA";
VAL_ 525 LongitudinalVelocity_GNMM 16383 "SNA";
VAL_ 525 Pitch_RMSE 254 "OutOfRange" 255 "SNA";
VAL_ 525 PitchRate_GNMM 4095 "SNA";
VAL_ 525 Roll_RMSE 254 "OutOfRange" 255 "SNA";
VAL_ 525 RollRate_GNMM 4095 "SNA";
VAL_ 525 VerticalAcceleration_GNMM 4095 "SNA";
VAL_ 525 VerticalVelocity_GNMM 16383 "SNA";
VAL_ 525 YawRate_GNMM 32767 "SNA";
VAL_ 525 YawRate_RMSE 254 "OutOfRange" 255 "SNA";
VAL_ 1487 Chargeport_Lock_Status 0 "Default" 1 "Locked" 2 "Unlocked" 3 "reserved";
VAL_ 1487 Cooperative_Status 0 "Default" 1 "Regular_Charging" 2 "External_Charging" 3 "ChargeNow_Override" 4 "Other_reason";
VAL_ 1487 Energy_to_Battery 511 "SNA";
VAL_ 1487 Est_Range_FullCharge 2047 "SNA";
VAL_ 1487 EV_Charge_Current 2047 "SNA";
VAL_ 1487 EVSE_Power 511 "SNA";
VAL_ 1487 Lv1_EstChargeTime_80 8191 "SNA";
VAL_ 1487 Lv2_EstChargeTime_80 8191 "SNA";
VAL_ 1487 Total_Battery_Capacity 4095 "SNA";
VAL_ 266 HVBatCellVoltage_Max 8191 "SNA";
VAL_ 266 HVBatCellVoltage_Min 8191 "SNA";
VAL_ 266 HVBatContactorSts 0 "Open" 1 "Precharging" 2 "Closed" 3 "Precharge_Failed" 4 "Precharge_Inhibited" 7 "SNA";
VAL_ 266 HVBatteryCurrent 16383 "SNA";
VAL_ 266 HVBatteryVoltage 4095 "SNA";
VAL_ 266 IsolationSts_HVBattery 0 "N_S" 1 "PASS" 2 "FAIL" 3 "INV";
VAL_ 266 IsolationSts_HVPowertrain 0 "N_S" 1 "PASS" 2 "FAIL" 3 "INV";
VAL_ 1027 HVBatteryMILRequest 0 "FALSE" 1 "TRUE";
VAL_ 1834 HVBattery_RealTimeClock 4294967295 "SNA";
VAL_ 1834 HVBattery_RealTimeClockV 0 "Valid" 1 "Not_Valid";
VAL_ 1049 BatteryPowerUsageV 0 "Valid" 1 "Not_Valid";
VAL_ 1049 BatteryPowerUse_DisplayV 0 "Valid" 1 "Not_Valid";
VAL_ 1049 ChargeSystemFault_DPT 0 "Not_Faulted" 1 "Faulted";
VAL_ 1049 ChargeSystemSts_DPT 0 "NotCharging" 1 "Charging" 2 "ChargeInterrupted" 3 "ChargeComplete" 7 "SNA";
VAL_ 1049 ChargingLevelForDisplay 0 "Default_NoLevel" 1 "Level_1_AC" 2 "Level_2_AC" 3 "Level_3_AC" 4 "Level_1_DC" 5 "Level_2_DC" 6 "PlugInNotDet" 7 "PPI_1_No_Drive" 8 "PPI_2_OK_Drive" 15 "SNA";
VAL_ 1049 EstimatedRange 255 "SNA";
VAL_ 1049 FOTA_Schedule_Conflict 0 "False" 1 "True";
VAL_ 1049 HCP_EVServiceLampOn 0 "OFF" 1 "ON" 2 "BLINK" 3 "SNA";
VAL_ 1049 HVACPowerUse_DisplayV 0 "Valid" 1 "Not_Valid";
VAL_ 1049 HVBatterySOC_DisplayV 0 "Valid" 1 "Not_Valid";
VAL_ 1049 HybridEfficiencyCoachV 0 "Valid" 1 "Invalid";
VAL_ 1049 HybridMILRequest 0 "Not_Active" 1 "Active";
VAL_ 1049 HybridOutputPowerV 0 "Valid" 1 "Invalid";
VAL_ 1049 Lv1_EstChargeTime 8191 "SNA";
VAL_ 1049 Lv2_EstChargeTime 2047 "SNA";
VAL_ 1049 OnePedal_Drive_Sts 0 "Off" 1 "On" 2 "Unavailable";
VAL_ 1049 PlugAndChargeSts 0 "Inactive" 1 "Active";
VAL_ 1049 PopUpMessage1 0 "False" 1 "True";
VAL_ 1049 PopUpMessage10 0 "False" 1 "True";
VAL_ 1049 PopUpMessage11 0 "False" 1 "True";
VAL_ 1049 PopUpMessage12 0 "MaxRegen_OFF" 1 "MaxRegen_ON" 2 "MaxRegen_Unavailable" 3 "Not_Defined";
VAL_ 1049 PopUpMessage2 0 "False" 1 "True";
VAL_ 1049 PopUpMessage3 0 "False" 1 "True";
VAL_ 1049 PopUpMessage4 0 "False" 1 "True";
VAL_ 1049 PopUpMessage5 0 "False" 1 "True";
VAL_ 1049 PopUpMessage6 0 "False" 1 "True";
VAL_ 1049 PopUpMessage7 0 "False" 1 "True";
VAL_ 1049 PopUpMessage9 0 "False" 1 "True";
VAL_ 1049 RefrigerantPressure 511 "SNA";
VAL_ 1049 Regen_Status 0 "unavailable " 1 "Level1" 2 "Level2" 3 "Level3" 4 "Level4" 5 "Level5";
VAL_ 1044 DischargingSysStatus 0 "Inactive" 1 "Active" 2 "Faulted" 3 "SNA";
VAL_ 1044 PnC_Failure 0 "No_Failure" 1 "Failure";
VAL_ 1044 PnC_Reattepmt_Failure 0 "No_Failure" 1 "Failure";
