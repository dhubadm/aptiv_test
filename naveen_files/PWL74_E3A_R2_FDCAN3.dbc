VERSION ""

NS_ :

BS_:

BU_: AGSM BCM BSM CADM DMSM DTCM ECM EVCU2 GNMM HCP IPC RFHM SGW TCM
BO_ 2654339142 PDC_INFO_FD_BPCM: 32 EVCU2
 SG_ CurrentCanNMState_FD05_BPCM : 95|4@0+ (1,0) [0|15] "" Vector__XXX
 SG_ CurrentCanNMState_FD11_BPCM : 15|4@0+ (1,0) [0|15] "" Vector__XXX
 SG_ CurrentFailSts_FD05_BPCM : 6|1@0+ (1,0) [0|1] "" Vector__XXX
 SG_ CurrentFailSts_FD11_BPCM : 2|1@0+ (1,0) [0|1] "" BCM
 SG_ DES_FD05_BPCM : 91|2@0+ (1,0) [0|3] "" Vector__XXX
 SG_ DES_FD11_BPCM : 4|2@0+ (1,0) [0|3] "" Vector__XXX
 SG_ EOL_FD05_BPCM : 1|1@0+ (1,0) [0|1] "-" Vector__XXX
 SG_ EOL_FD11_BPCM : 7|1@0+ (1,0) [0|1] "-" BCM
 SG_ GenericFailSts_FD05_BPCM : 89|1@0+ (1,0) [0|1] "" Vector__XXX
 SG_ GenericFailSts_FD11_BPCM : 5|1@0+ (1,0) [0|1] "" BCM
 SG_ PreviousCanNMState_FD05_BPCM : 103|4@0+ (1,0) [0|15] "" Vector__XXX
 SG_ PreviousCanNMState_FD11_BPCM : 11|4@0+ (1,0) [0|15] "" Vector__XXX
 SG_ StayActiveSource_FD05_BPCM : 99|64@0+ (1,0) [0|0] "" Vector__XXX
 SG_ StayActiveSource_FD11_BPCM : 31|64@0+ (1,0) [0|18446744073709600000] "" Vector__XXX
 SG_ WakeupSource_FD05_BPCM : 175|8@0+ (1,0) [0|255] "" Vector__XXX
 SG_ WakeupSource_FD11_BPCM : 23|8@0+ (1,0) [0|255] "" Vector__XXX

BO_ 2654339078 PDC_INFO_FD_BSM: 12 BSM
 SG_ CurrentCanNMState_FD03_BSM : 15|4@0+ (1,0) [0|15] "" SGW
 SG_ CurrentFailSts_FD03_BSM : 6|1@0+ (1,0) [0|1] "" BCM,SGW
 SG_ DES_FD03_BSM : 4|2@0+ (1,0) [0|1] "" SGW
 SG_ EOL_FD03_BSM : 7|1@0+ (1,0) [0|1] "-" BCM,SGW
 SG_ GenericFailSts_FD03_BSM : 5|1@0+ (1,0) [0|1] "" BCM,SGW
 SG_ PreviousCanNMState_FD03_BSM : 11|4@0+ (1,0) [0|15] "" SGW
 SG_ StayActiveSource_FD03_BSM : 31|64@0+ (1,0) [0|18446744073709551615] "" SGW
 SG_ WakeupSource_FD03_BSM : 23|8@0+ (1,0) [0|255] "" SGW

BO_ 2654339213 PDC_INFO_FD_CADM: 12 CADM
 SG_ CurrentCanNMState_FD03_CADM : 15|4@0+ (1,0) [0|15] "" SGW
 SG_ CurrentFailSts_FD03_CADM : 6|1@0+ (1,0) [0|1] "" BCM,SGW
 SG_ DES_FD03_CADM : 4|2@0+ (1,0) [0|3] "" SGW
 SG_ EOL_FD03_CADM : 7|1@0+ (1,0) [0|1] "-" BCM,SGW
 SG_ GenericFailSts_FD03_CADM : 5|1@0+ (1,0) [0|1] "" BCM,SGW
 SG_ PreviousCanNMState_FD03_CADM : 11|4@0+ (1,0) [0|15] "" SGW
 SG_ StayActiveSource_FD03_CADM : 31|64@0+ (1,0) [0|18446744073709600000] "" SGW
 SG_ WakeupSource_FD03_CADM : 23|8@0+ (1,0) [0|255] "" SGW

BO_ 2654339225 PDC_INFO_FD_DMSM: 12 DMSM
 SG_ CurrentCanNMState_FD03_DMSM : 15|4@0+ (1,0) [0|15] "" SGW
 SG_ CurrentFailSts_FD03_DMSM : 6|1@0+ (1,0) [0|1] "" BCM,SGW
 SG_ DES_FD03_DMSM : 4|2@0+ (1,0) [0|3] "" SGW
 SG_ EOL_FD03_DMSM : 7|1@0+ (1,0) [0|1] "-" BCM,SGW
 SG_ GenericFailSts_FD03_DMSM : 5|1@0+ (1,0) [0|1] "" BCM,SGW
 SG_ PreviousCanNMState_FD03_DMSM : 11|4@0+ (1,0) [0|15] "" SGW
 SG_ StayActiveSource_FD03_DMSM : 31|64@0+ (1,0) [0|18446744073709600000] "" SGW
 SG_ WakeupSource_FD03_DMSM : 23|8@0+ (1,0) [0|255] "" SGW

BO_ 2654339139 PDC_INFO_FD_DTCM: 12 DTCM
 SG_ CurrentCanNMState_FD03_DTCM : 15|4@0+ (1,0) [0|15] "" SGW
 SG_ CurrentFailSts_FD03_DTCM : 6|1@0+ (1,0) [0|1] "" BCM,SGW
 SG_ DES_FD03_DTCM : 4|2@0+ (1,0) [0|3] "" SGW
 SG_ EOL_FD03_DTCM : 7|1@0+ (1,0) [0|1] "-" BCM,SGW
 SG_ GenericFailSts_FD03_DTCM : 5|1@0+ (1,0) [0|1] "" BCM,SGW
 SG_ PreviousCanNMState_FD03_DTCM : 11|4@0+ (1,0) [0|15] "" SGW
 SG_ StayActiveSource_FD03_DTCM : 31|64@0+ (1,0) [0|18446744073709600000] "" SGW
 SG_ WakeupSource_FD03_DTCM : 23|8@0+ (1,0) [0|255] "" SGW

BO_ 2654339073 PDC_INFO_FD_ECM: 48 ECM
 SG_ CurrentCanNMState_FD03_ECM : 15|4@0+ (1,0) [0|15] "" SGW
 SG_ CurrentCanNMState_FD05_ECM : 99|4@0+ (1,0) [0|15] "" SGW
 SG_ CurrentCanNMState_FD16_ECM : 179|4@0+ (1,0) [0|15] "" SGW
 SG_ CurrentFailSts_FD03_ECM : 6|1@0+ (1,0) [0|1] "" BCM,SGW
 SG_ CurrentFailSts_FD05_ECM : 181|1@0+ (1,0) [0|1] "" SGW
 SG_ CurrentFailSts_FD16_ECM : 185|1@0+ (1,0) [0|1] "" SGW
 SG_ DES_FD03_ECM : 4|2@0+ (1,0) [0|1] "" SGW
 SG_ DES_FD05_ECM : 183|2@0+ (1,0) [0|1] "" SGW
 SG_ DES_FD16_ECM : 187|2@0+ (1,0) [0|1] "" SGW
 SG_ EOL_FD03_ECM : 7|1@0+ (1,0) [0|1] "-" BCM,SGW
 SG_ EOL_FD05_ECM : 2|1@0+ (1,0) [0|1] "-" SGW
 SG_ EOL_FD16_ECM : 1|1@0+ (1,0) [0|1] "-" SGW
 SG_ GenericFailSts_FD03_ECM : 5|1@0+ (1,0) [0|1] "" BCM,SGW
 SG_ GenericFailSts_FD05_ECM : 180|1@0+ (1,0) [0|1] "" SGW
 SG_ GenericFailSts_FD16_ECM : 184|1@0+ (1,0) [0|1] "" SGW
 SG_ PreviousCanNMState_FD03_ECM : 11|4@0+ (1,0) [0|15] "" SGW
 SG_ PreviousCanNMState_FD05_ECM : 103|4@0+ (1,0) [0|15] "" SGW
 SG_ PreviousCanNMState_FD16_ECM : 191|4@0+ (1,0) [0|15] "" SGW
 SG_ StayActiveSource_FD03_ECM : 31|64@0+ (1,0) [0|18446744073709600000] "" SGW
 SG_ StayActiveSource_FD05_ECM : 111|64@0+ (1,0) [0|0] "" SGW
 SG_ StayActiveSource_FD16_ECM : 207|64@0+ (1,0) [0|0] "" SGW
 SG_ WakeupSource_FD03_ECM : 23|8@0+ (1,0) [0|255] "" SGW
 SG_ WakeupSource_FD05_ECM : 95|8@0+ (1,0) [0|255] "" SGW
 SG_ WakeupSource_FD16_ECM : 199|8@0+ (1,0) [0|255] "" SGW

BO_ 2654339108 PDC_INFO_FD_ETM: 12 SGW
 SG_ CurrentCanNMState_FD08_ETM : 15|4@0+ (1,0) [0|15] "" Vector__XXX
 SG_ CurrentFailSts_FD08_ETM : 6|1@0+ (1,0) [0|1] "" BCM
 SG_ DES_FD08_ETM : 4|2@0+ (1,0) [0|3] "" Vector__XXX
 SG_ EOL_FD08_ETM : 7|1@0+ (1,0) [0|1] "-" BCM
 SG_ GenericFailSts_FD08_ETM : 5|1@0+ (1,0) [0|1] "" BCM
 SG_ PreviousCanNMState_FD08_ETM : 11|4@0+ (1,0) [0|15] "" Vector__XXX
 SG_ StayActiveSource_FD08_ETM : 31|64@0+ (1,0) [0|18446744073709551615] "" Vector__XXX
 SG_ WakeupSource_FD08_ETM : 23|8@0+ (1,0) [0|255] "" Vector__XXX

BO_ 2654339136 PDC_INFO_FD_EVCU2: 64 EVCU2
 SG_ CurrentCanNMState_FD03_EVCU2 : 339|4@0+ (1,0) [0|15] "" Vector__XXX
 SG_ CurrentCanNMState_FD11_EVCU2 : 15|4@0+ (1,0) [0|15] "" SGW
 SG_ CurrentCanNMState_FD16_EVCU2 : 179|4@0+ (1,0) [0|15] "" SGW
 SG_ CurrentFailSts_FD03_EVCU2 : 7|1@0+ (1,0) [0|1] "" BCM
 SG_ CurrentFailSts_FD11_EVCU2 : 2|1@0+ (1,0) [0|1] "" SGW
 SG_ CurrentFailSts_FD16_EVCU2 : 185|1@0+ (1,0) [0|1] "" SGW
 SG_ DES_FD03_EVCU2 : 23|2@0+ (1,0) [0|3] "" Vector__XXX
 SG_ DES_FD11_EVCU2 : 4|2@0+ (1,0) [0|3] "" SGW
 SG_ DES_FD16_EVCU2 : 187|2@0+ (1,0) [0|1] "" SGW
 SG_ EOL_FD03_EVCU2 : 0|1@0+ (1,0) [0|1] "-" BCM
 SG_ EOL_FD11_EVCU2 : 20|1@0+ (1,0) [0|1] "-" SGW
 SG_ EOL_FD16_EVCU2 : 19|1@0+ (1,0) [0|1] "-" SGW
 SG_ GenericFailSts_FD03_EVCU2 : 1|1@0+ (1,0) [0|1] "" BCM
 SG_ GenericFailSts_FD11_EVCU2 : 5|1@0+ (1,0) [0|1] "" SGW
 SG_ GenericFailSts_FD16_EVCU2 : 184|1@0+ (1,0) [0|1] "" SGW
 SG_ PreviousCanNMState_FD03_EVCU2 : 343|4@0+ (1,0) [0|15] "" Vector__XXX
 SG_ PreviousCanNMState_FD11_EVCU2 : 11|4@0+ (1,0) [0|15] "" SGW
 SG_ PreviousCanNMState_FD16_EVCU2 : 191|4@0+ (1,0) [0|15] "" SGW
 SG_ StayActiveSource_FD03_EVCU2 : 31|64@0+ (1,0) [0|0] "" Vector__XXX
 SG_ StayActiveSource_FD11_EVCU2 : 271|64@0+ (1,0) [0|18446744073709551615] "" SGW
 SG_ StayActiveSource_FD16_EVCU2 : 207|64@0+ (1,0) [0|0] "" SGW
 SG_ WakeupSource_FD03_EVCU2 : 335|8@0+ (1,0) [0|255] "" Vector__XXX
 SG_ WakeupSource_FD11_EVCU2 : 175|8@0+ (1,0) [0|255] "" SGW
 SG_ WakeupSource_FD16_EVCU2 : 199|8@0+ (1,0) [0|255] "" SGW

BO_ 2654339216 PDC_INFO_FD_GNMM: 12 GNMM
 SG_ CurrentCanNMState_FD03_GNMM : 15|4@0+ (1,0) [0|3] "" SGW
 SG_ CurrentFailSts_FD03_GNMM : 6|1@0+ (1,0) [0|1] "" BCM,SGW
 SG_ DES_FD03_GNMM : 4|2@0+ (1,0) [0|3] "" SGW
 SG_ EOL_FD03_GNMM : 7|1@0+ (1,0) [0|1] "-" BCM,SGW
 SG_ GenericFailSts_FD03_GNMM : 5|1@0+ (1,0) [0|1] "" BCM,SGW
 SG_ PreviousCanNMState_FD03_GNMM : 11|4@0+ (1,0) [0|15] "" SGW
 SG_ StayActiveSource_FD03_GNMM : 31|64@0+ (1,0) [0|18446744073709551615] "" SGW
 SG_ WakeupSource_FD03_GNMM : 23|8@0+ (1,0) [0|255] "" SGW

BO_ 2654339170 PDC_INFO_FD_HCP: 12 HCP
 SG_ CurrentCanNMState_FD03_HCP : 15|4@0+ (1,0) [0|15] "" SGW
 SG_ CurrentFailSts_FD03_HCP : 6|1@0+ (1,0) [0|1] "" BCM,SGW
 SG_ DES_FD03_HCP : 4|2@0+ (1,0) [0|3] "" SGW
 SG_ EOL_FD03_HCP : 7|1@0+ (1,0) [0|1] "-" BCM,SGW
 SG_ GenericFailSts_FD03_HCP : 5|1@0+ (1,0) [0|1] "" BCM,SGW
 SG_ PreviousCanNMState_FD03_HCP : 11|4@0+ (1,0) [0|15] "" SGW
 SG_ StayActiveSource_FD03_HCP : 31|64@0+ (1,0) [0|18446744073709600000] "" SGW
 SG_ WakeupSource_FD03_HCP : 23|8@0+ (1,0) [0|255] "" SGW

BO_ 2654339197 PDC_INFO_FD_IDCM: 32 EVCU2
 SG_ CurrentCanNMState_FD11_IDCM : 99|4@0+ (1,0) [0|15] "" Vector__XXX
 SG_ CurrentFailSts_FD11_IDCM : 181|1@0+ (1,0) [0|1] "" BCM
 SG_ DES_FD11_IDCM : 183|2@0+ (1,0) [0|3] "" Vector__XXX
 SG_ EOL_FD11_IDCM : 7|1@0+ (1,0) [0|1] "-" BCM
 SG_ GenericFailSts_FD11_IDCM : 180|1@0+ (1,0) [0|1] "" BCM
 SG_ PreviousCanNMState_FD11_IDCM : 103|4@0+ (1,0) [0|15] "" Vector__XXX
 SG_ StayActiveSource_FD11_IDCM : 111|64@0+ (1,0) [0|0] "" Vector__XXX
 SG_ WakeupSource_FD11_IDCM : 95|8@0+ (1,0) [0|255] "" Vector__XXX

BO_ 2654339075 PDC_INFO_FD_IPC: 12 IPC
 SG_ CurrentCanNMState_FD03_IPC : 15|4@0+ (1,0) [0|15] "" SGW
 SG_ CurrentFailSts_FD03_IPC : 6|1@0+ (1,0) [0|1] "" BCM,SGW
 SG_ DES_FD03_IPC : 4|2@0+ (1,0) [0|3] "" SGW
 SG_ EOL_FD03_IPC : 7|1@0+ (1,0) [0|1] "-" BCM,SGW
 SG_ GenericFailSts_FD03_IPC : 5|1@0+ (1,0) [0|1] "" BCM,SGW
 SG_ PreviousCanNMState_FD03_IPC : 11|4@0+ (1,0) [0|15] "" SGW
 SG_ StayActiveSource_FD03_IPC : 31|64@0+ (1,0) [0|18446744073709600000] "" SGW
 SG_ WakeupSource_FD03_IPC : 23|8@0+ (1,0) [0|255] "" SGW

BO_ 2654339160 PDC_INFO_FD_MCPA: 32 EVCU2
 SG_ CurrentCanNMState_FD05_MCPA : 15|4@0+ (1,0) [0|15] "" SGW
 SG_ CurrentCanNMState_FD16_MCPA : 99|4@0+ (1,0) [0|15] "" SGW
 SG_ CurrentFailSts_FD05_MCPA : 6|1@0+ (1,0) [0|1] "" BCM,SGW
 SG_ CurrentFailSts_FD16_MCPA : 173|1@0+ (1,0) [0|1] "" SGW
 SG_ DES_FD05_MCPA : 4|2@0+ (1,0) [0|3] "" SGW
 SG_ DES_FD16_MCPA : 175|2@0+ (1,0) [0|3] "" SGW
 SG_ EOL_FD05_MCPA : 7|1@0+ (1,0) [0|1] "-" BCM,SGW
 SG_ EOL_FD16_MCPA : 2|1@0+ (1,0) [0|1] "-" SGW
 SG_ GenericFailSts_FD05_MCPA : 5|1@0+ (1,0) [0|1] "" BCM,SGW
 SG_ GenericFailSts_FD16_MCPA : 172|1@0+ (1,0) [0|1] "" SGW
 SG_ PreviousCanNMState_FD05_MCPA : 11|4@0+ (1,0) [0|15] "" SGW
 SG_ PreviousCanNMState_FD16_MCPA : 103|4@0+ (1,0) [0|15] "" SGW
 SG_ StayActiveSource_FD05_MCPA : 31|64@0+ (1,0) [0|0] "" SGW
 SG_ StayActiveSource_FD16_MCPA : 111|64@0+ (1,0) [0|0] "" SGW
 SG_ WakeupSource_FD05_MCPA : 23|8@0+ (1,0) [0|255] "" SGW
 SG_ WakeupSource_FD16_MCPA : 95|8@0+ (1,0) [0|255] "" SGW

BO_TX_BU_ 2654339142 : EVCU2,HCP;
CM_ SG_ 2654339142 CurrentCanNMState_FD05_BPCM "Indicates that CanNM state the ECU is currently executing";
CM_ SG_ 2654339142 CurrentCanNMState_FD11_BPCM "Indicates that CanNM state the ECU is currently executing";
CM_ SG_ 2654339142 CurrentFailSts_FD05_BPCM "Indicates the presence/absence of at least one DTC with DTCStatus = present in the System Memory";
CM_ SG_ 2654339142 CurrentFailSts_FD11_BPCM "Indicates the presence/absence of at least one DTC with DTCStatus = present in the System Memory";
CM_ SG_ 2654339142 DES_FD05_BPCM "Indicates whether the ECU?s CAN cell is in either ErrorActive, or ErrorPassive state OR has just now recovered from a BusOff condition";
CM_ SG_ 2654339142 DES_FD11_BPCM "Indicates whether the ECU?s CAN cell is in either ErrorActive, or ErrorPassive state OR has just now recovered from a BusOff condition";
CM_ SG_ 2654339142 EOL_FD05_BPCM "Indicates if the ECU requires configuration data at the assembly plant End Of Line";
CM_ SG_ 2654339142 EOL_FD11_BPCM "Indicates if the ECU requires configuration data at the assembly plant End Of Line";
CM_ SG_ 2654339142 GenericFailSts_FD05_BPCM "Indicates the presence/absent of at least one DTC in the System Memory";
CM_ SG_ 2654339142 GenericFailSts_FD11_BPCM "Indicates the presence/absent of at least one DTC in the System Memory";
CM_ SG_ 2654339142 PreviousCanNMState_FD05_BPCM "Indicates the last CanNM state that the ECU existed in";
CM_ SG_ 2654339142 PreviousCanNMState_FD11_BPCM "Indicates the last CanNM state that the ECU existed in";
CM_ SG_ 2654339142 StayActiveSource_FD05_BPCM "Indicates the source that requests the ECU to stay active";
CM_ SG_ 2654339142 StayActiveSource_FD11_BPCM "Indicates the source that requests the ECU to stay active";
CM_ SG_ 2654339142 WakeupSource_FD05_BPCM "Indicates the reason the ECU was most recently awakened";
CM_ SG_ 2654339142 WakeupSource_FD11_BPCM "Indicates the reason the ECU was most recently awakened";
CM_ SG_ 2654339078 CurrentCanNMState_FD03_BSM "Indicates that CanNM state the ECU is currently executing";
CM_ SG_ 2654339078 CurrentFailSts_FD03_BSM "Indicates the presence/absence of at least one DTC with DTCStatus = present in the System Memory";
CM_ SG_ 2654339078 DES_FD03_BSM "Indicates whether the ECU?s CAN cell is in either ErrorActive, or ErrorPassive state OR has just now recovered from a BusOff condition";
CM_ SG_ 2654339078 EOL_FD03_BSM "Indicates if the ECU requires configuration data at the assembly plant End Of Line";
CM_ SG_ 2654339078 GenericFailSts_FD03_BSM "Indicates the presence/absent of at least one DTC in the System Memory";
CM_ SG_ 2654339078 PreviousCanNMState_FD03_BSM "Indicates the last CanNM state that the ECU existed in";
CM_ SG_ 2654339078 StayActiveSource_FD03_BSM "Indicates the source that requests the ECU to stay active";
CM_ SG_ 2654339078 WakeupSource_FD03_BSM "Indicates the reason the ECU was most recently awakened";
CM_ SG_ 2654339213 CurrentCanNMState_FD03_CADM "Indicates that CanNM state the ECU is currently executing";
CM_ SG_ 2654339213 CurrentFailSts_FD03_CADM "Indicates the presence/absence of at least one DTC with DTCStatus = present in the System Memory";
CM_ SG_ 2654339213 DES_FD03_CADM "Indicates whether the ECU?s CAN cell is in either ErrorActive, or ErrorPassive state OR has just now recovered from a BusOff condition";
CM_ SG_ 2654339213 EOL_FD03_CADM "Indicates if the ECU requires configuration data at the assembly plant End Of Line";
CM_ SG_ 2654339213 GenericFailSts_FD03_CADM "Indicates the presence/absent of at least one DTC in the System Memory";
CM_ SG_ 2654339213 PreviousCanNMState_FD03_CADM "Indicates the last CanNM state that the ECU existed in";
CM_ SG_ 2654339213 StayActiveSource_FD03_CADM "Indicates the source that requests the ECU to stay active";
CM_ SG_ 2654339213 WakeupSource_FD03_CADM "Indicates the reason the ECU was most recently awakened";
CM_ SG_ 2654339225 CurrentCanNMState_FD03_DMSM "Indicates that CanNM state the ECU is currently executing";
CM_ SG_ 2654339225 CurrentFailSts_FD03_DMSM "Indicates the presence/absence of at least one DTC with DTCStatus = present in the System Memory";
CM_ SG_ 2654339225 DES_FD03_DMSM "Indicates whether the ECU?s CAN cell is in either ErrorActive, or ErrorPassive state OR has just now recovered from a BusOff condition";
CM_ SG_ 2654339225 EOL_FD03_DMSM "Indicates if the ECU requires configuration data at the assembly plant End Of Line";
CM_ SG_ 2654339225 GenericFailSts_FD03_DMSM "Indicates the presence/absent of at least one DTC in the System Memory";
CM_ SG_ 2654339225 PreviousCanNMState_FD03_DMSM "Indicates the last CanNM state that the ECU existed in";
CM_ SG_ 2654339225 StayActiveSource_FD03_DMSM "Indicates the source that requests the ECU to stay active";
CM_ SG_ 2654339225 WakeupSource_FD03_DMSM "Indicates the reason the ECU was most recently awakened";
CM_ SG_ 2654339139 CurrentCanNMState_FD03_DTCM "Indicates that CanNM state the ECU is currently executing";
CM_ SG_ 2654339139 CurrentFailSts_FD03_DTCM "Indicates the presence/absence of at least one DTC with DTCStatus = present in the System Memory";
CM_ SG_ 2654339139 DES_FD03_DTCM "Indicates whether the ECU?s CAN cell is in either ErrorActive, or ErrorPassive state OR has just now recovered from a BusOff condition";
CM_ SG_ 2654339139 EOL_FD03_DTCM "Indicates if the ECU requires configuration data at the assembly plant End Of Line";
CM_ SG_ 2654339139 GenericFailSts_FD03_DTCM "Indicates the presence/absent of at least one DTC in the System Memory";
CM_ SG_ 2654339139 PreviousCanNMState_FD03_DTCM "Indicates the last CanNM state that the ECU existed in";
CM_ SG_ 2654339139 StayActiveSource_FD03_DTCM "Indicates the source that requests the ECU to stay active";
CM_ SG_ 2654339139 WakeupSource_FD03_DTCM "Indicates the reason the ECU was most recently awakened";
CM_ SG_ 2654339073 CurrentCanNMState_FD03_ECM "Indicates that CanNM state the ECU is currently executing";
CM_ SG_ 2654339073 CurrentCanNMState_FD05_ECM "Indicates that CanNM state the ECU is currently executing";
CM_ SG_ 2654339073 CurrentCanNMState_FD16_ECM "Indicates that CanNM state the ECU is currently executing";
CM_ SG_ 2654339073 CurrentFailSts_FD03_ECM "Indicates the presence/absence of at least one DTC with DTCStatus = present in the System Memory";
CM_ SG_ 2654339073 CurrentFailSts_FD05_ECM "Indicates the presence/absence of at least one DTC with DTCStatus = present in the System Memory";
CM_ SG_ 2654339073 CurrentFailSts_FD16_ECM "Indicates the presence/absence of at least one DTC with DTCStatus = present in the System Memory";
CM_ SG_ 2654339073 DES_FD03_ECM "Indicates whether the ECU?s CAN cell is in either ErrorActive, or ErrorPassive state OR has just now recovered from a BusOff condition";
CM_ SG_ 2654339073 DES_FD05_ECM "Indicates whether the ECU?s CAN cell is in either ErrorActive, or ErrorPassive state OR has just now recovered from a BusOff condition";
CM_ SG_ 2654339073 DES_FD16_ECM "Indicates whether the ECU?s CAN cell is in either ErrorActive, or ErrorPassive state OR has just now recovered from a BusOff condition";
CM_ SG_ 2654339073 EOL_FD03_ECM "Indicates if the ECU requires configuration data at the assembly plant End Of Line";
CM_ SG_ 2654339073 EOL_FD05_ECM "Indicates if the ECU requires configuration data at the assembly plant End Of Line";
CM_ SG_ 2654339073 EOL_FD16_ECM "Indicates if the ECU requires configuration data at the assembly plant End Of Line";
CM_ SG_ 2654339073 GenericFailSts_FD03_ECM "Indicates the presence/absent of at least one DTC in the System Memory";
CM_ SG_ 2654339073 GenericFailSts_FD05_ECM "Indicates the presence/absent of at least one DTC in the System Memory";
CM_ SG_ 2654339073 GenericFailSts_FD16_ECM "Indicates the presence/absent of at least one DTC in the System Memory";
CM_ SG_ 2654339073 PreviousCanNMState_FD03_ECM "Indicates the last CanNM state that the ECU existed in";
CM_ SG_ 2654339073 PreviousCanNMState_FD05_ECM "Indicates the last CanNM state that the ECU existed in";
CM_ SG_ 2654339073 PreviousCanNMState_FD16_ECM "Indicates the last CanNM state that the ECU existed in";
CM_ SG_ 2654339073 StayActiveSource_FD03_ECM "Indicates the source that requests the ECU to stay active";
CM_ SG_ 2654339073 StayActiveSource_FD05_ECM "Indicates the source that requests the ECU to stay active";
CM_ SG_ 2654339073 StayActiveSource_FD16_ECM "Indicates the source that requests the ECU to stay active";
CM_ SG_ 2654339073 WakeupSource_FD03_ECM "Indicates the reason the ECU was most recently awakened";
CM_ SG_ 2654339073 WakeupSource_FD05_ECM "Indicates the reason the ECU was most recently awakened";
CM_ SG_ 2654339073 WakeupSource_FD16_ECM "Indicates the reason the ECU was most recently awakened";
CM_ SG_ 2654339108 CurrentCanNMState_FD08_ETM "Indicates that CanNM state the ECU is currently executing";
CM_ SG_ 2654339108 CurrentFailSts_FD08_ETM "Indicates the presence/absence of at least one DTC with DTCStatus = present in the System Memory";
CM_ SG_ 2654339108 DES_FD08_ETM "Indicates whether the ECU?s CAN cell is in either ErrorActive, or ErrorPassive state OR has just now recovered from a BusOff condition";
CM_ SG_ 2654339108 EOL_FD08_ETM "Indicates if the ECU requires configuration data at the assembly plant End Of Line";
CM_ SG_ 2654339108 GenericFailSts_FD08_ETM "Indicates the presence/absent of at least one DTC in the System Memory";
CM_ SG_ 2654339108 PreviousCanNMState_FD08_ETM "Indicates the last CanNM state that the ECU existed in";
CM_ SG_ 2654339108 StayActiveSource_FD08_ETM "Indicates the source that requests the ECU to stay active";
CM_ SG_ 2654339108 WakeupSource_FD08_ETM "Indicates the reason the ECU was most recently awakened";
CM_ SG_ 2654339136 CurrentCanNMState_FD03_EVCU2 "Indicates that CanNM state the ECU is currently executing";
CM_ SG_ 2654339136 CurrentCanNMState_FD11_EVCU2 "Indicates that CanNM state the ECU is currently executing";
CM_ SG_ 2654339136 CurrentCanNMState_FD16_EVCU2 "Indicates that CanNM state the ECU is currently executing";
CM_ SG_ 2654339136 CurrentFailSts_FD03_EVCU2 "Indicates the presence/absence of at least one DTC with DTCStatus = present in the System Memory";
CM_ SG_ 2654339136 CurrentFailSts_FD11_EVCU2 "Indicates the presence/absence of at least one DTC with DTCStatus = present in the System Memory";
CM_ SG_ 2654339136 CurrentFailSts_FD16_EVCU2 "Indicates the presence/absence of at least one DTC with DTCStatus = present in the System Memory";
CM_ SG_ 2654339136 DES_FD03_EVCU2 "Indicates whether the ECU?s CAN cell is in either ErrorActive, or ErrorPassive state OR has just now recovered from a BusOff condition";
CM_ SG_ 2654339136 DES_FD11_EVCU2 "Indicates whether the ECU?s CAN cell is in either ErrorActive, or ErrorPassive state OR has just now recovered from a BusOff condition";
CM_ SG_ 2654339136 DES_FD16_EVCU2 "Indicates whether the ECU?s CAN cell is in either ErrorActive, or ErrorPassive state OR has just now recovered from a BusOff condition";
CM_ SG_ 2654339136 EOL_FD03_EVCU2 "Indicates if the ECU requires configuration data at the assembly plant End Of Line";
CM_ SG_ 2654339136 EOL_FD11_EVCU2 "Indicates if the ECU requires configuration data at the assembly plant End Of Line";
CM_ SG_ 2654339136 EOL_FD16_EVCU2 "Indicates if the ECU requires configuration data at the assembly plant End Of Line";
CM_ SG_ 2654339136 GenericFailSts_FD03_EVCU2 "Indicates the presence/absent of at least one DTC in the System Memory";
CM_ SG_ 2654339136 GenericFailSts_FD11_EVCU2 "Indicates the presence/absent of at least one DTC in the System Memory";
CM_ SG_ 2654339136 GenericFailSts_FD16_EVCU2 "Indicates the presence/absent of at least one DTC in the System Memory";
CM_ SG_ 2654339136 PreviousCanNMState_FD03_EVCU2 "Indicates the last CanNM state that the ECU existed in";
CM_ SG_ 2654339136 PreviousCanNMState_FD11_EVCU2 "Indicates the last CanNM state that the ECU existed in";
CM_ SG_ 2654339136 PreviousCanNMState_FD16_EVCU2 "Indicates the last CanNM state that the ECU existed in";
CM_ SG_ 2654339136 StayActiveSource_FD03_EVCU2 "Indicates the source that requests the ECU to stay active";
CM_ SG_ 2654339136 StayActiveSource_FD11_EVCU2 "Indicates the source that requests the ECU to stay active";
CM_ SG_ 2654339136 StayActiveSource_FD16_EVCU2 "Indicates the source that requests the ECU to stay active";
CM_ SG_ 2654339136 WakeupSource_FD03_EVCU2 "Indicates the reason the ECU was most recently awakened";
CM_ SG_ 2654339136 WakeupSource_FD11_EVCU2 "Indicates the reason the ECU was most recently awakened";
CM_ SG_ 2654339136 WakeupSource_FD16_EVCU2 "Indicates the reason the ECU was most recently awakened";
CM_ SG_ 2654339216 CurrentCanNMState_FD03_GNMM "Indicates that CanNM state the ECU is currently executing";
CM_ SG_ 2654339216 CurrentFailSts_FD03_GNMM "Indicates the presence/absence of at least one DTC with DTCStatus = present in the System Memory";
CM_ SG_ 2654339216 DES_FD03_GNMM "Indicates whether the ECU?s CAN cell is in either ErrorActive, or ErrorPassive state OR has just now recovered from a BusOff condition";
CM_ SG_ 2654339216 EOL_FD03_GNMM "Indicates if the ECU requires configuration data at the assembly plant End Of Line";
CM_ SG_ 2654339216 GenericFailSts_FD03_GNMM "Indicates the presence/absent of at least one DTC in the System Memory";
CM_ SG_ 2654339216 PreviousCanNMState_FD03_GNMM "Indicates the last CanNM state that the ECU existed in";
CM_ SG_ 2654339216 StayActiveSource_FD03_GNMM "Indicates the source that requests the ECU to stay active";
CM_ SG_ 2654339216 WakeupSource_FD03_GNMM "Indicates the reason the ECU was most recently awakened";
CM_ SG_ 2654339170 CurrentCanNMState_FD03_HCP "Indicates that CanNM state the ECU is currently executing";
CM_ SG_ 2654339170 CurrentFailSts_FD03_HCP "Indicates the presence/absence of at least one DTC with DTCStatus = present in the System Memory";
CM_ SG_ 2654339170 DES_FD03_HCP "Indicates whether the ECU?s CAN cell is in either ErrorActive, or ErrorPassive state OR has just now recovered from a BusOff condition";
CM_ SG_ 2654339170 EOL_FD03_HCP "Indicates if the ECU requires configuration data at the assembly plant End Of Line";
CM_ SG_ 2654339170 GenericFailSts_FD03_HCP "Indicates the presence/absent of at least one DTC in the System Memory";
CM_ SG_ 2654339170 PreviousCanNMState_FD03_HCP "Indicates the last CanNM state that the ECU existed in";
CM_ SG_ 2654339170 StayActiveSource_FD03_HCP "Indicates the source that requests the ECU to stay active";
CM_ SG_ 2654339170 WakeupSource_FD03_HCP "Indicates the reason the ECU was most recently awakened";
CM_ SG_ 2654339197 CurrentCanNMState_FD11_IDCM "Indicates that CanNM state the ECU is currently executing";
CM_ SG_ 2654339197 CurrentFailSts_FD11_IDCM "Indicates the presence/absence of at least one DTC with DTCStatus = present in the System Memory";
CM_ SG_ 2654339197 DES_FD11_IDCM "Indicates whether the ECU?s CAN cell is in either ErrorActive, or ErrorPassive state OR has just now recovered from a BusOff condition";
CM_ SG_ 2654339197 EOL_FD11_IDCM "Indicates if the ECU requires configuration data at the assembly plant End Of Line";
CM_ SG_ 2654339197 GenericFailSts_FD11_IDCM "Indicates the presence/absent of at least one DTC in the System Memory";
CM_ SG_ 2654339197 PreviousCanNMState_FD11_IDCM "Indicates the last CanNM state that the ECU existed in";
CM_ SG_ 2654339197 StayActiveSource_FD11_IDCM "Indicates the source that requests the ECU to stay active";
CM_ SG_ 2654339197 WakeupSource_FD11_IDCM "Indicates the reason the ECU was most recently awakened";
CM_ SG_ 2654339075 CurrentCanNMState_FD03_IPC "Indicates that CanNM state the ECU is currently executing";
CM_ SG_ 2654339075 CurrentFailSts_FD03_IPC "Indicates the presence/absence of at least one DTC with DTCStatus = present in the System Memory";
CM_ SG_ 2654339075 DES_FD03_IPC "Indicates whether the ECU?s CAN cell is in either ErrorActive, or ErrorPassive state OR has just now recovered from a BusOff condition";
CM_ SG_ 2654339075 EOL_FD03_IPC "Indicates if the ECU requires configuration data at the assembly plant End Of Line";
CM_ SG_ 2654339075 GenericFailSts_FD03_IPC "Indicates the presence/absent of at least one DTC in the System Memory";
CM_ SG_ 2654339075 PreviousCanNMState_FD03_IPC "Indicates the last CanNM state that the ECU existed in";
CM_ SG_ 2654339075 StayActiveSource_FD03_IPC "Indicates the source that requests the ECU to stay active";
CM_ SG_ 2654339075 WakeupSource_FD03_IPC "Indicates the reason the ECU was most recently awakened";
CM_ SG_ 2654339160 CurrentCanNMState_FD05_MCPA "Indicates that CanNM state the ECU is currently executing";
CM_ SG_ 2654339160 CurrentCanNMState_FD16_MCPA "Indicates that CanNM state the ECU is currently executing";
CM_ SG_ 2654339160 CurrentFailSts_FD05_MCPA "Indicates the presence/absence of at least one DTC with DTCStatus = present in the System Memory";
CM_ SG_ 2654339160 CurrentFailSts_FD16_MCPA "Indicates the presence/absence of at least one DTC with DTCStatus = present in the System Memory";
CM_ SG_ 2654339160 DES_FD05_MCPA "Indicates whether the ECU?s CAN cell is in either ErrorActive, or ErrorPassive state OR has just now recovered from a BusOff condition";
CM_ SG_ 2654339160 DES_FD16_MCPA "Indicates whether the ECU?s CAN cell is in either ErrorActive, or ErrorPassive state OR has just now recovered from a BusOff condition";
CM_ SG_ 2654339160 EOL_FD05_MCPA "Indicates if the ECU requires configuration data at the assembly plant End Of Line";
CM_ SG_ 2654339160 EOL_FD16_MCPA "Indicates if the ECU requires configuration data at the assembly plant End Of Line";
CM_ SG_ 2654339160 GenericFailSts_FD05_MCPA "Indicates the presence/absent of at least one DTC in the System Memory";
CM_ SG_ 2654339160 GenericFailSts_FD16_MCPA "Indicates the presence/absent of at least one DTC in the System Memory";
CM_ SG_ 2654339160 PreviousCanNMState_FD05_MCPA "Indicates the last CanNM state that the ECU existed in";
CM_ SG_ 2654339160 PreviousCanNMState_FD16_MCPA "Indicates the last CanNM state that the ECU existed in";
CM_ SG_ 2654339160 StayActiveSource_FD05_MCPA "Indicates the source that requests the ECU to stay active";
CM_ SG_ 2654339160 StayActiveSource_FD16_MCPA "Indicates the source that requests the ECU to stay active";
CM_ SG_ 2654339160 WakeupSource_FD05_MCPA "Indicates the reason the ECU was most recently awakened";
CM_ SG_ 2654339160 WakeupSource_FD16_MCPA "Indicates the reason the ECU was most recently awakened";

BA_DEF_ SG_ "GenSigStartValue" INT 0 2147483647;
BA_DEF_ SG_ "GenSigInactiveValue" INT 0 2147483647;
BA_DEF_ SG_ "GenSigSendType" ENUM "NotUsed","OnWrite","OnWriteWithRepetition","OnChange","OnChangeWithRepetition","IfActive","IfActiveWithRepetition","NoSigSendType";
BA_DEF_ SG_ "SystemSignalLongSymbol" STRING ;
BA_DEF_ SG_ "GenSigTimeoutTime_AGSM" INT 0 65535;
BA_DEF_ SG_ "GenSigTimeoutTime_BCM" INT 0 65535;
BA_DEF_ SG_ "GenSigTimeoutTime_BSM" INT 0 65535;
BA_DEF_ SG_ "GenSigTimeoutTime_CADM" INT 0 65535;
BA_DEF_ SG_ "GenSigTimeoutTime_DMSM" INT 0 65535;
BA_DEF_ SG_ "GenSigTimeoutTime_DTCM" INT 0 65535;
BA_DEF_ SG_ "GenSigTimeoutTime_ECM" INT 0 65535;
BA_DEF_ SG_ "GenSigTimeoutTime_EVCU2" INT 0 65535;
BA_DEF_ SG_ "GenSigTimeoutTime_GNMM" INT 0 65535;
BA_DEF_ SG_ "GenSigTimeoutTime_HCP" INT 0 65535;
BA_DEF_ SG_ "GenSigTimeoutTime_IPC" INT 0 65535;
BA_DEF_ SG_ "GenSigTimeoutTime_RFHM" INT 0 65535;
BA_DEF_ SG_ "GenSigTimeoutTime_SGW" INT 0 65535;
BA_DEF_ SG_ "GenSigTimeoutTime_TCM" INT 0 65535;
BA_DEF_ BO_ "DiagRequest" ENUM "No","Yes";
BA_DEF_ BO_ "Type" ENUM "P","C","PE","COC","PE_Cntrl","E","E_Cntrl","OC","S","BAF","DC","EM","MM","ISO-TP","-";
BA_DEF_ BO_ "DiagResponse" ENUM "No","Yes";
BA_DEF_ BO_ "NmMessage" ENUM "No","Yes";
BA_DEF_ BO_ "GenMsgSendType" ENUM "Cyclic","NotUsed","NotUsed","NotUsed","NotUsed","NotUsed","NotUsed","NotUsed","NoMsgSendType";
BA_DEF_ BO_ "GenMsgNrOfRepetition" INT 0 255;
BA_DEF_ BO_ "GenMsgILSupport" ENUM "No","Yes";
BA_DEF_ BO_ "GenMsgStartDelayTime" INT 0 65535;
BA_DEF_ BO_ "GenMsgCycleTimeFast" INT 0 65535;
BA_DEF_ BO_ "GenMsgCycleTime" INT 0 65535;
BA_DEF_ BO_ "GenMsgDelayTime" INT 0 65535;
BA_DEF_ BO_ "NmAsrMessage" ENUM "No","Yes";
BA_DEF_ BO_ "DiagState" ENUM "No","Yes";
BA_DEF_ BO_ "DiagConnection" HEX 0 65535;
BA_DEF_ BO_ "VFrameFormat" ENUM "StandardCAN","ExtendedCAN","reserved","reserved","reserved","reserved","reserved","reserved","reserved","reserved","reserved","reserved","reserved","reserved","StandardCAN_FD","ExtendedCAN_FD";
BA_DEF_ BO_ "CANFD_BRS" ENUM "No","Yes";
BA_DEF_DEF_ "DiagRequest" "No";
BA_DEF_DEF_ "Type" "-";
BA_DEF_DEF_ "DiagResponse" "No";
BA_DEF_DEF_ "NmMessage" "No";
BA_DEF_DEF_ "GenMsgSendType" "NoMsgSendType";
BA_DEF_DEF_ "GenMsgNrOfRepetition" 0;
BA_DEF_DEF_ "GenMsgILSupport" "No";
BA_DEF_DEF_ "GenMsgStartDelayTime" 0;
BA_DEF_DEF_ "GenMsgCycleTimeFast" 0;
BA_DEF_DEF_ "GenMsgCycleTime" 0;
BA_DEF_DEF_ "GenMsgDelayTime" 0;
BA_DEF_DEF_ "NmAsrMessage" "No";
BA_DEF_DEF_ "DiagState" "No";
BA_DEF_DEF_ "DiagConnection" 0;
BA_DEF_DEF_ "VFrameFormat" "StandardCAN_FD";
BA_DEF_DEF_ "CANFD_BRS" "No";
BA_DEF_DEF_ "GenSigStartValue" 0;
BA_DEF_DEF_ "GenSigInactiveValue" 0;
BA_DEF_DEF_ "GenSigSendType" "NoSigSendType";
BA_DEF_DEF_ "SystemSignalLongSymbol" "";
BA_DEF_DEF_ "GenSigTimeoutTime_AGSM" 2500;
BA_DEF_DEF_ "GenSigTimeoutTime_BCM" 2500;
BA_DEF_DEF_ "GenSigTimeoutTime_BSM" 2500;
BA_DEF_DEF_ "GenSigTimeoutTime_CADM" 2500;
BA_DEF_DEF_ "GenSigTimeoutTime_DMSM" 2500;
BA_DEF_DEF_ "GenSigTimeoutTime_DTCM" 2500;
BA_DEF_DEF_ "GenSigTimeoutTime_ECM" 2500;
BA_DEF_DEF_ "GenSigTimeoutTime_EVCU2" 2500;
BA_DEF_DEF_ "GenSigTimeoutTime_GNMM" 2500;
BA_DEF_DEF_ "GenSigTimeoutTime_HCP" 2500;
BA_DEF_DEF_ "GenSigTimeoutTime_IPC" 2500;
BA_DEF_DEF_ "GenSigTimeoutTime_RFHM" 2500;
BA_DEF_DEF_ "GenSigTimeoutTime_SGW" 2500;
BA_DEF_DEF_ "GenSigTimeoutTime_TCM" 2500;
BA_ "Type" BO_ 2654339142 1;
BA_ "GenMsgSendType" BO_ 2654339142 0;
BA_ "GenMsgILSupport" BO_ 2654339142 1;
BA_ "GenMsgCycleTime" BO_ 2654339142 1000;
BA_ "VFrameFormat" BO_ 2654339142 15;
BA_ "CANFD_BRS" BO_ 2654339142 1;
BA_ "Type" BO_ 2654339078 1;
BA_ "GenMsgSendType" BO_ 2654339078 0;
BA_ "GenMsgILSupport" BO_ 2654339078 1;
BA_ "GenMsgCycleTime" BO_ 2654339078 1000;
BA_ "VFrameFormat" BO_ 2654339078 15;
BA_ "CANFD_BRS" BO_ 2654339078 1;
BA_ "Type" BO_ 2654339213 1;
BA_ "GenMsgSendType" BO_ 2654339213 0;
BA_ "GenMsgILSupport" BO_ 2654339213 1;
BA_ "GenMsgCycleTime" BO_ 2654339213 1000;
BA_ "VFrameFormat" BO_ 2654339213 15;
BA_ "CANFD_BRS" BO_ 2654339213 1;
BA_ "Type" BO_ 2654339225 1;
BA_ "GenMsgSendType" BO_ 2654339225 0;
BA_ "GenMsgILSupport" BO_ 2654339225 1;
BA_ "GenMsgCycleTime" BO_ 2654339225 1000;
BA_ "VFrameFormat" BO_ 2654339225 15;
BA_ "CANFD_BRS" BO_ 2654339225 1;
BA_ "Type" BO_ 2654339139 1;
BA_ "GenMsgSendType" BO_ 2654339139 0;
BA_ "GenMsgILSupport" BO_ 2654339139 1;
BA_ "GenMsgCycleTime" BO_ 2654339139 1000;
BA_ "VFrameFormat" BO_ 2654339139 15;
BA_ "CANFD_BRS" BO_ 2654339139 1;
BA_ "Type" BO_ 2654339073 1;
BA_ "GenMsgSendType" BO_ 2654339073 0;
BA_ "GenMsgILSupport" BO_ 2654339073 1;
BA_ "GenMsgCycleTime" BO_ 2654339073 1000;
BA_ "VFrameFormat" BO_ 2654339073 15;
BA_ "CANFD_BRS" BO_ 2654339073 1;
BA_ "Type" BO_ 2654339108 1;
BA_ "GenMsgSendType" BO_ 2654339108 0;
BA_ "GenMsgILSupport" BO_ 2654339108 1;
BA_ "GenMsgCycleTime" BO_ 2654339108 1000;
BA_ "VFrameFormat" BO_ 2654339108 15;
BA_ "CANFD_BRS" BO_ 2654339108 1;
BA_ "Type" BO_ 2654339136 1;
BA_ "GenMsgSendType" BO_ 2654339136 0;
BA_ "GenMsgILSupport" BO_ 2654339136 1;
BA_ "GenMsgCycleTime" BO_ 2654339136 1000;
BA_ "VFrameFormat" BO_ 2654339136 15;
BA_ "CANFD_BRS" BO_ 2654339136 1;
BA_ "Type" BO_ 2654339216 1;
BA_ "GenMsgSendType" BO_ 2654339216 0;
BA_ "GenMsgILSupport" BO_ 2654339216 1;
BA_ "GenMsgCycleTime" BO_ 2654339216 1000;
BA_ "VFrameFormat" BO_ 2654339216 15;
BA_ "CANFD_BRS" BO_ 2654339216 1;
BA_ "Type" BO_ 2654339170 1;
BA_ "GenMsgSendType" BO_ 2654339170 0;
BA_ "GenMsgILSupport" BO_ 2654339170 1;
BA_ "GenMsgCycleTime" BO_ 2654339170 1000;
BA_ "VFrameFormat" BO_ 2654339170 15;
BA_ "CANFD_BRS" BO_ 2654339170 1;
BA_ "Type" BO_ 2654339197 1;
BA_ "GenMsgSendType" BO_ 2654339197 0;
BA_ "GenMsgILSupport" BO_ 2654339197 1;
BA_ "GenMsgCycleTime" BO_ 2654339197 1000;
BA_ "VFrameFormat" BO_ 2654339197 15;
BA_ "CANFD_BRS" BO_ 2654339197 1;
BA_ "Type" BO_ 2654339075 1;
BA_ "GenMsgSendType" BO_ 2654339075 0;
BA_ "GenMsgILSupport" BO_ 2654339075 1;
BA_ "GenMsgCycleTime" BO_ 2654339075 1000;
BA_ "VFrameFormat" BO_ 2654339075 15;
BA_ "CANFD_BRS" BO_ 2654339075 1;
BA_ "Type" BO_ 2654339160 1;
BA_ "GenMsgSendType" BO_ 2654339160 0;
BA_ "GenMsgILSupport" BO_ 2654339160 1;
BA_ "GenMsgCycleTime" BO_ 2654339160 1000;
BA_ "VFrameFormat" BO_ 2654339160 15;
BA_ "CANFD_BRS" BO_ 2654339160 1;
BA_ "GenSigTimeoutTime_AGSM" SG_ 2654339142 CurrentCanNMState_FD05_BPCM 0;
BA_ "GenSigTimeoutTime_BCM" SG_ 2654339142 CurrentCanNMState_FD05_BPCM 0;
BA_ "GenSigTimeoutTime_BSM" SG_ 2654339142 CurrentCanNMState_FD05_BPCM 0;
BA_ "GenSigTimeoutTime_CADM" SG_ 2654339142 CurrentCanNMState_FD05_BPCM 0;
BA_ "GenSigTimeoutTime_DMSM" SG_ 2654339142 CurrentCanNMState_FD05_BPCM 0;
BA_ "GenSigTimeoutTime_DTCM" SG_ 2654339142 CurrentCanNMState_FD05_BPCM 0;
BA_ "GenSigTimeoutTime_ECM" SG_ 2654339142 CurrentCanNMState_FD05_BPCM 0;
BA_ "GenSigTimeoutTime_EVCU2" SG_ 2654339142 CurrentCanNMState_FD05_BPCM 0;
BA_ "GenSigTimeoutTime_GNMM" SG_ 2654339142 CurrentCanNMState_FD05_BPCM 0;
BA_ "GenSigTimeoutTime_HCP" SG_ 2654339142 CurrentCanNMState_FD05_BPCM 0;
BA_ "GenSigTimeoutTime_IPC" SG_ 2654339142 CurrentCanNMState_FD05_BPCM 0;
BA_ "GenSigTimeoutTime_RFHM" SG_ 2654339142 CurrentCanNMState_FD05_BPCM 0;
BA_ "GenSigTimeoutTime_SGW" SG_ 2654339142 CurrentCanNMState_FD05_BPCM 0;
BA_ "GenSigTimeoutTime_TCM" SG_ 2654339142 CurrentCanNMState_FD05_BPCM 0;
BA_ "GenSigTimeoutTime_AGSM" SG_ 2654339142 CurrentCanNMState_FD11_BPCM 0;
BA_ "GenSigTimeoutTime_BCM" SG_ 2654339142 CurrentCanNMState_FD11_BPCM 0;
BA_ "GenSigTimeoutTime_BSM" SG_ 2654339142 CurrentCanNMState_FD11_BPCM 0;
BA_ "GenSigTimeoutTime_CADM" SG_ 2654339142 CurrentCanNMState_FD11_BPCM 0;
BA_ "GenSigTimeoutTime_DMSM" SG_ 2654339142 CurrentCanNMState_FD11_BPCM 0;
BA_ "GenSigTimeoutTime_DTCM" SG_ 2654339142 CurrentCanNMState_FD11_BPCM 0;
BA_ "GenSigTimeoutTime_ECM" SG_ 2654339142 CurrentCanNMState_FD11_BPCM 0;
BA_ "GenSigTimeoutTime_EVCU2" SG_ 2654339142 CurrentCanNMState_FD11_BPCM 0;
BA_ "GenSigTimeoutTime_GNMM" SG_ 2654339142 CurrentCanNMState_FD11_BPCM 0;
BA_ "GenSigTimeoutTime_HCP" SG_ 2654339142 CurrentCanNMState_FD11_BPCM 0;
BA_ "GenSigTimeoutTime_IPC" SG_ 2654339142 CurrentCanNMState_FD11_BPCM 0;
BA_ "GenSigTimeoutTime_RFHM" SG_ 2654339142 CurrentCanNMState_FD11_BPCM 0;
BA_ "GenSigTimeoutTime_SGW" SG_ 2654339142 CurrentCanNMState_FD11_BPCM 0;
BA_ "GenSigTimeoutTime_TCM" SG_ 2654339142 CurrentCanNMState_FD11_BPCM 0;
BA_ "GenSigTimeoutTime_AGSM" SG_ 2654339142 CurrentFailSts_FD05_BPCM 0;
BA_ "GenSigTimeoutTime_BCM" SG_ 2654339142 CurrentFailSts_FD05_BPCM 0;
BA_ "GenSigTimeoutTime_BSM" SG_ 2654339142 CurrentFailSts_FD05_BPCM 0;
BA_ "GenSigTimeoutTime_CADM" SG_ 2654339142 CurrentFailSts_FD05_BPCM 0;
BA_ "GenSigTimeoutTime_DMSM" SG_ 2654339142 CurrentFailSts_FD05_BPCM 0;
BA_ "GenSigTimeoutTime_DTCM" SG_ 2654339142 CurrentFailSts_FD05_BPCM 0;
BA_ "GenSigTimeoutTime_ECM" SG_ 2654339142 CurrentFailSts_FD05_BPCM 0;
BA_ "GenSigTimeoutTime_EVCU2" SG_ 2654339142 CurrentFailSts_FD05_BPCM 0;
BA_ "GenSigTimeoutTime_GNMM" SG_ 2654339142 CurrentFailSts_FD05_BPCM 0;
BA_ "GenSigTimeoutTime_HCP" SG_ 2654339142 CurrentFailSts_FD05_BPCM 0;
BA_ "GenSigTimeoutTime_IPC" SG_ 2654339142 CurrentFailSts_FD05_BPCM 0;
BA_ "GenSigTimeoutTime_RFHM" SG_ 2654339142 CurrentFailSts_FD05_BPCM 0;
BA_ "GenSigTimeoutTime_SGW" SG_ 2654339142 CurrentFailSts_FD05_BPCM 0;
BA_ "GenSigTimeoutTime_TCM" SG_ 2654339142 CurrentFailSts_FD05_BPCM 0;
BA_ "GenSigTimeoutTime_AGSM" SG_ 2654339142 CurrentFailSts_FD11_BPCM 0;
BA_ "GenSigTimeoutTime_BSM" SG_ 2654339142 CurrentFailSts_FD11_BPCM 0;
BA_ "GenSigTimeoutTime_CADM" SG_ 2654339142 CurrentFailSts_FD11_BPCM 0;
BA_ "GenSigTimeoutTime_DMSM" SG_ 2654339142 CurrentFailSts_FD11_BPCM 0;
BA_ "GenSigTimeoutTime_DTCM" SG_ 2654339142 CurrentFailSts_FD11_BPCM 0;
BA_ "GenSigTimeoutTime_ECM" SG_ 2654339142 CurrentFailSts_FD11_BPCM 0;
BA_ "GenSigTimeoutTime_EVCU2" SG_ 2654339142 CurrentFailSts_FD11_BPCM 0;
BA_ "GenSigTimeoutTime_GNMM" SG_ 2654339142 CurrentFailSts_FD11_BPCM 0;
BA_ "GenSigTimeoutTime_HCP" SG_ 2654339142 CurrentFailSts_FD11_BPCM 0;
BA_ "GenSigTimeoutTime_IPC" SG_ 2654339142 CurrentFailSts_FD11_BPCM 0;
BA_ "GenSigTimeoutTime_RFHM" SG_ 2654339142 CurrentFailSts_FD11_BPCM 0;
BA_ "GenSigTimeoutTime_SGW" SG_ 2654339142 CurrentFailSts_FD11_BPCM 0;
BA_ "GenSigTimeoutTime_TCM" SG_ 2654339142 CurrentFailSts_FD11_BPCM 0;
BA_ "GenSigTimeoutTime_AGSM" SG_ 2654339142 DES_FD05_BPCM 0;
BA_ "GenSigTimeoutTime_BCM" SG_ 2654339142 DES_FD05_BPCM 0;
BA_ "GenSigTimeoutTime_BSM" SG_ 2654339142 DES_FD05_BPCM 0;
BA_ "GenSigTimeoutTime_CADM" SG_ 2654339142 DES_FD05_BPCM 0;
BA_ "GenSigTimeoutTime_DMSM" SG_ 2654339142 DES_FD05_BPCM 0;
BA_ "GenSigTimeoutTime_DTCM" SG_ 2654339142 DES_FD05_BPCM 0;
BA_ "GenSigTimeoutTime_ECM" SG_ 2654339142 DES_FD05_BPCM 0;
BA_ "GenSigTimeoutTime_EVCU2" SG_ 2654339142 DES_FD05_BPCM 0;
BA_ "GenSigTimeoutTime_GNMM" SG_ 2654339142 DES_FD05_BPCM 0;
BA_ "GenSigTimeoutTime_HCP" SG_ 2654339142 DES_FD05_BPCM 0;
BA_ "GenSigTimeoutTime_IPC" SG_ 2654339142 DES_FD05_BPCM 0;
BA_ "GenSigTimeoutTime_RFHM" SG_ 2654339142 DES_FD05_BPCM 0;
BA_ "GenSigTimeoutTime_SGW" SG_ 2654339142 DES_FD05_BPCM 0;
BA_ "GenSigTimeoutTime_TCM" SG_ 2654339142 DES_FD05_BPCM 0;
BA_ "GenSigTimeoutTime_AGSM" SG_ 2654339142 DES_FD11_BPCM 0;
BA_ "GenSigTimeoutTime_BCM" SG_ 2654339142 DES_FD11_BPCM 0;
BA_ "GenSigTimeoutTime_BSM" SG_ 2654339142 DES_FD11_BPCM 0;
BA_ "GenSigTimeoutTime_CADM" SG_ 2654339142 DES_FD11_BPCM 0;
BA_ "GenSigTimeoutTime_DMSM" SG_ 2654339142 DES_FD11_BPCM 0;
BA_ "GenSigTimeoutTime_DTCM" SG_ 2654339142 DES_FD11_BPCM 0;
BA_ "GenSigTimeoutTime_ECM" SG_ 2654339142 DES_FD11_BPCM 0;
BA_ "GenSigTimeoutTime_EVCU2" SG_ 2654339142 DES_FD11_BPCM 0;
BA_ "GenSigTimeoutTime_GNMM" SG_ 2654339142 DES_FD11_BPCM 0;
BA_ "GenSigTimeoutTime_HCP" SG_ 2654339142 DES_FD11_BPCM 0;
BA_ "GenSigTimeoutTime_IPC" SG_ 2654339142 DES_FD11_BPCM 0;
BA_ "GenSigTimeoutTime_RFHM" SG_ 2654339142 DES_FD11_BPCM 0;
BA_ "GenSigTimeoutTime_SGW" SG_ 2654339142 DES_FD11_BPCM 0;
BA_ "GenSigTimeoutTime_TCM" SG_ 2654339142 DES_FD11_BPCM 0;
BA_ "GenSigTimeoutTime_AGSM" SG_ 2654339142 EOL_FD05_BPCM 0;
BA_ "GenSigTimeoutTime_BCM" SG_ 2654339142 EOL_FD05_BPCM 0;
BA_ "GenSigTimeoutTime_BSM" SG_ 2654339142 EOL_FD05_BPCM 0;
BA_ "GenSigTimeoutTime_CADM" SG_ 2654339142 EOL_FD05_BPCM 0;
BA_ "GenSigTimeoutTime_DMSM" SG_ 2654339142 EOL_FD05_BPCM 0;
BA_ "GenSigTimeoutTime_DTCM" SG_ 2654339142 EOL_FD05_BPCM 0;
BA_ "GenSigTimeoutTime_ECM" SG_ 2654339142 EOL_FD05_BPCM 0;
BA_ "GenSigTimeoutTime_EVCU2" SG_ 2654339142 EOL_FD05_BPCM 0;
BA_ "GenSigTimeoutTime_GNMM" SG_ 2654339142 EOL_FD05_BPCM 0;
BA_ "GenSigTimeoutTime_HCP" SG_ 2654339142 EOL_FD05_BPCM 0;
BA_ "GenSigTimeoutTime_IPC" SG_ 2654339142 EOL_FD05_BPCM 0;
BA_ "GenSigTimeoutTime_RFHM" SG_ 2654339142 EOL_FD05_BPCM 0;
BA_ "GenSigTimeoutTime_SGW" SG_ 2654339142 EOL_FD05_BPCM 0;
BA_ "GenSigTimeoutTime_TCM" SG_ 2654339142 EOL_FD05_BPCM 0;
BA_ "GenSigTimeoutTime_AGSM" SG_ 2654339142 EOL_FD11_BPCM 0;
BA_ "GenSigTimeoutTime_BSM" SG_ 2654339142 EOL_FD11_BPCM 0;
BA_ "GenSigTimeoutTime_CADM" SG_ 2654339142 EOL_FD11_BPCM 0;
BA_ "GenSigTimeoutTime_DMSM" SG_ 2654339142 EOL_FD11_BPCM 0;
BA_ "GenSigTimeoutTime_DTCM" SG_ 2654339142 EOL_FD11_BPCM 0;
BA_ "GenSigTimeoutTime_ECM" SG_ 2654339142 EOL_FD11_BPCM 0;
BA_ "GenSigTimeoutTime_EVCU2" SG_ 2654339142 EOL_FD11_BPCM 0;
BA_ "GenSigTimeoutTime_GNMM" SG_ 2654339142 EOL_FD11_BPCM 0;
BA_ "GenSigTimeoutTime_HCP" SG_ 2654339142 EOL_FD11_BPCM 0;
BA_ "GenSigTimeoutTime_IPC" SG_ 2654339142 EOL_FD11_BPCM 0;
BA_ "GenSigTimeoutTime_RFHM" SG_ 2654339142 EOL_FD11_BPCM 0;
BA_ "GenSigTimeoutTime_SGW" SG_ 2654339142 EOL_FD11_BPCM 0;
BA_ "GenSigTimeoutTime_TCM" SG_ 2654339142 EOL_FD11_BPCM 0;
BA_ "GenSigTimeoutTime_AGSM" SG_ 2654339142 GenericFailSts_FD05_BPCM 0;
BA_ "GenSigTimeoutTime_BCM" SG_ 2654339142 GenericFailSts_FD05_BPCM 0;
BA_ "GenSigTimeoutTime_BSM" SG_ 2654339142 GenericFailSts_FD05_BPCM 0;
BA_ "GenSigTimeoutTime_CADM" SG_ 2654339142 GenericFailSts_FD05_BPCM 0;
BA_ "GenSigTimeoutTime_DMSM" SG_ 2654339142 GenericFailSts_FD05_BPCM 0;
BA_ "GenSigTimeoutTime_DTCM" SG_ 2654339142 GenericFailSts_FD05_BPCM 0;
BA_ "GenSigTimeoutTime_ECM" SG_ 2654339142 GenericFailSts_FD05_BPCM 0;
BA_ "GenSigTimeoutTime_EVCU2" SG_ 2654339142 GenericFailSts_FD05_BPCM 0;
BA_ "GenSigTimeoutTime_GNMM" SG_ 2654339142 GenericFailSts_FD05_BPCM 0;
BA_ "GenSigTimeoutTime_HCP" SG_ 2654339142 GenericFailSts_FD05_BPCM 0;
BA_ "GenSigTimeoutTime_IPC" SG_ 2654339142 GenericFailSts_FD05_BPCM 0;
BA_ "GenSigTimeoutTime_RFHM" SG_ 2654339142 GenericFailSts_FD05_BPCM 0;
BA_ "GenSigTimeoutTime_SGW" SG_ 2654339142 GenericFailSts_FD05_BPCM 0;
BA_ "GenSigTimeoutTime_TCM" SG_ 2654339142 GenericFailSts_FD05_BPCM 0;
BA_ "GenSigTimeoutTime_AGSM" SG_ 2654339142 GenericFailSts_FD11_BPCM 0;
BA_ "GenSigTimeoutTime_BSM" SG_ 2654339142 GenericFailSts_FD11_BPCM 0;
BA_ "GenSigTimeoutTime_CADM" SG_ 2654339142 GenericFailSts_FD11_BPCM 0;
BA_ "GenSigTimeoutTime_DMSM" SG_ 2654339142 GenericFailSts_FD11_BPCM 0;
BA_ "GenSigTimeoutTime_DTCM" SG_ 2654339142 GenericFailSts_FD11_BPCM 0;
BA_ "GenSigTimeoutTime_ECM" SG_ 2654339142 GenericFailSts_FD11_BPCM 0;
BA_ "GenSigTimeoutTime_EVCU2" SG_ 2654339142 GenericFailSts_FD11_BPCM 0;
BA_ "GenSigTimeoutTime_GNMM" SG_ 2654339142 GenericFailSts_FD11_BPCM 0;
BA_ "GenSigTimeoutTime_HCP" SG_ 2654339142 GenericFailSts_FD11_BPCM 0;
BA_ "GenSigTimeoutTime_IPC" SG_ 2654339142 GenericFailSts_FD11_BPCM 0;
BA_ "GenSigTimeoutTime_RFHM" SG_ 2654339142 GenericFailSts_FD11_BPCM 0;
BA_ "GenSigTimeoutTime_SGW" SG_ 2654339142 GenericFailSts_FD11_BPCM 0;
BA_ "GenSigTimeoutTime_TCM" SG_ 2654339142 GenericFailSts_FD11_BPCM 0;
BA_ "GenSigTimeoutTime_AGSM" SG_ 2654339142 PreviousCanNMState_FD05_BPCM 0;
BA_ "GenSigTimeoutTime_BCM" SG_ 2654339142 PreviousCanNMState_FD05_BPCM 0;
BA_ "GenSigTimeoutTime_BSM" SG_ 2654339142 PreviousCanNMState_FD05_BPCM 0;
BA_ "GenSigTimeoutTime_CADM" SG_ 2654339142 PreviousCanNMState_FD05_BPCM 0;
BA_ "GenSigTimeoutTime_DMSM" SG_ 2654339142 PreviousCanNMState_FD05_BPCM 0;
BA_ "GenSigTimeoutTime_DTCM" SG_ 2654339142 PreviousCanNMState_FD05_BPCM 0;
BA_ "GenSigTimeoutTime_ECM" SG_ 2654339142 PreviousCanNMState_FD05_BPCM 0;
BA_ "GenSigTimeoutTime_EVCU2" SG_ 2654339142 PreviousCanNMState_FD05_BPCM 0;
BA_ "GenSigTimeoutTime_GNMM" SG_ 2654339142 PreviousCanNMState_FD05_BPCM 0;
BA_ "GenSigTimeoutTime_HCP" SG_ 2654339142 PreviousCanNMState_FD05_BPCM 0;
BA_ "GenSigTimeoutTime_IPC" SG_ 2654339142 PreviousCanNMState_FD05_BPCM 0;
BA_ "GenSigTimeoutTime_RFHM" SG_ 2654339142 PreviousCanNMState_FD05_BPCM 0;
BA_ "GenSigTimeoutTime_SGW" SG_ 2654339142 PreviousCanNMState_FD05_BPCM 0;
BA_ "GenSigTimeoutTime_TCM" SG_ 2654339142 PreviousCanNMState_FD05_BPCM 0;
BA_ "GenSigTimeoutTime_AGSM" SG_ 2654339142 PreviousCanNMState_FD11_BPCM 0;
BA_ "GenSigTimeoutTime_BCM" SG_ 2654339142 PreviousCanNMState_FD11_BPCM 0;
BA_ "GenSigTimeoutTime_BSM" SG_ 2654339142 PreviousCanNMState_FD11_BPCM 0;
BA_ "GenSigTimeoutTime_CADM" SG_ 2654339142 PreviousCanNMState_FD11_BPCM 0;
BA_ "GenSigTimeoutTime_DMSM" SG_ 2654339142 PreviousCanNMState_FD11_BPCM 0;
BA_ "GenSigTimeoutTime_DTCM" SG_ 2654339142 PreviousCanNMState_FD11_BPCM 0;
BA_ "GenSigTimeoutTime_ECM" SG_ 2654339142 PreviousCanNMState_FD11_BPCM 0;
BA_ "GenSigTimeoutTime_EVCU2" SG_ 2654339142 PreviousCanNMState_FD11_BPCM 0;
BA_ "GenSigTimeoutTime_GNMM" SG_ 2654339142 PreviousCanNMState_FD11_BPCM 0;
BA_ "GenSigTimeoutTime_HCP" SG_ 2654339142 PreviousCanNMState_FD11_BPCM 0;
BA_ "GenSigTimeoutTime_IPC" SG_ 2654339142 PreviousCanNMState_FD11_BPCM 0;
BA_ "GenSigTimeoutTime_RFHM" SG_ 2654339142 PreviousCanNMState_FD11_BPCM 0;
BA_ "GenSigTimeoutTime_SGW" SG_ 2654339142 PreviousCanNMState_FD11_BPCM 0;
BA_ "GenSigTimeoutTime_TCM" SG_ 2654339142 PreviousCanNMState_FD11_BPCM 0;
BA_ "GenSigTimeoutTime_AGSM" SG_ 2654339142 StayActiveSource_FD05_BPCM 0;
BA_ "GenSigTimeoutTime_BCM" SG_ 2654339142 StayActiveSource_FD05_BPCM 0;
BA_ "GenSigTimeoutTime_BSM" SG_ 2654339142 StayActiveSource_FD05_BPCM 0;
BA_ "GenSigTimeoutTime_CADM" SG_ 2654339142 StayActiveSource_FD05_BPCM 0;
BA_ "GenSigTimeoutTime_DMSM" SG_ 2654339142 StayActiveSource_FD05_BPCM 0;
BA_ "GenSigTimeoutTime_DTCM" SG_ 2654339142 StayActiveSource_FD05_BPCM 0;
BA_ "GenSigTimeoutTime_ECM" SG_ 2654339142 StayActiveSource_FD05_BPCM 0;
BA_ "GenSigTimeoutTime_EVCU2" SG_ 2654339142 StayActiveSource_FD05_BPCM 0;
BA_ "GenSigTimeoutTime_GNMM" SG_ 2654339142 StayActiveSource_FD05_BPCM 0;
BA_ "GenSigTimeoutTime_HCP" SG_ 2654339142 StayActiveSource_FD05_BPCM 0;
BA_ "GenSigTimeoutTime_IPC" SG_ 2654339142 StayActiveSource_FD05_BPCM 0;
BA_ "GenSigTimeoutTime_RFHM" SG_ 2654339142 StayActiveSource_FD05_BPCM 0;
BA_ "GenSigTimeoutTime_SGW" SG_ 2654339142 StayActiveSource_FD05_BPCM 0;
BA_ "GenSigTimeoutTime_TCM" SG_ 2654339142 StayActiveSource_FD05_BPCM 0;
BA_ "GenSigTimeoutTime_AGSM" SG_ 2654339142 StayActiveSource_FD11_BPCM 0;
BA_ "GenSigTimeoutTime_BCM" SG_ 2654339142 StayActiveSource_FD11_BPCM 0;
BA_ "GenSigTimeoutTime_BSM" SG_ 2654339142 StayActiveSource_FD11_BPCM 0;
BA_ "GenSigTimeoutTime_CADM" SG_ 2654339142 StayActiveSource_FD11_BPCM 0;
BA_ "GenSigTimeoutTime_DMSM" SG_ 2654339142 StayActiveSource_FD11_BPCM 0;
BA_ "GenSigTimeoutTime_DTCM" SG_ 2654339142 StayActiveSource_FD11_BPCM 0;
BA_ "GenSigTimeoutTime_ECM" SG_ 2654339142 StayActiveSource_FD11_BPCM 0;
BA_ "GenSigTimeoutTime_EVCU2" SG_ 2654339142 StayActiveSource_FD11_BPCM 0;
BA_ "GenSigTimeoutTime_GNMM" SG_ 2654339142 StayActiveSource_FD11_BPCM 0;
BA_ "GenSigTimeoutTime_HCP" SG_ 2654339142 StayActiveSource_FD11_BPCM 0;
BA_ "GenSigTimeoutTime_IPC" SG_ 2654339142 StayActiveSource_FD11_BPCM 0;
BA_ "GenSigTimeoutTime_RFHM" SG_ 2654339142 StayActiveSource_FD11_BPCM 0;
BA_ "GenSigTimeoutTime_SGW" SG_ 2654339142 StayActiveSource_FD11_BPCM 0;
BA_ "GenSigTimeoutTime_TCM" SG_ 2654339142 StayActiveSource_FD11_BPCM 0;
BA_ "GenSigTimeoutTime_AGSM" SG_ 2654339142 WakeupSource_FD05_BPCM 0;
BA_ "GenSigTimeoutTime_BCM" SG_ 2654339142 WakeupSource_FD05_BPCM 0;
BA_ "GenSigTimeoutTime_BSM" SG_ 2654339142 WakeupSource_FD05_BPCM 0;
BA_ "GenSigTimeoutTime_CADM" SG_ 2654339142 WakeupSource_FD05_BPCM 0;
BA_ "GenSigTimeoutTime_DMSM" SG_ 2654339142 WakeupSource_FD05_BPCM 0;
BA_ "GenSigTimeoutTime_DTCM" SG_ 2654339142 WakeupSource_FD05_BPCM 0;
BA_ "GenSigTimeoutTime_ECM" SG_ 2654339142 WakeupSource_FD05_BPCM 0;
BA_ "GenSigTimeoutTime_EVCU2" SG_ 2654339142 WakeupSource_FD05_BPCM 0;
BA_ "GenSigTimeoutTime_GNMM" SG_ 2654339142 WakeupSource_FD05_BPCM 0;
BA_ "GenSigTimeoutTime_HCP" SG_ 2654339142 WakeupSource_FD05_BPCM 0;
BA_ "GenSigTimeoutTime_IPC" SG_ 2654339142 WakeupSource_FD05_BPCM 0;
BA_ "GenSigTimeoutTime_RFHM" SG_ 2654339142 WakeupSource_FD05_BPCM 0;
BA_ "GenSigTimeoutTime_SGW" SG_ 2654339142 WakeupSource_FD05_BPCM 0;
BA_ "GenSigTimeoutTime_TCM" SG_ 2654339142 WakeupSource_FD05_BPCM 0;
BA_ "GenSigTimeoutTime_AGSM" SG_ 2654339142 WakeupSource_FD11_BPCM 0;
BA_ "GenSigTimeoutTime_BCM" SG_ 2654339142 WakeupSource_FD11_BPCM 0;
BA_ "GenSigTimeoutTime_BSM" SG_ 2654339142 WakeupSource_FD11_BPCM 0;
BA_ "GenSigTimeoutTime_CADM" SG_ 2654339142 WakeupSource_FD11_BPCM 0;
BA_ "GenSigTimeoutTime_DMSM" SG_ 2654339142 WakeupSource_FD11_BPCM 0;
BA_ "GenSigTimeoutTime_DTCM" SG_ 2654339142 WakeupSource_FD11_BPCM 0;
BA_ "GenSigTimeoutTime_ECM" SG_ 2654339142 WakeupSource_FD11_BPCM 0;
BA_ "GenSigTimeoutTime_EVCU2" SG_ 2654339142 WakeupSource_FD11_BPCM 0;
BA_ "GenSigTimeoutTime_GNMM" SG_ 2654339142 WakeupSource_FD11_BPCM 0;
BA_ "GenSigTimeoutTime_HCP" SG_ 2654339142 WakeupSource_FD11_BPCM 0;
BA_ "GenSigTimeoutTime_IPC" SG_ 2654339142 WakeupSource_FD11_BPCM 0;
BA_ "GenSigTimeoutTime_RFHM" SG_ 2654339142 WakeupSource_FD11_BPCM 0;
BA_ "GenSigTimeoutTime_SGW" SG_ 2654339142 WakeupSource_FD11_BPCM 0;
BA_ "GenSigTimeoutTime_TCM" SG_ 2654339142 WakeupSource_FD11_BPCM 0;
BA_ "GenSigTimeoutTime_AGSM" SG_ 2654339078 CurrentCanNMState_FD03_BSM 0;
BA_ "GenSigTimeoutTime_BCM" SG_ 2654339078 CurrentCanNMState_FD03_BSM 0;
BA_ "GenSigTimeoutTime_BSM" SG_ 2654339078 CurrentCanNMState_FD03_BSM 0;
BA_ "GenSigTimeoutTime_CADM" SG_ 2654339078 CurrentCanNMState_FD03_BSM 0;
BA_ "GenSigTimeoutTime_DMSM" SG_ 2654339078 CurrentCanNMState_FD03_BSM 0;
BA_ "GenSigTimeoutTime_DTCM" SG_ 2654339078 CurrentCanNMState_FD03_BSM 0;
BA_ "GenSigTimeoutTime_ECM" SG_ 2654339078 CurrentCanNMState_FD03_BSM 0;
BA_ "GenSigTimeoutTime_EVCU2" SG_ 2654339078 CurrentCanNMState_FD03_BSM 0;
BA_ "GenSigTimeoutTime_GNMM" SG_ 2654339078 CurrentCanNMState_FD03_BSM 0;
BA_ "GenSigTimeoutTime_HCP" SG_ 2654339078 CurrentCanNMState_FD03_BSM 0;
BA_ "GenSigTimeoutTime_IPC" SG_ 2654339078 CurrentCanNMState_FD03_BSM 0;
BA_ "GenSigTimeoutTime_RFHM" SG_ 2654339078 CurrentCanNMState_FD03_BSM 0;
BA_ "GenSigTimeoutTime_TCM" SG_ 2654339078 CurrentCanNMState_FD03_BSM 0;
BA_ "GenSigTimeoutTime_AGSM" SG_ 2654339078 CurrentFailSts_FD03_BSM 0;
BA_ "GenSigTimeoutTime_BSM" SG_ 2654339078 CurrentFailSts_FD03_BSM 0;
BA_ "GenSigTimeoutTime_CADM" SG_ 2654339078 CurrentFailSts_FD03_BSM 0;
BA_ "GenSigTimeoutTime_DMSM" SG_ 2654339078 CurrentFailSts_FD03_BSM 0;
BA_ "GenSigTimeoutTime_DTCM" SG_ 2654339078 CurrentFailSts_FD03_BSM 0;
BA_ "GenSigTimeoutTime_ECM" SG_ 2654339078 CurrentFailSts_FD03_BSM 0;
BA_ "GenSigTimeoutTime_EVCU2" SG_ 2654339078 CurrentFailSts_FD03_BSM 0;
BA_ "GenSigTimeoutTime_GNMM" SG_ 2654339078 CurrentFailSts_FD03_BSM 0;
BA_ "GenSigTimeoutTime_HCP" SG_ 2654339078 CurrentFailSts_FD03_BSM 0;
BA_ "GenSigTimeoutTime_IPC" SG_ 2654339078 CurrentFailSts_FD03_BSM 0;
BA_ "GenSigTimeoutTime_RFHM" SG_ 2654339078 CurrentFailSts_FD03_BSM 0;
BA_ "GenSigTimeoutTime_TCM" SG_ 2654339078 CurrentFailSts_FD03_BSM 0;
BA_ "GenSigTimeoutTime_AGSM" SG_ 2654339078 DES_FD03_BSM 0;
BA_ "GenSigTimeoutTime_BCM" SG_ 2654339078 DES_FD03_BSM 0;
BA_ "GenSigTimeoutTime_BSM" SG_ 2654339078 DES_FD03_BSM 0;
BA_ "GenSigTimeoutTime_CADM" SG_ 2654339078 DES_FD03_BSM 0;
BA_ "GenSigTimeoutTime_DMSM" SG_ 2654339078 DES_FD03_BSM 0;
BA_ "GenSigTimeoutTime_DTCM" SG_ 2654339078 DES_FD03_BSM 0;
BA_ "GenSigTimeoutTime_ECM" SG_ 2654339078 DES_FD03_BSM 0;
BA_ "GenSigTimeoutTime_EVCU2" SG_ 2654339078 DES_FD03_BSM 0;
BA_ "GenSigTimeoutTime_GNMM" SG_ 2654339078 DES_FD03_BSM 0;
BA_ "GenSigTimeoutTime_HCP" SG_ 2654339078 DES_FD03_BSM 0;
BA_ "GenSigTimeoutTime_IPC" SG_ 2654339078 DES_FD03_BSM 0;
BA_ "GenSigTimeoutTime_RFHM" SG_ 2654339078 DES_FD03_BSM 0;
BA_ "GenSigTimeoutTime_TCM" SG_ 2654339078 DES_FD03_BSM 0;
BA_ "GenSigTimeoutTime_AGSM" SG_ 2654339078 EOL_FD03_BSM 0;
BA_ "GenSigTimeoutTime_BSM" SG_ 2654339078 EOL_FD03_BSM 0;
BA_ "GenSigTimeoutTime_CADM" SG_ 2654339078 EOL_FD03_BSM 0;
BA_ "GenSigTimeoutTime_DMSM" SG_ 2654339078 EOL_FD03_BSM 0;
BA_ "GenSigTimeoutTime_DTCM" SG_ 2654339078 EOL_FD03_BSM 0;
BA_ "GenSigTimeoutTime_ECM" SG_ 2654339078 EOL_FD03_BSM 0;
BA_ "GenSigTimeoutTime_EVCU2" SG_ 2654339078 EOL_FD03_BSM 0;
BA_ "GenSigTimeoutTime_GNMM" SG_ 2654339078 EOL_FD03_BSM 0;
BA_ "GenSigTimeoutTime_HCP" SG_ 2654339078 EOL_FD03_BSM 0;
BA_ "GenSigTimeoutTime_IPC" SG_ 2654339078 EOL_FD03_BSM 0;
BA_ "GenSigTimeoutTime_RFHM" SG_ 2654339078 EOL_FD03_BSM 0;
BA_ "GenSigTimeoutTime_TCM" SG_ 2654339078 EOL_FD03_BSM 0;
BA_ "GenSigTimeoutTime_AGSM" SG_ 2654339078 GenericFailSts_FD03_BSM 0;
BA_ "GenSigTimeoutTime_BSM" SG_ 2654339078 GenericFailSts_FD03_BSM 0;
BA_ "GenSigTimeoutTime_CADM" SG_ 2654339078 GenericFailSts_FD03_BSM 0;
BA_ "GenSigTimeoutTime_DMSM" SG_ 2654339078 GenericFailSts_FD03_BSM 0;
BA_ "GenSigTimeoutTime_DTCM" SG_ 2654339078 GenericFailSts_FD03_BSM 0;
BA_ "GenSigTimeoutTime_ECM" SG_ 2654339078 GenericFailSts_FD03_BSM 0;
BA_ "GenSigTimeoutTime_EVCU2" SG_ 2654339078 GenericFailSts_FD03_BSM 0;
BA_ "GenSigTimeoutTime_GNMM" SG_ 2654339078 GenericFailSts_FD03_BSM 0;
BA_ "GenSigTimeoutTime_HCP" SG_ 2654339078 GenericFailSts_FD03_BSM 0;
BA_ "GenSigTimeoutTime_IPC" SG_ 2654339078 GenericFailSts_FD03_BSM 0;
BA_ "GenSigTimeoutTime_RFHM" SG_ 2654339078 GenericFailSts_FD03_BSM 0;
BA_ "GenSigTimeoutTime_TCM" SG_ 2654339078 GenericFailSts_FD03_BSM 0;
BA_ "GenSigTimeoutTime_AGSM" SG_ 2654339078 PreviousCanNMState_FD03_BSM 0;
BA_ "GenSigTimeoutTime_BCM" SG_ 2654339078 PreviousCanNMState_FD03_BSM 0;
BA_ "GenSigTimeoutTime_BSM" SG_ 2654339078 PreviousCanNMState_FD03_BSM 0;
BA_ "GenSigTimeoutTime_CADM" SG_ 2654339078 PreviousCanNMState_FD03_BSM 0;
BA_ "GenSigTimeoutTime_DMSM" SG_ 2654339078 PreviousCanNMState_FD03_BSM 0;
BA_ "GenSigTimeoutTime_DTCM" SG_ 2654339078 PreviousCanNMState_FD03_BSM 0;
BA_ "GenSigTimeoutTime_ECM" SG_ 2654339078 PreviousCanNMState_FD03_BSM 0;
BA_ "GenSigTimeoutTime_EVCU2" SG_ 2654339078 PreviousCanNMState_FD03_BSM 0;
BA_ "GenSigTimeoutTime_GNMM" SG_ 2654339078 PreviousCanNMState_FD03_BSM 0;
BA_ "GenSigTimeoutTime_HCP" SG_ 2654339078 PreviousCanNMState_FD03_BSM 0;
BA_ "GenSigTimeoutTime_IPC" SG_ 2654339078 PreviousCanNMState_FD03_BSM 0;
BA_ "GenSigTimeoutTime_RFHM" SG_ 2654339078 PreviousCanNMState_FD03_BSM 0;
BA_ "GenSigTimeoutTime_TCM" SG_ 2654339078 PreviousCanNMState_FD03_BSM 0;
BA_ "GenSigTimeoutTime_AGSM" SG_ 2654339078 StayActiveSource_FD03_BSM 0;
BA_ "GenSigTimeoutTime_BCM" SG_ 2654339078 StayActiveSource_FD03_BSM 0;
BA_ "GenSigTimeoutTime_BSM" SG_ 2654339078 StayActiveSource_FD03_BSM 0;
BA_ "GenSigTimeoutTime_CADM" SG_ 2654339078 StayActiveSource_FD03_BSM 0;
BA_ "GenSigTimeoutTime_DMSM" SG_ 2654339078 StayActiveSource_FD03_BSM 0;
BA_ "GenSigTimeoutTime_DTCM" SG_ 2654339078 StayActiveSource_FD03_BSM 0;
BA_ "GenSigTimeoutTime_ECM" SG_ 2654339078 StayActiveSource_FD03_BSM 0;
BA_ "GenSigTimeoutTime_EVCU2" SG_ 2654339078 StayActiveSource_FD03_BSM 0;
BA_ "GenSigTimeoutTime_GNMM" SG_ 2654339078 StayActiveSource_FD03_BSM 0;
BA_ "GenSigTimeoutTime_HCP" SG_ 2654339078 StayActiveSource_FD03_BSM 0;
BA_ "GenSigTimeoutTime_IPC" SG_ 2654339078 StayActiveSource_FD03_BSM 0;
BA_ "GenSigTimeoutTime_RFHM" SG_ 2654339078 StayActiveSource_FD03_BSM 0;
BA_ "GenSigTimeoutTime_TCM" SG_ 2654339078 StayActiveSource_FD03_BSM 0;
BA_ "GenSigTimeoutTime_AGSM" SG_ 2654339078 WakeupSource_FD03_BSM 0;
BA_ "GenSigTimeoutTime_BCM" SG_ 2654339078 WakeupSource_FD03_BSM 0;
BA_ "GenSigTimeoutTime_BSM" SG_ 2654339078 WakeupSource_FD03_BSM 0;
BA_ "GenSigTimeoutTime_CADM" SG_ 2654339078 WakeupSource_FD03_BSM 0;
BA_ "GenSigTimeoutTime_DMSM" SG_ 2654339078 WakeupSource_FD03_BSM 0;
BA_ "GenSigTimeoutTime_DTCM" SG_ 2654339078 WakeupSource_FD03_BSM 0;
BA_ "GenSigTimeoutTime_ECM" SG_ 2654339078 WakeupSource_FD03_BSM 0;
BA_ "GenSigTimeoutTime_EVCU2" SG_ 2654339078 WakeupSource_FD03_BSM 0;
BA_ "GenSigTimeoutTime_GNMM" SG_ 2654339078 WakeupSource_FD03_BSM 0;
BA_ "GenSigTimeoutTime_HCP" SG_ 2654339078 WakeupSource_FD03_BSM 0;
BA_ "GenSigTimeoutTime_IPC" SG_ 2654339078 WakeupSource_FD03_BSM 0;
BA_ "GenSigTimeoutTime_RFHM" SG_ 2654339078 WakeupSource_FD03_BSM 0;
BA_ "GenSigTimeoutTime_TCM" SG_ 2654339078 WakeupSource_FD03_BSM 0;
BA_ "GenSigTimeoutTime_AGSM" SG_ 2654339213 CurrentCanNMState_FD03_CADM 0;
BA_ "GenSigTimeoutTime_BCM" SG_ 2654339213 CurrentCanNMState_FD03_CADM 0;
BA_ "GenSigTimeoutTime_BSM" SG_ 2654339213 CurrentCanNMState_FD03_CADM 0;
BA_ "GenSigTimeoutTime_CADM" SG_ 2654339213 CurrentCanNMState_FD03_CADM 0;
BA_ "GenSigTimeoutTime_DMSM" SG_ 2654339213 CurrentCanNMState_FD03_CADM 0;
BA_ "GenSigTimeoutTime_DTCM" SG_ 2654339213 CurrentCanNMState_FD03_CADM 0;
BA_ "GenSigTimeoutTime_ECM" SG_ 2654339213 CurrentCanNMState_FD03_CADM 0;
BA_ "GenSigTimeoutTime_EVCU2" SG_ 2654339213 CurrentCanNMState_FD03_CADM 0;
BA_ "GenSigTimeoutTime_GNMM" SG_ 2654339213 CurrentCanNMState_FD03_CADM 0;
BA_ "GenSigTimeoutTime_HCP" SG_ 2654339213 CurrentCanNMState_FD03_CADM 0;
BA_ "GenSigTimeoutTime_IPC" SG_ 2654339213 CurrentCanNMState_FD03_CADM 0;
BA_ "GenSigTimeoutTime_RFHM" SG_ 2654339213 CurrentCanNMState_FD03_CADM 0;
BA_ "GenSigTimeoutTime_TCM" SG_ 2654339213 CurrentCanNMState_FD03_CADM 0;
BA_ "GenSigTimeoutTime_AGSM" SG_ 2654339213 CurrentFailSts_FD03_CADM 0;
BA_ "GenSigTimeoutTime_BSM" SG_ 2654339213 CurrentFailSts_FD03_CADM 0;
BA_ "GenSigTimeoutTime_CADM" SG_ 2654339213 CurrentFailSts_FD03_CADM 0;
BA_ "GenSigTimeoutTime_DMSM" SG_ 2654339213 CurrentFailSts_FD03_CADM 0;
BA_ "GenSigTimeoutTime_DTCM" SG_ 2654339213 CurrentFailSts_FD03_CADM 0;
BA_ "GenSigTimeoutTime_ECM" SG_ 2654339213 CurrentFailSts_FD03_CADM 0;
BA_ "GenSigTimeoutTime_EVCU2" SG_ 2654339213 CurrentFailSts_FD03_CADM 0;
BA_ "GenSigTimeoutTime_GNMM" SG_ 2654339213 CurrentFailSts_FD03_CADM 0;
BA_ "GenSigTimeoutTime_HCP" SG_ 2654339213 CurrentFailSts_FD03_CADM 0;
BA_ "GenSigTimeoutTime_IPC" SG_ 2654339213 CurrentFailSts_FD03_CADM 0;
BA_ "GenSigTimeoutTime_RFHM" SG_ 2654339213 CurrentFailSts_FD03_CADM 0;
BA_ "GenSigTimeoutTime_TCM" SG_ 2654339213 CurrentFailSts_FD03_CADM 0;
BA_ "GenSigTimeoutTime_AGSM" SG_ 2654339213 DES_FD03_CADM 0;
BA_ "GenSigTimeoutTime_BCM" SG_ 2654339213 DES_FD03_CADM 0;
BA_ "GenSigTimeoutTime_BSM" SG_ 2654339213 DES_FD03_CADM 0;
BA_ "GenSigTimeoutTime_CADM" SG_ 2654339213 DES_FD03_CADM 0;
BA_ "GenSigTimeoutTime_DMSM" SG_ 2654339213 DES_FD03_CADM 0;
BA_ "GenSigTimeoutTime_DTCM" SG_ 2654339213 DES_FD03_CADM 0;
BA_ "GenSigTimeoutTime_ECM" SG_ 2654339213 DES_FD03_CADM 0;
BA_ "GenSigTimeoutTime_EVCU2" SG_ 2654339213 DES_FD03_CADM 0;
BA_ "GenSigTimeoutTime_GNMM" SG_ 2654339213 DES_FD03_CADM 0;
BA_ "GenSigTimeoutTime_HCP" SG_ 2654339213 DES_FD03_CADM 0;
BA_ "GenSigTimeoutTime_IPC" SG_ 2654339213 DES_FD03_CADM 0;
BA_ "GenSigTimeoutTime_RFHM" SG_ 2654339213 DES_FD03_CADM 0;
BA_ "GenSigTimeoutTime_TCM" SG_ 2654339213 DES_FD03_CADM 0;
BA_ "GenSigTimeoutTime_AGSM" SG_ 2654339213 EOL_FD03_CADM 0;
BA_ "GenSigTimeoutTime_BSM" SG_ 2654339213 EOL_FD03_CADM 0;
BA_ "GenSigTimeoutTime_CADM" SG_ 2654339213 EOL_FD03_CADM 0;
BA_ "GenSigTimeoutTime_DMSM" SG_ 2654339213 EOL_FD03_CADM 0;
BA_ "GenSigTimeoutTime_DTCM" SG_ 2654339213 EOL_FD03_CADM 0;
BA_ "GenSigTimeoutTime_ECM" SG_ 2654339213 EOL_FD03_CADM 0;
BA_ "GenSigTimeoutTime_EVCU2" SG_ 2654339213 EOL_FD03_CADM 0;
BA_ "GenSigTimeoutTime_GNMM" SG_ 2654339213 EOL_FD03_CADM 0;
BA_ "GenSigTimeoutTime_HCP" SG_ 2654339213 EOL_FD03_CADM 0;
BA_ "GenSigTimeoutTime_IPC" SG_ 2654339213 EOL_FD03_CADM 0;
BA_ "GenSigTimeoutTime_RFHM" SG_ 2654339213 EOL_FD03_CADM 0;
BA_ "GenSigTimeoutTime_TCM" SG_ 2654339213 EOL_FD03_CADM 0;
BA_ "GenSigTimeoutTime_AGSM" SG_ 2654339213 GenericFailSts_FD03_CADM 0;
BA_ "GenSigTimeoutTime_BSM" SG_ 2654339213 GenericFailSts_FD03_CADM 0;
BA_ "GenSigTimeoutTime_CADM" SG_ 2654339213 GenericFailSts_FD03_CADM 0;
BA_ "GenSigTimeoutTime_DMSM" SG_ 2654339213 GenericFailSts_FD03_CADM 0;
BA_ "GenSigTimeoutTime_DTCM" SG_ 2654339213 GenericFailSts_FD03_CADM 0;
BA_ "GenSigTimeoutTime_ECM" SG_ 2654339213 GenericFailSts_FD03_CADM 0;
BA_ "GenSigTimeoutTime_EVCU2" SG_ 2654339213 GenericFailSts_FD03_CADM 0;
BA_ "GenSigTimeoutTime_GNMM" SG_ 2654339213 GenericFailSts_FD03_CADM 0;
BA_ "GenSigTimeoutTime_HCP" SG_ 2654339213 GenericFailSts_FD03_CADM 0;
BA_ "GenSigTimeoutTime_IPC" SG_ 2654339213 GenericFailSts_FD03_CADM 0;
BA_ "GenSigTimeoutTime_RFHM" SG_ 2654339213 GenericFailSts_FD03_CADM 0;
BA_ "GenSigTimeoutTime_TCM" SG_ 2654339213 GenericFailSts_FD03_CADM 0;
BA_ "GenSigTimeoutTime_AGSM" SG_ 2654339213 PreviousCanNMState_FD03_CADM 0;
BA_ "GenSigTimeoutTime_BCM" SG_ 2654339213 PreviousCanNMState_FD03_CADM 0;
BA_ "GenSigTimeoutTime_BSM" SG_ 2654339213 PreviousCanNMState_FD03_CADM 0;
BA_ "GenSigTimeoutTime_CADM" SG_ 2654339213 PreviousCanNMState_FD03_CADM 0;
BA_ "GenSigTimeoutTime_DMSM" SG_ 2654339213 PreviousCanNMState_FD03_CADM 0;
BA_ "GenSigTimeoutTime_DTCM" SG_ 2654339213 PreviousCanNMState_FD03_CADM 0;
BA_ "GenSigTimeoutTime_ECM" SG_ 2654339213 PreviousCanNMState_FD03_CADM 0;
BA_ "GenSigTimeoutTime_EVCU2" SG_ 2654339213 PreviousCanNMState_FD03_CADM 0;
BA_ "GenSigTimeoutTime_GNMM" SG_ 2654339213 PreviousCanNMState_FD03_CADM 0;
BA_ "GenSigTimeoutTime_HCP" SG_ 2654339213 PreviousCanNMState_FD03_CADM 0;
BA_ "GenSigTimeoutTime_IPC" SG_ 2654339213 PreviousCanNMState_FD03_CADM 0;
BA_ "GenSigTimeoutTime_RFHM" SG_ 2654339213 PreviousCanNMState_FD03_CADM 0;
BA_ "GenSigTimeoutTime_TCM" SG_ 2654339213 PreviousCanNMState_FD03_CADM 0;
BA_ "GenSigTimeoutTime_AGSM" SG_ 2654339213 StayActiveSource_FD03_CADM 0;
BA_ "GenSigTimeoutTime_BCM" SG_ 2654339213 StayActiveSource_FD03_CADM 0;
BA_ "GenSigTimeoutTime_BSM" SG_ 2654339213 StayActiveSource_FD03_CADM 0;
BA_ "GenSigTimeoutTime_CADM" SG_ 2654339213 StayActiveSource_FD03_CADM 0;
BA_ "GenSigTimeoutTime_DMSM" SG_ 2654339213 StayActiveSource_FD03_CADM 0;
BA_ "GenSigTimeoutTime_DTCM" SG_ 2654339213 StayActiveSource_FD03_CADM 0;
BA_ "GenSigTimeoutTime_ECM" SG_ 2654339213 StayActiveSource_FD03_CADM 0;
BA_ "GenSigTimeoutTime_EVCU2" SG_ 2654339213 StayActiveSource_FD03_CADM 0;
BA_ "GenSigTimeoutTime_GNMM" SG_ 2654339213 StayActiveSource_FD03_CADM 0;
BA_ "GenSigTimeoutTime_HCP" SG_ 2654339213 StayActiveSource_FD03_CADM 0;
BA_ "GenSigTimeoutTime_IPC" SG_ 2654339213 StayActiveSource_FD03_CADM 0;
BA_ "GenSigTimeoutTime_RFHM" SG_ 2654339213 StayActiveSource_FD03_CADM 0;
BA_ "GenSigTimeoutTime_TCM" SG_ 2654339213 StayActiveSource_FD03_CADM 0;
BA_ "GenSigTimeoutTime_AGSM" SG_ 2654339213 WakeupSource_FD03_CADM 0;
BA_ "GenSigTimeoutTime_BCM" SG_ 2654339213 WakeupSource_FD03_CADM 0;
BA_ "GenSigTimeoutTime_BSM" SG_ 2654339213 WakeupSource_FD03_CADM 0;
BA_ "GenSigTimeoutTime_CADM" SG_ 2654339213 WakeupSource_FD03_CADM 0;
BA_ "GenSigTimeoutTime_DMSM" SG_ 2654339213 WakeupSource_FD03_CADM 0;
BA_ "GenSigTimeoutTime_DTCM" SG_ 2654339213 WakeupSource_FD03_CADM 0;
BA_ "GenSigTimeoutTime_ECM" SG_ 2654339213 WakeupSource_FD03_CADM 0;
BA_ "GenSigTimeoutTime_EVCU2" SG_ 2654339213 WakeupSource_FD03_CADM 0;
BA_ "GenSigTimeoutTime_GNMM" SG_ 2654339213 WakeupSource_FD03_CADM 0;
BA_ "GenSigTimeoutTime_HCP" SG_ 2654339213 WakeupSource_FD03_CADM 0;
BA_ "GenSigTimeoutTime_IPC" SG_ 2654339213 WakeupSource_FD03_CADM 0;
BA_ "GenSigTimeoutTime_RFHM" SG_ 2654339213 WakeupSource_FD03_CADM 0;
BA_ "GenSigTimeoutTime_TCM" SG_ 2654339213 WakeupSource_FD03_CADM 0;
BA_ "GenSigTimeoutTime_AGSM" SG_ 2654339225 CurrentCanNMState_FD03_DMSM 0;
BA_ "GenSigTimeoutTime_BCM" SG_ 2654339225 CurrentCanNMState_FD03_DMSM 0;
BA_ "GenSigTimeoutTime_BSM" SG_ 2654339225 CurrentCanNMState_FD03_DMSM 0;
BA_ "GenSigTimeoutTime_CADM" SG_ 2654339225 CurrentCanNMState_FD03_DMSM 0;
BA_ "GenSigTimeoutTime_DMSM" SG_ 2654339225 CurrentCanNMState_FD03_DMSM 0;
BA_ "GenSigTimeoutTime_DTCM" SG_ 2654339225 CurrentCanNMState_FD03_DMSM 0;
BA_ "GenSigTimeoutTime_ECM" SG_ 2654339225 CurrentCanNMState_FD03_DMSM 0;
BA_ "GenSigTimeoutTime_EVCU2" SG_ 2654339225 CurrentCanNMState_FD03_DMSM 0;
BA_ "GenSigTimeoutTime_GNMM" SG_ 2654339225 CurrentCanNMState_FD03_DMSM 0;
BA_ "GenSigTimeoutTime_HCP" SG_ 2654339225 CurrentCanNMState_FD03_DMSM 0;
BA_ "GenSigTimeoutTime_IPC" SG_ 2654339225 CurrentCanNMState_FD03_DMSM 0;
BA_ "GenSigTimeoutTime_RFHM" SG_ 2654339225 CurrentCanNMState_FD03_DMSM 0;
BA_ "GenSigTimeoutTime_TCM" SG_ 2654339225 CurrentCanNMState_FD03_DMSM 0;
BA_ "GenSigTimeoutTime_AGSM" SG_ 2654339225 CurrentFailSts_FD03_DMSM 0;
BA_ "GenSigTimeoutTime_BSM" SG_ 2654339225 CurrentFailSts_FD03_DMSM 0;
BA_ "GenSigTimeoutTime_CADM" SG_ 2654339225 CurrentFailSts_FD03_DMSM 0;
BA_ "GenSigTimeoutTime_DMSM" SG_ 2654339225 CurrentFailSts_FD03_DMSM 0;
BA_ "GenSigTimeoutTime_DTCM" SG_ 2654339225 CurrentFailSts_FD03_DMSM 0;
BA_ "GenSigTimeoutTime_ECM" SG_ 2654339225 CurrentFailSts_FD03_DMSM 0;
BA_ "GenSigTimeoutTime_EVCU2" SG_ 2654339225 CurrentFailSts_FD03_DMSM 0;
BA_ "GenSigTimeoutTime_GNMM" SG_ 2654339225 CurrentFailSts_FD03_DMSM 0;
BA_ "GenSigTimeoutTime_HCP" SG_ 2654339225 CurrentFailSts_FD03_DMSM 0;
BA_ "GenSigTimeoutTime_IPC" SG_ 2654339225 CurrentFailSts_FD03_DMSM 0;
BA_ "GenSigTimeoutTime_RFHM" SG_ 2654339225 CurrentFailSts_FD03_DMSM 0;
BA_ "GenSigTimeoutTime_TCM" SG_ 2654339225 CurrentFailSts_FD03_DMSM 0;
BA_ "GenSigTimeoutTime_AGSM" SG_ 2654339225 DES_FD03_DMSM 0;
BA_ "GenSigTimeoutTime_BCM" SG_ 2654339225 DES_FD03_DMSM 0;
BA_ "GenSigTimeoutTime_BSM" SG_ 2654339225 DES_FD03_DMSM 0;
BA_ "GenSigTimeoutTime_CADM" SG_ 2654339225 DES_FD03_DMSM 0;
BA_ "GenSigTimeoutTime_DMSM" SG_ 2654339225 DES_FD03_DMSM 0;
BA_ "GenSigTimeoutTime_DTCM" SG_ 2654339225 DES_FD03_DMSM 0;
BA_ "GenSigTimeoutTime_ECM" SG_ 2654339225 DES_FD03_DMSM 0;
BA_ "GenSigTimeoutTime_EVCU2" SG_ 2654339225 DES_FD03_DMSM 0;
BA_ "GenSigTimeoutTime_GNMM" SG_ 2654339225 DES_FD03_DMSM 0;
BA_ "GenSigTimeoutTime_HCP" SG_ 2654339225 DES_FD03_DMSM 0;
BA_ "GenSigTimeoutTime_IPC" SG_ 2654339225 DES_FD03_DMSM 0;
BA_ "GenSigTimeoutTime_RFHM" SG_ 2654339225 DES_FD03_DMSM 0;
BA_ "GenSigTimeoutTime_TCM" SG_ 2654339225 DES_FD03_DMSM 0;
BA_ "GenSigTimeoutTime_AGSM" SG_ 2654339225 EOL_FD03_DMSM 0;
BA_ "GenSigTimeoutTime_BSM" SG_ 2654339225 EOL_FD03_DMSM 0;
BA_ "GenSigTimeoutTime_CADM" SG_ 2654339225 EOL_FD03_DMSM 0;
BA_ "GenSigTimeoutTime_DMSM" SG_ 2654339225 EOL_FD03_DMSM 0;
BA_ "GenSigTimeoutTime_DTCM" SG_ 2654339225 EOL_FD03_DMSM 0;
BA_ "GenSigTimeoutTime_ECM" SG_ 2654339225 EOL_FD03_DMSM 0;
BA_ "GenSigTimeoutTime_EVCU2" SG_ 2654339225 EOL_FD03_DMSM 0;
BA_ "GenSigTimeoutTime_GNMM" SG_ 2654339225 EOL_FD03_DMSM 0;
BA_ "GenSigTimeoutTime_HCP" SG_ 2654339225 EOL_FD03_DMSM 0;
BA_ "GenSigTimeoutTime_IPC" SG_ 2654339225 EOL_FD03_DMSM 0;
BA_ "GenSigTimeoutTime_RFHM" SG_ 2654339225 EOL_FD03_DMSM 0;
BA_ "GenSigTimeoutTime_TCM" SG_ 2654339225 EOL_FD03_DMSM 0;
BA_ "GenSigTimeoutTime_AGSM" SG_ 2654339225 GenericFailSts_FD03_DMSM 0;
BA_ "GenSigTimeoutTime_BSM" SG_ 2654339225 GenericFailSts_FD03_DMSM 0;
BA_ "GenSigTimeoutTime_CADM" SG_ 2654339225 GenericFailSts_FD03_DMSM 0;
BA_ "GenSigTimeoutTime_DMSM" SG_ 2654339225 GenericFailSts_FD03_DMSM 0;
BA_ "GenSigTimeoutTime_DTCM" SG_ 2654339225 GenericFailSts_FD03_DMSM 0;
BA_ "GenSigTimeoutTime_ECM" SG_ 2654339225 GenericFailSts_FD03_DMSM 0;
BA_ "GenSigTimeoutTime_EVCU2" SG_ 2654339225 GenericFailSts_FD03_DMSM 0;
BA_ "GenSigTimeoutTime_GNMM" SG_ 2654339225 GenericFailSts_FD03_DMSM 0;
BA_ "GenSigTimeoutTime_HCP" SG_ 2654339225 GenericFailSts_FD03_DMSM 0;
BA_ "GenSigTimeoutTime_IPC" SG_ 2654339225 GenericFailSts_FD03_DMSM 0;
BA_ "GenSigTimeoutTime_RFHM" SG_ 2654339225 GenericFailSts_FD03_DMSM 0;
BA_ "GenSigTimeoutTime_TCM" SG_ 2654339225 GenericFailSts_FD03_DMSM 0;
BA_ "GenSigTimeoutTime_AGSM" SG_ 2654339225 PreviousCanNMState_FD03_DMSM 0;
BA_ "GenSigTimeoutTime_BCM" SG_ 2654339225 PreviousCanNMState_FD03_DMSM 0;
BA_ "GenSigTimeoutTime_BSM" SG_ 2654339225 PreviousCanNMState_FD03_DMSM 0;
BA_ "GenSigTimeoutTime_CADM" SG_ 2654339225 PreviousCanNMState_FD03_DMSM 0;
BA_ "GenSigTimeoutTime_DMSM" SG_ 2654339225 PreviousCanNMState_FD03_DMSM 0;
BA_ "GenSigTimeoutTime_DTCM" SG_ 2654339225 PreviousCanNMState_FD03_DMSM 0;
BA_ "GenSigTimeoutTime_ECM" SG_ 2654339225 PreviousCanNMState_FD03_DMSM 0;
BA_ "GenSigTimeoutTime_EVCU2" SG_ 2654339225 PreviousCanNMState_FD03_DMSM 0;
BA_ "GenSigTimeoutTime_GNMM" SG_ 2654339225 PreviousCanNMState_FD03_DMSM 0;
BA_ "GenSigTimeoutTime_HCP" SG_ 2654339225 PreviousCanNMState_FD03_DMSM 0;
BA_ "GenSigTimeoutTime_IPC" SG_ 2654339225 PreviousCanNMState_FD03_DMSM 0;
BA_ "GenSigTimeoutTime_RFHM" SG_ 2654339225 PreviousCanNMState_FD03_DMSM 0;
BA_ "GenSigTimeoutTime_TCM" SG_ 2654339225 PreviousCanNMState_FD03_DMSM 0;
BA_ "GenSigTimeoutTime_AGSM" SG_ 2654339225 StayActiveSource_FD03_DMSM 0;
BA_ "GenSigTimeoutTime_BCM" SG_ 2654339225 StayActiveSource_FD03_DMSM 0;
BA_ "GenSigTimeoutTime_BSM" SG_ 2654339225 StayActiveSource_FD03_DMSM 0;
BA_ "GenSigTimeoutTime_CADM" SG_ 2654339225 StayActiveSource_FD03_DMSM 0;
BA_ "GenSigTimeoutTime_DMSM" SG_ 2654339225 StayActiveSource_FD03_DMSM 0;
BA_ "GenSigTimeoutTime_DTCM" SG_ 2654339225 StayActiveSource_FD03_DMSM 0;
BA_ "GenSigTimeoutTime_ECM" SG_ 2654339225 StayActiveSource_FD03_DMSM 0;
BA_ "GenSigTimeoutTime_EVCU2" SG_ 2654339225 StayActiveSource_FD03_DMSM 0;
BA_ "GenSigTimeoutTime_GNMM" SG_ 2654339225 StayActiveSource_FD03_DMSM 0;
BA_ "GenSigTimeoutTime_HCP" SG_ 2654339225 StayActiveSource_FD03_DMSM 0;
BA_ "GenSigTimeoutTime_IPC" SG_ 2654339225 StayActiveSource_FD03_DMSM 0;
BA_ "GenSigTimeoutTime_RFHM" SG_ 2654339225 StayActiveSource_FD03_DMSM 0;
BA_ "GenSigTimeoutTime_TCM" SG_ 2654339225 StayActiveSource_FD03_DMSM 0;
BA_ "GenSigTimeoutTime_AGSM" SG_ 2654339225 WakeupSource_FD03_DMSM 0;
BA_ "GenSigTimeoutTime_BCM" SG_ 2654339225 WakeupSource_FD03_DMSM 0;
BA_ "GenSigTimeoutTime_BSM" SG_ 2654339225 WakeupSource_FD03_DMSM 0;
BA_ "GenSigTimeoutTime_CADM" SG_ 2654339225 WakeupSource_FD03_DMSM 0;
BA_ "GenSigTimeoutTime_DMSM" SG_ 2654339225 WakeupSource_FD03_DMSM 0;
BA_ "GenSigTimeoutTime_DTCM" SG_ 2654339225 WakeupSource_FD03_DMSM 0;
BA_ "GenSigTimeoutTime_ECM" SG_ 2654339225 WakeupSource_FD03_DMSM 0;
BA_ "GenSigTimeoutTime_EVCU2" SG_ 2654339225 WakeupSource_FD03_DMSM 0;
BA_ "GenSigTimeoutTime_GNMM" SG_ 2654339225 WakeupSource_FD03_DMSM 0;
BA_ "GenSigTimeoutTime_HCP" SG_ 2654339225 WakeupSource_FD03_DMSM 0;
BA_ "GenSigTimeoutTime_IPC" SG_ 2654339225 WakeupSource_FD03_DMSM 0;
BA_ "GenSigTimeoutTime_RFHM" SG_ 2654339225 WakeupSource_FD03_DMSM 0;
BA_ "GenSigTimeoutTime_TCM" SG_ 2654339225 WakeupSource_FD03_DMSM 0;
BA_ "GenSigTimeoutTime_AGSM" SG_ 2654339139 CurrentCanNMState_FD03_DTCM 0;
BA_ "GenSigTimeoutTime_BCM" SG_ 2654339139 CurrentCanNMState_FD03_DTCM 0;
BA_ "GenSigTimeoutTime_BSM" SG_ 2654339139 CurrentCanNMState_FD03_DTCM 0;
BA_ "GenSigTimeoutTime_CADM" SG_ 2654339139 CurrentCanNMState_FD03_DTCM 0;
BA_ "GenSigTimeoutTime_DMSM" SG_ 2654339139 CurrentCanNMState_FD03_DTCM 0;
BA_ "GenSigTimeoutTime_DTCM" SG_ 2654339139 CurrentCanNMState_FD03_DTCM 0;
BA_ "GenSigTimeoutTime_ECM" SG_ 2654339139 CurrentCanNMState_FD03_DTCM 0;
BA_ "GenSigTimeoutTime_EVCU2" SG_ 2654339139 CurrentCanNMState_FD03_DTCM 0;
BA_ "GenSigTimeoutTime_GNMM" SG_ 2654339139 CurrentCanNMState_FD03_DTCM 0;
BA_ "GenSigTimeoutTime_HCP" SG_ 2654339139 CurrentCanNMState_FD03_DTCM 0;
BA_ "GenSigTimeoutTime_IPC" SG_ 2654339139 CurrentCanNMState_FD03_DTCM 0;
BA_ "GenSigTimeoutTime_RFHM" SG_ 2654339139 CurrentCanNMState_FD03_DTCM 0;
BA_ "GenSigTimeoutTime_TCM" SG_ 2654339139 CurrentCanNMState_FD03_DTCM 0;
BA_ "GenSigTimeoutTime_AGSM" SG_ 2654339139 CurrentFailSts_FD03_DTCM 0;
BA_ "GenSigTimeoutTime_BSM" SG_ 2654339139 CurrentFailSts_FD03_DTCM 0;
BA_ "GenSigTimeoutTime_CADM" SG_ 2654339139 CurrentFailSts_FD03_DTCM 0;
BA_ "GenSigTimeoutTime_DMSM" SG_ 2654339139 CurrentFailSts_FD03_DTCM 0;
BA_ "GenSigTimeoutTime_DTCM" SG_ 2654339139 CurrentFailSts_FD03_DTCM 0;
BA_ "GenSigTimeoutTime_ECM" SG_ 2654339139 CurrentFailSts_FD03_DTCM 0;
BA_ "GenSigTimeoutTime_EVCU2" SG_ 2654339139 CurrentFailSts_FD03_DTCM 0;
BA_ "GenSigTimeoutTime_GNMM" SG_ 2654339139 CurrentFailSts_FD03_DTCM 0;
BA_ "GenSigTimeoutTime_HCP" SG_ 2654339139 CurrentFailSts_FD03_DTCM 0;
BA_ "GenSigTimeoutTime_IPC" SG_ 2654339139 CurrentFailSts_FD03_DTCM 0;
BA_ "GenSigTimeoutTime_RFHM" SG_ 2654339139 CurrentFailSts_FD03_DTCM 0;
BA_ "GenSigTimeoutTime_TCM" SG_ 2654339139 CurrentFailSts_FD03_DTCM 0;
BA_ "GenSigTimeoutTime_AGSM" SG_ 2654339139 DES_FD03_DTCM 0;
BA_ "GenSigTimeoutTime_BCM" SG_ 2654339139 DES_FD03_DTCM 0;
BA_ "GenSigTimeoutTime_BSM" SG_ 2654339139 DES_FD03_DTCM 0;
BA_ "GenSigTimeoutTime_CADM" SG_ 2654339139 DES_FD03_DTCM 0;
BA_ "GenSigTimeoutTime_DMSM" SG_ 2654339139 DES_FD03_DTCM 0;
BA_ "GenSigTimeoutTime_DTCM" SG_ 2654339139 DES_FD03_DTCM 0;
BA_ "GenSigTimeoutTime_ECM" SG_ 2654339139 DES_FD03_DTCM 0;
BA_ "GenSigTimeoutTime_EVCU2" SG_ 2654339139 DES_FD03_DTCM 0;
BA_ "GenSigTimeoutTime_GNMM" SG_ 2654339139 DES_FD03_DTCM 0;
BA_ "GenSigTimeoutTime_HCP" SG_ 2654339139 DES_FD03_DTCM 0;
BA_ "GenSigTimeoutTime_IPC" SG_ 2654339139 DES_FD03_DTCM 0;
BA_ "GenSigTimeoutTime_RFHM" SG_ 2654339139 DES_FD03_DTCM 0;
BA_ "GenSigTimeoutTime_TCM" SG_ 2654339139 DES_FD03_DTCM 0;
BA_ "GenSigTimeoutTime_AGSM" SG_ 2654339139 EOL_FD03_DTCM 0;
BA_ "GenSigTimeoutTime_BSM" SG_ 2654339139 EOL_FD03_DTCM 0;
BA_ "GenSigTimeoutTime_CADM" SG_ 2654339139 EOL_FD03_DTCM 0;
BA_ "GenSigTimeoutTime_DMSM" SG_ 2654339139 EOL_FD03_DTCM 0;
BA_ "GenSigTimeoutTime_DTCM" SG_ 2654339139 EOL_FD03_DTCM 0;
BA_ "GenSigTimeoutTime_ECM" SG_ 2654339139 EOL_FD03_DTCM 0;
BA_ "GenSigTimeoutTime_EVCU2" SG_ 2654339139 EOL_FD03_DTCM 0;
BA_ "GenSigTimeoutTime_GNMM" SG_ 2654339139 EOL_FD03_DTCM 0;
BA_ "GenSigTimeoutTime_HCP" SG_ 2654339139 EOL_FD03_DTCM 0;
BA_ "GenSigTimeoutTime_IPC" SG_ 2654339139 EOL_FD03_DTCM 0;
BA_ "GenSigTimeoutTime_RFHM" SG_ 2654339139 EOL_FD03_DTCM 0;
BA_ "GenSigTimeoutTime_TCM" SG_ 2654339139 EOL_FD03_DTCM 0;
BA_ "GenSigTimeoutTime_AGSM" SG_ 2654339139 GenericFailSts_FD03_DTCM 0;
BA_ "GenSigTimeoutTime_BSM" SG_ 2654339139 GenericFailSts_FD03_DTCM 0;
BA_ "GenSigTimeoutTime_CADM" SG_ 2654339139 GenericFailSts_FD03_DTCM 0;
BA_ "GenSigTimeoutTime_DMSM" SG_ 2654339139 GenericFailSts_FD03_DTCM 0;
BA_ "GenSigTimeoutTime_DTCM" SG_ 2654339139 GenericFailSts_FD03_DTCM 0;
BA_ "GenSigTimeoutTime_ECM" SG_ 2654339139 GenericFailSts_FD03_DTCM 0;
BA_ "GenSigTimeoutTime_EVCU2" SG_ 2654339139 GenericFailSts_FD03_DTCM 0;
BA_ "GenSigTimeoutTime_GNMM" SG_ 2654339139 GenericFailSts_FD03_DTCM 0;
BA_ "GenSigTimeoutTime_HCP" SG_ 2654339139 GenericFailSts_FD03_DTCM 0;
BA_ "GenSigTimeoutTime_IPC" SG_ 2654339139 GenericFailSts_FD03_DTCM 0;
BA_ "GenSigTimeoutTime_RFHM" SG_ 2654339139 GenericFailSts_FD03_DTCM 0;
BA_ "GenSigTimeoutTime_TCM" SG_ 2654339139 GenericFailSts_FD03_DTCM 0;
BA_ "GenSigTimeoutTime_AGSM" SG_ 2654339139 PreviousCanNMState_FD03_DTCM 0;
BA_ "GenSigTimeoutTime_BCM" SG_ 2654339139 PreviousCanNMState_FD03_DTCM 0;
BA_ "GenSigTimeoutTime_BSM" SG_ 2654339139 PreviousCanNMState_FD03_DTCM 0;
BA_ "GenSigTimeoutTime_CADM" SG_ 2654339139 PreviousCanNMState_FD03_DTCM 0;
BA_ "GenSigTimeoutTime_DMSM" SG_ 2654339139 PreviousCanNMState_FD03_DTCM 0;
BA_ "GenSigTimeoutTime_DTCM" SG_ 2654339139 PreviousCanNMState_FD03_DTCM 0;
BA_ "GenSigTimeoutTime_ECM" SG_ 2654339139 PreviousCanNMState_FD03_DTCM 0;
BA_ "GenSigTimeoutTime_EVCU2" SG_ 2654339139 PreviousCanNMState_FD03_DTCM 0;
BA_ "GenSigTimeoutTime_GNMM" SG_ 2654339139 PreviousCanNMState_FD03_DTCM 0;
BA_ "GenSigTimeoutTime_HCP" SG_ 2654339139 PreviousCanNMState_FD03_DTCM 0;
BA_ "GenSigTimeoutTime_IPC" SG_ 2654339139 PreviousCanNMState_FD03_DTCM 0;
BA_ "GenSigTimeoutTime_RFHM" SG_ 2654339139 PreviousCanNMState_FD03_DTCM 0;
BA_ "GenSigTimeoutTime_TCM" SG_ 2654339139 PreviousCanNMState_FD03_DTCM 0;
BA_ "GenSigTimeoutTime_AGSM" SG_ 2654339139 StayActiveSource_FD03_DTCM 0;
BA_ "GenSigTimeoutTime_BCM" SG_ 2654339139 StayActiveSource_FD03_DTCM 0;
BA_ "GenSigTimeoutTime_BSM" SG_ 2654339139 StayActiveSource_FD03_DTCM 0;
BA_ "GenSigTimeoutTime_CADM" SG_ 2654339139 StayActiveSource_FD03_DTCM 0;
BA_ "GenSigTimeoutTime_DMSM" SG_ 2654339139 StayActiveSource_FD03_DTCM 0;
BA_ "GenSigTimeoutTime_DTCM" SG_ 2654339139 StayActiveSource_FD03_DTCM 0;
BA_ "GenSigTimeoutTime_ECM" SG_ 2654339139 StayActiveSource_FD03_DTCM 0;
BA_ "GenSigTimeoutTime_EVCU2" SG_ 2654339139 StayActiveSource_FD03_DTCM 0;
BA_ "GenSigTimeoutTime_GNMM" SG_ 2654339139 StayActiveSource_FD03_DTCM 0;
BA_ "GenSigTimeoutTime_HCP" SG_ 2654339139 StayActiveSource_FD03_DTCM 0;
BA_ "GenSigTimeoutTime_IPC" SG_ 2654339139 StayActiveSource_FD03_DTCM 0;
BA_ "GenSigTimeoutTime_RFHM" SG_ 2654339139 StayActiveSource_FD03_DTCM 0;
BA_ "GenSigTimeoutTime_TCM" SG_ 2654339139 StayActiveSource_FD03_DTCM 0;
BA_ "GenSigTimeoutTime_AGSM" SG_ 2654339139 WakeupSource_FD03_DTCM 0;
BA_ "GenSigTimeoutTime_BCM" SG_ 2654339139 WakeupSource_FD03_DTCM 0;
BA_ "GenSigTimeoutTime_BSM" SG_ 2654339139 WakeupSource_FD03_DTCM 0;
BA_ "GenSigTimeoutTime_CADM" SG_ 2654339139 WakeupSource_FD03_DTCM 0;
BA_ "GenSigTimeoutTime_DMSM" SG_ 2654339139 WakeupSource_FD03_DTCM 0;
BA_ "GenSigTimeoutTime_DTCM" SG_ 2654339139 WakeupSource_FD03_DTCM 0;
BA_ "GenSigTimeoutTime_ECM" SG_ 2654339139 WakeupSource_FD03_DTCM 0;
BA_ "GenSigTimeoutTime_EVCU2" SG_ 2654339139 WakeupSource_FD03_DTCM 0;
BA_ "GenSigTimeoutTime_GNMM" SG_ 2654339139 WakeupSource_FD03_DTCM 0;
BA_ "GenSigTimeoutTime_HCP" SG_ 2654339139 WakeupSource_FD03_DTCM 0;
BA_ "GenSigTimeoutTime_IPC" SG_ 2654339139 WakeupSource_FD03_DTCM 0;
BA_ "GenSigTimeoutTime_RFHM" SG_ 2654339139 WakeupSource_FD03_DTCM 0;
BA_ "GenSigTimeoutTime_TCM" SG_ 2654339139 WakeupSource_FD03_DTCM 0;
BA_ "GenSigTimeoutTime_AGSM" SG_ 2654339073 CurrentCanNMState_FD03_ECM 0;
BA_ "GenSigTimeoutTime_BCM" SG_ 2654339073 CurrentCanNMState_FD03_ECM 0;
BA_ "GenSigTimeoutTime_BSM" SG_ 2654339073 CurrentCanNMState_FD03_ECM 0;
BA_ "GenSigTimeoutTime_CADM" SG_ 2654339073 CurrentCanNMState_FD03_ECM 0;
BA_ "GenSigTimeoutTime_DMSM" SG_ 2654339073 CurrentCanNMState_FD03_ECM 0;
BA_ "GenSigTimeoutTime_DTCM" SG_ 2654339073 CurrentCanNMState_FD03_ECM 0;
BA_ "GenSigTimeoutTime_ECM" SG_ 2654339073 CurrentCanNMState_FD03_ECM 0;
BA_ "GenSigTimeoutTime_EVCU2" SG_ 2654339073 CurrentCanNMState_FD03_ECM 0;
BA_ "GenSigTimeoutTime_GNMM" SG_ 2654339073 CurrentCanNMState_FD03_ECM 0;
BA_ "GenSigTimeoutTime_HCP" SG_ 2654339073 CurrentCanNMState_FD03_ECM 0;
BA_ "GenSigTimeoutTime_IPC" SG_ 2654339073 CurrentCanNMState_FD03_ECM 0;
BA_ "GenSigTimeoutTime_RFHM" SG_ 2654339073 CurrentCanNMState_FD03_ECM 0;
BA_ "GenSigTimeoutTime_TCM" SG_ 2654339073 CurrentCanNMState_FD03_ECM 0;
BA_ "GenSigTimeoutTime_AGSM" SG_ 2654339073 CurrentCanNMState_FD05_ECM 0;
BA_ "GenSigTimeoutTime_BCM" SG_ 2654339073 CurrentCanNMState_FD05_ECM 0;
BA_ "GenSigTimeoutTime_BSM" SG_ 2654339073 CurrentCanNMState_FD05_ECM 0;
BA_ "GenSigTimeoutTime_CADM" SG_ 2654339073 CurrentCanNMState_FD05_ECM 0;
BA_ "GenSigTimeoutTime_DMSM" SG_ 2654339073 CurrentCanNMState_FD05_ECM 0;
BA_ "GenSigTimeoutTime_DTCM" SG_ 2654339073 CurrentCanNMState_FD05_ECM 0;
BA_ "GenSigTimeoutTime_ECM" SG_ 2654339073 CurrentCanNMState_FD05_ECM 0;
BA_ "GenSigTimeoutTime_EVCU2" SG_ 2654339073 CurrentCanNMState_FD05_ECM 0;
BA_ "GenSigTimeoutTime_GNMM" SG_ 2654339073 CurrentCanNMState_FD05_ECM 0;
BA_ "GenSigTimeoutTime_HCP" SG_ 2654339073 CurrentCanNMState_FD05_ECM 0;
BA_ "GenSigTimeoutTime_IPC" SG_ 2654339073 CurrentCanNMState_FD05_ECM 0;
BA_ "GenSigTimeoutTime_RFHM" SG_ 2654339073 CurrentCanNMState_FD05_ECM 0;
BA_ "GenSigTimeoutTime_TCM" SG_ 2654339073 CurrentCanNMState_FD05_ECM 0;
BA_ "GenSigTimeoutTime_AGSM" SG_ 2654339073 CurrentCanNMState_FD16_ECM 0;
BA_ "GenSigTimeoutTime_BCM" SG_ 2654339073 CurrentCanNMState_FD16_ECM 0;
BA_ "GenSigTimeoutTime_BSM" SG_ 2654339073 CurrentCanNMState_FD16_ECM 0;
BA_ "GenSigTimeoutTime_CADM" SG_ 2654339073 CurrentCanNMState_FD16_ECM 0;
BA_ "GenSigTimeoutTime_DMSM" SG_ 2654339073 CurrentCanNMState_FD16_ECM 0;
BA_ "GenSigTimeoutTime_DTCM" SG_ 2654339073 CurrentCanNMState_FD16_ECM 0;
BA_ "GenSigTimeoutTime_ECM" SG_ 2654339073 CurrentCanNMState_FD16_ECM 0;
BA_ "GenSigTimeoutTime_EVCU2" SG_ 2654339073 CurrentCanNMState_FD16_ECM 0;
BA_ "GenSigTimeoutTime_GNMM" SG_ 2654339073 CurrentCanNMState_FD16_ECM 0;
BA_ "GenSigTimeoutTime_HCP" SG_ 2654339073 CurrentCanNMState_FD16_ECM 0;
BA_ "GenSigTimeoutTime_IPC" SG_ 2654339073 CurrentCanNMState_FD16_ECM 0;
BA_ "GenSigTimeoutTime_RFHM" SG_ 2654339073 CurrentCanNMState_FD16_ECM 0;
BA_ "GenSigTimeoutTime_TCM" SG_ 2654339073 CurrentCanNMState_FD16_ECM 0;
BA_ "GenSigTimeoutTime_AGSM" SG_ 2654339073 CurrentFailSts_FD03_ECM 0;
BA_ "GenSigTimeoutTime_BSM" SG_ 2654339073 CurrentFailSts_FD03_ECM 0;
BA_ "GenSigTimeoutTime_CADM" SG_ 2654339073 CurrentFailSts_FD03_ECM 0;
BA_ "GenSigTimeoutTime_DMSM" SG_ 2654339073 CurrentFailSts_FD03_ECM 0;
BA_ "GenSigTimeoutTime_DTCM" SG_ 2654339073 CurrentFailSts_FD03_ECM 0;
BA_ "GenSigTimeoutTime_ECM" SG_ 2654339073 CurrentFailSts_FD03_ECM 0;
BA_ "GenSigTimeoutTime_EVCU2" SG_ 2654339073 CurrentFailSts_FD03_ECM 0;
BA_ "GenSigTimeoutTime_GNMM" SG_ 2654339073 CurrentFailSts_FD03_ECM 0;
BA_ "GenSigTimeoutTime_HCP" SG_ 2654339073 CurrentFailSts_FD03_ECM 0;
BA_ "GenSigTimeoutTime_IPC" SG_ 2654339073 CurrentFailSts_FD03_ECM 0;
BA_ "GenSigTimeoutTime_RFHM" SG_ 2654339073 CurrentFailSts_FD03_ECM 0;
BA_ "GenSigTimeoutTime_TCM" SG_ 2654339073 CurrentFailSts_FD03_ECM 0;
BA_ "GenSigTimeoutTime_AGSM" SG_ 2654339073 CurrentFailSts_FD05_ECM 0;
BA_ "GenSigTimeoutTime_BCM" SG_ 2654339073 CurrentFailSts_FD05_ECM 0;
BA_ "GenSigTimeoutTime_BSM" SG_ 2654339073 CurrentFailSts_FD05_ECM 0;
BA_ "GenSigTimeoutTime_CADM" SG_ 2654339073 CurrentFailSts_FD05_ECM 0;
BA_ "GenSigTimeoutTime_DMSM" SG_ 2654339073 CurrentFailSts_FD05_ECM 0;
BA_ "GenSigTimeoutTime_DTCM" SG_ 2654339073 CurrentFailSts_FD05_ECM 0;
BA_ "GenSigTimeoutTime_ECM" SG_ 2654339073 CurrentFailSts_FD05_ECM 0;
BA_ "GenSigTimeoutTime_EVCU2" SG_ 2654339073 CurrentFailSts_FD05_ECM 0;
BA_ "GenSigTimeoutTime_GNMM" SG_ 2654339073 CurrentFailSts_FD05_ECM 0;
BA_ "GenSigTimeoutTime_HCP" SG_ 2654339073 CurrentFailSts_FD05_ECM 0;
BA_ "GenSigTimeoutTime_IPC" SG_ 2654339073 CurrentFailSts_FD05_ECM 0;
BA_ "GenSigTimeoutTime_RFHM" SG_ 2654339073 CurrentFailSts_FD05_ECM 0;
BA_ "GenSigTimeoutTime_TCM" SG_ 2654339073 CurrentFailSts_FD05_ECM 0;
BA_ "GenSigTimeoutTime_AGSM" SG_ 2654339073 CurrentFailSts_FD16_ECM 0;
BA_ "GenSigTimeoutTime_BCM" SG_ 2654339073 CurrentFailSts_FD16_ECM 0;
BA_ "GenSigTimeoutTime_BSM" SG_ 2654339073 CurrentFailSts_FD16_ECM 0;
BA_ "GenSigTimeoutTime_CADM" SG_ 2654339073 CurrentFailSts_FD16_ECM 0;
BA_ "GenSigTimeoutTime_DMSM" SG_ 2654339073 CurrentFailSts_FD16_ECM 0;
BA_ "GenSigTimeoutTime_DTCM" SG_ 2654339073 CurrentFailSts_FD16_ECM 0;
BA_ "GenSigTimeoutTime_ECM" SG_ 2654339073 CurrentFailSts_FD16_ECM 0;
BA_ "GenSigTimeoutTime_EVCU2" SG_ 2654339073 CurrentFailSts_FD16_ECM 0;
BA_ "GenSigTimeoutTime_GNMM" SG_ 2654339073 CurrentFailSts_FD16_ECM 0;
BA_ "GenSigTimeoutTime_HCP" SG_ 2654339073 CurrentFailSts_FD16_ECM 0;
BA_ "GenSigTimeoutTime_IPC" SG_ 2654339073 CurrentFailSts_FD16_ECM 0;
BA_ "GenSigTimeoutTime_RFHM" SG_ 2654339073 CurrentFailSts_FD16_ECM 0;
BA_ "GenSigTimeoutTime_TCM" SG_ 2654339073 CurrentFailSts_FD16_ECM 0;
BA_ "GenSigTimeoutTime_AGSM" SG_ 2654339073 DES_FD03_ECM 0;
BA_ "GenSigTimeoutTime_BCM" SG_ 2654339073 DES_FD03_ECM 0;
BA_ "GenSigTimeoutTime_BSM" SG_ 2654339073 DES_FD03_ECM 0;
BA_ "GenSigTimeoutTime_CADM" SG_ 2654339073 DES_FD03_ECM 0;
BA_ "GenSigTimeoutTime_DMSM" SG_ 2654339073 DES_FD03_ECM 0;
BA_ "GenSigTimeoutTime_DTCM" SG_ 2654339073 DES_FD03_ECM 0;
BA_ "GenSigTimeoutTime_ECM" SG_ 2654339073 DES_FD03_ECM 0;
BA_ "GenSigTimeoutTime_EVCU2" SG_ 2654339073 DES_FD03_ECM 0;
BA_ "GenSigTimeoutTime_GNMM" SG_ 2654339073 DES_FD03_ECM 0;
BA_ "GenSigTimeoutTime_HCP" SG_ 2654339073 DES_FD03_ECM 0;
BA_ "GenSigTimeoutTime_IPC" SG_ 2654339073 DES_FD03_ECM 0;
BA_ "GenSigTimeoutTime_RFHM" SG_ 2654339073 DES_FD03_ECM 0;
BA_ "GenSigTimeoutTime_TCM" SG_ 2654339073 DES_FD03_ECM 0;
BA_ "GenSigTimeoutTime_AGSM" SG_ 2654339073 DES_FD05_ECM 0;
BA_ "GenSigTimeoutTime_BCM" SG_ 2654339073 DES_FD05_ECM 0;
BA_ "GenSigTimeoutTime_BSM" SG_ 2654339073 DES_FD05_ECM 0;
BA_ "GenSigTimeoutTime_CADM" SG_ 2654339073 DES_FD05_ECM 0;
BA_ "GenSigTimeoutTime_DMSM" SG_ 2654339073 DES_FD05_ECM 0;
BA_ "GenSigTimeoutTime_DTCM" SG_ 2654339073 DES_FD05_ECM 0;
BA_ "GenSigTimeoutTime_ECM" SG_ 2654339073 DES_FD05_ECM 0;
BA_ "GenSigTimeoutTime_EVCU2" SG_ 2654339073 DES_FD05_ECM 0;
BA_ "GenSigTimeoutTime_GNMM" SG_ 2654339073 DES_FD05_ECM 0;
BA_ "GenSigTimeoutTime_HCP" SG_ 2654339073 DES_FD05_ECM 0;
BA_ "GenSigTimeoutTime_IPC" SG_ 2654339073 DES_FD05_ECM 0;
BA_ "GenSigTimeoutTime_RFHM" SG_ 2654339073 DES_FD05_ECM 0;
BA_ "GenSigTimeoutTime_TCM" SG_ 2654339073 DES_FD05_ECM 0;
BA_ "GenSigTimeoutTime_AGSM" SG_ 2654339073 DES_FD16_ECM 0;
BA_ "GenSigTimeoutTime_BCM" SG_ 2654339073 DES_FD16_ECM 0;
BA_ "GenSigTimeoutTime_BSM" SG_ 2654339073 DES_FD16_ECM 0;
BA_ "GenSigTimeoutTime_CADM" SG_ 2654339073 DES_FD16_ECM 0;
BA_ "GenSigTimeoutTime_DMSM" SG_ 2654339073 DES_FD16_ECM 0;
BA_ "GenSigTimeoutTime_DTCM" SG_ 2654339073 DES_FD16_ECM 0;
BA_ "GenSigTimeoutTime_ECM" SG_ 2654339073 DES_FD16_ECM 0;
BA_ "GenSigTimeoutTime_EVCU2" SG_ 2654339073 DES_FD16_ECM 0;
BA_ "GenSigTimeoutTime_GNMM" SG_ 2654339073 DES_FD16_ECM 0;
BA_ "GenSigTimeoutTime_HCP" SG_ 2654339073 DES_FD16_ECM 0;
BA_ "GenSigTimeoutTime_IPC" SG_ 2654339073 DES_FD16_ECM 0;
BA_ "GenSigTimeoutTime_RFHM" SG_ 2654339073 DES_FD16_ECM 0;
BA_ "GenSigTimeoutTime_TCM" SG_ 2654339073 DES_FD16_ECM 0;
BA_ "GenSigTimeoutTime_AGSM" SG_ 2654339073 EOL_FD03_ECM 0;
BA_ "GenSigTimeoutTime_BSM" SG_ 2654339073 EOL_FD03_ECM 0;
BA_ "GenSigTimeoutTime_CADM" SG_ 2654339073 EOL_FD03_ECM 0;
BA_ "GenSigTimeoutTime_DMSM" SG_ 2654339073 EOL_FD03_ECM 0;
BA_ "GenSigTimeoutTime_DTCM" SG_ 2654339073 EOL_FD03_ECM 0;
BA_ "GenSigTimeoutTime_ECM" SG_ 2654339073 EOL_FD03_ECM 0;
BA_ "GenSigTimeoutTime_EVCU2" SG_ 2654339073 EOL_FD03_ECM 0;
BA_ "GenSigTimeoutTime_GNMM" SG_ 2654339073 EOL_FD03_ECM 0;
BA_ "GenSigTimeoutTime_HCP" SG_ 2654339073 EOL_FD03_ECM 0;
BA_ "GenSigTimeoutTime_IPC" SG_ 2654339073 EOL_FD03_ECM 0;
BA_ "GenSigTimeoutTime_RFHM" SG_ 2654339073 EOL_FD03_ECM 0;
BA_ "GenSigTimeoutTime_TCM" SG_ 2654339073 EOL_FD03_ECM 0;
BA_ "GenSigTimeoutTime_AGSM" SG_ 2654339073 EOL_FD05_ECM 0;
BA_ "GenSigTimeoutTime_BCM" SG_ 2654339073 EOL_FD05_ECM 0;
BA_ "GenSigTimeoutTime_BSM" SG_ 2654339073 EOL_FD05_ECM 0;
BA_ "GenSigTimeoutTime_CADM" SG_ 2654339073 EOL_FD05_ECM 0;
BA_ "GenSigTimeoutTime_DMSM" SG_ 2654339073 EOL_FD05_ECM 0;
BA_ "GenSigTimeoutTime_DTCM" SG_ 2654339073 EOL_FD05_ECM 0;
BA_ "GenSigTimeoutTime_ECM" SG_ 2654339073 EOL_FD05_ECM 0;
BA_ "GenSigTimeoutTime_EVCU2" SG_ 2654339073 EOL_FD05_ECM 0;
BA_ "GenSigTimeoutTime_GNMM" SG_ 2654339073 EOL_FD05_ECM 0;
BA_ "GenSigTimeoutTime_HCP" SG_ 2654339073 EOL_FD05_ECM 0;
BA_ "GenSigTimeoutTime_IPC" SG_ 2654339073 EOL_FD05_ECM 0;
BA_ "GenSigTimeoutTime_RFHM" SG_ 2654339073 EOL_FD05_ECM 0;
BA_ "GenSigTimeoutTime_TCM" SG_ 2654339073 EOL_FD05_ECM 0;
BA_ "GenSigTimeoutTime_AGSM" SG_ 2654339073 EOL_FD16_ECM 0;
BA_ "GenSigTimeoutTime_BCM" SG_ 2654339073 EOL_FD16_ECM 0;
BA_ "GenSigTimeoutTime_BSM" SG_ 2654339073 EOL_FD16_ECM 0;
BA_ "GenSigTimeoutTime_CADM" SG_ 2654339073 EOL_FD16_ECM 0;
BA_ "GenSigTimeoutTime_DMSM" SG_ 2654339073 EOL_FD16_ECM 0;
BA_ "GenSigTimeoutTime_DTCM" SG_ 2654339073 EOL_FD16_ECM 0;
BA_ "GenSigTimeoutTime_ECM" SG_ 2654339073 EOL_FD16_ECM 0;
BA_ "GenSigTimeoutTime_EVCU2" SG_ 2654339073 EOL_FD16_ECM 0;
BA_ "GenSigTimeoutTime_GNMM" SG_ 2654339073 EOL_FD16_ECM 0;
BA_ "GenSigTimeoutTime_HCP" SG_ 2654339073 EOL_FD16_ECM 0;
BA_ "GenSigTimeoutTime_IPC" SG_ 2654339073 EOL_FD16_ECM 0;
BA_ "GenSigTimeoutTime_RFHM" SG_ 2654339073 EOL_FD16_ECM 0;
BA_ "GenSigTimeoutTime_TCM" SG_ 2654339073 EOL_FD16_ECM 0;
BA_ "GenSigTimeoutTime_AGSM" SG_ 2654339073 GenericFailSts_FD03_ECM 0;
BA_ "GenSigTimeoutTime_BSM" SG_ 2654339073 GenericFailSts_FD03_ECM 0;
BA_ "GenSigTimeoutTime_CADM" SG_ 2654339073 GenericFailSts_FD03_ECM 0;
BA_ "GenSigTimeoutTime_DMSM" SG_ 2654339073 GenericFailSts_FD03_ECM 0;
BA_ "GenSigTimeoutTime_DTCM" SG_ 2654339073 GenericFailSts_FD03_ECM 0;
BA_ "GenSigTimeoutTime_ECM" SG_ 2654339073 GenericFailSts_FD03_ECM 0;
BA_ "GenSigTimeoutTime_EVCU2" SG_ 2654339073 GenericFailSts_FD03_ECM 0;
BA_ "GenSigTimeoutTime_GNMM" SG_ 2654339073 GenericFailSts_FD03_ECM 0;
BA_ "GenSigTimeoutTime_HCP" SG_ 2654339073 GenericFailSts_FD03_ECM 0;
BA_ "GenSigTimeoutTime_IPC" SG_ 2654339073 GenericFailSts_FD03_ECM 0;
BA_ "GenSigTimeoutTime_RFHM" SG_ 2654339073 GenericFailSts_FD03_ECM 0;
BA_ "GenSigTimeoutTime_TCM" SG_ 2654339073 GenericFailSts_FD03_ECM 0;
BA_ "GenSigTimeoutTime_AGSM" SG_ 2654339073 GenericFailSts_FD05_ECM 0;
BA_ "GenSigTimeoutTime_BCM" SG_ 2654339073 GenericFailSts_FD05_ECM 0;
BA_ "GenSigTimeoutTime_BSM" SG_ 2654339073 GenericFailSts_FD05_ECM 0;
BA_ "GenSigTimeoutTime_CADM" SG_ 2654339073 GenericFailSts_FD05_ECM 0;
BA_ "GenSigTimeoutTime_DMSM" SG_ 2654339073 GenericFailSts_FD05_ECM 0;
BA_ "GenSigTimeoutTime_DTCM" SG_ 2654339073 GenericFailSts_FD05_ECM 0;
BA_ "GenSigTimeoutTime_ECM" SG_ 2654339073 GenericFailSts_FD05_ECM 0;
BA_ "GenSigTimeoutTime_EVCU2" SG_ 2654339073 GenericFailSts_FD05_ECM 0;
BA_ "GenSigTimeoutTime_GNMM" SG_ 2654339073 GenericFailSts_FD05_ECM 0;
BA_ "GenSigTimeoutTime_HCP" SG_ 2654339073 GenericFailSts_FD05_ECM 0;
BA_ "GenSigTimeoutTime_IPC" SG_ 2654339073 GenericFailSts_FD05_ECM 0;
BA_ "GenSigTimeoutTime_RFHM" SG_ 2654339073 GenericFailSts_FD05_ECM 0;
BA_ "GenSigTimeoutTime_TCM" SG_ 2654339073 GenericFailSts_FD05_ECM 0;
BA_ "GenSigTimeoutTime_AGSM" SG_ 2654339073 GenericFailSts_FD16_ECM 0;
BA_ "GenSigTimeoutTime_BCM" SG_ 2654339073 GenericFailSts_FD16_ECM 0;
BA_ "GenSigTimeoutTime_BSM" SG_ 2654339073 GenericFailSts_FD16_ECM 0;
BA_ "GenSigTimeoutTime_CADM" SG_ 2654339073 GenericFailSts_FD16_ECM 0;
BA_ "GenSigTimeoutTime_DMSM" SG_ 2654339073 GenericFailSts_FD16_ECM 0;
BA_ "GenSigTimeoutTime_DTCM" SG_ 2654339073 GenericFailSts_FD16_ECM 0;
BA_ "GenSigTimeoutTime_ECM" SG_ 2654339073 GenericFailSts_FD16_ECM 0;
BA_ "GenSigTimeoutTime_EVCU2" SG_ 2654339073 GenericFailSts_FD16_ECM 0;
BA_ "GenSigTimeoutTime_GNMM" SG_ 2654339073 GenericFailSts_FD16_ECM 0;
BA_ "GenSigTimeoutTime_HCP" SG_ 2654339073 GenericFailSts_FD16_ECM 0;
BA_ "GenSigTimeoutTime_IPC" SG_ 2654339073 GenericFailSts_FD16_ECM 0;
BA_ "GenSigTimeoutTime_RFHM" SG_ 2654339073 GenericFailSts_FD16_ECM 0;
BA_ "GenSigTimeoutTime_TCM" SG_ 2654339073 GenericFailSts_FD16_ECM 0;
BA_ "GenSigTimeoutTime_AGSM" SG_ 2654339073 PreviousCanNMState_FD03_ECM 0;
BA_ "GenSigTimeoutTime_BCM" SG_ 2654339073 PreviousCanNMState_FD03_ECM 0;
BA_ "GenSigTimeoutTime_BSM" SG_ 2654339073 PreviousCanNMState_FD03_ECM 0;
BA_ "GenSigTimeoutTime_CADM" SG_ 2654339073 PreviousCanNMState_FD03_ECM 0;
BA_ "GenSigTimeoutTime_DMSM" SG_ 2654339073 PreviousCanNMState_FD03_ECM 0;
BA_ "GenSigTimeoutTime_DTCM" SG_ 2654339073 PreviousCanNMState_FD03_ECM 0;
BA_ "GenSigTimeoutTime_ECM" SG_ 2654339073 PreviousCanNMState_FD03_ECM 0;
BA_ "GenSigTimeoutTime_EVCU2" SG_ 2654339073 PreviousCanNMState_FD03_ECM 0;
BA_ "GenSigTimeoutTime_GNMM" SG_ 2654339073 PreviousCanNMState_FD03_ECM 0;
BA_ "GenSigTimeoutTime_HCP" SG_ 2654339073 PreviousCanNMState_FD03_ECM 0;
BA_ "GenSigTimeoutTime_IPC" SG_ 2654339073 PreviousCanNMState_FD03_ECM 0;
BA_ "GenSigTimeoutTime_RFHM" SG_ 2654339073 PreviousCanNMState_FD03_ECM 0;
BA_ "GenSigTimeoutTime_TCM" SG_ 2654339073 PreviousCanNMState_FD03_ECM 0;
BA_ "GenSigTimeoutTime_AGSM" SG_ 2654339073 PreviousCanNMState_FD05_ECM 0;
BA_ "GenSigTimeoutTime_BCM" SG_ 2654339073 PreviousCanNMState_FD05_ECM 0;
BA_ "GenSigTimeoutTime_BSM" SG_ 2654339073 PreviousCanNMState_FD05_ECM 0;
BA_ "GenSigTimeoutTime_CADM" SG_ 2654339073 PreviousCanNMState_FD05_ECM 0;
BA_ "GenSigTimeoutTime_DMSM" SG_ 2654339073 PreviousCanNMState_FD05_ECM 0;
BA_ "GenSigTimeoutTime_DTCM" SG_ 2654339073 PreviousCanNMState_FD05_ECM 0;
BA_ "GenSigTimeoutTime_ECM" SG_ 2654339073 PreviousCanNMState_FD05_ECM 0;
BA_ "GenSigTimeoutTime_EVCU2" SG_ 2654339073 PreviousCanNMState_FD05_ECM 0;
BA_ "GenSigTimeoutTime_GNMM" SG_ 2654339073 PreviousCanNMState_FD05_ECM 0;
BA_ "GenSigTimeoutTime_HCP" SG_ 2654339073 PreviousCanNMState_FD05_ECM 0;
BA_ "GenSigTimeoutTime_IPC" SG_ 2654339073 PreviousCanNMState_FD05_ECM 0;
BA_ "GenSigTimeoutTime_RFHM" SG_ 2654339073 PreviousCanNMState_FD05_ECM 0;
BA_ "GenSigTimeoutTime_TCM" SG_ 2654339073 PreviousCanNMState_FD05_ECM 0;
BA_ "GenSigTimeoutTime_AGSM" SG_ 2654339073 PreviousCanNMState_FD16_ECM 0;
BA_ "GenSigTimeoutTime_BCM" SG_ 2654339073 PreviousCanNMState_FD16_ECM 0;
BA_ "GenSigTimeoutTime_BSM" SG_ 2654339073 PreviousCanNMState_FD16_ECM 0;
BA_ "GenSigTimeoutTime_CADM" SG_ 2654339073 PreviousCanNMState_FD16_ECM 0;
BA_ "GenSigTimeoutTime_DMSM" SG_ 2654339073 PreviousCanNMState_FD16_ECM 0;
BA_ "GenSigTimeoutTime_DTCM" SG_ 2654339073 PreviousCanNMState_FD16_ECM 0;
BA_ "GenSigTimeoutTime_ECM" SG_ 2654339073 PreviousCanNMState_FD16_ECM 0;
BA_ "GenSigTimeoutTime_EVCU2" SG_ 2654339073 PreviousCanNMState_FD16_ECM 0;
BA_ "GenSigTimeoutTime_GNMM" SG_ 2654339073 PreviousCanNMState_FD16_ECM 0;
BA_ "GenSigTimeoutTime_HCP" SG_ 2654339073 PreviousCanNMState_FD16_ECM 0;
BA_ "GenSigTimeoutTime_IPC" SG_ 2654339073 PreviousCanNMState_FD16_ECM 0;
BA_ "GenSigTimeoutTime_RFHM" SG_ 2654339073 PreviousCanNMState_FD16_ECM 0;
BA_ "GenSigTimeoutTime_TCM" SG_ 2654339073 PreviousCanNMState_FD16_ECM 0;
BA_ "GenSigTimeoutTime_AGSM" SG_ 2654339073 StayActiveSource_FD03_ECM 0;
BA_ "GenSigTimeoutTime_BCM" SG_ 2654339073 StayActiveSource_FD03_ECM 0;
BA_ "GenSigTimeoutTime_BSM" SG_ 2654339073 StayActiveSource_FD03_ECM 0;
BA_ "GenSigTimeoutTime_CADM" SG_ 2654339073 StayActiveSource_FD03_ECM 0;
BA_ "GenSigTimeoutTime_DMSM" SG_ 2654339073 StayActiveSource_FD03_ECM 0;
BA_ "GenSigTimeoutTime_DTCM" SG_ 2654339073 StayActiveSource_FD03_ECM 0;
BA_ "GenSigTimeoutTime_ECM" SG_ 2654339073 StayActiveSource_FD03_ECM 0;
BA_ "GenSigTimeoutTime_EVCU2" SG_ 2654339073 StayActiveSource_FD03_ECM 0;
BA_ "GenSigTimeoutTime_GNMM" SG_ 2654339073 StayActiveSource_FD03_ECM 0;
BA_ "GenSigTimeoutTime_HCP" SG_ 2654339073 StayActiveSource_FD03_ECM 0;
BA_ "GenSigTimeoutTime_IPC" SG_ 2654339073 StayActiveSource_FD03_ECM 0;
BA_ "GenSigTimeoutTime_RFHM" SG_ 2654339073 StayActiveSource_FD03_ECM 0;
BA_ "GenSigTimeoutTime_TCM" SG_ 2654339073 StayActiveSource_FD03_ECM 0;
BA_ "GenSigTimeoutTime_AGSM" SG_ 2654339073 StayActiveSource_FD05_ECM 0;
BA_ "GenSigTimeoutTime_BCM" SG_ 2654339073 StayActiveSource_FD05_ECM 0;
BA_ "GenSigTimeoutTime_BSM" SG_ 2654339073 StayActiveSource_FD05_ECM 0;
BA_ "GenSigTimeoutTime_CADM" SG_ 2654339073 StayActiveSource_FD05_ECM 0;
BA_ "GenSigTimeoutTime_DMSM" SG_ 2654339073 StayActiveSource_FD05_ECM 0;
BA_ "GenSigTimeoutTime_DTCM" SG_ 2654339073 StayActiveSource_FD05_ECM 0;
BA_ "GenSigTimeoutTime_ECM" SG_ 2654339073 StayActiveSource_FD05_ECM 0;
BA_ "GenSigTimeoutTime_EVCU2" SG_ 2654339073 StayActiveSource_FD05_ECM 0;
BA_ "GenSigTimeoutTime_GNMM" SG_ 2654339073 StayActiveSource_FD05_ECM 0;
BA_ "GenSigTimeoutTime_HCP" SG_ 2654339073 StayActiveSource_FD05_ECM 0;
BA_ "GenSigTimeoutTime_IPC" SG_ 2654339073 StayActiveSource_FD05_ECM 0;
BA_ "GenSigTimeoutTime_RFHM" SG_ 2654339073 StayActiveSource_FD05_ECM 0;
BA_ "GenSigTimeoutTime_TCM" SG_ 2654339073 StayActiveSource_FD05_ECM 0;
BA_ "GenSigTimeoutTime_AGSM" SG_ 2654339073 StayActiveSource_FD16_ECM 0;
BA_ "GenSigTimeoutTime_BCM" SG_ 2654339073 StayActiveSource_FD16_ECM 0;
BA_ "GenSigTimeoutTime_BSM" SG_ 2654339073 StayActiveSource_FD16_ECM 0;
BA_ "GenSigTimeoutTime_CADM" SG_ 2654339073 StayActiveSource_FD16_ECM 0;
BA_ "GenSigTimeoutTime_DMSM" SG_ 2654339073 StayActiveSource_FD16_ECM 0;
BA_ "GenSigTimeoutTime_DTCM" SG_ 2654339073 StayActiveSource_FD16_ECM 0;
BA_ "GenSigTimeoutTime_ECM" SG_ 2654339073 StayActiveSource_FD16_ECM 0;
BA_ "GenSigTimeoutTime_EVCU2" SG_ 2654339073 StayActiveSource_FD16_ECM 0;
BA_ "GenSigTimeoutTime_GNMM" SG_ 2654339073 StayActiveSource_FD16_ECM 0;
BA_ "GenSigTimeoutTime_HCP" SG_ 2654339073 StayActiveSource_FD16_ECM 0;
BA_ "GenSigTimeoutTime_IPC" SG_ 2654339073 StayActiveSource_FD16_ECM 0;
BA_ "GenSigTimeoutTime_RFHM" SG_ 2654339073 StayActiveSource_FD16_ECM 0;
BA_ "GenSigTimeoutTime_TCM" SG_ 2654339073 StayActiveSource_FD16_ECM 0;
BA_ "GenSigTimeoutTime_AGSM" SG_ 2654339073 WakeupSource_FD03_ECM 0;
BA_ "GenSigTimeoutTime_BCM" SG_ 2654339073 WakeupSource_FD03_ECM 0;
BA_ "GenSigTimeoutTime_BSM" SG_ 2654339073 WakeupSource_FD03_ECM 0;
BA_ "GenSigTimeoutTime_CADM" SG_ 2654339073 WakeupSource_FD03_ECM 0;
BA_ "GenSigTimeoutTime_DMSM" SG_ 2654339073 WakeupSource_FD03_ECM 0;
BA_ "GenSigTimeoutTime_DTCM" SG_ 2654339073 WakeupSource_FD03_ECM 0;
BA_ "GenSigTimeoutTime_ECM" SG_ 2654339073 WakeupSource_FD03_ECM 0;
BA_ "GenSigTimeoutTime_EVCU2" SG_ 2654339073 WakeupSource_FD03_ECM 0;
BA_ "GenSigTimeoutTime_GNMM" SG_ 2654339073 WakeupSource_FD03_ECM 0;
BA_ "GenSigTimeoutTime_HCP" SG_ 2654339073 WakeupSource_FD03_ECM 0;
BA_ "GenSigTimeoutTime_IPC" SG_ 2654339073 WakeupSource_FD03_ECM 0;
BA_ "GenSigTimeoutTime_RFHM" SG_ 2654339073 WakeupSource_FD03_ECM 0;
BA_ "GenSigTimeoutTime_TCM" SG_ 2654339073 WakeupSource_FD03_ECM 0;
BA_ "GenSigTimeoutTime_AGSM" SG_ 2654339073 WakeupSource_FD05_ECM 0;
BA_ "GenSigTimeoutTime_BCM" SG_ 2654339073 WakeupSource_FD05_ECM 0;
BA_ "GenSigTimeoutTime_BSM" SG_ 2654339073 WakeupSource_FD05_ECM 0;
BA_ "GenSigTimeoutTime_CADM" SG_ 2654339073 WakeupSource_FD05_ECM 0;
BA_ "GenSigTimeoutTime_DMSM" SG_ 2654339073 WakeupSource_FD05_ECM 0;
BA_ "GenSigTimeoutTime_DTCM" SG_ 2654339073 WakeupSource_FD05_ECM 0;
BA_ "GenSigTimeoutTime_ECM" SG_ 2654339073 WakeupSource_FD05_ECM 0;
BA_ "GenSigTimeoutTime_EVCU2" SG_ 2654339073 WakeupSource_FD05_ECM 0;
BA_ "GenSigTimeoutTime_GNMM" SG_ 2654339073 WakeupSource_FD05_ECM 0;
BA_ "GenSigTimeoutTime_HCP" SG_ 2654339073 WakeupSource_FD05_ECM 0;
BA_ "GenSigTimeoutTime_IPC" SG_ 2654339073 WakeupSource_FD05_ECM 0;
BA_ "GenSigTimeoutTime_RFHM" SG_ 2654339073 WakeupSource_FD05_ECM 0;
BA_ "GenSigTimeoutTime_TCM" SG_ 2654339073 WakeupSource_FD05_ECM 0;
BA_ "GenSigTimeoutTime_AGSM" SG_ 2654339073 WakeupSource_FD16_ECM 0;
BA_ "GenSigTimeoutTime_BCM" SG_ 2654339073 WakeupSource_FD16_ECM 0;
BA_ "GenSigTimeoutTime_BSM" SG_ 2654339073 WakeupSource_FD16_ECM 0;
BA_ "GenSigTimeoutTime_CADM" SG_ 2654339073 WakeupSource_FD16_ECM 0;
BA_ "GenSigTimeoutTime_DMSM" SG_ 2654339073 WakeupSource_FD16_ECM 0;
BA_ "GenSigTimeoutTime_DTCM" SG_ 2654339073 WakeupSource_FD16_ECM 0;
BA_ "GenSigTimeoutTime_ECM" SG_ 2654339073 WakeupSource_FD16_ECM 0;
BA_ "GenSigTimeoutTime_EVCU2" SG_ 2654339073 WakeupSource_FD16_ECM 0;
BA_ "GenSigTimeoutTime_GNMM" SG_ 2654339073 WakeupSource_FD16_ECM 0;
BA_ "GenSigTimeoutTime_HCP" SG_ 2654339073 WakeupSource_FD16_ECM 0;
BA_ "GenSigTimeoutTime_IPC" SG_ 2654339073 WakeupSource_FD16_ECM 0;
BA_ "GenSigTimeoutTime_RFHM" SG_ 2654339073 WakeupSource_FD16_ECM 0;
BA_ "GenSigTimeoutTime_TCM" SG_ 2654339073 WakeupSource_FD16_ECM 0;
BA_ "GenSigTimeoutTime_AGSM" SG_ 2654339108 CurrentCanNMState_FD08_ETM 0;
BA_ "GenSigTimeoutTime_BCM" SG_ 2654339108 CurrentCanNMState_FD08_ETM 0;
BA_ "GenSigTimeoutTime_BSM" SG_ 2654339108 CurrentCanNMState_FD08_ETM 0;
BA_ "GenSigTimeoutTime_CADM" SG_ 2654339108 CurrentCanNMState_FD08_ETM 0;
BA_ "GenSigTimeoutTime_DMSM" SG_ 2654339108 CurrentCanNMState_FD08_ETM 0;
BA_ "GenSigTimeoutTime_DTCM" SG_ 2654339108 CurrentCanNMState_FD08_ETM 0;
BA_ "GenSigTimeoutTime_ECM" SG_ 2654339108 CurrentCanNMState_FD08_ETM 0;
BA_ "GenSigTimeoutTime_EVCU2" SG_ 2654339108 CurrentCanNMState_FD08_ETM 0;
BA_ "GenSigTimeoutTime_GNMM" SG_ 2654339108 CurrentCanNMState_FD08_ETM 0;
BA_ "GenSigTimeoutTime_HCP" SG_ 2654339108 CurrentCanNMState_FD08_ETM 0;
BA_ "GenSigTimeoutTime_IPC" SG_ 2654339108 CurrentCanNMState_FD08_ETM 0;
BA_ "GenSigTimeoutTime_RFHM" SG_ 2654339108 CurrentCanNMState_FD08_ETM 0;
BA_ "GenSigTimeoutTime_SGW" SG_ 2654339108 CurrentCanNMState_FD08_ETM 0;
BA_ "GenSigTimeoutTime_TCM" SG_ 2654339108 CurrentCanNMState_FD08_ETM 0;
BA_ "GenSigTimeoutTime_AGSM" SG_ 2654339108 CurrentFailSts_FD08_ETM 0;
BA_ "GenSigTimeoutTime_BSM" SG_ 2654339108 CurrentFailSts_FD08_ETM 0;
BA_ "GenSigTimeoutTime_CADM" SG_ 2654339108 CurrentFailSts_FD08_ETM 0;
BA_ "GenSigTimeoutTime_DMSM" SG_ 2654339108 CurrentFailSts_FD08_ETM 0;
BA_ "GenSigTimeoutTime_DTCM" SG_ 2654339108 CurrentFailSts_FD08_ETM 0;
BA_ "GenSigTimeoutTime_ECM" SG_ 2654339108 CurrentFailSts_FD08_ETM 0;
BA_ "GenSigTimeoutTime_EVCU2" SG_ 2654339108 CurrentFailSts_FD08_ETM 0;
BA_ "GenSigTimeoutTime_GNMM" SG_ 2654339108 CurrentFailSts_FD08_ETM 0;
BA_ "GenSigTimeoutTime_HCP" SG_ 2654339108 CurrentFailSts_FD08_ETM 0;
BA_ "GenSigTimeoutTime_IPC" SG_ 2654339108 CurrentFailSts_FD08_ETM 0;
BA_ "GenSigTimeoutTime_RFHM" SG_ 2654339108 CurrentFailSts_FD08_ETM 0;
BA_ "GenSigTimeoutTime_SGW" SG_ 2654339108 CurrentFailSts_FD08_ETM 0;
BA_ "GenSigTimeoutTime_TCM" SG_ 2654339108 CurrentFailSts_FD08_ETM 0;
BA_ "GenSigTimeoutTime_AGSM" SG_ 2654339108 DES_FD08_ETM 0;
BA_ "GenSigTimeoutTime_BCM" SG_ 2654339108 DES_FD08_ETM 0;
BA_ "GenSigTimeoutTime_BSM" SG_ 2654339108 DES_FD08_ETM 0;
BA_ "GenSigTimeoutTime_CADM" SG_ 2654339108 DES_FD08_ETM 0;
BA_ "GenSigTimeoutTime_DMSM" SG_ 2654339108 DES_FD08_ETM 0;
BA_ "GenSigTimeoutTime_DTCM" SG_ 2654339108 DES_FD08_ETM 0;
BA_ "GenSigTimeoutTime_ECM" SG_ 2654339108 DES_FD08_ETM 0;
BA_ "GenSigTimeoutTime_EVCU2" SG_ 2654339108 DES_FD08_ETM 0;
BA_ "GenSigTimeoutTime_GNMM" SG_ 2654339108 DES_FD08_ETM 0;
BA_ "GenSigTimeoutTime_HCP" SG_ 2654339108 DES_FD08_ETM 0;
BA_ "GenSigTimeoutTime_IPC" SG_ 2654339108 DES_FD08_ETM 0;
BA_ "GenSigTimeoutTime_RFHM" SG_ 2654339108 DES_FD08_ETM 0;
BA_ "GenSigTimeoutTime_SGW" SG_ 2654339108 DES_FD08_ETM 0;
BA_ "GenSigTimeoutTime_TCM" SG_ 2654339108 DES_FD08_ETM 0;
BA_ "GenSigTimeoutTime_AGSM" SG_ 2654339108 EOL_FD08_ETM 0;
BA_ "GenSigTimeoutTime_BSM" SG_ 2654339108 EOL_FD08_ETM 0;
BA_ "GenSigTimeoutTime_CADM" SG_ 2654339108 EOL_FD08_ETM 0;
BA_ "GenSigTimeoutTime_DMSM" SG_ 2654339108 EOL_FD08_ETM 0;
BA_ "GenSigTimeoutTime_DTCM" SG_ 2654339108 EOL_FD08_ETM 0;
BA_ "GenSigTimeoutTime_ECM" SG_ 2654339108 EOL_FD08_ETM 0;
BA_ "GenSigTimeoutTime_EVCU2" SG_ 2654339108 EOL_FD08_ETM 0;
BA_ "GenSigTimeoutTime_GNMM" SG_ 2654339108 EOL_FD08_ETM 0;
BA_ "GenSigTimeoutTime_HCP" SG_ 2654339108 EOL_FD08_ETM 0;
BA_ "GenSigTimeoutTime_IPC" SG_ 2654339108 EOL_FD08_ETM 0;
BA_ "GenSigTimeoutTime_RFHM" SG_ 2654339108 EOL_FD08_ETM 0;
BA_ "GenSigTimeoutTime_SGW" SG_ 2654339108 EOL_FD08_ETM 0;
BA_ "GenSigTimeoutTime_TCM" SG_ 2654339108 EOL_FD08_ETM 0;
BA_ "GenSigTimeoutTime_AGSM" SG_ 2654339108 GenericFailSts_FD08_ETM 0;
BA_ "GenSigTimeoutTime_BSM" SG_ 2654339108 GenericFailSts_FD08_ETM 0;
BA_ "GenSigTimeoutTime_CADM" SG_ 2654339108 GenericFailSts_FD08_ETM 0;
BA_ "GenSigTimeoutTime_DMSM" SG_ 2654339108 GenericFailSts_FD08_ETM 0;
BA_ "GenSigTimeoutTime_DTCM" SG_ 2654339108 GenericFailSts_FD08_ETM 0;
BA_ "GenSigTimeoutTime_ECM" SG_ 2654339108 GenericFailSts_FD08_ETM 0;
BA_ "GenSigTimeoutTime_EVCU2" SG_ 2654339108 GenericFailSts_FD08_ETM 0;
BA_ "GenSigTimeoutTime_GNMM" SG_ 2654339108 GenericFailSts_FD08_ETM 0;
BA_ "GenSigTimeoutTime_HCP" SG_ 2654339108 GenericFailSts_FD08_ETM 0;
BA_ "GenSigTimeoutTime_IPC" SG_ 2654339108 GenericFailSts_FD08_ETM 0;
BA_ "GenSigTimeoutTime_RFHM" SG_ 2654339108 GenericFailSts_FD08_ETM 0;
BA_ "GenSigTimeoutTime_SGW" SG_ 2654339108 GenericFailSts_FD08_ETM 0;
BA_ "GenSigTimeoutTime_TCM" SG_ 2654339108 GenericFailSts_FD08_ETM 0;
BA_ "GenSigTimeoutTime_AGSM" SG_ 2654339108 PreviousCanNMState_FD08_ETM 0;
BA_ "GenSigTimeoutTime_BCM" SG_ 2654339108 PreviousCanNMState_FD08_ETM 0;
BA_ "GenSigTimeoutTime_BSM" SG_ 2654339108 PreviousCanNMState_FD08_ETM 0;
BA_ "GenSigTimeoutTime_CADM" SG_ 2654339108 PreviousCanNMState_FD08_ETM 0;
BA_ "GenSigTimeoutTime_DMSM" SG_ 2654339108 PreviousCanNMState_FD08_ETM 0;
BA_ "GenSigTimeoutTime_DTCM" SG_ 2654339108 PreviousCanNMState_FD08_ETM 0;
BA_ "GenSigTimeoutTime_ECM" SG_ 2654339108 PreviousCanNMState_FD08_ETM 0;
BA_ "GenSigTimeoutTime_EVCU2" SG_ 2654339108 PreviousCanNMState_FD08_ETM 0;
BA_ "GenSigTimeoutTime_GNMM" SG_ 2654339108 PreviousCanNMState_FD08_ETM 0;
BA_ "GenSigTimeoutTime_HCP" SG_ 2654339108 PreviousCanNMState_FD08_ETM 0;
BA_ "GenSigTimeoutTime_IPC" SG_ 2654339108 PreviousCanNMState_FD08_ETM 0;
BA_ "GenSigTimeoutTime_RFHM" SG_ 2654339108 PreviousCanNMState_FD08_ETM 0;
BA_ "GenSigTimeoutTime_SGW" SG_ 2654339108 PreviousCanNMState_FD08_ETM 0;
BA_ "GenSigTimeoutTime_TCM" SG_ 2654339108 PreviousCanNMState_FD08_ETM 0;
BA_ "GenSigTimeoutTime_AGSM" SG_ 2654339108 StayActiveSource_FD08_ETM 0;
BA_ "GenSigTimeoutTime_BCM" SG_ 2654339108 StayActiveSource_FD08_ETM 0;
BA_ "GenSigTimeoutTime_BSM" SG_ 2654339108 StayActiveSource_FD08_ETM 0;
BA_ "GenSigTimeoutTime_CADM" SG_ 2654339108 StayActiveSource_FD08_ETM 0;
BA_ "GenSigTimeoutTime_DMSM" SG_ 2654339108 StayActiveSource_FD08_ETM 0;
BA_ "GenSigTimeoutTime_DTCM" SG_ 2654339108 StayActiveSource_FD08_ETM 0;
BA_ "GenSigTimeoutTime_ECM" SG_ 2654339108 StayActiveSource_FD08_ETM 0;
BA_ "GenSigTimeoutTime_EVCU2" SG_ 2654339108 StayActiveSource_FD08_ETM 0;
BA_ "GenSigTimeoutTime_GNMM" SG_ 2654339108 StayActiveSource_FD08_ETM 0;
BA_ "GenSigTimeoutTime_HCP" SG_ 2654339108 StayActiveSource_FD08_ETM 0;
BA_ "GenSigTimeoutTime_IPC" SG_ 2654339108 StayActiveSource_FD08_ETM 0;
BA_ "GenSigTimeoutTime_RFHM" SG_ 2654339108 StayActiveSource_FD08_ETM 0;
BA_ "GenSigTimeoutTime_SGW" SG_ 2654339108 StayActiveSource_FD08_ETM 0;
BA_ "GenSigTimeoutTime_TCM" SG_ 2654339108 StayActiveSource_FD08_ETM 0;
BA_ "GenSigTimeoutTime_AGSM" SG_ 2654339108 WakeupSource_FD08_ETM 0;
BA_ "GenSigTimeoutTime_BCM" SG_ 2654339108 WakeupSource_FD08_ETM 0;
BA_ "GenSigTimeoutTime_BSM" SG_ 2654339108 WakeupSource_FD08_ETM 0;
BA_ "GenSigTimeoutTime_CADM" SG_ 2654339108 WakeupSource_FD08_ETM 0;
BA_ "GenSigTimeoutTime_DMSM" SG_ 2654339108 WakeupSource_FD08_ETM 0;
BA_ "GenSigTimeoutTime_DTCM" SG_ 2654339108 WakeupSource_FD08_ETM 0;
BA_ "GenSigTimeoutTime_ECM" SG_ 2654339108 WakeupSource_FD08_ETM 0;
BA_ "GenSigTimeoutTime_EVCU2" SG_ 2654339108 WakeupSource_FD08_ETM 0;
BA_ "GenSigTimeoutTime_GNMM" SG_ 2654339108 WakeupSource_FD08_ETM 0;
BA_ "GenSigTimeoutTime_HCP" SG_ 2654339108 WakeupSource_FD08_ETM 0;
BA_ "GenSigTimeoutTime_IPC" SG_ 2654339108 WakeupSource_FD08_ETM 0;
BA_ "GenSigTimeoutTime_RFHM" SG_ 2654339108 WakeupSource_FD08_ETM 0;
BA_ "GenSigTimeoutTime_SGW" SG_ 2654339108 WakeupSource_FD08_ETM 0;
BA_ "GenSigTimeoutTime_TCM" SG_ 2654339108 WakeupSource_FD08_ETM 0;
BA_ "GenSigTimeoutTime_AGSM" SG_ 2654339136 CurrentCanNMState_FD03_EVCU2 0;
BA_ "GenSigTimeoutTime_BCM" SG_ 2654339136 CurrentCanNMState_FD03_EVCU2 0;
BA_ "GenSigTimeoutTime_BSM" SG_ 2654339136 CurrentCanNMState_FD03_EVCU2 0;
BA_ "GenSigTimeoutTime_CADM" SG_ 2654339136 CurrentCanNMState_FD03_EVCU2 0;
BA_ "GenSigTimeoutTime_DMSM" SG_ 2654339136 CurrentCanNMState_FD03_EVCU2 0;
BA_ "GenSigTimeoutTime_DTCM" SG_ 2654339136 CurrentCanNMState_FD03_EVCU2 0;
BA_ "GenSigTimeoutTime_ECM" SG_ 2654339136 CurrentCanNMState_FD03_EVCU2 0;
BA_ "GenSigTimeoutTime_EVCU2" SG_ 2654339136 CurrentCanNMState_FD03_EVCU2 0;
BA_ "GenSigTimeoutTime_GNMM" SG_ 2654339136 CurrentCanNMState_FD03_EVCU2 0;
BA_ "GenSigTimeoutTime_HCP" SG_ 2654339136 CurrentCanNMState_FD03_EVCU2 0;
BA_ "GenSigTimeoutTime_IPC" SG_ 2654339136 CurrentCanNMState_FD03_EVCU2 0;
BA_ "GenSigTimeoutTime_RFHM" SG_ 2654339136 CurrentCanNMState_FD03_EVCU2 0;
BA_ "GenSigTimeoutTime_SGW" SG_ 2654339136 CurrentCanNMState_FD03_EVCU2 0;
BA_ "GenSigTimeoutTime_TCM" SG_ 2654339136 CurrentCanNMState_FD03_EVCU2 0;
BA_ "GenSigTimeoutTime_AGSM" SG_ 2654339136 CurrentCanNMState_FD11_EVCU2 0;
BA_ "GenSigTimeoutTime_BCM" SG_ 2654339136 CurrentCanNMState_FD11_EVCU2 0;
BA_ "GenSigTimeoutTime_BSM" SG_ 2654339136 CurrentCanNMState_FD11_EVCU2 0;
BA_ "GenSigTimeoutTime_CADM" SG_ 2654339136 CurrentCanNMState_FD11_EVCU2 0;
BA_ "GenSigTimeoutTime_DMSM" SG_ 2654339136 CurrentCanNMState_FD11_EVCU2 0;
BA_ "GenSigTimeoutTime_DTCM" SG_ 2654339136 CurrentCanNMState_FD11_EVCU2 0;
BA_ "GenSigTimeoutTime_ECM" SG_ 2654339136 CurrentCanNMState_FD11_EVCU2 0;
BA_ "GenSigTimeoutTime_EVCU2" SG_ 2654339136 CurrentCanNMState_FD11_EVCU2 0;
BA_ "GenSigTimeoutTime_GNMM" SG_ 2654339136 CurrentCanNMState_FD11_EVCU2 0;
BA_ "GenSigTimeoutTime_HCP" SG_ 2654339136 CurrentCanNMState_FD11_EVCU2 0;
BA_ "GenSigTimeoutTime_IPC" SG_ 2654339136 CurrentCanNMState_FD11_EVCU2 0;
BA_ "GenSigTimeoutTime_RFHM" SG_ 2654339136 CurrentCanNMState_FD11_EVCU2 0;
BA_ "GenSigTimeoutTime_TCM" SG_ 2654339136 CurrentCanNMState_FD11_EVCU2 0;
BA_ "GenSigTimeoutTime_AGSM" SG_ 2654339136 CurrentCanNMState_FD16_EVCU2 0;
BA_ "GenSigTimeoutTime_BCM" SG_ 2654339136 CurrentCanNMState_FD16_EVCU2 0;
BA_ "GenSigTimeoutTime_BSM" SG_ 2654339136 CurrentCanNMState_FD16_EVCU2 0;
BA_ "GenSigTimeoutTime_CADM" SG_ 2654339136 CurrentCanNMState_FD16_EVCU2 0;
BA_ "GenSigTimeoutTime_DMSM" SG_ 2654339136 CurrentCanNMState_FD16_EVCU2 0;
BA_ "GenSigTimeoutTime_DTCM" SG_ 2654339136 CurrentCanNMState_FD16_EVCU2 0;
BA_ "GenSigTimeoutTime_ECM" SG_ 2654339136 CurrentCanNMState_FD16_EVCU2 0;
BA_ "GenSigTimeoutTime_EVCU2" SG_ 2654339136 CurrentCanNMState_FD16_EVCU2 0;
BA_ "GenSigTimeoutTime_GNMM" SG_ 2654339136 CurrentCanNMState_FD16_EVCU2 0;
BA_ "GenSigTimeoutTime_HCP" SG_ 2654339136 CurrentCanNMState_FD16_EVCU2 0;
BA_ "GenSigTimeoutTime_IPC" SG_ 2654339136 CurrentCanNMState_FD16_EVCU2 0;
BA_ "GenSigTimeoutTime_RFHM" SG_ 2654339136 CurrentCanNMState_FD16_EVCU2 0;
BA_ "GenSigTimeoutTime_TCM" SG_ 2654339136 CurrentCanNMState_FD16_EVCU2 0;
BA_ "GenSigTimeoutTime_AGSM" SG_ 2654339136 CurrentFailSts_FD03_EVCU2 0;
BA_ "GenSigTimeoutTime_BSM" SG_ 2654339136 CurrentFailSts_FD03_EVCU2 0;
BA_ "GenSigTimeoutTime_CADM" SG_ 2654339136 CurrentFailSts_FD03_EVCU2 0;
BA_ "GenSigTimeoutTime_DMSM" SG_ 2654339136 CurrentFailSts_FD03_EVCU2 0;
BA_ "GenSigTimeoutTime_DTCM" SG_ 2654339136 CurrentFailSts_FD03_EVCU2 0;
BA_ "GenSigTimeoutTime_ECM" SG_ 2654339136 CurrentFailSts_FD03_EVCU2 0;
BA_ "GenSigTimeoutTime_EVCU2" SG_ 2654339136 CurrentFailSts_FD03_EVCU2 0;
BA_ "GenSigTimeoutTime_GNMM" SG_ 2654339136 CurrentFailSts_FD03_EVCU2 0;
BA_ "GenSigTimeoutTime_HCP" SG_ 2654339136 CurrentFailSts_FD03_EVCU2 0;
BA_ "GenSigTimeoutTime_IPC" SG_ 2654339136 CurrentFailSts_FD03_EVCU2 0;
BA_ "GenSigTimeoutTime_RFHM" SG_ 2654339136 CurrentFailSts_FD03_EVCU2 0;
BA_ "GenSigTimeoutTime_SGW" SG_ 2654339136 CurrentFailSts_FD03_EVCU2 0;
BA_ "GenSigTimeoutTime_TCM" SG_ 2654339136 CurrentFailSts_FD03_EVCU2 0;
BA_ "GenSigTimeoutTime_AGSM" SG_ 2654339136 CurrentFailSts_FD11_EVCU2 0;
BA_ "GenSigTimeoutTime_BCM" SG_ 2654339136 CurrentFailSts_FD11_EVCU2 0;
BA_ "GenSigTimeoutTime_BSM" SG_ 2654339136 CurrentFailSts_FD11_EVCU2 0;
BA_ "GenSigTimeoutTime_CADM" SG_ 2654339136 CurrentFailSts_FD11_EVCU2 0;
BA_ "GenSigTimeoutTime_DMSM" SG_ 2654339136 CurrentFailSts_FD11_EVCU2 0;
BA_ "GenSigTimeoutTime_DTCM" SG_ 2654339136 CurrentFailSts_FD11_EVCU2 0;
BA_ "GenSigTimeoutTime_ECM" SG_ 2654339136 CurrentFailSts_FD11_EVCU2 0;
BA_ "GenSigTimeoutTime_EVCU2" SG_ 2654339136 CurrentFailSts_FD11_EVCU2 0;
BA_ "GenSigTimeoutTime_GNMM" SG_ 2654339136 CurrentFailSts_FD11_EVCU2 0;
BA_ "GenSigTimeoutTime_HCP" SG_ 2654339136 CurrentFailSts_FD11_EVCU2 0;
BA_ "GenSigTimeoutTime_IPC" SG_ 2654339136 CurrentFailSts_FD11_EVCU2 0;
BA_ "GenSigTimeoutTime_RFHM" SG_ 2654339136 CurrentFailSts_FD11_EVCU2 0;
BA_ "GenSigTimeoutTime_TCM" SG_ 2654339136 CurrentFailSts_FD11_EVCU2 0;
BA_ "GenSigTimeoutTime_AGSM" SG_ 2654339136 CurrentFailSts_FD16_EVCU2 0;
BA_ "GenSigTimeoutTime_BCM" SG_ 2654339136 CurrentFailSts_FD16_EVCU2 0;
BA_ "GenSigTimeoutTime_BSM" SG_ 2654339136 CurrentFailSts_FD16_EVCU2 0;
BA_ "GenSigTimeoutTime_CADM" SG_ 2654339136 CurrentFailSts_FD16_EVCU2 0;
BA_ "GenSigTimeoutTime_DMSM" SG_ 2654339136 CurrentFailSts_FD16_EVCU2 0;
BA_ "GenSigTimeoutTime_DTCM" SG_ 2654339136 CurrentFailSts_FD16_EVCU2 0;
BA_ "GenSigTimeoutTime_ECM" SG_ 2654339136 CurrentFailSts_FD16_EVCU2 0;
BA_ "GenSigTimeoutTime_EVCU2" SG_ 2654339136 CurrentFailSts_FD16_EVCU2 0;
BA_ "GenSigTimeoutTime_GNMM" SG_ 2654339136 CurrentFailSts_FD16_EVCU2 0;
BA_ "GenSigTimeoutTime_HCP" SG_ 2654339136 CurrentFailSts_FD16_EVCU2 0;
BA_ "GenSigTimeoutTime_IPC" SG_ 2654339136 CurrentFailSts_FD16_EVCU2 0;
BA_ "GenSigTimeoutTime_RFHM" SG_ 2654339136 CurrentFailSts_FD16_EVCU2 0;
BA_ "GenSigTimeoutTime_TCM" SG_ 2654339136 CurrentFailSts_FD16_EVCU2 0;
BA_ "GenSigTimeoutTime_AGSM" SG_ 2654339136 DES_FD03_EVCU2 0;
BA_ "GenSigTimeoutTime_BCM" SG_ 2654339136 DES_FD03_EVCU2 0;
BA_ "GenSigTimeoutTime_BSM" SG_ 2654339136 DES_FD03_EVCU2 0;
BA_ "GenSigTimeoutTime_CADM" SG_ 2654339136 DES_FD03_EVCU2 0;
BA_ "GenSigTimeoutTime_DMSM" SG_ 2654339136 DES_FD03_EVCU2 0;
BA_ "GenSigTimeoutTime_DTCM" SG_ 2654339136 DES_FD03_EVCU2 0;
BA_ "GenSigTimeoutTime_ECM" SG_ 2654339136 DES_FD03_EVCU2 0;
BA_ "GenSigTimeoutTime_EVCU2" SG_ 2654339136 DES_FD03_EVCU2 0;
BA_ "GenSigTimeoutTime_GNMM" SG_ 2654339136 DES_FD03_EVCU2 0;
BA_ "GenSigTimeoutTime_HCP" SG_ 2654339136 DES_FD03_EVCU2 0;
BA_ "GenSigTimeoutTime_IPC" SG_ 2654339136 DES_FD03_EVCU2 0;
BA_ "GenSigTimeoutTime_RFHM" SG_ 2654339136 DES_FD03_EVCU2 0;
BA_ "GenSigTimeoutTime_SGW" SG_ 2654339136 DES_FD03_EVCU2 0;
BA_ "GenSigTimeoutTime_TCM" SG_ 2654339136 DES_FD03_EVCU2 0;
BA_ "GenSigTimeoutTime_AGSM" SG_ 2654339136 DES_FD11_EVCU2 0;
BA_ "GenSigTimeoutTime_BCM" SG_ 2654339136 DES_FD11_EVCU2 0;
BA_ "GenSigTimeoutTime_BSM" SG_ 2654339136 DES_FD11_EVCU2 0;
BA_ "GenSigTimeoutTime_CADM" SG_ 2654339136 DES_FD11_EVCU2 0;
BA_ "GenSigTimeoutTime_DMSM" SG_ 2654339136 DES_FD11_EVCU2 0;
BA_ "GenSigTimeoutTime_DTCM" SG_ 2654339136 DES_FD11_EVCU2 0;
BA_ "GenSigTimeoutTime_ECM" SG_ 2654339136 DES_FD11_EVCU2 0;
BA_ "GenSigTimeoutTime_EVCU2" SG_ 2654339136 DES_FD11_EVCU2 0;
BA_ "GenSigTimeoutTime_GNMM" SG_ 2654339136 DES_FD11_EVCU2 0;
BA_ "GenSigTimeoutTime_HCP" SG_ 2654339136 DES_FD11_EVCU2 0;
BA_ "GenSigTimeoutTime_IPC" SG_ 2654339136 DES_FD11_EVCU2 0;
BA_ "GenSigTimeoutTime_RFHM" SG_ 2654339136 DES_FD11_EVCU2 0;
BA_ "GenSigTimeoutTime_TCM" SG_ 2654339136 DES_FD11_EVCU2 0;
BA_ "GenSigTimeoutTime_AGSM" SG_ 2654339136 DES_FD16_EVCU2 0;
BA_ "GenSigTimeoutTime_BCM" SG_ 2654339136 DES_FD16_EVCU2 0;
BA_ "GenSigTimeoutTime_BSM" SG_ 2654339136 DES_FD16_EVCU2 0;
BA_ "GenSigTimeoutTime_CADM" SG_ 2654339136 DES_FD16_EVCU2 0;
BA_ "GenSigTimeoutTime_DMSM" SG_ 2654339136 DES_FD16_EVCU2 0;
BA_ "GenSigTimeoutTime_DTCM" SG_ 2654339136 DES_FD16_EVCU2 0;
BA_ "GenSigTimeoutTime_ECM" SG_ 2654339136 DES_FD16_EVCU2 0;
BA_ "GenSigTimeoutTime_EVCU2" SG_ 2654339136 DES_FD16_EVCU2 0;
BA_ "GenSigTimeoutTime_GNMM" SG_ 2654339136 DES_FD16_EVCU2 0;
BA_ "GenSigTimeoutTime_HCP" SG_ 2654339136 DES_FD16_EVCU2 0;
BA_ "GenSigTimeoutTime_IPC" SG_ 2654339136 DES_FD16_EVCU2 0;
BA_ "GenSigTimeoutTime_RFHM" SG_ 2654339136 DES_FD16_EVCU2 0;
BA_ "GenSigTimeoutTime_TCM" SG_ 2654339136 DES_FD16_EVCU2 0;
BA_ "GenSigTimeoutTime_AGSM" SG_ 2654339136 EOL_FD03_EVCU2 0;
BA_ "GenSigTimeoutTime_BSM" SG_ 2654339136 EOL_FD03_EVCU2 0;
BA_ "GenSigTimeoutTime_CADM" SG_ 2654339136 EOL_FD03_EVCU2 0;
BA_ "GenSigTimeoutTime_DMSM" SG_ 2654339136 EOL_FD03_EVCU2 0;
BA_ "GenSigTimeoutTime_DTCM" SG_ 2654339136 EOL_FD03_EVCU2 0;
BA_ "GenSigTimeoutTime_ECM" SG_ 2654339136 EOL_FD03_EVCU2 0;
BA_ "GenSigTimeoutTime_EVCU2" SG_ 2654339136 EOL_FD03_EVCU2 0;
BA_ "GenSigTimeoutTime_GNMM" SG_ 2654339136 EOL_FD03_EVCU2 0;
BA_ "GenSigTimeoutTime_HCP" SG_ 2654339136 EOL_FD03_EVCU2 0;
BA_ "GenSigTimeoutTime_IPC" SG_ 2654339136 EOL_FD03_EVCU2 0;
BA_ "GenSigTimeoutTime_RFHM" SG_ 2654339136 EOL_FD03_EVCU2 0;
BA_ "GenSigTimeoutTime_SGW" SG_ 2654339136 EOL_FD03_EVCU2 0;
BA_ "GenSigTimeoutTime_TCM" SG_ 2654339136 EOL_FD03_EVCU2 0;
BA_ "GenSigTimeoutTime_AGSM" SG_ 2654339136 EOL_FD11_EVCU2 0;
BA_ "GenSigTimeoutTime_BCM" SG_ 2654339136 EOL_FD11_EVCU2 0;
BA_ "GenSigTimeoutTime_BSM" SG_ 2654339136 EOL_FD11_EVCU2 0;
BA_ "GenSigTimeoutTime_CADM" SG_ 2654339136 EOL_FD11_EVCU2 0;
BA_ "GenSigTimeoutTime_DMSM" SG_ 2654339136 EOL_FD11_EVCU2 0;
BA_ "GenSigTimeoutTime_DTCM" SG_ 2654339136 EOL_FD11_EVCU2 0;
BA_ "GenSigTimeoutTime_ECM" SG_ 2654339136 EOL_FD11_EVCU2 0;
BA_ "GenSigTimeoutTime_EVCU2" SG_ 2654339136 EOL_FD11_EVCU2 0;
BA_ "GenSigTimeoutTime_GNMM" SG_ 2654339136 EOL_FD11_EVCU2 0;
BA_ "GenSigTimeoutTime_HCP" SG_ 2654339136 EOL_FD11_EVCU2 0;
BA_ "GenSigTimeoutTime_IPC" SG_ 2654339136 EOL_FD11_EVCU2 0;
BA_ "GenSigTimeoutTime_RFHM" SG_ 2654339136 EOL_FD11_EVCU2 0;
BA_ "GenSigTimeoutTime_TCM" SG_ 2654339136 EOL_FD11_EVCU2 0;
BA_ "GenSigTimeoutTime_AGSM" SG_ 2654339136 EOL_FD16_EVCU2 0;
BA_ "GenSigTimeoutTime_BCM" SG_ 2654339136 EOL_FD16_EVCU2 0;
BA_ "GenSigTimeoutTime_BSM" SG_ 2654339136 EOL_FD16_EVCU2 0;
BA_ "GenSigTimeoutTime_CADM" SG_ 2654339136 EOL_FD16_EVCU2 0;
BA_ "GenSigTimeoutTime_DMSM" SG_ 2654339136 EOL_FD16_EVCU2 0;
BA_ "GenSigTimeoutTime_DTCM" SG_ 2654339136 EOL_FD16_EVCU2 0;
BA_ "GenSigTimeoutTime_ECM" SG_ 2654339136 EOL_FD16_EVCU2 0;
BA_ "GenSigTimeoutTime_EVCU2" SG_ 2654339136 EOL_FD16_EVCU2 0;
BA_ "GenSigTimeoutTime_GNMM" SG_ 2654339136 EOL_FD16_EVCU2 0;
BA_ "GenSigTimeoutTime_HCP" SG_ 2654339136 EOL_FD16_EVCU2 0;
BA_ "GenSigTimeoutTime_IPC" SG_ 2654339136 EOL_FD16_EVCU2 0;
BA_ "GenSigTimeoutTime_RFHM" SG_ 2654339136 EOL_FD16_EVCU2 0;
BA_ "GenSigTimeoutTime_TCM" SG_ 2654339136 EOL_FD16_EVCU2 0;
BA_ "GenSigTimeoutTime_AGSM" SG_ 2654339136 GenericFailSts_FD03_EVCU2 0;
BA_ "GenSigTimeoutTime_BSM" SG_ 2654339136 GenericFailSts_FD03_EVCU2 0;
BA_ "GenSigTimeoutTime_CADM" SG_ 2654339136 GenericFailSts_FD03_EVCU2 0;
BA_ "GenSigTimeoutTime_DMSM" SG_ 2654339136 GenericFailSts_FD03_EVCU2 0;
BA_ "GenSigTimeoutTime_DTCM" SG_ 2654339136 GenericFailSts_FD03_EVCU2 0;
BA_ "GenSigTimeoutTime_ECM" SG_ 2654339136 GenericFailSts_FD03_EVCU2 0;
BA_ "GenSigTimeoutTime_EVCU2" SG_ 2654339136 GenericFailSts_FD03_EVCU2 0;
BA_ "GenSigTimeoutTime_GNMM" SG_ 2654339136 GenericFailSts_FD03_EVCU2 0;
BA_ "GenSigTimeoutTime_HCP" SG_ 2654339136 GenericFailSts_FD03_EVCU2 0;
BA_ "GenSigTimeoutTime_IPC" SG_ 2654339136 GenericFailSts_FD03_EVCU2 0;
BA_ "GenSigTimeoutTime_RFHM" SG_ 2654339136 GenericFailSts_FD03_EVCU2 0;
BA_ "GenSigTimeoutTime_SGW" SG_ 2654339136 GenericFailSts_FD03_EVCU2 0;
BA_ "GenSigTimeoutTime_TCM" SG_ 2654339136 GenericFailSts_FD03_EVCU2 0;
BA_ "GenSigTimeoutTime_AGSM" SG_ 2654339136 GenericFailSts_FD11_EVCU2 0;
BA_ "GenSigTimeoutTime_BCM" SG_ 2654339136 GenericFailSts_FD11_EVCU2 0;
BA_ "GenSigTimeoutTime_BSM" SG_ 2654339136 GenericFailSts_FD11_EVCU2 0;
BA_ "GenSigTimeoutTime_CADM" SG_ 2654339136 GenericFailSts_FD11_EVCU2 0;
BA_ "GenSigTimeoutTime_DMSM" SG_ 2654339136 GenericFailSts_FD11_EVCU2 0;
BA_ "GenSigTimeoutTime_DTCM" SG_ 2654339136 GenericFailSts_FD11_EVCU2 0;
BA_ "GenSigTimeoutTime_ECM" SG_ 2654339136 GenericFailSts_FD11_EVCU2 0;
BA_ "GenSigTimeoutTime_EVCU2" SG_ 2654339136 GenericFailSts_FD11_EVCU2 0;
BA_ "GenSigTimeoutTime_GNMM" SG_ 2654339136 GenericFailSts_FD11_EVCU2 0;
BA_ "GenSigTimeoutTime_HCP" SG_ 2654339136 GenericFailSts_FD11_EVCU2 0;
BA_ "GenSigTimeoutTime_IPC" SG_ 2654339136 GenericFailSts_FD11_EVCU2 0;
BA_ "GenSigTimeoutTime_RFHM" SG_ 2654339136 GenericFailSts_FD11_EVCU2 0;
BA_ "GenSigTimeoutTime_TCM" SG_ 2654339136 GenericFailSts_FD11_EVCU2 0;
BA_ "GenSigTimeoutTime_AGSM" SG_ 2654339136 GenericFailSts_FD16_EVCU2 0;
BA_ "GenSigTimeoutTime_BCM" SG_ 2654339136 GenericFailSts_FD16_EVCU2 0;
BA_ "GenSigTimeoutTime_BSM" SG_ 2654339136 GenericFailSts_FD16_EVCU2 0;
BA_ "GenSigTimeoutTime_CADM" SG_ 2654339136 GenericFailSts_FD16_EVCU2 0;
BA_ "GenSigTimeoutTime_DMSM" SG_ 2654339136 GenericFailSts_FD16_EVCU2 0;
BA_ "GenSigTimeoutTime_DTCM" SG_ 2654339136 GenericFailSts_FD16_EVCU2 0;
BA_ "GenSigTimeoutTime_ECM" SG_ 2654339136 GenericFailSts_FD16_EVCU2 0;
BA_ "GenSigTimeoutTime_EVCU2" SG_ 2654339136 GenericFailSts_FD16_EVCU2 0;
BA_ "GenSigTimeoutTime_GNMM" SG_ 2654339136 GenericFailSts_FD16_EVCU2 0;
BA_ "GenSigTimeoutTime_HCP" SG_ 2654339136 GenericFailSts_FD16_EVCU2 0;
BA_ "GenSigTimeoutTime_IPC" SG_ 2654339136 GenericFailSts_FD16_EVCU2 0;
BA_ "GenSigTimeoutTime_RFHM" SG_ 2654339136 GenericFailSts_FD16_EVCU2 0;
BA_ "GenSigTimeoutTime_TCM" SG_ 2654339136 GenericFailSts_FD16_EVCU2 0;
BA_ "GenSigTimeoutTime_AGSM" SG_ 2654339136 PreviousCanNMState_FD03_EVCU2 0;
BA_ "GenSigTimeoutTime_BCM" SG_ 2654339136 PreviousCanNMState_FD03_EVCU2 0;
BA_ "GenSigTimeoutTime_BSM" SG_ 2654339136 PreviousCanNMState_FD03_EVCU2 0;
BA_ "GenSigTimeoutTime_CADM" SG_ 2654339136 PreviousCanNMState_FD03_EVCU2 0;
BA_ "GenSigTimeoutTime_DMSM" SG_ 2654339136 PreviousCanNMState_FD03_EVCU2 0;
BA_ "GenSigTimeoutTime_DTCM" SG_ 2654339136 PreviousCanNMState_FD03_EVCU2 0;
BA_ "GenSigTimeoutTime_ECM" SG_ 2654339136 PreviousCanNMState_FD03_EVCU2 0;
BA_ "GenSigTimeoutTime_EVCU2" SG_ 2654339136 PreviousCanNMState_FD03_EVCU2 0;
BA_ "GenSigTimeoutTime_GNMM" SG_ 2654339136 PreviousCanNMState_FD03_EVCU2 0;
BA_ "GenSigTimeoutTime_HCP" SG_ 2654339136 PreviousCanNMState_FD03_EVCU2 0;
BA_ "GenSigTimeoutTime_IPC" SG_ 2654339136 PreviousCanNMState_FD03_EVCU2 0;
BA_ "GenSigTimeoutTime_RFHM" SG_ 2654339136 PreviousCanNMState_FD03_EVCU2 0;
BA_ "GenSigTimeoutTime_SGW" SG_ 2654339136 PreviousCanNMState_FD03_EVCU2 0;
BA_ "GenSigTimeoutTime_TCM" SG_ 2654339136 PreviousCanNMState_FD03_EVCU2 0;
BA_ "GenSigTimeoutTime_AGSM" SG_ 2654339136 PreviousCanNMState_FD11_EVCU2 0;
BA_ "GenSigTimeoutTime_BCM" SG_ 2654339136 PreviousCanNMState_FD11_EVCU2 0;
BA_ "GenSigTimeoutTime_BSM" SG_ 2654339136 PreviousCanNMState_FD11_EVCU2 0;
BA_ "GenSigTimeoutTime_CADM" SG_ 2654339136 PreviousCanNMState_FD11_EVCU2 0;
BA_ "GenSigTimeoutTime_DMSM" SG_ 2654339136 PreviousCanNMState_FD11_EVCU2 0;
BA_ "GenSigTimeoutTime_DTCM" SG_ 2654339136 PreviousCanNMState_FD11_EVCU2 0;
BA_ "GenSigTimeoutTime_ECM" SG_ 2654339136 PreviousCanNMState_FD11_EVCU2 0;
BA_ "GenSigTimeoutTime_EVCU2" SG_ 2654339136 PreviousCanNMState_FD11_EVCU2 0;
BA_ "GenSigTimeoutTime_GNMM" SG_ 2654339136 PreviousCanNMState_FD11_EVCU2 0;
BA_ "GenSigTimeoutTime_HCP" SG_ 2654339136 PreviousCanNMState_FD11_EVCU2 0;
BA_ "GenSigTimeoutTime_IPC" SG_ 2654339136 PreviousCanNMState_FD11_EVCU2 0;
BA_ "GenSigTimeoutTime_RFHM" SG_ 2654339136 PreviousCanNMState_FD11_EVCU2 0;
BA_ "GenSigTimeoutTime_TCM" SG_ 2654339136 PreviousCanNMState_FD11_EVCU2 0;
BA_ "GenSigTimeoutTime_AGSM" SG_ 2654339136 PreviousCanNMState_FD16_EVCU2 0;
BA_ "GenSigTimeoutTime_BCM" SG_ 2654339136 PreviousCanNMState_FD16_EVCU2 0;
BA_ "GenSigTimeoutTime_BSM" SG_ 2654339136 PreviousCanNMState_FD16_EVCU2 0;
BA_ "GenSigTimeoutTime_CADM" SG_ 2654339136 PreviousCanNMState_FD16_EVCU2 0;
BA_ "GenSigTimeoutTime_DMSM" SG_ 2654339136 PreviousCanNMState_FD16_EVCU2 0;
BA_ "GenSigTimeoutTime_DTCM" SG_ 2654339136 PreviousCanNMState_FD16_EVCU2 0;
BA_ "GenSigTimeoutTime_ECM" SG_ 2654339136 PreviousCanNMState_FD16_EVCU2 0;
BA_ "GenSigTimeoutTime_EVCU2" SG_ 2654339136 PreviousCanNMState_FD16_EVCU2 0;
BA_ "GenSigTimeoutTime_GNMM" SG_ 2654339136 PreviousCanNMState_FD16_EVCU2 0;
BA_ "GenSigTimeoutTime_HCP" SG_ 2654339136 PreviousCanNMState_FD16_EVCU2 0;
BA_ "GenSigTimeoutTime_IPC" SG_ 2654339136 PreviousCanNMState_FD16_EVCU2 0;
BA_ "GenSigTimeoutTime_RFHM" SG_ 2654339136 PreviousCanNMState_FD16_EVCU2 0;
BA_ "GenSigTimeoutTime_TCM" SG_ 2654339136 PreviousCanNMState_FD16_EVCU2 0;
BA_ "GenSigTimeoutTime_AGSM" SG_ 2654339136 StayActiveSource_FD03_EVCU2 0;
BA_ "GenSigTimeoutTime_BCM" SG_ 2654339136 StayActiveSource_FD03_EVCU2 0;
BA_ "GenSigTimeoutTime_BSM" SG_ 2654339136 StayActiveSource_FD03_EVCU2 0;
BA_ "GenSigTimeoutTime_CADM" SG_ 2654339136 StayActiveSource_FD03_EVCU2 0;
BA_ "GenSigTimeoutTime_DMSM" SG_ 2654339136 StayActiveSource_FD03_EVCU2 0;
BA_ "GenSigTimeoutTime_DTCM" SG_ 2654339136 StayActiveSource_FD03_EVCU2 0;
BA_ "GenSigTimeoutTime_ECM" SG_ 2654339136 StayActiveSource_FD03_EVCU2 0;
BA_ "GenSigTimeoutTime_EVCU2" SG_ 2654339136 StayActiveSource_FD03_EVCU2 0;
BA_ "GenSigTimeoutTime_GNMM" SG_ 2654339136 StayActiveSource_FD03_EVCU2 0;
BA_ "GenSigTimeoutTime_HCP" SG_ 2654339136 StayActiveSource_FD03_EVCU2 0;
BA_ "GenSigTimeoutTime_IPC" SG_ 2654339136 StayActiveSource_FD03_EVCU2 0;
BA_ "GenSigTimeoutTime_RFHM" SG_ 2654339136 StayActiveSource_FD03_EVCU2 0;
BA_ "GenSigTimeoutTime_SGW" SG_ 2654339136 StayActiveSource_FD03_EVCU2 0;
BA_ "GenSigTimeoutTime_TCM" SG_ 2654339136 StayActiveSource_FD03_EVCU2 0;
BA_ "GenSigTimeoutTime_AGSM" SG_ 2654339136 StayActiveSource_FD11_EVCU2 0;
BA_ "GenSigTimeoutTime_BCM" SG_ 2654339136 StayActiveSource_FD11_EVCU2 0;
BA_ "GenSigTimeoutTime_BSM" SG_ 2654339136 StayActiveSource_FD11_EVCU2 0;
BA_ "GenSigTimeoutTime_CADM" SG_ 2654339136 StayActiveSource_FD11_EVCU2 0;
BA_ "GenSigTimeoutTime_DMSM" SG_ 2654339136 StayActiveSource_FD11_EVCU2 0;
BA_ "GenSigTimeoutTime_DTCM" SG_ 2654339136 StayActiveSource_FD11_EVCU2 0;
BA_ "GenSigTimeoutTime_ECM" SG_ 2654339136 StayActiveSource_FD11_EVCU2 0;
BA_ "GenSigTimeoutTime_EVCU2" SG_ 2654339136 StayActiveSource_FD11_EVCU2 0;
BA_ "GenSigTimeoutTime_GNMM" SG_ 2654339136 StayActiveSource_FD11_EVCU2 0;
BA_ "GenSigTimeoutTime_HCP" SG_ 2654339136 StayActiveSource_FD11_EVCU2 0;
BA_ "GenSigTimeoutTime_IPC" SG_ 2654339136 StayActiveSource_FD11_EVCU2 0;
BA_ "GenSigTimeoutTime_RFHM" SG_ 2654339136 StayActiveSource_FD11_EVCU2 0;
BA_ "GenSigTimeoutTime_TCM" SG_ 2654339136 StayActiveSource_FD11_EVCU2 0;
BA_ "GenSigTimeoutTime_AGSM" SG_ 2654339136 StayActiveSource_FD16_EVCU2 0;
BA_ "GenSigTimeoutTime_BCM" SG_ 2654339136 StayActiveSource_FD16_EVCU2 0;
BA_ "GenSigTimeoutTime_BSM" SG_ 2654339136 StayActiveSource_FD16_EVCU2 0;
BA_ "GenSigTimeoutTime_CADM" SG_ 2654339136 StayActiveSource_FD16_EVCU2 0;
BA_ "GenSigTimeoutTime_DMSM" SG_ 2654339136 StayActiveSource_FD16_EVCU2 0;
BA_ "GenSigTimeoutTime_DTCM" SG_ 2654339136 StayActiveSource_FD16_EVCU2 0;
BA_ "GenSigTimeoutTime_ECM" SG_ 2654339136 StayActiveSource_FD16_EVCU2 0;
BA_ "GenSigTimeoutTime_EVCU2" SG_ 2654339136 StayActiveSource_FD16_EVCU2 0;
BA_ "GenSigTimeoutTime_GNMM" SG_ 2654339136 StayActiveSource_FD16_EVCU2 0;
BA_ "GenSigTimeoutTime_HCP" SG_ 2654339136 StayActiveSource_FD16_EVCU2 0;
BA_ "GenSigTimeoutTime_IPC" SG_ 2654339136 StayActiveSource_FD16_EVCU2 0;
BA_ "GenSigTimeoutTime_RFHM" SG_ 2654339136 StayActiveSource_FD16_EVCU2 0;
BA_ "GenSigTimeoutTime_TCM" SG_ 2654339136 StayActiveSource_FD16_EVCU2 0;
BA_ "GenSigTimeoutTime_AGSM" SG_ 2654339136 WakeupSource_FD03_EVCU2 0;
BA_ "GenSigTimeoutTime_BCM" SG_ 2654339136 WakeupSource_FD03_EVCU2 0;
BA_ "GenSigTimeoutTime_BSM" SG_ 2654339136 WakeupSource_FD03_EVCU2 0;
BA_ "GenSigTimeoutTime_CADM" SG_ 2654339136 WakeupSource_FD03_EVCU2 0;
BA_ "GenSigTimeoutTime_DMSM" SG_ 2654339136 WakeupSource_FD03_EVCU2 0;
BA_ "GenSigTimeoutTime_DTCM" SG_ 2654339136 WakeupSource_FD03_EVCU2 0;
BA_ "GenSigTimeoutTime_ECM" SG_ 2654339136 WakeupSource_FD03_EVCU2 0;
BA_ "GenSigTimeoutTime_EVCU2" SG_ 2654339136 WakeupSource_FD03_EVCU2 0;
BA_ "GenSigTimeoutTime_GNMM" SG_ 2654339136 WakeupSource_FD03_EVCU2 0;
BA_ "GenSigTimeoutTime_HCP" SG_ 2654339136 WakeupSource_FD03_EVCU2 0;
BA_ "GenSigTimeoutTime_IPC" SG_ 2654339136 WakeupSource_FD03_EVCU2 0;
BA_ "GenSigTimeoutTime_RFHM" SG_ 2654339136 WakeupSource_FD03_EVCU2 0;
BA_ "GenSigTimeoutTime_SGW" SG_ 2654339136 WakeupSource_FD03_EVCU2 0;
BA_ "GenSigTimeoutTime_TCM" SG_ 2654339136 WakeupSource_FD03_EVCU2 0;
BA_ "GenSigTimeoutTime_AGSM" SG_ 2654339136 WakeupSource_FD11_EVCU2 0;
BA_ "GenSigTimeoutTime_BCM" SG_ 2654339136 WakeupSource_FD11_EVCU2 0;
BA_ "GenSigTimeoutTime_BSM" SG_ 2654339136 WakeupSource_FD11_EVCU2 0;
BA_ "GenSigTimeoutTime_CADM" SG_ 2654339136 WakeupSource_FD11_EVCU2 0;
BA_ "GenSigTimeoutTime_DMSM" SG_ 2654339136 WakeupSource_FD11_EVCU2 0;
BA_ "GenSigTimeoutTime_DTCM" SG_ 2654339136 WakeupSource_FD11_EVCU2 0;
BA_ "GenSigTimeoutTime_ECM" SG_ 2654339136 WakeupSource_FD11_EVCU2 0;
BA_ "GenSigTimeoutTime_EVCU2" SG_ 2654339136 WakeupSource_FD11_EVCU2 0;
BA_ "GenSigTimeoutTime_GNMM" SG_ 2654339136 WakeupSource_FD11_EVCU2 0;
BA_ "GenSigTimeoutTime_HCP" SG_ 2654339136 WakeupSource_FD11_EVCU2 0;
BA_ "GenSigTimeoutTime_IPC" SG_ 2654339136 WakeupSource_FD11_EVCU2 0;
BA_ "GenSigTimeoutTime_RFHM" SG_ 2654339136 WakeupSource_FD11_EVCU2 0;
BA_ "GenSigTimeoutTime_TCM" SG_ 2654339136 WakeupSource_FD11_EVCU2 0;
BA_ "GenSigTimeoutTime_AGSM" SG_ 2654339136 WakeupSource_FD16_EVCU2 0;
BA_ "GenSigTimeoutTime_BCM" SG_ 2654339136 WakeupSource_FD16_EVCU2 0;
BA_ "GenSigTimeoutTime_BSM" SG_ 2654339136 WakeupSource_FD16_EVCU2 0;
BA_ "GenSigTimeoutTime_CADM" SG_ 2654339136 WakeupSource_FD16_EVCU2 0;
BA_ "GenSigTimeoutTime_DMSM" SG_ 2654339136 WakeupSource_FD16_EVCU2 0;
BA_ "GenSigTimeoutTime_DTCM" SG_ 2654339136 WakeupSource_FD16_EVCU2 0;
BA_ "GenSigTimeoutTime_ECM" SG_ 2654339136 WakeupSource_FD16_EVCU2 0;
BA_ "GenSigTimeoutTime_EVCU2" SG_ 2654339136 WakeupSource_FD16_EVCU2 0;
BA_ "GenSigTimeoutTime_GNMM" SG_ 2654339136 WakeupSource_FD16_EVCU2 0;
BA_ "GenSigTimeoutTime_HCP" SG_ 2654339136 WakeupSource_FD16_EVCU2 0;
BA_ "GenSigTimeoutTime_IPC" SG_ 2654339136 WakeupSource_FD16_EVCU2 0;
BA_ "GenSigTimeoutTime_RFHM" SG_ 2654339136 WakeupSource_FD16_EVCU2 0;
BA_ "GenSigTimeoutTime_TCM" SG_ 2654339136 WakeupSource_FD16_EVCU2 0;
BA_ "GenSigTimeoutTime_AGSM" SG_ 2654339216 CurrentCanNMState_FD03_GNMM 0;
BA_ "GenSigTimeoutTime_BCM" SG_ 2654339216 CurrentCanNMState_FD03_GNMM 0;
BA_ "GenSigTimeoutTime_BSM" SG_ 2654339216 CurrentCanNMState_FD03_GNMM 0;
BA_ "GenSigTimeoutTime_CADM" SG_ 2654339216 CurrentCanNMState_FD03_GNMM 0;
BA_ "GenSigTimeoutTime_DMSM" SG_ 2654339216 CurrentCanNMState_FD03_GNMM 0;
BA_ "GenSigTimeoutTime_DTCM" SG_ 2654339216 CurrentCanNMState_FD03_GNMM 0;
BA_ "GenSigTimeoutTime_ECM" SG_ 2654339216 CurrentCanNMState_FD03_GNMM 0;
BA_ "GenSigTimeoutTime_EVCU2" SG_ 2654339216 CurrentCanNMState_FD03_GNMM 0;
BA_ "GenSigTimeoutTime_GNMM" SG_ 2654339216 CurrentCanNMState_FD03_GNMM 0;
BA_ "GenSigTimeoutTime_HCP" SG_ 2654339216 CurrentCanNMState_FD03_GNMM 0;
BA_ "GenSigTimeoutTime_IPC" SG_ 2654339216 CurrentCanNMState_FD03_GNMM 0;
BA_ "GenSigTimeoutTime_RFHM" SG_ 2654339216 CurrentCanNMState_FD03_GNMM 0;
BA_ "GenSigTimeoutTime_TCM" SG_ 2654339216 CurrentCanNMState_FD03_GNMM 0;
BA_ "GenSigTimeoutTime_AGSM" SG_ 2654339216 CurrentFailSts_FD03_GNMM 0;
BA_ "GenSigTimeoutTime_BSM" SG_ 2654339216 CurrentFailSts_FD03_GNMM 0;
BA_ "GenSigTimeoutTime_CADM" SG_ 2654339216 CurrentFailSts_FD03_GNMM 0;
BA_ "GenSigTimeoutTime_DMSM" SG_ 2654339216 CurrentFailSts_FD03_GNMM 0;
BA_ "GenSigTimeoutTime_DTCM" SG_ 2654339216 CurrentFailSts_FD03_GNMM 0;
BA_ "GenSigTimeoutTime_ECM" SG_ 2654339216 CurrentFailSts_FD03_GNMM 0;
BA_ "GenSigTimeoutTime_EVCU2" SG_ 2654339216 CurrentFailSts_FD03_GNMM 0;
BA_ "GenSigTimeoutTime_GNMM" SG_ 2654339216 CurrentFailSts_FD03_GNMM 0;
BA_ "GenSigTimeoutTime_HCP" SG_ 2654339216 CurrentFailSts_FD03_GNMM 0;
BA_ "GenSigTimeoutTime_IPC" SG_ 2654339216 CurrentFailSts_FD03_GNMM 0;
BA_ "GenSigTimeoutTime_RFHM" SG_ 2654339216 CurrentFailSts_FD03_GNMM 0;
BA_ "GenSigTimeoutTime_TCM" SG_ 2654339216 CurrentFailSts_FD03_GNMM 0;
BA_ "GenSigTimeoutTime_AGSM" SG_ 2654339216 DES_FD03_GNMM 0;
BA_ "GenSigTimeoutTime_BCM" SG_ 2654339216 DES_FD03_GNMM 0;
BA_ "GenSigTimeoutTime_BSM" SG_ 2654339216 DES_FD03_GNMM 0;
BA_ "GenSigTimeoutTime_CADM" SG_ 2654339216 DES_FD03_GNMM 0;
BA_ "GenSigTimeoutTime_DMSM" SG_ 2654339216 DES_FD03_GNMM 0;
BA_ "GenSigTimeoutTime_DTCM" SG_ 2654339216 DES_FD03_GNMM 0;
BA_ "GenSigTimeoutTime_ECM" SG_ 2654339216 DES_FD03_GNMM 0;
BA_ "GenSigTimeoutTime_EVCU2" SG_ 2654339216 DES_FD03_GNMM 0;
BA_ "GenSigTimeoutTime_GNMM" SG_ 2654339216 DES_FD03_GNMM 0;
BA_ "GenSigTimeoutTime_HCP" SG_ 2654339216 DES_FD03_GNMM 0;
BA_ "GenSigTimeoutTime_IPC" SG_ 2654339216 DES_FD03_GNMM 0;
BA_ "GenSigTimeoutTime_RFHM" SG_ 2654339216 DES_FD03_GNMM 0;
BA_ "GenSigTimeoutTime_TCM" SG_ 2654339216 DES_FD03_GNMM 0;
BA_ "GenSigTimeoutTime_AGSM" SG_ 2654339216 EOL_FD03_GNMM 0;
BA_ "GenSigTimeoutTime_BSM" SG_ 2654339216 EOL_FD03_GNMM 0;
BA_ "GenSigTimeoutTime_CADM" SG_ 2654339216 EOL_FD03_GNMM 0;
BA_ "GenSigTimeoutTime_DMSM" SG_ 2654339216 EOL_FD03_GNMM 0;
BA_ "GenSigTimeoutTime_DTCM" SG_ 2654339216 EOL_FD03_GNMM 0;
BA_ "GenSigTimeoutTime_ECM" SG_ 2654339216 EOL_FD03_GNMM 0;
BA_ "GenSigTimeoutTime_EVCU2" SG_ 2654339216 EOL_FD03_GNMM 0;
BA_ "GenSigTimeoutTime_GNMM" SG_ 2654339216 EOL_FD03_GNMM 0;
BA_ "GenSigTimeoutTime_HCP" SG_ 2654339216 EOL_FD03_GNMM 0;
BA_ "GenSigTimeoutTime_IPC" SG_ 2654339216 EOL_FD03_GNMM 0;
BA_ "GenSigTimeoutTime_RFHM" SG_ 2654339216 EOL_FD03_GNMM 0;
BA_ "GenSigTimeoutTime_TCM" SG_ 2654339216 EOL_FD03_GNMM 0;
BA_ "GenSigTimeoutTime_AGSM" SG_ 2654339216 GenericFailSts_FD03_GNMM 0;
BA_ "GenSigTimeoutTime_BSM" SG_ 2654339216 GenericFailSts_FD03_GNMM 0;
BA_ "GenSigTimeoutTime_CADM" SG_ 2654339216 GenericFailSts_FD03_GNMM 0;
BA_ "GenSigTimeoutTime_DMSM" SG_ 2654339216 GenericFailSts_FD03_GNMM 0;
BA_ "GenSigTimeoutTime_DTCM" SG_ 2654339216 GenericFailSts_FD03_GNMM 0;
BA_ "GenSigTimeoutTime_ECM" SG_ 2654339216 GenericFailSts_FD03_GNMM 0;
BA_ "GenSigTimeoutTime_EVCU2" SG_ 2654339216 GenericFailSts_FD03_GNMM 0;
BA_ "GenSigTimeoutTime_GNMM" SG_ 2654339216 GenericFailSts_FD03_GNMM 0;
BA_ "GenSigTimeoutTime_HCP" SG_ 2654339216 GenericFailSts_FD03_GNMM 0;
BA_ "GenSigTimeoutTime_IPC" SG_ 2654339216 GenericFailSts_FD03_GNMM 0;
BA_ "GenSigTimeoutTime_RFHM" SG_ 2654339216 GenericFailSts_FD03_GNMM 0;
BA_ "GenSigTimeoutTime_TCM" SG_ 2654339216 GenericFailSts_FD03_GNMM 0;
BA_ "GenSigTimeoutTime_AGSM" SG_ 2654339216 PreviousCanNMState_FD03_GNMM 0;
BA_ "GenSigTimeoutTime_BCM" SG_ 2654339216 PreviousCanNMState_FD03_GNMM 0;
BA_ "GenSigTimeoutTime_BSM" SG_ 2654339216 PreviousCanNMState_FD03_GNMM 0;
BA_ "GenSigTimeoutTime_CADM" SG_ 2654339216 PreviousCanNMState_FD03_GNMM 0;
BA_ "GenSigTimeoutTime_DMSM" SG_ 2654339216 PreviousCanNMState_FD03_GNMM 0;
BA_ "GenSigTimeoutTime_DTCM" SG_ 2654339216 PreviousCanNMState_FD03_GNMM 0;
BA_ "GenSigTimeoutTime_ECM" SG_ 2654339216 PreviousCanNMState_FD03_GNMM 0;
BA_ "GenSigTimeoutTime_EVCU2" SG_ 2654339216 PreviousCanNMState_FD03_GNMM 0;
BA_ "GenSigTimeoutTime_GNMM" SG_ 2654339216 PreviousCanNMState_FD03_GNMM 0;
BA_ "GenSigTimeoutTime_HCP" SG_ 2654339216 PreviousCanNMState_FD03_GNMM 0;
BA_ "GenSigTimeoutTime_IPC" SG_ 2654339216 PreviousCanNMState_FD03_GNMM 0;
BA_ "GenSigTimeoutTime_RFHM" SG_ 2654339216 PreviousCanNMState_FD03_GNMM 0;
BA_ "GenSigTimeoutTime_TCM" SG_ 2654339216 PreviousCanNMState_FD03_GNMM 0;
BA_ "GenSigTimeoutTime_AGSM" SG_ 2654339216 StayActiveSource_FD03_GNMM 0;
BA_ "GenSigTimeoutTime_BCM" SG_ 2654339216 StayActiveSource_FD03_GNMM 0;
BA_ "GenSigTimeoutTime_BSM" SG_ 2654339216 StayActiveSource_FD03_GNMM 0;
BA_ "GenSigTimeoutTime_CADM" SG_ 2654339216 StayActiveSource_FD03_GNMM 0;
BA_ "GenSigTimeoutTime_DMSM" SG_ 2654339216 StayActiveSource_FD03_GNMM 0;
BA_ "GenSigTimeoutTime_DTCM" SG_ 2654339216 StayActiveSource_FD03_GNMM 0;
BA_ "GenSigTimeoutTime_ECM" SG_ 2654339216 StayActiveSource_FD03_GNMM 0;
BA_ "GenSigTimeoutTime_EVCU2" SG_ 2654339216 StayActiveSource_FD03_GNMM 0;
BA_ "GenSigTimeoutTime_GNMM" SG_ 2654339216 StayActiveSource_FD03_GNMM 0;
BA_ "GenSigTimeoutTime_HCP" SG_ 2654339216 StayActiveSource_FD03_GNMM 0;
BA_ "GenSigTimeoutTime_IPC" SG_ 2654339216 StayActiveSource_FD03_GNMM 0;
BA_ "GenSigTimeoutTime_RFHM" SG_ 2654339216 StayActiveSource_FD03_GNMM 0;
BA_ "GenSigTimeoutTime_TCM" SG_ 2654339216 StayActiveSource_FD03_GNMM 0;
BA_ "GenSigTimeoutTime_AGSM" SG_ 2654339216 WakeupSource_FD03_GNMM 0;
BA_ "GenSigTimeoutTime_BCM" SG_ 2654339216 WakeupSource_FD03_GNMM 0;
BA_ "GenSigTimeoutTime_BSM" SG_ 2654339216 WakeupSource_FD03_GNMM 0;
BA_ "GenSigTimeoutTime_CADM" SG_ 2654339216 WakeupSource_FD03_GNMM 0;
BA_ "GenSigTimeoutTime_DMSM" SG_ 2654339216 WakeupSource_FD03_GNMM 0;
BA_ "GenSigTimeoutTime_DTCM" SG_ 2654339216 WakeupSource_FD03_GNMM 0;
BA_ "GenSigTimeoutTime_ECM" SG_ 2654339216 WakeupSource_FD03_GNMM 0;
BA_ "GenSigTimeoutTime_EVCU2" SG_ 2654339216 WakeupSource_FD03_GNMM 0;
BA_ "GenSigTimeoutTime_GNMM" SG_ 2654339216 WakeupSource_FD03_GNMM 0;
BA_ "GenSigTimeoutTime_HCP" SG_ 2654339216 WakeupSource_FD03_GNMM 0;
BA_ "GenSigTimeoutTime_IPC" SG_ 2654339216 WakeupSource_FD03_GNMM 0;
BA_ "GenSigTimeoutTime_RFHM" SG_ 2654339216 WakeupSource_FD03_GNMM 0;
BA_ "GenSigTimeoutTime_TCM" SG_ 2654339216 WakeupSource_FD03_GNMM 0;
BA_ "GenSigTimeoutTime_AGSM" SG_ 2654339170 CurrentCanNMState_FD03_HCP 0;
BA_ "GenSigTimeoutTime_BCM" SG_ 2654339170 CurrentCanNMState_FD03_HCP 0;
BA_ "GenSigTimeoutTime_BSM" SG_ 2654339170 CurrentCanNMState_FD03_HCP 0;
BA_ "GenSigTimeoutTime_CADM" SG_ 2654339170 CurrentCanNMState_FD03_HCP 0;
BA_ "GenSigTimeoutTime_DMSM" SG_ 2654339170 CurrentCanNMState_FD03_HCP 0;
BA_ "GenSigTimeoutTime_DTCM" SG_ 2654339170 CurrentCanNMState_FD03_HCP 0;
BA_ "GenSigTimeoutTime_ECM" SG_ 2654339170 CurrentCanNMState_FD03_HCP 0;
BA_ "GenSigTimeoutTime_EVCU2" SG_ 2654339170 CurrentCanNMState_FD03_HCP 0;
BA_ "GenSigTimeoutTime_GNMM" SG_ 2654339170 CurrentCanNMState_FD03_HCP 0;
BA_ "GenSigTimeoutTime_HCP" SG_ 2654339170 CurrentCanNMState_FD03_HCP 0;
BA_ "GenSigTimeoutTime_IPC" SG_ 2654339170 CurrentCanNMState_FD03_HCP 0;
BA_ "GenSigTimeoutTime_RFHM" SG_ 2654339170 CurrentCanNMState_FD03_HCP 0;
BA_ "GenSigTimeoutTime_TCM" SG_ 2654339170 CurrentCanNMState_FD03_HCP 0;
BA_ "GenSigTimeoutTime_AGSM" SG_ 2654339170 CurrentFailSts_FD03_HCP 0;
BA_ "GenSigTimeoutTime_BSM" SG_ 2654339170 CurrentFailSts_FD03_HCP 0;
BA_ "GenSigTimeoutTime_CADM" SG_ 2654339170 CurrentFailSts_FD03_HCP 0;
BA_ "GenSigTimeoutTime_DMSM" SG_ 2654339170 CurrentFailSts_FD03_HCP 0;
BA_ "GenSigTimeoutTime_DTCM" SG_ 2654339170 CurrentFailSts_FD03_HCP 0;
BA_ "GenSigTimeoutTime_ECM" SG_ 2654339170 CurrentFailSts_FD03_HCP 0;
BA_ "GenSigTimeoutTime_EVCU2" SG_ 2654339170 CurrentFailSts_FD03_HCP 0;
BA_ "GenSigTimeoutTime_GNMM" SG_ 2654339170 CurrentFailSts_FD03_HCP 0;
BA_ "GenSigTimeoutTime_HCP" SG_ 2654339170 CurrentFailSts_FD03_HCP 0;
BA_ "GenSigTimeoutTime_IPC" SG_ 2654339170 CurrentFailSts_FD03_HCP 0;
BA_ "GenSigTimeoutTime_RFHM" SG_ 2654339170 CurrentFailSts_FD03_HCP 0;
BA_ "GenSigTimeoutTime_TCM" SG_ 2654339170 CurrentFailSts_FD03_HCP 0;
BA_ "GenSigTimeoutTime_AGSM" SG_ 2654339170 DES_FD03_HCP 0;
BA_ "GenSigTimeoutTime_BCM" SG_ 2654339170 DES_FD03_HCP 0;
BA_ "GenSigTimeoutTime_BSM" SG_ 2654339170 DES_FD03_HCP 0;
BA_ "GenSigTimeoutTime_CADM" SG_ 2654339170 DES_FD03_HCP 0;
BA_ "GenSigTimeoutTime_DMSM" SG_ 2654339170 DES_FD03_HCP 0;
BA_ "GenSigTimeoutTime_DTCM" SG_ 2654339170 DES_FD03_HCP 0;
BA_ "GenSigTimeoutTime_ECM" SG_ 2654339170 DES_FD03_HCP 0;
BA_ "GenSigTimeoutTime_EVCU2" SG_ 2654339170 DES_FD03_HCP 0;
BA_ "GenSigTimeoutTime_GNMM" SG_ 2654339170 DES_FD03_HCP 0;
BA_ "GenSigTimeoutTime_HCP" SG_ 2654339170 DES_FD03_HCP 0;
BA_ "GenSigTimeoutTime_IPC" SG_ 2654339170 DES_FD03_HCP 0;
BA_ "GenSigTimeoutTime_RFHM" SG_ 2654339170 DES_FD03_HCP 0;
BA_ "GenSigTimeoutTime_TCM" SG_ 2654339170 DES_FD03_HCP 0;
BA_ "GenSigTimeoutTime_AGSM" SG_ 2654339170 EOL_FD03_HCP 0;
BA_ "GenSigTimeoutTime_BSM" SG_ 2654339170 EOL_FD03_HCP 0;
BA_ "GenSigTimeoutTime_CADM" SG_ 2654339170 EOL_FD03_HCP 0;
BA_ "GenSigTimeoutTime_DMSM" SG_ 2654339170 EOL_FD03_HCP 0;
BA_ "GenSigTimeoutTime_DTCM" SG_ 2654339170 EOL_FD03_HCP 0;
BA_ "GenSigTimeoutTime_ECM" SG_ 2654339170 EOL_FD03_HCP 0;
BA_ "GenSigTimeoutTime_EVCU2" SG_ 2654339170 EOL_FD03_HCP 0;
BA_ "GenSigTimeoutTime_GNMM" SG_ 2654339170 EOL_FD03_HCP 0;
BA_ "GenSigTimeoutTime_HCP" SG_ 2654339170 EOL_FD03_HCP 0;
BA_ "GenSigTimeoutTime_IPC" SG_ 2654339170 EOL_FD03_HCP 0;
BA_ "GenSigTimeoutTime_RFHM" SG_ 2654339170 EOL_FD03_HCP 0;
BA_ "GenSigTimeoutTime_TCM" SG_ 2654339170 EOL_FD03_HCP 0;
BA_ "GenSigTimeoutTime_AGSM" SG_ 2654339170 GenericFailSts_FD03_HCP 0;
BA_ "GenSigTimeoutTime_BSM" SG_ 2654339170 GenericFailSts_FD03_HCP 0;
BA_ "GenSigTimeoutTime_CADM" SG_ 2654339170 GenericFailSts_FD03_HCP 0;
BA_ "GenSigTimeoutTime_DMSM" SG_ 2654339170 GenericFailSts_FD03_HCP 0;
BA_ "GenSigTimeoutTime_DTCM" SG_ 2654339170 GenericFailSts_FD03_HCP 0;
BA_ "GenSigTimeoutTime_ECM" SG_ 2654339170 GenericFailSts_FD03_HCP 0;
BA_ "GenSigTimeoutTime_EVCU2" SG_ 2654339170 GenericFailSts_FD03_HCP 0;
BA_ "GenSigTimeoutTime_GNMM" SG_ 2654339170 GenericFailSts_FD03_HCP 0;
BA_ "GenSigTimeoutTime_HCP" SG_ 2654339170 GenericFailSts_FD03_HCP 0;
BA_ "GenSigTimeoutTime_IPC" SG_ 2654339170 GenericFailSts_FD03_HCP 0;
BA_ "GenSigTimeoutTime_RFHM" SG_ 2654339170 GenericFailSts_FD03_HCP 0;
BA_ "GenSigTimeoutTime_TCM" SG_ 2654339170 GenericFailSts_FD03_HCP 0;
BA_ "GenSigTimeoutTime_AGSM" SG_ 2654339170 PreviousCanNMState_FD03_HCP 0;
BA_ "GenSigTimeoutTime_BCM" SG_ 2654339170 PreviousCanNMState_FD03_HCP 0;
BA_ "GenSigTimeoutTime_BSM" SG_ 2654339170 PreviousCanNMState_FD03_HCP 0;
BA_ "GenSigTimeoutTime_CADM" SG_ 2654339170 PreviousCanNMState_FD03_HCP 0;
BA_ "GenSigTimeoutTime_DMSM" SG_ 2654339170 PreviousCanNMState_FD03_HCP 0;
BA_ "GenSigTimeoutTime_DTCM" SG_ 2654339170 PreviousCanNMState_FD03_HCP 0;
BA_ "GenSigTimeoutTime_ECM" SG_ 2654339170 PreviousCanNMState_FD03_HCP 0;
BA_ "GenSigTimeoutTime_EVCU2" SG_ 2654339170 PreviousCanNMState_FD03_HCP 0;
BA_ "GenSigTimeoutTime_GNMM" SG_ 2654339170 PreviousCanNMState_FD03_HCP 0;
BA_ "GenSigTimeoutTime_HCP" SG_ 2654339170 PreviousCanNMState_FD03_HCP 0;
BA_ "GenSigTimeoutTime_IPC" SG_ 2654339170 PreviousCanNMState_FD03_HCP 0;
BA_ "GenSigTimeoutTime_RFHM" SG_ 2654339170 PreviousCanNMState_FD03_HCP 0;
BA_ "GenSigTimeoutTime_TCM" SG_ 2654339170 PreviousCanNMState_FD03_HCP 0;
BA_ "GenSigTimeoutTime_AGSM" SG_ 2654339170 StayActiveSource_FD03_HCP 0;
BA_ "GenSigTimeoutTime_BCM" SG_ 2654339170 StayActiveSource_FD03_HCP 0;
BA_ "GenSigTimeoutTime_BSM" SG_ 2654339170 StayActiveSource_FD03_HCP 0;
BA_ "GenSigTimeoutTime_CADM" SG_ 2654339170 StayActiveSource_FD03_HCP 0;
BA_ "GenSigTimeoutTime_DMSM" SG_ 2654339170 StayActiveSource_FD03_HCP 0;
BA_ "GenSigTimeoutTime_DTCM" SG_ 2654339170 StayActiveSource_FD03_HCP 0;
BA_ "GenSigTimeoutTime_ECM" SG_ 2654339170 StayActiveSource_FD03_HCP 0;
BA_ "GenSigTimeoutTime_EVCU2" SG_ 2654339170 StayActiveSource_FD03_HCP 0;
BA_ "GenSigTimeoutTime_GNMM" SG_ 2654339170 StayActiveSource_FD03_HCP 0;
BA_ "GenSigTimeoutTime_HCP" SG_ 2654339170 StayActiveSource_FD03_HCP 0;
BA_ "GenSigTimeoutTime_IPC" SG_ 2654339170 StayActiveSource_FD03_HCP 0;
BA_ "GenSigTimeoutTime_RFHM" SG_ 2654339170 StayActiveSource_FD03_HCP 0;
BA_ "GenSigTimeoutTime_TCM" SG_ 2654339170 StayActiveSource_FD03_HCP 0;
BA_ "GenSigTimeoutTime_AGSM" SG_ 2654339170 WakeupSource_FD03_HCP 0;
BA_ "GenSigTimeoutTime_BCM" SG_ 2654339170 WakeupSource_FD03_HCP 0;
BA_ "GenSigTimeoutTime_BSM" SG_ 2654339170 WakeupSource_FD03_HCP 0;
BA_ "GenSigTimeoutTime_CADM" SG_ 2654339170 WakeupSource_FD03_HCP 0;
BA_ "GenSigTimeoutTime_DMSM" SG_ 2654339170 WakeupSource_FD03_HCP 0;
BA_ "GenSigTimeoutTime_DTCM" SG_ 2654339170 WakeupSource_FD03_HCP 0;
BA_ "GenSigTimeoutTime_ECM" SG_ 2654339170 WakeupSource_FD03_HCP 0;
BA_ "GenSigTimeoutTime_EVCU2" SG_ 2654339170 WakeupSource_FD03_HCP 0;
BA_ "GenSigTimeoutTime_GNMM" SG_ 2654339170 WakeupSource_FD03_HCP 0;
BA_ "GenSigTimeoutTime_HCP" SG_ 2654339170 WakeupSource_FD03_HCP 0;
BA_ "GenSigTimeoutTime_IPC" SG_ 2654339170 WakeupSource_FD03_HCP 0;
BA_ "GenSigTimeoutTime_RFHM" SG_ 2654339170 WakeupSource_FD03_HCP 0;
BA_ "GenSigTimeoutTime_TCM" SG_ 2654339170 WakeupSource_FD03_HCP 0;
BA_ "GenSigTimeoutTime_AGSM" SG_ 2654339197 CurrentCanNMState_FD11_IDCM 0;
BA_ "GenSigTimeoutTime_BCM" SG_ 2654339197 CurrentCanNMState_FD11_IDCM 0;
BA_ "GenSigTimeoutTime_BSM" SG_ 2654339197 CurrentCanNMState_FD11_IDCM 0;
BA_ "GenSigTimeoutTime_CADM" SG_ 2654339197 CurrentCanNMState_FD11_IDCM 0;
BA_ "GenSigTimeoutTime_DMSM" SG_ 2654339197 CurrentCanNMState_FD11_IDCM 0;
BA_ "GenSigTimeoutTime_DTCM" SG_ 2654339197 CurrentCanNMState_FD11_IDCM 0;
BA_ "GenSigTimeoutTime_ECM" SG_ 2654339197 CurrentCanNMState_FD11_IDCM 0;
BA_ "GenSigTimeoutTime_EVCU2" SG_ 2654339197 CurrentCanNMState_FD11_IDCM 0;
BA_ "GenSigTimeoutTime_GNMM" SG_ 2654339197 CurrentCanNMState_FD11_IDCM 0;
BA_ "GenSigTimeoutTime_HCP" SG_ 2654339197 CurrentCanNMState_FD11_IDCM 0;
BA_ "GenSigTimeoutTime_IPC" SG_ 2654339197 CurrentCanNMState_FD11_IDCM 0;
BA_ "GenSigTimeoutTime_RFHM" SG_ 2654339197 CurrentCanNMState_FD11_IDCM 0;
BA_ "GenSigTimeoutTime_SGW" SG_ 2654339197 CurrentCanNMState_FD11_IDCM 0;
BA_ "GenSigTimeoutTime_TCM" SG_ 2654339197 CurrentCanNMState_FD11_IDCM 0;
BA_ "GenSigTimeoutTime_AGSM" SG_ 2654339197 CurrentFailSts_FD11_IDCM 0;
BA_ "GenSigTimeoutTime_BSM" SG_ 2654339197 CurrentFailSts_FD11_IDCM 0;
BA_ "GenSigTimeoutTime_CADM" SG_ 2654339197 CurrentFailSts_FD11_IDCM 0;
BA_ "GenSigTimeoutTime_DMSM" SG_ 2654339197 CurrentFailSts_FD11_IDCM 0;
BA_ "GenSigTimeoutTime_DTCM" SG_ 2654339197 CurrentFailSts_FD11_IDCM 0;
BA_ "GenSigTimeoutTime_ECM" SG_ 2654339197 CurrentFailSts_FD11_IDCM 0;
BA_ "GenSigTimeoutTime_EVCU2" SG_ 2654339197 CurrentFailSts_FD11_IDCM 0;
BA_ "GenSigTimeoutTime_GNMM" SG_ 2654339197 CurrentFailSts_FD11_IDCM 0;
BA_ "GenSigTimeoutTime_HCP" SG_ 2654339197 CurrentFailSts_FD11_IDCM 0;
BA_ "GenSigTimeoutTime_IPC" SG_ 2654339197 CurrentFailSts_FD11_IDCM 0;
BA_ "GenSigTimeoutTime_RFHM" SG_ 2654339197 CurrentFailSts_FD11_IDCM 0;
BA_ "GenSigTimeoutTime_SGW" SG_ 2654339197 CurrentFailSts_FD11_IDCM 0;
BA_ "GenSigTimeoutTime_TCM" SG_ 2654339197 CurrentFailSts_FD11_IDCM 0;
BA_ "GenSigTimeoutTime_AGSM" SG_ 2654339197 DES_FD11_IDCM 0;
BA_ "GenSigTimeoutTime_BCM" SG_ 2654339197 DES_FD11_IDCM 0;
BA_ "GenSigTimeoutTime_BSM" SG_ 2654339197 DES_FD11_IDCM 0;
BA_ "GenSigTimeoutTime_CADM" SG_ 2654339197 DES_FD11_IDCM 0;
BA_ "GenSigTimeoutTime_DMSM" SG_ 2654339197 DES_FD11_IDCM 0;
BA_ "GenSigTimeoutTime_DTCM" SG_ 2654339197 DES_FD11_IDCM 0;
BA_ "GenSigTimeoutTime_ECM" SG_ 2654339197 DES_FD11_IDCM 0;
BA_ "GenSigTimeoutTime_EVCU2" SG_ 2654339197 DES_FD11_IDCM 0;
BA_ "GenSigTimeoutTime_GNMM" SG_ 2654339197 DES_FD11_IDCM 0;
BA_ "GenSigTimeoutTime_HCP" SG_ 2654339197 DES_FD11_IDCM 0;
BA_ "GenSigTimeoutTime_IPC" SG_ 2654339197 DES_FD11_IDCM 0;
BA_ "GenSigTimeoutTime_RFHM" SG_ 2654339197 DES_FD11_IDCM 0;
BA_ "GenSigTimeoutTime_SGW" SG_ 2654339197 DES_FD11_IDCM 0;
BA_ "GenSigTimeoutTime_TCM" SG_ 2654339197 DES_FD11_IDCM 0;
BA_ "GenSigTimeoutTime_AGSM" SG_ 2654339197 EOL_FD11_IDCM 0;
BA_ "GenSigTimeoutTime_BSM" SG_ 2654339197 EOL_FD11_IDCM 0;
BA_ "GenSigTimeoutTime_CADM" SG_ 2654339197 EOL_FD11_IDCM 0;
BA_ "GenSigTimeoutTime_DMSM" SG_ 2654339197 EOL_FD11_IDCM 0;
BA_ "GenSigTimeoutTime_DTCM" SG_ 2654339197 EOL_FD11_IDCM 0;
BA_ "GenSigTimeoutTime_ECM" SG_ 2654339197 EOL_FD11_IDCM 0;
BA_ "GenSigTimeoutTime_EVCU2" SG_ 2654339197 EOL_FD11_IDCM 0;
BA_ "GenSigTimeoutTime_GNMM" SG_ 2654339197 EOL_FD11_IDCM 0;
BA_ "GenSigTimeoutTime_HCP" SG_ 2654339197 EOL_FD11_IDCM 0;
BA_ "GenSigTimeoutTime_IPC" SG_ 2654339197 EOL_FD11_IDCM 0;
BA_ "GenSigTimeoutTime_RFHM" SG_ 2654339197 EOL_FD11_IDCM 0;
BA_ "GenSigTimeoutTime_SGW" SG_ 2654339197 EOL_FD11_IDCM 0;
BA_ "GenSigTimeoutTime_TCM" SG_ 2654339197 EOL_FD11_IDCM 0;
BA_ "GenSigTimeoutTime_AGSM" SG_ 2654339197 GenericFailSts_FD11_IDCM 0;
BA_ "GenSigTimeoutTime_BSM" SG_ 2654339197 GenericFailSts_FD11_IDCM 0;
BA_ "GenSigTimeoutTime_CADM" SG_ 2654339197 GenericFailSts_FD11_IDCM 0;
BA_ "GenSigTimeoutTime_DMSM" SG_ 2654339197 GenericFailSts_FD11_IDCM 0;
BA_ "GenSigTimeoutTime_DTCM" SG_ 2654339197 GenericFailSts_FD11_IDCM 0;
BA_ "GenSigTimeoutTime_ECM" SG_ 2654339197 GenericFailSts_FD11_IDCM 0;
BA_ "GenSigTimeoutTime_EVCU2" SG_ 2654339197 GenericFailSts_FD11_IDCM 0;
BA_ "GenSigTimeoutTime_GNMM" SG_ 2654339197 GenericFailSts_FD11_IDCM 0;
BA_ "GenSigTimeoutTime_HCP" SG_ 2654339197 GenericFailSts_FD11_IDCM 0;
BA_ "GenSigTimeoutTime_IPC" SG_ 2654339197 GenericFailSts_FD11_IDCM 0;
BA_ "GenSigTimeoutTime_RFHM" SG_ 2654339197 GenericFailSts_FD11_IDCM 0;
BA_ "GenSigTimeoutTime_SGW" SG_ 2654339197 GenericFailSts_FD11_IDCM 0;
BA_ "GenSigTimeoutTime_TCM" SG_ 2654339197 GenericFailSts_FD11_IDCM 0;
BA_ "GenSigTimeoutTime_AGSM" SG_ 2654339197 PreviousCanNMState_FD11_IDCM 0;
BA_ "GenSigTimeoutTime_BCM" SG_ 2654339197 PreviousCanNMState_FD11_IDCM 0;
BA_ "GenSigTimeoutTime_BSM" SG_ 2654339197 PreviousCanNMState_FD11_IDCM 0;
BA_ "GenSigTimeoutTime_CADM" SG_ 2654339197 PreviousCanNMState_FD11_IDCM 0;
BA_ "GenSigTimeoutTime_DMSM" SG_ 2654339197 PreviousCanNMState_FD11_IDCM 0;
BA_ "GenSigTimeoutTime_DTCM" SG_ 2654339197 PreviousCanNMState_FD11_IDCM 0;
BA_ "GenSigTimeoutTime_ECM" SG_ 2654339197 PreviousCanNMState_FD11_IDCM 0;
BA_ "GenSigTimeoutTime_EVCU2" SG_ 2654339197 PreviousCanNMState_FD11_IDCM 0;
BA_ "GenSigTimeoutTime_GNMM" SG_ 2654339197 PreviousCanNMState_FD11_IDCM 0;
BA_ "GenSigTimeoutTime_HCP" SG_ 2654339197 PreviousCanNMState_FD11_IDCM 0;
BA_ "GenSigTimeoutTime_IPC" SG_ 2654339197 PreviousCanNMState_FD11_IDCM 0;
BA_ "GenSigTimeoutTime_RFHM" SG_ 2654339197 PreviousCanNMState_FD11_IDCM 0;
BA_ "GenSigTimeoutTime_SGW" SG_ 2654339197 PreviousCanNMState_FD11_IDCM 0;
BA_ "GenSigTimeoutTime_TCM" SG_ 2654339197 PreviousCanNMState_FD11_IDCM 0;
BA_ "GenSigTimeoutTime_AGSM" SG_ 2654339197 StayActiveSource_FD11_IDCM 0;
BA_ "GenSigTimeoutTime_BCM" SG_ 2654339197 StayActiveSource_FD11_IDCM 0;
BA_ "GenSigTimeoutTime_BSM" SG_ 2654339197 StayActiveSource_FD11_IDCM 0;
BA_ "GenSigTimeoutTime_CADM" SG_ 2654339197 StayActiveSource_FD11_IDCM 0;
BA_ "GenSigTimeoutTime_DMSM" SG_ 2654339197 StayActiveSource_FD11_IDCM 0;
BA_ "GenSigTimeoutTime_DTCM" SG_ 2654339197 StayActiveSource_FD11_IDCM 0;
BA_ "GenSigTimeoutTime_ECM" SG_ 2654339197 StayActiveSource_FD11_IDCM 0;
BA_ "GenSigTimeoutTime_EVCU2" SG_ 2654339197 StayActiveSource_FD11_IDCM 0;
BA_ "GenSigTimeoutTime_GNMM" SG_ 2654339197 StayActiveSource_FD11_IDCM 0;
BA_ "GenSigTimeoutTime_HCP" SG_ 2654339197 StayActiveSource_FD11_IDCM 0;
BA_ "GenSigTimeoutTime_IPC" SG_ 2654339197 StayActiveSource_FD11_IDCM 0;
BA_ "GenSigTimeoutTime_RFHM" SG_ 2654339197 StayActiveSource_FD11_IDCM 0;
BA_ "GenSigTimeoutTime_SGW" SG_ 2654339197 StayActiveSource_FD11_IDCM 0;
BA_ "GenSigTimeoutTime_TCM" SG_ 2654339197 StayActiveSource_FD11_IDCM 0;
BA_ "GenSigTimeoutTime_AGSM" SG_ 2654339197 WakeupSource_FD11_IDCM 0;
BA_ "GenSigTimeoutTime_BCM" SG_ 2654339197 WakeupSource_FD11_IDCM 0;
BA_ "GenSigTimeoutTime_BSM" SG_ 2654339197 WakeupSource_FD11_IDCM 0;
BA_ "GenSigTimeoutTime_CADM" SG_ 2654339197 WakeupSource_FD11_IDCM 0;
BA_ "GenSigTimeoutTime_DMSM" SG_ 2654339197 WakeupSource_FD11_IDCM 0;
BA_ "GenSigTimeoutTime_DTCM" SG_ 2654339197 WakeupSource_FD11_IDCM 0;
BA_ "GenSigTimeoutTime_ECM" SG_ 2654339197 WakeupSource_FD11_IDCM 0;
BA_ "GenSigTimeoutTime_EVCU2" SG_ 2654339197 WakeupSource_FD11_IDCM 0;
BA_ "GenSigTimeoutTime_GNMM" SG_ 2654339197 WakeupSource_FD11_IDCM 0;
BA_ "GenSigTimeoutTime_HCP" SG_ 2654339197 WakeupSource_FD11_IDCM 0;
BA_ "GenSigTimeoutTime_IPC" SG_ 2654339197 WakeupSource_FD11_IDCM 0;
BA_ "GenSigTimeoutTime_RFHM" SG_ 2654339197 WakeupSource_FD11_IDCM 0;
BA_ "GenSigTimeoutTime_SGW" SG_ 2654339197 WakeupSource_FD11_IDCM 0;
BA_ "GenSigTimeoutTime_TCM" SG_ 2654339197 WakeupSource_FD11_IDCM 0;
BA_ "GenSigTimeoutTime_AGSM" SG_ 2654339075 CurrentCanNMState_FD03_IPC 0;
BA_ "GenSigTimeoutTime_BCM" SG_ 2654339075 CurrentCanNMState_FD03_IPC 0;
BA_ "GenSigTimeoutTime_BSM" SG_ 2654339075 CurrentCanNMState_FD03_IPC 0;
BA_ "GenSigTimeoutTime_CADM" SG_ 2654339075 CurrentCanNMState_FD03_IPC 0;
BA_ "GenSigTimeoutTime_DMSM" SG_ 2654339075 CurrentCanNMState_FD03_IPC 0;
BA_ "GenSigTimeoutTime_DTCM" SG_ 2654339075 CurrentCanNMState_FD03_IPC 0;
BA_ "GenSigTimeoutTime_ECM" SG_ 2654339075 CurrentCanNMState_FD03_IPC 0;
BA_ "GenSigTimeoutTime_EVCU2" SG_ 2654339075 CurrentCanNMState_FD03_IPC 0;
BA_ "GenSigTimeoutTime_GNMM" SG_ 2654339075 CurrentCanNMState_FD03_IPC 0;
BA_ "GenSigTimeoutTime_HCP" SG_ 2654339075 CurrentCanNMState_FD03_IPC 0;
BA_ "GenSigTimeoutTime_IPC" SG_ 2654339075 CurrentCanNMState_FD03_IPC 0;
BA_ "GenSigTimeoutTime_RFHM" SG_ 2654339075 CurrentCanNMState_FD03_IPC 0;
BA_ "GenSigTimeoutTime_TCM" SG_ 2654339075 CurrentCanNMState_FD03_IPC 0;
BA_ "GenSigTimeoutTime_AGSM" SG_ 2654339075 CurrentFailSts_FD03_IPC 0;
BA_ "GenSigTimeoutTime_BSM" SG_ 2654339075 CurrentFailSts_FD03_IPC 0;
BA_ "GenSigTimeoutTime_CADM" SG_ 2654339075 CurrentFailSts_FD03_IPC 0;
BA_ "GenSigTimeoutTime_DMSM" SG_ 2654339075 CurrentFailSts_FD03_IPC 0;
BA_ "GenSigTimeoutTime_DTCM" SG_ 2654339075 CurrentFailSts_FD03_IPC 0;
BA_ "GenSigTimeoutTime_ECM" SG_ 2654339075 CurrentFailSts_FD03_IPC 0;
BA_ "GenSigTimeoutTime_EVCU2" SG_ 2654339075 CurrentFailSts_FD03_IPC 0;
BA_ "GenSigTimeoutTime_GNMM" SG_ 2654339075 CurrentFailSts_FD03_IPC 0;
BA_ "GenSigTimeoutTime_HCP" SG_ 2654339075 CurrentFailSts_FD03_IPC 0;
BA_ "GenSigTimeoutTime_IPC" SG_ 2654339075 CurrentFailSts_FD03_IPC 0;
BA_ "GenSigTimeoutTime_RFHM" SG_ 2654339075 CurrentFailSts_FD03_IPC 0;
BA_ "GenSigTimeoutTime_TCM" SG_ 2654339075 CurrentFailSts_FD03_IPC 0;
BA_ "GenSigTimeoutTime_AGSM" SG_ 2654339075 DES_FD03_IPC 0;
BA_ "GenSigTimeoutTime_BCM" SG_ 2654339075 DES_FD03_IPC 0;
BA_ "GenSigTimeoutTime_BSM" SG_ 2654339075 DES_FD03_IPC 0;
BA_ "GenSigTimeoutTime_CADM" SG_ 2654339075 DES_FD03_IPC 0;
BA_ "GenSigTimeoutTime_DMSM" SG_ 2654339075 DES_FD03_IPC 0;
BA_ "GenSigTimeoutTime_DTCM" SG_ 2654339075 DES_FD03_IPC 0;
BA_ "GenSigTimeoutTime_ECM" SG_ 2654339075 DES_FD03_IPC 0;
BA_ "GenSigTimeoutTime_EVCU2" SG_ 2654339075 DES_FD03_IPC 0;
BA_ "GenSigTimeoutTime_GNMM" SG_ 2654339075 DES_FD03_IPC 0;
BA_ "GenSigTimeoutTime_HCP" SG_ 2654339075 DES_FD03_IPC 0;
BA_ "GenSigTimeoutTime_IPC" SG_ 2654339075 DES_FD03_IPC 0;
BA_ "GenSigTimeoutTime_RFHM" SG_ 2654339075 DES_FD03_IPC 0;
BA_ "GenSigTimeoutTime_TCM" SG_ 2654339075 DES_FD03_IPC 0;
BA_ "GenSigTimeoutTime_AGSM" SG_ 2654339075 EOL_FD03_IPC 0;
BA_ "GenSigTimeoutTime_BSM" SG_ 2654339075 EOL_FD03_IPC 0;
BA_ "GenSigTimeoutTime_CADM" SG_ 2654339075 EOL_FD03_IPC 0;
BA_ "GenSigTimeoutTime_DMSM" SG_ 2654339075 EOL_FD03_IPC 0;
BA_ "GenSigTimeoutTime_DTCM" SG_ 2654339075 EOL_FD03_IPC 0;
BA_ "GenSigTimeoutTime_ECM" SG_ 2654339075 EOL_FD03_IPC 0;
BA_ "GenSigTimeoutTime_EVCU2" SG_ 2654339075 EOL_FD03_IPC 0;
BA_ "GenSigTimeoutTime_GNMM" SG_ 2654339075 EOL_FD03_IPC 0;
BA_ "GenSigTimeoutTime_HCP" SG_ 2654339075 EOL_FD03_IPC 0;
BA_ "GenSigTimeoutTime_IPC" SG_ 2654339075 EOL_FD03_IPC 0;
BA_ "GenSigTimeoutTime_RFHM" SG_ 2654339075 EOL_FD03_IPC 0;
BA_ "GenSigTimeoutTime_TCM" SG_ 2654339075 EOL_FD03_IPC 0;
BA_ "GenSigTimeoutTime_AGSM" SG_ 2654339075 GenericFailSts_FD03_IPC 0;
BA_ "GenSigTimeoutTime_BSM" SG_ 2654339075 GenericFailSts_FD03_IPC 0;
BA_ "GenSigTimeoutTime_CADM" SG_ 2654339075 GenericFailSts_FD03_IPC 0;
BA_ "GenSigTimeoutTime_DMSM" SG_ 2654339075 GenericFailSts_FD03_IPC 0;
BA_ "GenSigTimeoutTime_DTCM" SG_ 2654339075 GenericFailSts_FD03_IPC 0;
BA_ "GenSigTimeoutTime_ECM" SG_ 2654339075 GenericFailSts_FD03_IPC 0;
BA_ "GenSigTimeoutTime_EVCU2" SG_ 2654339075 GenericFailSts_FD03_IPC 0;
BA_ "GenSigTimeoutTime_GNMM" SG_ 2654339075 GenericFailSts_FD03_IPC 0;
BA_ "GenSigTimeoutTime_HCP" SG_ 2654339075 GenericFailSts_FD03_IPC 0;
BA_ "GenSigTimeoutTime_IPC" SG_ 2654339075 GenericFailSts_FD03_IPC 0;
BA_ "GenSigTimeoutTime_RFHM" SG_ 2654339075 GenericFailSts_FD03_IPC 0;
BA_ "GenSigTimeoutTime_TCM" SG_ 2654339075 GenericFailSts_FD03_IPC 0;
BA_ "GenSigTimeoutTime_AGSM" SG_ 2654339075 PreviousCanNMState_FD03_IPC 0;
BA_ "GenSigTimeoutTime_BCM" SG_ 2654339075 PreviousCanNMState_FD03_IPC 0;
BA_ "GenSigTimeoutTime_BSM" SG_ 2654339075 PreviousCanNMState_FD03_IPC 0;
BA_ "GenSigTimeoutTime_CADM" SG_ 2654339075 PreviousCanNMState_FD03_IPC 0;
BA_ "GenSigTimeoutTime_DMSM" SG_ 2654339075 PreviousCanNMState_FD03_IPC 0;
BA_ "GenSigTimeoutTime_DTCM" SG_ 2654339075 PreviousCanNMState_FD03_IPC 0;
BA_ "GenSigTimeoutTime_ECM" SG_ 2654339075 PreviousCanNMState_FD03_IPC 0;
BA_ "GenSigTimeoutTime_EVCU2" SG_ 2654339075 PreviousCanNMState_FD03_IPC 0;
BA_ "GenSigTimeoutTime_GNMM" SG_ 2654339075 PreviousCanNMState_FD03_IPC 0;
BA_ "GenSigTimeoutTime_HCP" SG_ 2654339075 PreviousCanNMState_FD03_IPC 0;
BA_ "GenSigTimeoutTime_IPC" SG_ 2654339075 PreviousCanNMState_FD03_IPC 0;
BA_ "GenSigTimeoutTime_RFHM" SG_ 2654339075 PreviousCanNMState_FD03_IPC 0;
BA_ "GenSigTimeoutTime_TCM" SG_ 2654339075 PreviousCanNMState_FD03_IPC 0;
BA_ "GenSigTimeoutTime_AGSM" SG_ 2654339075 StayActiveSource_FD03_IPC 0;
BA_ "GenSigTimeoutTime_BCM" SG_ 2654339075 StayActiveSource_FD03_IPC 0;
BA_ "GenSigTimeoutTime_BSM" SG_ 2654339075 StayActiveSource_FD03_IPC 0;
BA_ "GenSigTimeoutTime_CADM" SG_ 2654339075 StayActiveSource_FD03_IPC 0;
BA_ "GenSigTimeoutTime_DMSM" SG_ 2654339075 StayActiveSource_FD03_IPC 0;
BA_ "GenSigTimeoutTime_DTCM" SG_ 2654339075 StayActiveSource_FD03_IPC 0;
BA_ "GenSigTimeoutTime_ECM" SG_ 2654339075 StayActiveSource_FD03_IPC 0;
BA_ "GenSigTimeoutTime_EVCU2" SG_ 2654339075 StayActiveSource_FD03_IPC 0;
BA_ "GenSigTimeoutTime_GNMM" SG_ 2654339075 StayActiveSource_FD03_IPC 0;
BA_ "GenSigTimeoutTime_HCP" SG_ 2654339075 StayActiveSource_FD03_IPC 0;
BA_ "GenSigTimeoutTime_IPC" SG_ 2654339075 StayActiveSource_FD03_IPC 0;
BA_ "GenSigTimeoutTime_RFHM" SG_ 2654339075 StayActiveSource_FD03_IPC 0;
BA_ "GenSigTimeoutTime_TCM" SG_ 2654339075 StayActiveSource_FD03_IPC 0;
BA_ "GenSigTimeoutTime_AGSM" SG_ 2654339075 WakeupSource_FD03_IPC 0;
BA_ "GenSigTimeoutTime_BCM" SG_ 2654339075 WakeupSource_FD03_IPC 0;
BA_ "GenSigTimeoutTime_BSM" SG_ 2654339075 WakeupSource_FD03_IPC 0;
BA_ "GenSigTimeoutTime_CADM" SG_ 2654339075 WakeupSource_FD03_IPC 0;
BA_ "GenSigTimeoutTime_DMSM" SG_ 2654339075 WakeupSource_FD03_IPC 0;
BA_ "GenSigTimeoutTime_DTCM" SG_ 2654339075 WakeupSource_FD03_IPC 0;
BA_ "GenSigTimeoutTime_ECM" SG_ 2654339075 WakeupSource_FD03_IPC 0;
BA_ "GenSigTimeoutTime_EVCU2" SG_ 2654339075 WakeupSource_FD03_IPC 0;
BA_ "GenSigTimeoutTime_GNMM" SG_ 2654339075 WakeupSource_FD03_IPC 0;
BA_ "GenSigTimeoutTime_HCP" SG_ 2654339075 WakeupSource_FD03_IPC 0;
BA_ "GenSigTimeoutTime_IPC" SG_ 2654339075 WakeupSource_FD03_IPC 0;
BA_ "GenSigTimeoutTime_RFHM" SG_ 2654339075 WakeupSource_FD03_IPC 0;
BA_ "GenSigTimeoutTime_TCM" SG_ 2654339075 WakeupSource_FD03_IPC 0;
BA_ "GenSigTimeoutTime_AGSM" SG_ 2654339160 CurrentCanNMState_FD05_MCPA 0;
BA_ "GenSigTimeoutTime_BCM" SG_ 2654339160 CurrentCanNMState_FD05_MCPA 0;
BA_ "GenSigTimeoutTime_BSM" SG_ 2654339160 CurrentCanNMState_FD05_MCPA 0;
BA_ "GenSigTimeoutTime_CADM" SG_ 2654339160 CurrentCanNMState_FD05_MCPA 0;
BA_ "GenSigTimeoutTime_DMSM" SG_ 2654339160 CurrentCanNMState_FD05_MCPA 0;
BA_ "GenSigTimeoutTime_DTCM" SG_ 2654339160 CurrentCanNMState_FD05_MCPA 0;
BA_ "GenSigTimeoutTime_ECM" SG_ 2654339160 CurrentCanNMState_FD05_MCPA 0;
BA_ "GenSigTimeoutTime_EVCU2" SG_ 2654339160 CurrentCanNMState_FD05_MCPA 0;
BA_ "GenSigTimeoutTime_GNMM" SG_ 2654339160 CurrentCanNMState_FD05_MCPA 0;
BA_ "GenSigTimeoutTime_HCP" SG_ 2654339160 CurrentCanNMState_FD05_MCPA 0;
BA_ "GenSigTimeoutTime_IPC" SG_ 2654339160 CurrentCanNMState_FD05_MCPA 0;
BA_ "GenSigTimeoutTime_RFHM" SG_ 2654339160 CurrentCanNMState_FD05_MCPA 0;
BA_ "GenSigTimeoutTime_TCM" SG_ 2654339160 CurrentCanNMState_FD05_MCPA 0;
BA_ "GenSigTimeoutTime_AGSM" SG_ 2654339160 CurrentCanNMState_FD16_MCPA 0;
BA_ "GenSigTimeoutTime_BCM" SG_ 2654339160 CurrentCanNMState_FD16_MCPA 0;
BA_ "GenSigTimeoutTime_BSM" SG_ 2654339160 CurrentCanNMState_FD16_MCPA 0;
BA_ "GenSigTimeoutTime_CADM" SG_ 2654339160 CurrentCanNMState_FD16_MCPA 0;
BA_ "GenSigTimeoutTime_DMSM" SG_ 2654339160 CurrentCanNMState_FD16_MCPA 0;
BA_ "GenSigTimeoutTime_DTCM" SG_ 2654339160 CurrentCanNMState_FD16_MCPA 0;
BA_ "GenSigTimeoutTime_ECM" SG_ 2654339160 CurrentCanNMState_FD16_MCPA 0;
BA_ "GenSigTimeoutTime_EVCU2" SG_ 2654339160 CurrentCanNMState_FD16_MCPA 0;
BA_ "GenSigTimeoutTime_GNMM" SG_ 2654339160 CurrentCanNMState_FD16_MCPA 0;
BA_ "GenSigTimeoutTime_HCP" SG_ 2654339160 CurrentCanNMState_FD16_MCPA 0;
BA_ "GenSigTimeoutTime_IPC" SG_ 2654339160 CurrentCanNMState_FD16_MCPA 0;
BA_ "GenSigTimeoutTime_RFHM" SG_ 2654339160 CurrentCanNMState_FD16_MCPA 0;
BA_ "GenSigTimeoutTime_TCM" SG_ 2654339160 CurrentCanNMState_FD16_MCPA 0;
BA_ "GenSigTimeoutTime_AGSM" SG_ 2654339160 CurrentFailSts_FD05_MCPA 0;
BA_ "GenSigTimeoutTime_BSM" SG_ 2654339160 CurrentFailSts_FD05_MCPA 0;
BA_ "GenSigTimeoutTime_CADM" SG_ 2654339160 CurrentFailSts_FD05_MCPA 0;
BA_ "GenSigTimeoutTime_DMSM" SG_ 2654339160 CurrentFailSts_FD05_MCPA 0;
BA_ "GenSigTimeoutTime_DTCM" SG_ 2654339160 CurrentFailSts_FD05_MCPA 0;
BA_ "GenSigTimeoutTime_ECM" SG_ 2654339160 CurrentFailSts_FD05_MCPA 0;
BA_ "GenSigTimeoutTime_EVCU2" SG_ 2654339160 CurrentFailSts_FD05_MCPA 0;
BA_ "GenSigTimeoutTime_GNMM" SG_ 2654339160 CurrentFailSts_FD05_MCPA 0;
BA_ "GenSigTimeoutTime_HCP" SG_ 2654339160 CurrentFailSts_FD05_MCPA 0;
BA_ "GenSigTimeoutTime_IPC" SG_ 2654339160 CurrentFailSts_FD05_MCPA 0;
BA_ "GenSigTimeoutTime_RFHM" SG_ 2654339160 CurrentFailSts_FD05_MCPA 0;
BA_ "GenSigTimeoutTime_TCM" SG_ 2654339160 CurrentFailSts_FD05_MCPA 0;
BA_ "GenSigTimeoutTime_AGSM" SG_ 2654339160 CurrentFailSts_FD16_MCPA 0;
BA_ "GenSigTimeoutTime_BCM" SG_ 2654339160 CurrentFailSts_FD16_MCPA 0;
BA_ "GenSigTimeoutTime_BSM" SG_ 2654339160 CurrentFailSts_FD16_MCPA 0;
BA_ "GenSigTimeoutTime_CADM" SG_ 2654339160 CurrentFailSts_FD16_MCPA 0;
BA_ "GenSigTimeoutTime_DMSM" SG_ 2654339160 CurrentFailSts_FD16_MCPA 0;
BA_ "GenSigTimeoutTime_DTCM" SG_ 2654339160 CurrentFailSts_FD16_MCPA 0;
BA_ "GenSigTimeoutTime_ECM" SG_ 2654339160 CurrentFailSts_FD16_MCPA 0;
BA_ "GenSigTimeoutTime_EVCU2" SG_ 2654339160 CurrentFailSts_FD16_MCPA 0;
BA_ "GenSigTimeoutTime_GNMM" SG_ 2654339160 CurrentFailSts_FD16_MCPA 0;
BA_ "GenSigTimeoutTime_HCP" SG_ 2654339160 CurrentFailSts_FD16_MCPA 0;
BA_ "GenSigTimeoutTime_IPC" SG_ 2654339160 CurrentFailSts_FD16_MCPA 0;
BA_ "GenSigTimeoutTime_RFHM" SG_ 2654339160 CurrentFailSts_FD16_MCPA 0;
BA_ "GenSigTimeoutTime_TCM" SG_ 2654339160 CurrentFailSts_FD16_MCPA 0;
BA_ "GenSigTimeoutTime_AGSM" SG_ 2654339160 DES_FD05_MCPA 0;
BA_ "GenSigTimeoutTime_BCM" SG_ 2654339160 DES_FD05_MCPA 0;
BA_ "GenSigTimeoutTime_BSM" SG_ 2654339160 DES_FD05_MCPA 0;
BA_ "GenSigTimeoutTime_CADM" SG_ 2654339160 DES_FD05_MCPA 0;
BA_ "GenSigTimeoutTime_DMSM" SG_ 2654339160 DES_FD05_MCPA 0;
BA_ "GenSigTimeoutTime_DTCM" SG_ 2654339160 DES_FD05_MCPA 0;
BA_ "GenSigTimeoutTime_ECM" SG_ 2654339160 DES_FD05_MCPA 0;
BA_ "GenSigTimeoutTime_EVCU2" SG_ 2654339160 DES_FD05_MCPA 0;
BA_ "GenSigTimeoutTime_GNMM" SG_ 2654339160 DES_FD05_MCPA 0;
BA_ "GenSigTimeoutTime_HCP" SG_ 2654339160 DES_FD05_MCPA 0;
BA_ "GenSigTimeoutTime_IPC" SG_ 2654339160 DES_FD05_MCPA 0;
BA_ "GenSigTimeoutTime_RFHM" SG_ 2654339160 DES_FD05_MCPA 0;
BA_ "GenSigTimeoutTime_TCM" SG_ 2654339160 DES_FD05_MCPA 0;
BA_ "GenSigTimeoutTime_AGSM" SG_ 2654339160 DES_FD16_MCPA 0;
BA_ "GenSigTimeoutTime_BCM" SG_ 2654339160 DES_FD16_MCPA 0;
BA_ "GenSigTimeoutTime_BSM" SG_ 2654339160 DES_FD16_MCPA 0;
BA_ "GenSigTimeoutTime_CADM" SG_ 2654339160 DES_FD16_MCPA 0;
BA_ "GenSigTimeoutTime_DMSM" SG_ 2654339160 DES_FD16_MCPA 0;
BA_ "GenSigTimeoutTime_DTCM" SG_ 2654339160 DES_FD16_MCPA 0;
BA_ "GenSigTimeoutTime_ECM" SG_ 2654339160 DES_FD16_MCPA 0;
BA_ "GenSigTimeoutTime_EVCU2" SG_ 2654339160 DES_FD16_MCPA 0;
BA_ "GenSigTimeoutTime_GNMM" SG_ 2654339160 DES_FD16_MCPA 0;
BA_ "GenSigTimeoutTime_HCP" SG_ 2654339160 DES_FD16_MCPA 0;
BA_ "GenSigTimeoutTime_IPC" SG_ 2654339160 DES_FD16_MCPA 0;
BA_ "GenSigTimeoutTime_RFHM" SG_ 2654339160 DES_FD16_MCPA 0;
BA_ "GenSigTimeoutTime_TCM" SG_ 2654339160 DES_FD16_MCPA 0;
BA_ "GenSigTimeoutTime_AGSM" SG_ 2654339160 EOL_FD05_MCPA 0;
BA_ "GenSigTimeoutTime_BSM" SG_ 2654339160 EOL_FD05_MCPA 0;
BA_ "GenSigTimeoutTime_CADM" SG_ 2654339160 EOL_FD05_MCPA 0;
BA_ "GenSigTimeoutTime_DMSM" SG_ 2654339160 EOL_FD05_MCPA 0;
BA_ "GenSigTimeoutTime_DTCM" SG_ 2654339160 EOL_FD05_MCPA 0;
BA_ "GenSigTimeoutTime_ECM" SG_ 2654339160 EOL_FD05_MCPA 0;
BA_ "GenSigTimeoutTime_EVCU2" SG_ 2654339160 EOL_FD05_MCPA 0;
BA_ "GenSigTimeoutTime_GNMM" SG_ 2654339160 EOL_FD05_MCPA 0;
BA_ "GenSigTimeoutTime_HCP" SG_ 2654339160 EOL_FD05_MCPA 0;
BA_ "GenSigTimeoutTime_IPC" SG_ 2654339160 EOL_FD05_MCPA 0;
BA_ "GenSigTimeoutTime_RFHM" SG_ 2654339160 EOL_FD05_MCPA 0;
BA_ "GenSigTimeoutTime_TCM" SG_ 2654339160 EOL_FD05_MCPA 0;
BA_ "GenSigTimeoutTime_AGSM" SG_ 2654339160 EOL_FD16_MCPA 0;
BA_ "GenSigTimeoutTime_BCM" SG_ 2654339160 EOL_FD16_MCPA 0;
BA_ "GenSigTimeoutTime_BSM" SG_ 2654339160 EOL_FD16_MCPA 0;
BA_ "GenSigTimeoutTime_CADM" SG_ 2654339160 EOL_FD16_MCPA 0;
BA_ "GenSigTimeoutTime_DMSM" SG_ 2654339160 EOL_FD16_MCPA 0;
BA_ "GenSigTimeoutTime_DTCM" SG_ 2654339160 EOL_FD16_MCPA 0;
BA_ "GenSigTimeoutTime_ECM" SG_ 2654339160 EOL_FD16_MCPA 0;
BA_ "GenSigTimeoutTime_EVCU2" SG_ 2654339160 EOL_FD16_MCPA 0;
BA_ "GenSigTimeoutTime_GNMM" SG_ 2654339160 EOL_FD16_MCPA 0;
BA_ "GenSigTimeoutTime_HCP" SG_ 2654339160 EOL_FD16_MCPA 0;
BA_ "GenSigTimeoutTime_IPC" SG_ 2654339160 EOL_FD16_MCPA 0;
BA_ "GenSigTimeoutTime_RFHM" SG_ 2654339160 EOL_FD16_MCPA 0;
BA_ "GenSigTimeoutTime_TCM" SG_ 2654339160 EOL_FD16_MCPA 0;
BA_ "GenSigTimeoutTime_AGSM" SG_ 2654339160 GenericFailSts_FD05_MCPA 0;
BA_ "GenSigTimeoutTime_BSM" SG_ 2654339160 GenericFailSts_FD05_MCPA 0;
BA_ "GenSigTimeoutTime_CADM" SG_ 2654339160 GenericFailSts_FD05_MCPA 0;
BA_ "GenSigTimeoutTime_DMSM" SG_ 2654339160 GenericFailSts_FD05_MCPA 0;
BA_ "GenSigTimeoutTime_DTCM" SG_ 2654339160 GenericFailSts_FD05_MCPA 0;
BA_ "GenSigTimeoutTime_ECM" SG_ 2654339160 GenericFailSts_FD05_MCPA 0;
BA_ "GenSigTimeoutTime_EVCU2" SG_ 2654339160 GenericFailSts_FD05_MCPA 0;
BA_ "GenSigTimeoutTime_GNMM" SG_ 2654339160 GenericFailSts_FD05_MCPA 0;
BA_ "GenSigTimeoutTime_HCP" SG_ 2654339160 GenericFailSts_FD05_MCPA 0;
BA_ "GenSigTimeoutTime_IPC" SG_ 2654339160 GenericFailSts_FD05_MCPA 0;
BA_ "GenSigTimeoutTime_RFHM" SG_ 2654339160 GenericFailSts_FD05_MCPA 0;
BA_ "GenSigTimeoutTime_TCM" SG_ 2654339160 GenericFailSts_FD05_MCPA 0;
BA_ "GenSigTimeoutTime_AGSM" SG_ 2654339160 GenericFailSts_FD16_MCPA 0;
BA_ "GenSigTimeoutTime_BCM" SG_ 2654339160 GenericFailSts_FD16_MCPA 0;
BA_ "GenSigTimeoutTime_BSM" SG_ 2654339160 GenericFailSts_FD16_MCPA 0;
BA_ "GenSigTimeoutTime_CADM" SG_ 2654339160 GenericFailSts_FD16_MCPA 0;
BA_ "GenSigTimeoutTime_DMSM" SG_ 2654339160 GenericFailSts_FD16_MCPA 0;
BA_ "GenSigTimeoutTime_DTCM" SG_ 2654339160 GenericFailSts_FD16_MCPA 0;
BA_ "GenSigTimeoutTime_ECM" SG_ 2654339160 GenericFailSts_FD16_MCPA 0;
BA_ "GenSigTimeoutTime_EVCU2" SG_ 2654339160 GenericFailSts_FD16_MCPA 0;
BA_ "GenSigTimeoutTime_GNMM" SG_ 2654339160 GenericFailSts_FD16_MCPA 0;
BA_ "GenSigTimeoutTime_HCP" SG_ 2654339160 GenericFailSts_FD16_MCPA 0;
BA_ "GenSigTimeoutTime_IPC" SG_ 2654339160 GenericFailSts_FD16_MCPA 0;
BA_ "GenSigTimeoutTime_RFHM" SG_ 2654339160 GenericFailSts_FD16_MCPA 0;
BA_ "GenSigTimeoutTime_TCM" SG_ 2654339160 GenericFailSts_FD16_MCPA 0;
BA_ "GenSigTimeoutTime_AGSM" SG_ 2654339160 PreviousCanNMState_FD05_MCPA 0;
BA_ "GenSigTimeoutTime_BCM" SG_ 2654339160 PreviousCanNMState_FD05_MCPA 0;
BA_ "GenSigTimeoutTime_BSM" SG_ 2654339160 PreviousCanNMState_FD05_MCPA 0;
BA_ "GenSigTimeoutTime_CADM" SG_ 2654339160 PreviousCanNMState_FD05_MCPA 0;
BA_ "GenSigTimeoutTime_DMSM" SG_ 2654339160 PreviousCanNMState_FD05_MCPA 0;
BA_ "GenSigTimeoutTime_DTCM" SG_ 2654339160 PreviousCanNMState_FD05_MCPA 0;
BA_ "GenSigTimeoutTime_ECM" SG_ 2654339160 PreviousCanNMState_FD05_MCPA 0;
BA_ "GenSigTimeoutTime_EVCU2" SG_ 2654339160 PreviousCanNMState_FD05_MCPA 0;
BA_ "GenSigTimeoutTime_GNMM" SG_ 2654339160 PreviousCanNMState_FD05_MCPA 0;
BA_ "GenSigTimeoutTime_HCP" SG_ 2654339160 PreviousCanNMState_FD05_MCPA 0;
BA_ "GenSigTimeoutTime_IPC" SG_ 2654339160 PreviousCanNMState_FD05_MCPA 0;
BA_ "GenSigTimeoutTime_RFHM" SG_ 2654339160 PreviousCanNMState_FD05_MCPA 0;
BA_ "GenSigTimeoutTime_TCM" SG_ 2654339160 PreviousCanNMState_FD05_MCPA 0;
BA_ "GenSigTimeoutTime_AGSM" SG_ 2654339160 PreviousCanNMState_FD16_MCPA 0;
BA_ "GenSigTimeoutTime_BCM" SG_ 2654339160 PreviousCanNMState_FD16_MCPA 0;
BA_ "GenSigTimeoutTime_BSM" SG_ 2654339160 PreviousCanNMState_FD16_MCPA 0;
BA_ "GenSigTimeoutTime_CADM" SG_ 2654339160 PreviousCanNMState_FD16_MCPA 0;
BA_ "GenSigTimeoutTime_DMSM" SG_ 2654339160 PreviousCanNMState_FD16_MCPA 0;
BA_ "GenSigTimeoutTime_DTCM" SG_ 2654339160 PreviousCanNMState_FD16_MCPA 0;
BA_ "GenSigTimeoutTime_ECM" SG_ 2654339160 PreviousCanNMState_FD16_MCPA 0;
BA_ "GenSigTimeoutTime_EVCU2" SG_ 2654339160 PreviousCanNMState_FD16_MCPA 0;
BA_ "GenSigTimeoutTime_GNMM" SG_ 2654339160 PreviousCanNMState_FD16_MCPA 0;
BA_ "GenSigTimeoutTime_HCP" SG_ 2654339160 PreviousCanNMState_FD16_MCPA 0;
BA_ "GenSigTimeoutTime_IPC" SG_ 2654339160 PreviousCanNMState_FD16_MCPA 0;
BA_ "GenSigTimeoutTime_RFHM" SG_ 2654339160 PreviousCanNMState_FD16_MCPA 0;
BA_ "GenSigTimeoutTime_TCM" SG_ 2654339160 PreviousCanNMState_FD16_MCPA 0;
BA_ "GenSigTimeoutTime_AGSM" SG_ 2654339160 StayActiveSource_FD05_MCPA 0;
BA_ "GenSigTimeoutTime_BCM" SG_ 2654339160 StayActiveSource_FD05_MCPA 0;
BA_ "GenSigTimeoutTime_BSM" SG_ 2654339160 StayActiveSource_FD05_MCPA 0;
BA_ "GenSigTimeoutTime_CADM" SG_ 2654339160 StayActiveSource_FD05_MCPA 0;
BA_ "GenSigTimeoutTime_DMSM" SG_ 2654339160 StayActiveSource_FD05_MCPA 0;
BA_ "GenSigTimeoutTime_DTCM" SG_ 2654339160 StayActiveSource_FD05_MCPA 0;
BA_ "GenSigTimeoutTime_ECM" SG_ 2654339160 StayActiveSource_FD05_MCPA 0;
BA_ "GenSigTimeoutTime_EVCU2" SG_ 2654339160 StayActiveSource_FD05_MCPA 0;
BA_ "GenSigTimeoutTime_GNMM" SG_ 2654339160 StayActiveSource_FD05_MCPA 0;
BA_ "GenSigTimeoutTime_HCP" SG_ 2654339160 StayActiveSource_FD05_MCPA 0;
BA_ "GenSigTimeoutTime_IPC" SG_ 2654339160 StayActiveSource_FD05_MCPA 0;
BA_ "GenSigTimeoutTime_RFHM" SG_ 2654339160 StayActiveSource_FD05_MCPA 0;
BA_ "GenSigTimeoutTime_TCM" SG_ 2654339160 StayActiveSource_FD05_MCPA 0;
BA_ "GenSigTimeoutTime_AGSM" SG_ 2654339160 StayActiveSource_FD16_MCPA 0;
BA_ "GenSigTimeoutTime_BCM" SG_ 2654339160 StayActiveSource_FD16_MCPA 0;
BA_ "GenSigTimeoutTime_BSM" SG_ 2654339160 StayActiveSource_FD16_MCPA 0;
BA_ "GenSigTimeoutTime_CADM" SG_ 2654339160 StayActiveSource_FD16_MCPA 0;
BA_ "GenSigTimeoutTime_DMSM" SG_ 2654339160 StayActiveSource_FD16_MCPA 0;
BA_ "GenSigTimeoutTime_DTCM" SG_ 2654339160 StayActiveSource_FD16_MCPA 0;
BA_ "GenSigTimeoutTime_ECM" SG_ 2654339160 StayActiveSource_FD16_MCPA 0;
BA_ "GenSigTimeoutTime_EVCU2" SG_ 2654339160 StayActiveSource_FD16_MCPA 0;
BA_ "GenSigTimeoutTime_GNMM" SG_ 2654339160 StayActiveSource_FD16_MCPA 0;
BA_ "GenSigTimeoutTime_HCP" SG_ 2654339160 StayActiveSource_FD16_MCPA 0;
BA_ "GenSigTimeoutTime_IPC" SG_ 2654339160 StayActiveSource_FD16_MCPA 0;
BA_ "GenSigTimeoutTime_RFHM" SG_ 2654339160 StayActiveSource_FD16_MCPA 0;
BA_ "GenSigTimeoutTime_TCM" SG_ 2654339160 StayActiveSource_FD16_MCPA 0;
BA_ "GenSigTimeoutTime_AGSM" SG_ 2654339160 WakeupSource_FD05_MCPA 0;
BA_ "GenSigTimeoutTime_BCM" SG_ 2654339160 WakeupSource_FD05_MCPA 0;
BA_ "GenSigTimeoutTime_BSM" SG_ 2654339160 WakeupSource_FD05_MCPA 0;
BA_ "GenSigTimeoutTime_CADM" SG_ 2654339160 WakeupSource_FD05_MCPA 0;
BA_ "GenSigTimeoutTime_DMSM" SG_ 2654339160 WakeupSource_FD05_MCPA 0;
BA_ "GenSigTimeoutTime_DTCM" SG_ 2654339160 WakeupSource_FD05_MCPA 0;
BA_ "GenSigTimeoutTime_ECM" SG_ 2654339160 WakeupSource_FD05_MCPA 0;
BA_ "GenSigTimeoutTime_EVCU2" SG_ 2654339160 WakeupSource_FD05_MCPA 0;
BA_ "GenSigTimeoutTime_GNMM" SG_ 2654339160 WakeupSource_FD05_MCPA 0;
BA_ "GenSigTimeoutTime_HCP" SG_ 2654339160 WakeupSource_FD05_MCPA 0;
BA_ "GenSigTimeoutTime_IPC" SG_ 2654339160 WakeupSource_FD05_MCPA 0;
BA_ "GenSigTimeoutTime_RFHM" SG_ 2654339160 WakeupSource_FD05_MCPA 0;
BA_ "GenSigTimeoutTime_TCM" SG_ 2654339160 WakeupSource_FD05_MCPA 0;
BA_ "GenSigTimeoutTime_AGSM" SG_ 2654339160 WakeupSource_FD16_MCPA 0;
BA_ "GenSigTimeoutTime_BCM" SG_ 2654339160 WakeupSource_FD16_MCPA 0;
BA_ "GenSigTimeoutTime_BSM" SG_ 2654339160 WakeupSource_FD16_MCPA 0;
BA_ "GenSigTimeoutTime_CADM" SG_ 2654339160 WakeupSource_FD16_MCPA 0;
BA_ "GenSigTimeoutTime_DMSM" SG_ 2654339160 WakeupSource_FD16_MCPA 0;
BA_ "GenSigTimeoutTime_DTCM" SG_ 2654339160 WakeupSource_FD16_MCPA 0;
BA_ "GenSigTimeoutTime_ECM" SG_ 2654339160 WakeupSource_FD16_MCPA 0;
BA_ "GenSigTimeoutTime_EVCU2" SG_ 2654339160 WakeupSource_FD16_MCPA 0;
BA_ "GenSigTimeoutTime_GNMM" SG_ 2654339160 WakeupSource_FD16_MCPA 0;
BA_ "GenSigTimeoutTime_HCP" SG_ 2654339160 WakeupSource_FD16_MCPA 0;
BA_ "GenSigTimeoutTime_IPC" SG_ 2654339160 WakeupSource_FD16_MCPA 0;
BA_ "GenSigTimeoutTime_RFHM" SG_ 2654339160 WakeupSource_FD16_MCPA 0;
BA_ "GenSigTimeoutTime_TCM" SG_ 2654339160 WakeupSource_FD16_MCPA 0;
VAL_ 2654339142 CurrentCanNMState_FD05_BPCM 0 "Uninitialized State" 1 "Bus-Sleep State" 2 "Prepare-Bus State" 3 "Ready-Sleep State" 4 "Normal Operation State" 5 "Repeat Message State" 6 "Synchronize State" 7 "Offline State";
VAL_ 2654339142 CurrentCanNMState_FD11_BPCM 0 "Uninitialized State" 1 "Bus-Sleep State" 2 "Prepare-Bus State" 3 "Ready-Sleep State" 4 "Normal Operation State" 5 "Repeat Message State" 6 "Synchronize State" 7 "Offline State";
VAL_ 2654339142 CurrentFailSts_FD05_BPCM 0 "No_Fail_Present" 1 "Fail_Present";
VAL_ 2654339142 CurrentFailSts_FD11_BPCM 0 "No_Fail_Present" 1 "Fail_Present";
VAL_ 2654339142 DES_FD05_BPCM 0 "Error_Active_state" 1 "Error_passive_warning_state" 2 "Bus_off_state" 3 "Not_used";
VAL_ 2654339142 DES_FD11_BPCM 0 "Error_Active_state" 1 "Error_passive_warning_state" 2 "Bus_off_state" 3 "Not_used";
VAL_ 2654339142 EOL_FD05_BPCM 0 "No_EOL_Programming" 1 "EOL_Programming";
VAL_ 2654339142 EOL_FD11_BPCM 0 "No_EOL_Programming" 1 "EOL_Programming";
VAL_ 2654339142 GenericFailSts_FD05_BPCM 0 "No_Fail_Present" 1 "Fail_Present";
VAL_ 2654339142 GenericFailSts_FD11_BPCM 0 "No_Fail_Present" 1 "Fail_Present";
VAL_ 2654339142 PreviousCanNMState_FD05_BPCM 0 "Uninitialized State" 1 "Bus-Sleep State" 2 "Prepare-Bus State" 3 "Ready-Sleep State" 4 "Normal Operation State" 5 "Repeat Message State" 6 "Synchronize State" 7 "Offline State";
VAL_ 2654339142 PreviousCanNMState_FD11_BPCM 0 "Uninitialized State" 1 "Bus-Sleep State" 2 "Prepare-Bus State" 3 "Ready-Sleep State" 4 "Normal Operation State" 5 "Repeat Message State" 6 "Synchronize State" 7 "Offline State";
VAL_ 2654339142 StayActiveSource_FD11_BPCM 0 "CANNM_Ready_Sleep" 1 "IGN_ON" 2 "NonDefault_Diag" 4 "ING_OFF_NormSt_RptSt" 8 "HV_ON";
VAL_ 2654339142 WakeupSource_FD05_BPCM 0 "No_Wakeup";
VAL_ 2654339142 WakeupSource_FD11_BPCM 0 "No_Wakeup";
VAL_ 2654339078 CurrentCanNMState_FD03_BSM 0 "Uninitialized State" 1 "Bus-Sleep State" 2 "Prepare-Bus State" 3 "Ready-Sleep State" 4 "Normal Operation State" 5 "Repeat Message State" 6 "Synchronize State" 7 "Offline State";
VAL_ 2654339078 CurrentFailSts_FD03_BSM 0 "No_Fail_Present" 1 "Fail_Present";
VAL_ 2654339078 DES_FD03_BSM 0 "Error_Active_state" 1 "Error_passive_warning_state" 2 "Bus_off_state" 3 "Not_used";
VAL_ 2654339078 EOL_FD03_BSM 0 "No_EOL_Programming" 1 "EOL_Programming";
VAL_ 2654339078 GenericFailSts_FD03_BSM 0 "No_Fail_Present" 1 "Fail_Present";
VAL_ 2654339078 PreviousCanNMState_FD03_BSM 0 "Uninitialized State" 1 "Bus-Sleep State" 2 "Prepare-Bus State" 3 "Ready-Sleep State" 4 "Normal Operation State" 5 "Repeat Message State" 6 "Synchronize State" 7 "Offline State";
VAL_ 2654339078 StayActiveSource_FD03_BSM 0 "CANNM_Ready_Sleep" 1 "IGN_ON" 2 "NonDefault_Diag" 4 "ING_OFF_NormSt_RptSt" 8 "EPB_Switch_Apply_Release_Request" 10 "Brake_Pedal_Pressed" 20 "Vahicle_is_Moving";
VAL_ 2654339078 WakeupSource_FD03_BSM 0 "No_Wakeup" 1 "IGN_ON" 131 "FD3_Psv_WU" 255 "HW_DIA_WU";
VAL_ 2654339213 CurrentCanNMState_FD03_CADM 0 "Uninitialized State" 1 "Bus-Sleep State" 2 "Prepare-Bus State" 3 "Ready-Sleep State" 4 "Normal Operation State" 5 "Repeat Message State" 6 "Synchronize State" 7 "Offline State";
VAL_ 2654339213 CurrentFailSts_FD03_CADM 0 "No_Fail_Present" 1 "Fail_Present";
VAL_ 2654339213 DES_FD03_CADM 0 "Error_Active_state" 1 "Error_passive_warning_state" 2 "Bus_off_state" 3 "Not_used";
VAL_ 2654339213 EOL_FD03_CADM 0 "No_EOL_Programming" 1 "EOL_Programming";
VAL_ 2654339213 GenericFailSts_FD03_CADM 0 "No_Fail_Present" 1 "Fail_Present";
VAL_ 2654339213 PreviousCanNMState_FD03_CADM 0 "Uninitialized State" 1 "Bus-Sleep State" 2 "Prepare-Bus State" 3 "Ready-Sleep State" 4 "Normal Operation State" 5 "Repeat Message State" 6 "Synchronize State" 7 "Offline State";
VAL_ 2654339213 WakeupSource_FD03_CADM 0 "No_Wakeup";
VAL_ 2654339225 CurrentCanNMState_FD03_DMSM 0 "Uninitialized State" 1 "Bus-Sleep State" 2 "Prepare-Bus State" 3 "Ready-Sleep State" 4 "Normal Operation State" 5 "Repeat Message State" 6 "Synchronize State" 7 "Offline State";
VAL_ 2654339225 CurrentFailSts_FD03_DMSM 0 "No_Fail_Present" 1 "Fail_Present";
VAL_ 2654339225 DES_FD03_DMSM 0 "Error_Active_state" 1 "Error_passive_warning_state" 2 "Bus_off_state" 3 "Not_used";
VAL_ 2654339225 EOL_FD03_DMSM 0 "No_EOL_Programming" 1 "EOL_Programming";
VAL_ 2654339225 GenericFailSts_FD03_DMSM 0 "No_Fail_Present" 1 "Fail_Present";
VAL_ 2654339225 PreviousCanNMState_FD03_DMSM 0 "Uninitialized State" 1 "Bus-Sleep State" 2 "Prepare-Bus State" 3 "Ready-Sleep State" 4 "Normal Operation State" 5 "Repeat Message State" 6 "Synchronize State" 7 "Offline State";
VAL_ 2654339225 WakeupSource_FD03_DMSM 0 "No_Wakeup";
VAL_ 2654339139 CurrentCanNMState_FD03_DTCM 0 "Uninitialized State" 1 "Bus-Sleep State" 2 "Prepare-Bus State" 3 "Ready-Sleep State" 4 "Normal Operation State" 5 "Repeat Message State" 6 "Synchronize State" 7 "Offline State";
VAL_ 2654339139 CurrentFailSts_FD03_DTCM 0 "No_Fail_Present" 1 "Fail_Present";
VAL_ 2654339139 DES_FD03_DTCM 0 "Error_Active_state" 1 "Error_passive_warning_state" 2 "Bus_off_state" 3 "Not_used";
VAL_ 2654339139 EOL_FD03_DTCM 0 "No_EOL_Programming" 1 "EOL_Programming";
VAL_ 2654339139 GenericFailSts_FD03_DTCM 0 "No_Fail_Present" 1 "Fail_Present";
VAL_ 2654339139 PreviousCanNMState_FD03_DTCM 0 "Uninitialized State" 1 "Bus-Sleep State" 2 "Prepare-Bus State" 3 "Ready-Sleep State" 4 "Normal Operation State" 5 "Repeat Message State" 6 "Synchronize State" 7 "Offline State";
VAL_ 2654339139 WakeupSource_FD03_DTCM 0 "No_Wakeup";
VAL_ 2654339073 CurrentCanNMState_FD03_ECM 0 "Uninitialized State" 1 "Bus-Sleep State" 2 "Prepare-Bus State" 3 "Ready-Sleep State" 4 "Normal Operation State" 5 "Repeat Message State" 6 "Synchronize State" 7 "Offline State";
VAL_ 2654339073 CurrentCanNMState_FD05_ECM 0 "Uninitialized State" 1 "Bus-Sleep State" 2 "Prepare-Bus State" 3 "Ready-Sleep State" 4 "Normal Operation State" 5 "Repeat Message State" 6 "Synchronize State" 7 "Offline State";
VAL_ 2654339073 CurrentCanNMState_FD16_ECM 0 "Uninitialized State" 1 "Bus-Sleep State" 2 "Prepare-Bus State" 3 "Ready-Sleep State" 4 "Normal Operation State" 5 "Repeat Message State" 6 "Synchronize State" 7 "Offline State";
VAL_ 2654339073 CurrentFailSts_FD03_ECM 0 "No_Fail_Present" 1 "Fail_Present";
VAL_ 2654339073 CurrentFailSts_FD05_ECM 0 "No_Fail_Present" 1 "Fail_Present";
VAL_ 2654339073 CurrentFailSts_FD16_ECM 0 "No_Fail_Present" 1 "Fail_Present";
VAL_ 2654339073 DES_FD03_ECM 0 "Error_Active_state" 1 "Error_passive_warning_state" 2 "Bus_off_state" 3 "Not_used";
VAL_ 2654339073 DES_FD05_ECM 0 "Error_Active_state" 1 "Error_passive_warning_state" 2 "Bus_off_state" 3 "Not_used";
VAL_ 2654339073 DES_FD16_ECM 0 "Error_Active_state" 1 "Error_passive_warning_state" 2 "Bus_off_state" 3 "Not_used";
VAL_ 2654339073 EOL_FD03_ECM 0 "No_EOL_Programming" 1 "EOL_Programming";
VAL_ 2654339073 EOL_FD05_ECM 0 "No_EOL_Programming" 1 "EOL_Programming";
VAL_ 2654339073 EOL_FD16_ECM 0 "No_EOL_Programming" 1 "EOL_Programming";
VAL_ 2654339073 GenericFailSts_FD03_ECM 0 "No_Fail_Present" 1 "Fail_Present";
VAL_ 2654339073 GenericFailSts_FD05_ECM 0 "No_Fail_Present" 1 "Fail_Present";
VAL_ 2654339073 GenericFailSts_FD16_ECM 0 "No_Fail_Present" 1 "Fail_Present";
VAL_ 2654339073 PreviousCanNMState_FD03_ECM 0 "Uninitialized State" 1 "Bus-Sleep State" 2 "Prepare-Bus State" 3 "Ready-Sleep State" 4 "Normal Operation State" 5 "Repeat Message State" 6 "Synchronize State" 7 "Offline State";
VAL_ 2654339073 PreviousCanNMState_FD05_ECM 0 "Uninitialized State" 1 "Bus-Sleep State" 2 "Prepare-Bus State" 3 "Ready-Sleep State" 4 "Normal Operation State" 5 "Repeat Message State" 6 "Synchronize State" 7 "Offline State";
VAL_ 2654339073 PreviousCanNMState_FD16_ECM 0 "Uninitialized State" 1 "Bus-Sleep State" 2 "Prepare-Bus State" 3 "Ready-Sleep State" 4 "Normal Operation State" 5 "Repeat Message State" 6 "Synchronize State" 7 "Offline State";
VAL_ 2654339073 WakeupSource_FD03_ECM 0 "No_Wakeup";
VAL_ 2654339073 WakeupSource_FD05_ECM 0 "No_Wakeup";
VAL_ 2654339073 WakeupSource_FD16_ECM 0 "No_Wakeup";
VAL_ 2654339108 CurrentCanNMState_FD08_ETM 0 "Uninitialized State" 1 "Bus-Sleep State" 2 "Prepare-Bus State" 3 "Ready-Sleep State" 4 "Normal Operation State" 5 "Repeat Message State" 6 "Synchronize State" 7 "Offline State";
VAL_ 2654339108 CurrentFailSts_FD08_ETM 0 "No_Fail_Present" 1 "Fail_Present";
VAL_ 2654339108 DES_FD08_ETM 0 "Error_Active_state" 1 "Error_passive_warning_state" 2 "Bus_off_state" 3 "Not_used";
VAL_ 2654339108 EOL_FD08_ETM 0 "No_EOL_Programming" 1 "EOL_Programming";
VAL_ 2654339108 GenericFailSts_FD08_ETM 0 "No_Fail_Present" 1 "Fail_Present";
VAL_ 2654339108 PreviousCanNMState_FD08_ETM 0 "Uninitialized State" 1 "Bus-Sleep State" 2 "Prepare-Bus State" 3 "Ready-Sleep State" 4 "Normal Operation State" 5 "Repeat Message State" 6 "Synchronize State" 7 "Offline State";
VAL_ 2654339108 StayActiveSource_FD08_ETM 0 "CANNM_Ready_Sleep" 1 "IGN_ON" 2 "NonDefault_Diag" 4 "ING_OFF_NormSt_RptSt";
VAL_ 2654339108 WakeupSource_FD08_ETM 0 "No_Wakeup" 1 "IGN_ON" 129 "FD1_Psv_WU" 130 "FD2_Psv_WU" 131 "FD3_Psv_WU" 132 "FD4_Psv_WU" 133 "FD5_Psv_WU" 134 "FD6_Psv_WU" 135 "FD7_Psv_WU" 136 "FD8_Psv_WU" 137 "FD9_Psv_WU" 138 "FD10_Psv_WU" 139 "FD11_Psv_WU" 140 "FD12_Psv_WU" 141 "FD13_Psv_WU" 142 "FD14_Psv_WU" 143 "FD15_Psv_WU" 144 "FD16_Psv_WU" 145 "FD17_Psv_WU" 146 "FD18_Psv_WU" 147 "FD19_Psv_WU" 148 "FD20_Psv_WU" 149 "FD21_Psv_WU" 150 "FD22_Psv_WU" 151 "FD23_Psv_WU" 152 "FD24_Psv_WU" 153 "FD25_Psv_WU" 154 "FD26_Psv_WU" 155 "FD27_Psv_WU" 156 "FD28_Psv_WU" 157 "FD29_Psv_WU" 158 "BHCAN_Psv_WU" 159 "CCAN_Psv_WU";
VAL_ 2654339136 CurrentCanNMState_FD03_EVCU2 0 "Uninitialized State" 1 "Bus-Sleep State" 2 "Prepare-Bus State" 3 "Ready-Sleep State" 4 "Normal Operation State" 5 "Repeat Message State" 6 "Synchronize State" 7 "Offline State";
VAL_ 2654339136 CurrentCanNMState_FD11_EVCU2 0 "Uninitialized State" 1 "Bus-Sleep State" 2 "Prepare-Bus State" 3 "Ready-Sleep State" 4 "Normal Operation State" 5 "Repeat Message State" 6 "Synchronize State" 7 "Offline State";
VAL_ 2654339136 CurrentCanNMState_FD16_EVCU2 0 "Uninitialized State" 1 "Bus-Sleep State" 2 "Prepare-Bus State" 3 "Ready-Sleep State" 4 "Normal Operation State" 5 "Repeat Message State" 6 "Synchronize State" 7 "Offline State";
VAL_ 2654339136 CurrentFailSts_FD03_EVCU2 0 "No_Fail_Present" 1 "Fail_Present";
VAL_ 2654339136 CurrentFailSts_FD11_EVCU2 0 "No_Fail_Present" 1 "Fail_Present";
VAL_ 2654339136 CurrentFailSts_FD16_EVCU2 0 "No_Fail_Present" 1 "Fail_Present";
VAL_ 2654339136 DES_FD03_EVCU2 0 "Error_Active_state" 1 "Error_passive_warning_state" 2 "Bus_off_state" 3 "Not_used";
VAL_ 2654339136 DES_FD11_EVCU2 0 "Error_Active_state" 1 "Error_passive_warning_state" 2 "Bus_off_state" 3 "Not_used";
VAL_ 2654339136 DES_FD16_EVCU2 0 "Error_Active_state" 1 "Error_passive_warning_state" 2 "Bus_off_state" 3 "Not_used";
VAL_ 2654339136 EOL_FD03_EVCU2 0 "No_EOL_Programming" 1 "EOL_Programming";
VAL_ 2654339136 EOL_FD11_EVCU2 0 "No_EOL_Programming" 1 "EOL_Programming";
VAL_ 2654339136 EOL_FD16_EVCU2 0 "No_EOL_Programming" 1 "EOL_Programming";
VAL_ 2654339136 GenericFailSts_FD03_EVCU2 0 "No_Fail_Present" 1 "Fail_Present";
VAL_ 2654339136 GenericFailSts_FD11_EVCU2 0 "No_Fail_Present" 1 "Fail_Present";
VAL_ 2654339136 GenericFailSts_FD16_EVCU2 0 "No_Fail_Present" 1 "Fail_Present";
VAL_ 2654339136 PreviousCanNMState_FD03_EVCU2 0 "Uninitialized State" 1 "Bus-Sleep State" 2 "Prepare-Bus State" 3 "Ready-Sleep State" 4 "Normal Operation State" 5 "Repeat Message State" 6 "Synchronize State" 7 "Offline State";
VAL_ 2654339136 PreviousCanNMState_FD11_EVCU2 0 "Uninitialized State" 1 "Bus-Sleep State" 2 "Prepare-Bus State" 3 "Ready-Sleep State" 4 "Normal Operation State" 5 "Repeat Message State" 6 "Synchronize State" 7 "Offline State";
VAL_ 2654339136 PreviousCanNMState_FD16_EVCU2 0 "Uninitialized State" 1 "Bus-Sleep State" 2 "Prepare-Bus State" 3 "Ready-Sleep State" 4 "Normal Operation State" 5 "Repeat Message State" 6 "Synchronize State" 7 "Offline State";
VAL_ 2654339136 StayActiveSource_FD11_EVCU2 0 "None" 1 "Ignition_Active" 2 "CmdIgnSts_LK_to_ACC_RUN_START" 4 "HazardSwitch_ON" 8 "DrvDoorAjar" 16 "DrvDoor2Ajar" 32 "PsngrDoorAjar" 64 "LR_DoorAjar" 128 "RR_DoorAjar" 256 "TrunkAjar" 512 "BonnetAjar" 1024 "RAPHandle_Req" 2048 "MainLightSelector_Req_OFF" 4096 "HiBmLvr_Stat_HIBM_FLASH_ON_PSD" 8192 "LowBeamSts_SET" 16384 "ParkingLightSts_SET" 32768 "FlashToPass_SET" 65536 "RemStActvSts_Active" 131072 "Fuel_Door_Release_Switch" 262144 "ENGINE_FD_8_RefuelEvent_Pending" 524288 "OHC_1_Front_Int_LG_Sw_1" 1048576 "HFRM_1_RearKick" 2097152 "LeakCheckTimerExpired" 4194304 "Horn_Req_Not_Pressed_to_Pressed" 8388608 "Comfort_Enable_Time_not_0" 16777216 "CmdIgnSts_ACC_RUN_START" 33554432 "ENGINE_FD_8_LeakTestSts_1" 67108864 "Non_Default_Diagnostic_Session" 134217728 "RL_Lk_Sw_LK_RQ_or_UNLK_RQ" 268435456 "RR_Lk_Sw_LK_RQ_or_UNLK_RQ" 536870912 "FD_CAN1" 1073741824 "FD_CAN2" 2147483648 "FD_CAN3" 4294967296 "FD_CAN4" 8589934592 "BH_CAN" 17179869184 "C_CAN1" 34359738368 "EVAP_SWC" 68719476736 "FUEL_DR_REL_SWC" 137438953472 "Other_Software_Factory_Component";
VAL_ 2654339136 WakeupSource_FD03_EVCU2 0 "No_Wakeup";
VAL_ 2654339136 WakeupSource_FD11_EVCU2 0 "None" 1 "Ignition_Active" 2 "CmdIgnSts_LK_to_ACC_RUN_START" 3 "HazardSwitch_ON" 4 "DrvDoorAjar" 5 "DrvDoor2Ajar" 6 "PsngrDoorAjar" 7 "LR_DoorAjar" 8 "RR_DoorAjar" 9 "TrunkAjar" 10 "BonnetAjar" 11 "RAPHandle_Req" 12 "MainLightSelector_Req_OFF" 13 "HiBmLvr_Stat_HIBM_FLASH_ON_PSD" 14 "LowBeamSts_SET" 15 "ParkingLightSts_SET" 16 "FlashToPass_SET" 17 "RemStActvSts_Active" 18 "Fuel_Door_Release_Switch" 19 "ENGINE_FD_8_RefuelEvent_Pending" 20 "OHC_1_Front_Int_LG_Sw_1" 21 "HFRM_1_RearKick" 22 "LeakCheckTimerExpired" 23 "Horn_Req_Not Pressed_to_Pressed" 24 "Comfort_Enable_Time_not_0" 25 "CmdIgnSts_ACC_RUN_START" 26 "ENGINE_FD_8_LeakTestSts_1" 27 "Non_Default_Diagnostic_Session" 28 "RL_Lk_Sw_LK_RQ_or_UNLK_RQ" 29 "RR_Lk_Sw_LK_RQ_or_UNLK_RQ" 30 "FD-CAN1" 31 "FD-CAN2" 32 "FD-CAN3" 33 "FD-CAN4" 34 "BH-CAN" 35 "C-CAN1" 36 "EVAP_SWC" 37 "FUEL_DR_REL_SWC" 38 "Other_Software_Factory_Component" 39 "OHC_1_Front_Map_LGT_RT_Sw" 40 "OHC_1_Front_Map_LGT_LT_Sw" 41 "Fog_Lights_Signal " 42 "DOME_ON_OR_DOME_DEFEAT " 43 "Screen_Open_Close_is_pressed" 44 "Diagnostic_Message_Routing_DMR" 45 "Reserved" 46 "Reserved" 47 "Reserved" 48 "Reserved" 49 "Reserved" 50 "Reserved" 51 "Reserved" 52 "Reserved" 53 "Reserved" 54 "Reserved" 55 "Reserved" 56 "Reserved" 57 "Reserved" 58 "Reserved" 59 "Reserved" 60 "Reserved" 61 "Reserved" 62 "Reserved" 63 "Reserved" 64 "Reserved" 65 "Reserved" 66 "Reserved" 67 "Reserved" 68 "Reserved" 69 "Reserved" 70 "Reserved" 71 "Reserved" 72 "Reserved" 73 "Reserved" 74 "Reserved" 75 "Reserved" 76 "Reserved" 77 "Reserved" 78 "Reserved" 79 "Reserved" 80 "Reserved" 81 "Reserved" 82 "Reserved" 83 "Reserved" 84 "Reserved" 85 "Reserved" 86 "Reserved" 87 "Reserved" 88 "Reserved" 89 "Reserved" 90 "Reserved" 91 "Reserved" 92 "Reserved" 93 "Reserved" 94 "Reserved" 95 "Reserved" 96 "Reserved" 97 "Reserved" 98 "Reserved" 99 "Reserved" 100 "Reserved" 101 "Reserved" 102 "Reserved" 103 "Reserved" 104 "Reserved" 105 "Reserved" 106 "Reserved" 107 "Reserved" 108 "Reserved" 109 "Reserved" 110 "Reserved" 111 "Reserved" 112 "Reserved" 113 "Reserved" 114 "Reserved" 115 "Reserved" 116 "Reserved" 117 "Reserved" 118 "Reserved" 119 "Reserved" 120 "Reserved" 121 "Reserved" 122 "Reserved" 123 "Reserved" 124 "Reserved" 125 "Reserved" 126 "Reserved" 127 "Reserved" 128 "Reserved" 129 "FD_CAN1" 130 "FD_CAN2" 131 "FD_CAN3" 132 "FD_CAN4" 133 "FD_CAN5" 134 "FD_CAN6" 135 "FD_CAN7" 136 "FD_CAN8" 137 "FD_CAN9" 138 "FD_CAN10" 139 "FD_CAN11" 140 "FD_CAN12" 141 "FD_CAN13" 142 "FD_CAN14" 143 "FD_CAN15" 144 "FD_CAN16" 145 "FD_CAN17" 146 "FD_CAN18" 147 "FD_CAN19" 148 "FD_CAN20" 149 "FD_CAN21" 150 "FD_CAN22" 151 "FD_CAN23" 152 "FD_CAN24" 153 "FD_CAN25" 154 "FD_CAN26" 155 "FD_CAN27" 156 "FD_CAN28" 157 "FD_CAN29" 158 "FD_CAN30" 159 "FD_CAN31" 160 "BH-CAN" 161 "BH-CAN1" 162 "BH-CAN2" 163 "C-CAN" 164 "C-CAN1" 165 "Reserved" 166 "Reserved" 167 "Reserved" 168 "Reserved" 169 "Reserved" 170 "Reserved" 171 "Reserved" 172 "Reserved" 173 "Reserved" 174 "Reserved" 175 "Reserved" 176 "Reserved" 177 "Reserved" 178 "Reserved" 179 "Reserved" 180 "Reserved" 181 "Reserved" 182 "Reserved" 183 "Reserved" 184 "Reserved" 185 "Reserved" 186 "Reserved" 187 "Reserved" 188 "Reserved" 189 "Reserved" 190 "Reserved" 191 "Reserved" 192 "Reserved" 193 "Reserved" 194 "Reserved" 195 "Reserved" 196 "Reserved" 197 "Reserved" 198 "Reserved" 199 "Reserved" 200 "Reserved" 201 "Reserved" 202 "Reserved" 203 "Reserved" 204 "Reserved" 205 "Reserved" 206 "Reserved" 207 "Reserved" 208 "Reserved" 209 "Reserved" 210 "Reserved" 211 "Reserved" 212 "Reserved" 213 "Reserved" 214 "Reserved" 215 "Reserved" 216 "Reserved" 217 "Reserved" 218 "Reserved" 219 "Reserved" 220 "Reserved" 221 "Reserved" 222 "Reserved" 223 "Reserved" 224 "Reserved" 225 "Reserved" 226 "Reserved" 227 "Reserved" 228 "Reserved" 229 "Reserved" 230 "Reserved" 231 "Reserved" 232 "Reserved" 233 "Reserved" 234 "Reserved" 235 "Reserved" 236 "Reserved" 237 "Reserved" 238 "Reserved" 239 "Reserved" 240 "Reserved" 241 "Reserved" 242 "Reserved" 243 "Reserved" 244 "Reserved" 245 "Reserved" 246 "Reserved" 247 "Reserved" 248 "Reserved" 249 "Reserved" 250 "Reserved" 251 "Reserved" 252 "Reserved" 253 "Reserved" 254 "Reserved" 255 "Reserved";
VAL_ 2654339136 WakeupSource_FD16_EVCU2 0 "No_Wakeup";
VAL_ 2654339216 CurrentCanNMState_FD03_GNMM 0 "Uninitialized State" 1 "Bus-Sleep State" 2 "Prepare-Bus State" 3 "Ready-Sleep State" 4 "Normal Operation State" 5 "Repeat Message State" 6 "Synchronize State" 7 "Offline State";
VAL_ 2654339216 CurrentFailSts_FD03_GNMM 0 "No_Fail_Present" 1 "Fail_Present";
VAL_ 2654339216 DES_FD03_GNMM 0 "Error_Active_state" 1 "Error_passive_warning_state" 2 "Bus_off_state" 3 "Not_used";
VAL_ 2654339216 EOL_FD03_GNMM 0 "No_EOL_Programming" 1 "EOL_Programming";
VAL_ 2654339216 GenericFailSts_FD03_GNMM 0 "No_Fail_Present" 1 "Fail_Present";
VAL_ 2654339216 PreviousCanNMState_FD03_GNMM 0 "Uninitialized State" 1 "Bus-Sleep State" 2 "Prepare-Bus State" 3 "Ready-Sleep State" 4 "Normal Operation State" 5 "Repeat Message State" 6 "Synchronize State" 7 "Offline State";
VAL_ 2654339216 StayActiveSource_FD03_GNMM 0 "CANNM_Ready_Sleep" 1 "IGN_ON" 2 "NonDefault_Diag" 4 "ING_OFF_NormSt_RptSt";
VAL_ 2654339216 WakeupSource_FD03_GNMM 0 "No_Wakeup" 1 "IGN_ON" 129 "FD1_Psv_WU" 130 "FD2_Psv_WU" 131 "FD3_Psv_WU" 132 "FD4_Psv_WU" 133 "FD5_Psv_WU" 134 "FD6_Psv_WU" 135 "FD7_Psv_WU" 136 "FD8_Psv_WU" 137 "FD9_Psv_WU" 138 "FD10_Psv_WU" 139 "FD11_Psv_WU" 140 "FD12_Psv_WU" 141 "FD13_Psv_WU" 142 "FD14_Psv_WU" 143 "FD15_Psv_WU" 144 "FD16_Psv_WU" 145 "FD17_Psv_WU" 146 "FD18_Psv_WU" 147 "FD19_Psv_WU" 148 "FD20_Psv_WU" 149 "FD21_Psv_WU" 150 "FD22_Psv_WU" 151 "FD23_Psv_WU" 152 "FD24_Psv_WU" 153 "FD25_Psv_WU" 154 "FD26_Psv_WU" 155 "FD27_Psv_WU" 156 "FD28_Psv_WU" 157 "FD29_Psv_WU" 158 "BHCAN_Psv_WU" 159 "CCAN_Psv_WU";
VAL_ 2654339170 CurrentCanNMState_FD03_HCP 0 "Uninitialized State" 1 "Bus-Sleep State" 2 "Prepare-Bus State" 3 "Ready-Sleep State" 4 "Normal Operation State" 5 "Repeat Message State" 6 "Synchronize State" 7 "Offline State";
VAL_ 2654339170 CurrentFailSts_FD03_HCP 0 "No_Fail_Present" 1 "Fail_Present";
VAL_ 2654339170 DES_FD03_HCP 0 "Error_Active_state" 1 "Error_passive_warning_state" 2 "Bus_off_state" 3 "Not_used";
VAL_ 2654339170 EOL_FD03_HCP 0 "No_EOL_Programming" 1 "EOL_Programming";
VAL_ 2654339170 GenericFailSts_FD03_HCP 0 "No_Fail_Present" 1 "Fail_Present";
VAL_ 2654339170 PreviousCanNMState_FD03_HCP 0 "Uninitialized State" 1 "Bus-Sleep State" 2 "Prepare-Bus State" 3 "Ready-Sleep State" 4 "Normal Operation State" 5 "Repeat Message State" 6 "Synchronize State" 7 "Offline State";
VAL_ 2654339170 WakeupSource_FD03_HCP 0 "No_Wakeup";
VAL_ 2654339197 CurrentCanNMState_FD11_IDCM 0 "Uninitialized State" 1 "Bus-Sleep State" 2 "Prepare-Bus State" 3 "Ready-Sleep State" 4 "Normal Operation State" 5 "Repeat Message State" 6 "Synchronize State" 7 "Offline State";
VAL_ 2654339197 CurrentFailSts_FD11_IDCM 0 "No_Fail_Present" 1 "Fail_Present";
VAL_ 2654339197 DES_FD11_IDCM 0 "Error_Active_state" 1 "Error_passive_warning_state" 2 "Bus_off_state" 3 "Not_used";
VAL_ 2654339197 EOL_FD11_IDCM 0 "No_EOL_Programming" 1 "EOL_Programming";
VAL_ 2654339197 GenericFailSts_FD11_IDCM 0 "No_Fail_Present" 1 "Fail_Present";
VAL_ 2654339197 PreviousCanNMState_FD11_IDCM 0 "Uninitialized State" 1 "Bus-Sleep State" 2 "Prepare-Bus State" 3 "Ready-Sleep State" 4 "Normal Operation State" 5 "Repeat Message State" 6 "Synchronize State" 7 "Offline State";
VAL_ 2654339197 WakeupSource_FD11_IDCM 0 "No_Wakeup";
VAL_ 2654339075 CurrentCanNMState_FD03_IPC 0 "Uninitialized State" 1 "Bus-Sleep State" 2 "Prepare-Bus State" 3 "Ready-Sleep State" 4 "Normal Operation State" 5 "Repeat Message State" 6 "Synchronize State" 7 "Offline State";
VAL_ 2654339075 CurrentFailSts_FD03_IPC 0 "No_Fail_Present" 1 "Fail_Present";
VAL_ 2654339075 DES_FD03_IPC 0 "Error_Active_state" 1 "Error_passive_warning_state" 2 "Bus_off_state" 3 "Not_used";
VAL_ 2654339075 EOL_FD03_IPC 0 "No_EOL_Programming" 1 "EOL_Programming";
VAL_ 2654339075 GenericFailSts_FD03_IPC 0 "No_Fail_Present" 1 "Fail_Present";
VAL_ 2654339075 PreviousCanNMState_FD03_IPC 0 "Uninitialized State" 1 "Bus-Sleep State" 2 "Prepare-Bus State" 3 "Ready-Sleep State" 4 "Normal Operation State" 5 "Repeat Message State" 6 "Synchronize State" 7 "Offline State";
VAL_ 2654339075 WakeupSource_FD03_IPC 0 "No_Wakeup";
VAL_ 2654339160 CurrentCanNMState_FD05_MCPA 0 "Uninitialized State" 1 "Bus-Sleep State" 2 "Prepare-Bus State" 3 "Ready-Sleep State" 4 "Normal Operation State" 5 "Repeat Message State" 6 "Synchronize State" 7 "Offline State";
VAL_ 2654339160 CurrentCanNMState_FD16_MCPA 0 "Uninitialized State" 1 "Bus-Sleep State" 2 "Prepare-Bus State" 3 "Ready-Sleep State" 4 "Normal Operation State" 5 "Repeat Message State" 6 "Synchronize State" 7 "Offline State";
VAL_ 2654339160 CurrentFailSts_FD05_MCPA 0 "No_Fail_Present" 1 "Fail_Present";
VAL_ 2654339160 CurrentFailSts_FD16_MCPA 0 "No_Fail_Present" 1 "Fail_Present";
VAL_ 2654339160 DES_FD05_MCPA 0 "Error_Active_state" 1 "Error_passive_warning_state" 2 "Bus_off_state" 3 "Not_used";
VAL_ 2654339160 DES_FD16_MCPA 0 "Error_Active_state" 1 "Error_passive_warning_state" 2 "Bus_off_state" 3 "Not_used";
VAL_ 2654339160 EOL_FD05_MCPA 0 "No_EOL_Programming" 1 "EOL_Programming";
VAL_ 2654339160 EOL_FD16_MCPA 0 "No_EOL_Programming" 1 "EOL_Programming";
VAL_ 2654339160 GenericFailSts_FD05_MCPA 0 "No_Fail_Present" 1 "Fail_Present";
VAL_ 2654339160 GenericFailSts_FD16_MCPA 0 "No_Fail_Present" 1 "Fail_Present";
VAL_ 2654339160 PreviousCanNMState_FD05_MCPA 0 "Uninitialized State" 1 "Bus-Sleep State" 2 "Prepare-Bus State" 3 "Ready-Sleep State" 4 "Normal Operation State" 5 "Repeat Message State" 6 "Synchronize State" 7 "Offline State";
VAL_ 2654339160 PreviousCanNMState_FD16_MCPA 0 "Uninitialized State" 1 "Bus-Sleep State" 2 "Prepare-Bus State" 3 "Ready-Sleep State" 4 "Normal Operation State" 5 "Repeat Message State" 6 "Synchronize State" 7 "Offline State";
VAL_ 2654339160 WakeupSource_FD05_MCPA 0 "No_Wakeup";
VAL_ 2654339160 WakeupSource_FD16_MCPA 0 "No_Wakeup";
