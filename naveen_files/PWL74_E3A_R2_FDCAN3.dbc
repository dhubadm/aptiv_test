VERSION ""

NS_ :

BS_:

BU_: AGSM BCM BSM CADM DMSM DTCM ECM EVCU2 GNMM HCP IPC RFHM SGW TCM
BO_ 1435 BCM_FD_26: 32 BCM
 SG_ ACV_FailType : 165|3@0+ (1,0) [0|7] "" SGW
 SG_ ACV_Status : 167|2@0+ (1,0) [0|3] "" SGW
 SG_ AHP_EnblReq : 127|2@0+ (1,0) [0|2] "" EVCU2
 SG_ BSD_FAIL_D : 149|1@0+ (1,0) [0|1] "" CADM
 SG_ BSD_FAIL_P : 148|1@0+ (1,0) [0|1] "" CADM
 SG_ CRC_BCM26 : 191|8@0+ (1,0) [0|255] "-" CADM,IPC
 SG_ DEFROST_SEL : 23|1@0+ (1,0) [0|1] "" EVCU2
 SG_ DRV_TEMP_DR_POS : 22|7@0+ (1,0) [0|100] "%" EVCU2
 SG_ ESC_Mode_Req : 154|3@0+ (1,0) [0|7] "" BSM
 SG_ EvapTempTar : 7|8@0+ (0.5,-20) [-20|107] "°C" EVCU2
 SG_ FLTurnLampFault : 138|1@0+ (1,0) [0|1] "" CADM,IPC
 SG_ FrontFogLightFault : 155|1@0+ (1,0) [0|1] "" IPC
 SG_ FrontFogPressed : 120|1@0+ (1,0) [0|1] "" CADM
 SG_ FRTurnLampFault : 137|1@0+ (1,0) [0|1] "" CADM,IPC
 SG_ HAS_OnOffSts : 122|1@0+ (1,0) [0|1] "" CADM
 SG_ HazardSwitchPressed : 128|1@0+ (1,0) [0|1] "" CADM,SGW
 SG_ HLSPosition : 143|3@0+ (1,0) [0|6] "" CADM,IPC
 SG_ HtrCorTmp_InTgt : 15|8@0+ (1,-40) [-40|214] "°C" EVCU2
 SG_ HVAC_Blwr_Perct : 87|7@0+ (1,0) [0|100] "%" EVCU2
 SG_ HVAC_CLNT_FLW_MIN : 47|8@0+ (0.52155,0) [0|132.4737] "LpM" ECM
 SG_ L_TurnCluster : 140|1@0+ (1,0) [0|1] "" IPC
 SG_ LKA_RequestSts : 121|1@0+ (1,0) [0|1] "" CADM
 SG_ MessageCounter_BCM26 : 179|4@0+ (1,0) [0|15] "-" CADM,IPC
 SG_ Paddles_DrvMd_CfgSts_TMI : 105|2@0+ (1,0) [0|2] "" Vector__XXX
 SG_ PADL_MODE_CFG_STAT : 135|2@0+ (1,0) [0|0] "" Vector__XXX
 SG_ PAS_TEMP_DR_POS : 63|7@0+ (1,0) [0|100] "%" EVCU2
 SG_ PssgrScreenOn_Off_RequestSts : 147|1@0+ (1,0) [0|1] "" SGW
 SG_ R_TurnCluster : 139|1@0+ (1,0) [0|1] "" IPC
 SG_ RearFogPressed : 129|1@0+ (1,0) [0|1] "" CADM
 SG_ RLTurnLampFault : 136|1@0+ (1,0) [0|1] "" CADM,IPC,SGW
 SG_ RRTurnLampFault : 151|1@0+ (1,0) [0|1] "" CADM,IPC,SGW
 SG_ VEH_INT_TEMP : 31|16@0+ (0.01,-40) [-40|85] "°C" EVCU2

BO_ 1436 BCM_FD_27: 32 BCM
 SG_ ATMM_PopUpRqst : 123|2@0+ (1,0) [0|2] "" IPC
 SG_ Blower_Diagnostics : 121|10@0+ (0.1,0) [0|100] "%" ECM
 SG_ Blower_Speed : 136|9@0+ (1,0) [0|350] "Hz" ECM,HCP
 SG_ Comfort_Enable_Act : 5|1@0+ (1,0) [0|0] "" IPC,SGW
 SG_ Comfort_Enable_Time : 55|16@0+ (1,0) [0|65534] "sec" SGW
 SG_ COMM_Fault : 75|1@0+ (1,0) [0|1] "" IPC
 SG_ CRC_BCM27 : 191|8@0+ (1,0) [0|255] "-" BSM,CADM,IPC
 SG_ DAY_LGT_MD_DISP : 7|1@0+ (1,0) [0|0] "" AGSM,IPC,SGW
 SG_ E_Call_Button : 85|2@0+ (1,0) [0|3] "" SGW
 SG_ EBL_Stat : 87|2@0+ (1,0) [0|2] "" SGW
 SG_ Internal_Fault : 74|1@0+ (1,0) [0|1] "" IPC
 SG_ Mem_D_Pos_Rq : 119|2@0+ (1,0) [0|3] "" IPC
 SG_ Mem_D_Rc_Rq : 117|1@0+ (1,0) [0|1] "" IPC
 SG_ Mem_D_Sv_Rq : 116|1@0+ (1,0) [0|1] "" IPC
 SG_ MEM_RC_STAT : 125|2@0+ (1,0) [0|3] "" IPC
 SG_ MessageCounter_BCM27 : 179|4@0+ (1,0) [0|15] "-" BSM,CADM,IPC
 SG_ MOOD_LGT_INTS : 47|8@0+ (0.5,0) [0|100] "%" SGW
 SG_ PANEL_INTS_DISP : 15|8@0+ (0.5,0) [0|100] "%" AGSM,IPC,SGW
 SG_ TrailerConnectionSts : 106|2@0+ (1,0) [0|3] "" BSM,CADM,EVCU2,IPC,SGW
 SG_ TrailerGenericFailSts : 108|1@0+ (1,0) [0|1] "" IPC
 SG_ TrailerLHParkingLightFailSts : 99|1@0+ (1,0) [0|1] "" IPC
 SG_ TrailerLHTurnSignalFailSts : 98|1@0+ (1,0) [0|1] "" IPC
 SG_ TrailerRHParkingLightFailSts : 97|1@0+ (1,0) [0|1] "" IPC
 SG_ TrailerRHTurnSignalFailSts : 96|1@0+ (1,0) [0|1] "" IPC
 SG_ Turn_Lever_Unlatch_Resp : 25|2@0+ (1,0) [0|2] "-" CADM
 SG_ U_Call_Button : 83|2@0+ (1,0) [0|3] "" SGW

BO_ 1470 BCM_FD_29: 32 BCM
 SG_ CRC_BCM29 : 191|8@0+ (1,0) [0|255] "-" CADM,IPC
 SG_ DriverReclineRelativePosition : 103|8@0+ (1,-100) [-100|100] "%" CADM
 SG_ DriverSeatHorizontalButton : 183|2@0+ (1,0) [0|2] "" CADM
 SG_ DriverSeatReclinerButton : 181|2@0+ (1,0) [0|2] "" CADM
 SG_ DriverSeatRelativePosition : 95|8@0+ (1,-100) [-100|100] "%" CADM
 SG_ ITBM_BRK_SW : 62|2@0+ (1,0) [0|3] "" CADM,IPC
 SG_ ITBM_BrkStyle : 54|2@0+ (1,0) [0|0] "" IPC,SGW
 SG_ ITBM_CHM_RQ : 55|1@0+ (1,0) [0|0] "" IPC
 SG_ ITBM_DSP_RQ : 83|4@0+ (1,0) [0|0] "" IPC
 SG_ ITBM_GAIN_STAT : 36|5@0+ (0.5,0) [0|10] "" IPC,SGW
 SG_ ITBM_OP_PWR : 31|8@0+ (0.5,0) [0|100] "%" IPC,SGW
 SG_ ITBM_TrlrStat : 46|2@0+ (1,0) [0|3] "" CADM,IPC,SGW
 SG_ ITBM_WarnRq : 47|1@0+ (1,0) [0|0] "" IPC
 SG_ MessageCounter_BCM29 : 179|4@0+ (1,0) [0|15] "-" CADM,IPC
 SG_ SeatPosHAS : 70|2@0+ (1,0) [0|3] "" CADM
 SG_ SelTrlrNum : 39|3@0+ (1,0) [0|0] "" IPC,SGW
 SG_ SelTrlrStyle : 44|5@0+ (1,0) [0|0] "" IPC,SGW
 SG_ Trailer_Light_Check_Status : 79|2@0+ (1,0) [0|3] "" SGW
 SG_ TrlrStyle_1 : 52|5@0+ (1,0) [0|0] "" IPC,SGW
 SG_ TrlrStyle_2 : 60|5@0+ (1,0) [0|0] "" IPC,SGW
 SG_ TrlrStyle_3 : 68|5@0+ (1,0) [0|0] "" IPC,SGW
 SG_ TrlrStyle_4 : 76|5@0+ (1,0) [0|0] "" IPC,SGW
 SG_ TrlrTripDist : 7|24@0+ (0.1,0) [0|1677720] "km" IPC,SGW
 SG_ UCONREQ_TBM_TrailerLightCheck_FB : 87|2@0+ (1,0) [0|3] "" SGW

BO_ 750 BCM_FD_3: 32 BCM
 SG_ Battery_Volt_1 : 56|9@0+ (0.025,5) [5|17.75] "Volt" AGSM,BSM,CADM,DMSM,DTCM,ECM,EVCU2,GNMM,HCP,IPC,RFHM,SGW,TCM
 SG_ Battery_Volt_2 : 49|9@0+ (0.025,5) [5|17.75] "Volt" BSM,ECM,EVCU2,SGW
 SG_ CRC_BCM3 : 191|8@0+ (1,0) [0|255] "-" BSM,CADM,DMSM,TCM
 SG_ FronWiperFailSts : 7|1@0+ (1,0) [0|1] "" CADM,DTCM
 SG_ MessageCounter_BCM3 : 179|4@0+ (1,0) [0|15] "-" BSM,CADM,DMSM,TCM

BO_ 1051 BCM_FD_4: 32 BCM
 SG_ AM_ECM_Trace : 71|2@0+ (1,0) [0|2] "-" ECM
 SG_ BCMSAMFailSts : 183|1@0+ (1,0) [0|1] "-" ECM
 SG_ CRC_BCM4 : 191|8@0+ (1,0) [0|255] "-" ECM,EVCU2
 SG_ EVAP_TEMP_P1C : 18|11@0+ (0.1,-40) [-40|85] "°C" EVCU2
 SG_ ExternalTemperatureAD_Voltage : 159|8@0+ (0.019607843,0) [0|4.98] "Volt" ECM,EVCU2,HCP
 SG_ FUEL_VOLT : 143|8@0+ (0.019607843,0) [0|4.98] "Volt" ECM
 SG_ MessageCounter_BCM4 : 179|4@0+ (1,0) [0|15] "-" ECM,EVCU2
 SG_ PitchAngle : 167|8@0+ (1,-90) [-90|165] "°" IPC,SGW
 SG_ RollAngle : 175|8@0+ (1,-90) [-90|165] "°" IPC,SGW
 SG_ VoltageMax : 127|8@0+ (0.025,10.6) [10.6|16.975] "Volt" ECM
 SG_ VoltageMin : 119|8@0+ (0.025,10.6) [10.6|16.975] "Volt" ECM

BO_ 1375 BCM_FD_6: 32 BCM
 SG_ ChkFuelLevelSts : 99|3@0+ (1,0) [0|7] "-" ECM,IPC,SGW
 SG_ CRC_BCM6 : 191|8@0+ (1,0) [0|255] "-" BSM,CADM
 SG_ FrontWiperReq : 75|4@0+ (1,0) [0|5] "" BSM,CADM,DTCM,EVCU2,SGW
 SG_ MessageCounter_BCM6 : 179|4@0+ (1,0) [0|15] "-" BSM,CADM
 SG_ SysEOLSts : 7|1@0+ (1,0) [0|1] "-" CADM,IPC

BO_ 1827 BCM_FD_7: 32 BCM
 SG_ CRC_BCM7 : 191|8@0+ (1,0) [0|255] "-" BSM,CADM,DMSM,TCM
 SG_ IgnitionOnCounter : 95|16@0+ (1,0) [0|65535] "-" AGSM,BSM,CADM,DMSM,DTCM,ECM,EVCU2,GNMM,HCP,IPC,RFHM,SGW,TCM
 SG_ MessageCounter_BCM7 : 179|4@0+ (1,0) [0|15] "-" BSM,CADM,DMSM,TCM

BO_ 1066 BCM_FD_9: 32 BCM
 SG_ AHBFeature : 103|1@0+ (1,0) [0|1] "-" IPC,SGW
 SG_ BonnetSts : 182|1@0+ (1,0) [0|1] "-" BSM,EVCU2,IPC,SGW
 SG_ BrakeFluidLevelSts : 181|1@0+ (1,0) [0|1] "-" BSM,IPC,SGW
 SG_ CRC_BCM9 : 191|8@0+ (1,0) [0|255] "-" BSM,CADM,ECM,EVCU2,GNMM,HCP,IPC,SGW,TCM
 SG_ DoorLockLastElSts : 51|2@0+ (1,0) [0|3] "" EVCU2,RFHM,SGW
 SG_ DriverDoorSts : 35|1@0+ (1,0) [0|1] "-" AGSM,BSM,CADM,ECM,EVCU2,IPC,RFHM,SGW,TCM
 SG_ ExternalTemperature : 0|9@0+ (0.5,-85) [-85|170] "°C" BSM,CADM,DTCM,EVCU2,HCP,RFHM,SGW,TCM
 SG_ FrontFogLightSts : 99|1@0+ (1,0) [0|1] "-" IPC,SGW
 SG_ FrontWiperMoveSts : 60|1@0+ (1,0) [0|1] "" CADM,DTCM,ECM,EVCU2
 SG_ FuelLevel2 : 143|8@0+ (0.5,0) [0|127.5] "%" ECM,EVCU2,IPC,SGW
 SG_ HDCFnRqstSts : 4|2@0+ (1,0) [0|2] "" BSM,CADM
 SG_ HighBeamSts : 97|1@0+ (1,0) [0|1] "-" CADM,IPC,SGW
 SG_ LHParkingLightSts : 110|1@0+ (1,0) [0|1] "-" IPC,SGW
 SG_ LHRDoorSts : 32|1@0+ (1,0) [0|1] "-" IPC,RFHM,SGW
 SG_ LHTurnSignalSts : 107|1@0+ (1,0) [0|1] "-" SGW
 SG_ LnchCtrl_FnRqstSts : 28|2@0+ (1,0) [0|2] "-" BSM
 SG_ LowBeamSts : 72|1@0+ (1,0) [0|1] "" CADM,SGW
 SG_ LowFuelWarningSts : 47|1@0+ (1,0) [0|1] "-" ECM,EVCU2,IPC,SGW
 SG_ MessageCounter_BCM9 : 179|4@0+ (1,0) [0|15] "-" BSM,CADM,ECM,EVCU2,GNMM,HCP,IPC,SGW,TCM
 SG_ ParkBrakeSts : 180|1@0+ (1,0) [0|1] "-" SGW
 SG_ PowerModeSts : 161|2@0+ (1,0) [0|3] "" BSM,CADM,ECM,EVCU2,GNMM,IPC,RFHM,SGW
 SG_ PowerPanelMsg : 175|4@0+ (1,0) [0|15] "" SGW
 SG_ PsngrDoorSts : 46|1@0+ (1,0) [0|1] "-" IPC,RFHM,SGW
 SG_ RainSensorFailSts : 45|1@0+ (1,0) [0|1] "-" IPC
 SG_ RearFogLightFault : 21|1@0+ (1,0) [0|1] "-" IPC
 SG_ RearFogLightSts : 38|1@0+ (1,0) [0|1] "-" IPC,SGW
 SG_ RearTrunkEnableLastElSts : 33|1@0+ (1,0) [0|1] "-" SGW
 SG_ RHatchSts : 43|1@0+ (1,0) [0|1] "-" EVCU2,IPC,RFHM,SGW
 SG_ RHParkingLightSts : 73|1@0+ (1,0) [0|1] "-" IPC,SGW
 SG_ RHRDoorSts : 42|1@0+ (1,0) [0|1] "-" IPC,RFHM,SGW
 SG_ RHTurnSignalSts : 114|1@0+ (1,0) [0|1] "-" SGW
 SG_ StopLightFault : 108|1@0+ (1,0) [0|1] "-" CADM,SGW
 SG_ StopLightSts : 88|1@0+ (1,0) [0|1] "-" SGW
 SG_ TheftAlarmStatus : 87|3@0+ (1,0) [0|6] "" RFHM,SGW
 SG_ TrunkHandleReleaseSts : 92|1@0+ (1,0) [0|1] "" SGW
 SG_ WashLightWarningSts : 61|1@0+ (1,0) [0|1] "" IPC,SGW

BO_ 245 BCM_MINICRYPT_ACK: 32 BCM
 SG_ MinicryptReceptionSts : 72|1@0+ (1,0) [0|1] "-" RFHM

BO_ 513 BRAKE_FD_1: 32 BSM
 SG_ ACCFSafe : 7|8@0+ (1,0) [0|255] "-" BCM,CADM
 SG_ Brk_Jrk_Resp : 60|1@0+ (1,0) [0|1] "-" CADM
 SG_ Brk_Thermdl : 151|1@0+ (1,0) [0|1] "-" EVCU2,SGW
 SG_ BrkTrq : 94|15@0+ (3,0) [0|98301] "Nm" BCM,DTCM,ECM,EVCU2,IPC,SGW,TCM
 SG_ BrkTrq_Driver : 150|15@0+ (3,0) [0|98301] "Nm" BCM,DTCM,ECM,EVCU2,TCM
 SG_ CRC_BRAKE1 : 191|8@0+ (1,0) [0|255] "-" BCM,CADM,DTCM,ECM,EVCU2,HCP,IPC,TCM
 SG_ DASEngReqPos : 61|1@0+ (1,0) [0|1] "-" CADM
 SG_ eBurn_Stages : 76|3@0+ (1,0) [0|7] "" Vector__XXX
 SG_ EngSpdInterv : 163|16@0+ (1,0) [0|65535] "rpm" ECM
 SG_ EngSpdIntervReq : 95|1@0+ (1,0) [0|1] "-" ECM
 SG_ ExternalBrkRequestsDisabled : 109|2@0+ (1,0) [0|2] "-" CADM,EVCU2,TCM
 SG_ Ft_RrAxleCoupling_TrqRq : 15|8@0+ (12,0) [0|3060] "Nm" DTCM
 SG_ Ft_RrTrqCoupling_ModeRq : 107|2@0+ (1,0) [0|3] "-" DTCM
 SG_ GrMax_Rq_BSM : 123|4@0+ (1,0) [0|15] "-" DTCM,EVCU2,TCM
 SG_ GrMin_Rq_BSM : 139|4@0+ (1,0) [0|15] "-" EVCU2,TCM
 SG_ MessageCounter_BRAKE1 : 179|4@0+ (1,0) [0|15] "-" BCM,CADM,DTCM,ECM,EVCU2,HCP,IPC,TCM
 SG_ REF_VEH_SPEED : 57|10@0+ (0.5,0) [0|511] "kph" BCM,EVCU2,IPC
 SG_ SelectSpdSts : 165|2@0+ (1,0) [0|2] "-" EVCU2,IPC,SGW,TCM
 SG_ SelSpdLmp : 59|2@0+ (1,0) [0|0] "-" BCM,IPC,SGW
 SG_ ShftChrDsp_Rq_ESC : 127|4@0+ (1,0) [0|14] "-" TCM
 SG_ VehicleStandStillSts : 111|2@0+ (1,0) [0|2] "-" BCM,CADM

BO_ 258 BRAKE_FD_2: 64 BSM
 SG_ ABSActive : 83|1@0+ (1,0) [0|1] "-" BCM,DTCM,EVCU2,HCP,SGW,TCM
 SG_ BrakeBoostPressure : 370|11@0+ (0.1,0) [0|200] "bar" BCM,ECM,EVCU2,IPC,SGW,TCM
 SG_ BrakeBoostStat : 439|4@0+ (1,0) [0|14] "-" SGW
 SG_ BrakeInterventionSts : 103|1@0+ (1,0) [0|1] "-" BCM,DTCM,ECM,HCP,TCM
 SG_ BrakePedalPressure : 386|11@0+ (0.1,0) [0|200] "bar" BCM,ECM,EVCU2,SGW,TCM
 SG_ Brk_Stat : 343|2@0+ (1,0) [0|2] "-" BCM,ECM,IPC,SGW
 SG_ BSM_ESASystemSts : 239|3@0+ (1,0) [0|6] "" BCM
 SG_ BSM_RequesterFunction : 190|3@0+ (1,0) [0|7] "" IPC
 SG_ CRC_BRAKE2 : 447|8@0+ (1,0) [0|255] "-" AGSM,BCM,CADM,DMSM,DTCM,ECM,EVCU2,GNMM,HCP,IPC,RFHM,SGW,TCM
 SG_ ESCActive : 84|1@0+ (1,0) [0|1] "-" BCM,EVCU2,SGW,TCM
 SG_ ESP_Sys_Stat : 71|2@0+ (1,0) [0|3] "-" ECM,HCP,TCM
 SG_ HBAActive : 101|1@0+ (1,0) [0|1] "-" BCM
 SG_ HillHolderActive : 174|1@0+ (1,0) [0|1] "-" BCM
 SG_ ImpendingSkid : 205|1@0+ (1,0) [0|1] "-" EVCU2
 SG_ InternalError_BSM : 191|1@0+ (1,0) [0|1] "-" Vector__XXX
 SG_ LatAcceleration_BSM : 19|12@0+ (0.02,-40.96) [-40.96|40.92] "m/s^2" BCM,CADM,DTCM,ECM,EVCU2,HCP,IPC,SGW
 SG_ LatAccelerationFailSts_BSM : 68|1@0+ (1,0) [0|1] "-" BCM,CADM,DTCM,ECM,HCP,IPC,SGW
 SG_ LongAcceleration_BSM : 35|12@0+ (0.02,-40.96) [-40.96|40.92] "m/s^2" BCM,CADM,DTCM,ECM,EVCU2,HCP,IPC,SGW
 SG_ LongAccelerationFailSts_BSM : 69|1@0+ (1,0) [0|1] "-" BCM,CADM,DTCM,ECM,EVCU2,HCP,IPC,SGW
 SG_ MessageCounter_BRAKE2 : 435|4@0+ (1,0) [0|15] "-" AGSM,BCM,CADM,DMSM,DTCM,ECM,EVCU2,GNMM,HCP,IPC,RFHM,SGW,TCM
 SG_ MuSplit : 53|2@0+ (1,0) [0|2] "-" Vector__XXX
 SG_ OverSteering : 119|6@0+ (2,0) [0|124] "%" DTCM
 SG_ ParkingGearShiftReq_BSM : 22|3@0+ (1,0) [0|6] "" AGSM
 SG_ PrefillActive : 86|1@0+ (1,0) [0|1] "-" CADM
 SG_ Slope : 135|8@0+ (1,-100) [-100|154] "%" DTCM
 SG_ UnderSteering : 407|6@0+ (2,0) [0|124] "%" DTCM
 SG_ VehicleSpeedVSOSig : 4|13@0+ (0.0625,0) [0|511.875] "Km/h" AGSM,BCM,CADM,DMSM,DTCM,ECM,EVCU2,GNMM,HCP,IPC,RFHM,SGW,TCM
 SG_ WheelRPM_FL : 279|16@0+ (0.001953125,0) [0|127.9961] "Rev/s" BCM
 SG_ WheelRPM_FR : 295|16@0+ (0.001953125,0) [0|127.9961] "Rev/s" BCM
 SG_ YawRate_BSM : 67|12@0+ (0.08,-163.84) [-163.84|163.68] "deg/s" BCM,CADM,DTCM,SGW
 SG_ YawRateFailSts_BSM : 87|1@0+ (1,0) [0|1] "-" BCM,CADM,DTCM,SGW

BO_ 259 BRAKE_FD_3: 32 BSM
 SG_ CRC__BRAKE3 : 191|8@0+ (1,0) [0|255] "-" BCM,CADM,DTCM,ECM,EVCU2,GNMM,HCP,TCM
 SG_ LatAccelerationOffset_BSM : 127|8@0+ (0.02,-2.56) [-2.56|2.52] "m/s^2" BCM
 SG_ LHF_FastPulseCounter : 167|8@0+ (1,0) [0|255] "pulse" BCM,CADM,ECM,EVCU2,GNMM,RFHM,SGW
 SG_ LHF_Spin : 23|2@0+ (1,0) [0|3] "-" BCM,CADM,DTCM,ECM,EVCU2,HCP,SGW,TCM
 SG_ LHF_WheelSensorFailSts : 181|1@0+ (1,0) [0|1] "-" BCM,CADM,DTCM,ECM,EVCU2,SGW
 SG_ LHFWheelSpeed : 20|13@0+ (0.0625,0) [0|511.875] "Km/h" BCM,CADM,DTCM,ECM,EVCU2,GNMM,HCP,SGW,TCM
 SG_ LHR_FastPulseCounter : 151|8@0+ (1,0) [0|255] "pulse" BCM,CADM,ECM,EVCU2,GNMM,RFHM,SGW
 SG_ LHR_Spin : 86|2@0+ (1,0) [0|3] "-" BCM,CADM,DTCM,ECM,EVCU2,HCP,SGW,TCM
 SG_ LHR_WheelSensorFailSts : 87|1@0+ (1,0) [0|1] "-" BCM,CADM,DTCM,ECM,EVCU2,SGW
 SG_ LHRWheelSpeed : 4|13@0+ (0.0625,0) [0|511.875] "Km/h" BCM,CADM,DTCM,ECM,EVCU2,GNMM,HCP,SGW,TCM
 SG_ LongAccelerationOffset_BSM : 119|8@0+ (0.02,-2.56) [-2.56|2.52] "m/s^2" BCM
 SG_ LwsAngleOffset_BSM : 81|10@0+ (0.1,-51.1) [-51.1|51.1] "°" GNMM
 SG_ MessageCounter_BRAKE3 : 179|4@0+ (1,0) [0|15] "-" BCM,CADM,DTCM,ECM,EVCU2,GNMM,HCP,TCM
 SG_ RHF_FastPulseCounter : 175|8@0+ (1,0) [0|255] "pulse" BCM,CADM,ECM,EVCU2,GNMM,RFHM,SGW
 SG_ RHF_Spin : 7|2@0+ (1,0) [0|3] "-" BCM,CADM,DTCM,ECM,EVCU2,HCP,SGW,TCM
 SG_ RHF_WheelSensorFailSts : 182|1@0+ (1,0) [0|1] "-" BCM,CADM,DTCM,ECM,EVCU2,SGW
 SG_ RHFWheelSpeed : 52|13@0+ (0.0625,0) [0|511.875] "Km/h" BCM,CADM,DTCM,ECM,EVCU2,GNMM,HCP,SGW,TCM
 SG_ RHR_FastPulseCounter : 159|8@0+ (1,0) [0|255] "pulse" BCM,CADM,ECM,EVCU2,GNMM,RFHM,SGW
 SG_ RHR_Spin : 102|2@0+ (1,0) [0|3] "-" BCM,CADM,DTCM,ECM,EVCU2,HCP,SGW,TCM
 SG_ RHR_WheelSensorFailSts : 103|1@0+ (1,0) [0|1] "-" BCM,CADM,DTCM,ECM,EVCU2,SGW
 SG_ RHRWheelSpeed : 68|13@0+ (0.0625,0) [0|511.875] "Km/h" BCM,CADM,DTCM,ECM,EVCU2,GNMM,HCP,SGW,TCM

CM_ SG_ 1435 ACV_FailType "Active Cabin Ventilation Additional Info";
CM_ SG_ 1435 ACV_Status "Active Cabin Ventilation Status";
CM_ SG_ 1435 AHP_EnblReq "Used to require the activation of Auxiliary Heater Pump";
CM_ SG_ 1435 BSD_FAIL_D "Blind spot detection indicator failure - driver side";
CM_ SG_ 1435 BSD_FAIL_P "Blind spot detection indicator failure - passenger side";
CM_ SG_ 1435 CRC_BCM26 "CRC according to SAE J1850 standard at each frame transmission.";
CM_ SG_ 1435 DEFROST_SEL "Defrost select switch";
CM_ SG_ 1435 DRV_TEMP_DR_POS "Driver temperature door postion";
CM_ SG_ 1435 ESC_Mode_Req "ESC Mode Request";
CM_ SG_ 1435 EvapTempTar "Evaporator temperature target";
CM_ SG_ 1435 FLTurnLampFault "Front Left Turn Lamp Faulted";
CM_ SG_ 1435 FrontFogLightFault "Front Fog Light Faulted";
CM_ SG_ 1435 FrontFogPressed "Indicate Front Fog button is currently pressed";
CM_ SG_ 1435 FRTurnLampFault "Front Right Turn Lamp Faulted";
CM_ SG_ 1435 HAS_OnOffSts "HAS request signal";
CM_ SG_ 1435 HazardSwitchPressed "Indicate Hazard Switch is currently latched";
CM_ SG_ 1435 HLSPosition "Indicate current Headlamp Switch Position";
CM_ SG_ 1435 HtrCorTmp_InTgt "Heater core temp target";
CM_ SG_ 1435 HVAC_Blwr_Perct "HVAC blower PWM percentage for service mode";
CM_ SG_ 1435 HVAC_CLNT_FLW_MIN "HVAC coolant flow minimum request";
CM_ SG_ 1435 L_TurnCluster "Left Turn Signal Cluster Telltale";
CM_ SG_ 1435 LKA_RequestSts "LKA request signal";
CM_ SG_ 1435 MessageCounter_BCM26 "This signal is a counter used for safety checks strategies. This counter is incremented of 1 (one) unit at each frame transmission.";
CM_ SG_ 1435 Paddles_DrvMd_CfgSts_TMI "Paddles_DrvMd_CfgSts_TMI";
CM_ SG_ 1435 PADL_MODE_CFG_STAT "Config setting - Paddles functionality personalization mode";
CM_ SG_ 1435 PAS_TEMP_DR_POS "Passenger temperature door postion";
CM_ SG_ 1435 PssgrScreenOn_Off_RequestSts "PssgrScreenOn_Off request signal";
CM_ SG_ 1435 R_TurnCluster "Right Turn Signal Cluster Telltale";
CM_ SG_ 1435 RearFogPressed "Indicate Rear Fog button is currently pressed";
CM_ SG_ 1435 RLTurnLampFault "Rear Left Turn Lamp Faulted";
CM_ SG_ 1435 RRTurnLampFault "Rear Right Turn Lamp Faulted";
CM_ SG_ 1435 VEH_INT_TEMP "Vehicle interior temperature";
CM_ SG_ 1436 ATMM_PopUpRqst "ATMM Indication Status";
CM_ SG_ 1436 Blower_Diagnostics "Duty cycle Feedback received from the Blower";
CM_ SG_ 1436 Blower_Speed "Frequency Feedback received from the Blower";
CM_ SG_ 1436 Comfort_Enable_Act "Accessory Delay Active";
CM_ SG_ 1436 Comfort_Enable_Time "Power accessory delay time";
CM_ SG_ 1436 COMM_Fault "Camera wash repsonse";
CM_ SG_ 1436 CRC_BCM27 "CRC according to SAE J1850 standard at each frame transmission.";
CM_ SG_ 1436 DAY_LGT_MD_DISP "Day light brightness mode display; Night=[0], Day=[1]";
CM_ SG_ 1436 E_Call_Button "E-Call Button Status";
CM_ SG_ 1436 EBL_Stat "Rear Defrost Status";
CM_ SG_ 1436 Internal_Fault "Camera wash repsonse";
CM_ SG_ 1436 Mem_D_Pos_Rq "Memory driver - position request";
CM_ SG_ 1436 Mem_D_Rc_Rq "Memory driver - recall position";
CM_ SG_ 1436 Mem_D_Sv_Rq "Memory driver - save position";
CM_ SG_ 1436 MEM_RC_STAT "Memory recall status";
CM_ SG_ 1436 MessageCounter_BCM27 "This signal is a counter used for safety checks strategies. This counter is incremented of 1 (one) unit at each frame transmission.";
CM_ SG_ 1436 MOOD_LGT_INTS "Mood lighting intensity (ambient & glow rings)";
CM_ SG_ 1436 PANEL_INTS_DISP "Panel-/display intensity display";
CM_ SG_ 1436 TrailerConnectionSts "Connection status of TTM";
CM_ SG_ 1436 TrailerGenericFailSts "Status of Fail of TTM";
CM_ SG_ 1436 TrailerLHParkingLightFailSts "Status of Fail of Trailer Left Parking Light";
CM_ SG_ 1436 TrailerLHTurnSignalFailSts "Status of Fail of Trailer Left Turn Light";
CM_ SG_ 1436 TrailerRHParkingLightFailSts "Status of Fail of Trailer Right Parking Light";
CM_ SG_ 1436 TrailerRHTurnSignalFailSts "Status of Fail of Trailer Right Turn Light";
CM_ SG_ 1436 Turn_Lever_Unlatch_Resp "L2+ turn stalk unlatch response";
CM_ SG_ 1436 U_Call_Button "U-Call Button Status";
CM_ SG_ 1470 CRC_BCM29 "CRC according to SAE J1850 standard at each frame transmission.";
CM_ SG_ 1470 DriverReclineRelativePosition "Relative position of the driver recliner since highway assist was engaged";
CM_ SG_ 1470 DriverSeatHorizontalButton "Driver seat horizontal button press";
CM_ SG_ 1470 DriverSeatReclinerButton "Driver seat recliner button press";
CM_ SG_ 1470 DriverSeatRelativePosition "Relative position of the driver seat since highway assist was engaged";
CM_ SG_ 1470 ITBM_BRK_SW "Brake light activation";
CM_ SG_ 1470 ITBM_BrkStyle "Trailer brake style";
CM_ SG_ 1470 ITBM_CHM_RQ "ITBM fault chime request";
CM_ SG_ 1470 ITBM_DSP_RQ "ITBM display request";
CM_ SG_ 1470 ITBM_GAIN_STAT "Set gain";
CM_ SG_ 1470 ITBM_OP_PWR "ITBM brake output value (PWM)";
CM_ SG_ 1470 ITBM_TrlrStat "Trailer connection status";
CM_ SG_ 1470 ITBM_WarnRq "ITBM warning request";
CM_ SG_ 1470 MessageCounter_BCM29 "This signal is a counter used for safety checks strategies. This counter is incremented of 1 (one) unit at each frame transmission.";
CM_ SG_ 1470 SeatPosHAS "SeatPosHAS";
CM_ SG_ 1470 SelTrlrNum "Selected trailer number";
CM_ SG_ 1470 SelTrlrStyle "Selected trailer style";
CM_ SG_ 1470 Trailer_Light_Check_Status "Trailer Light Check Status";
CM_ SG_ 1470 TrlrStyle_1 "Trailer 1 style";
CM_ SG_ 1470 TrlrStyle_2 "Trailer 2 style";
CM_ SG_ 1470 TrlrStyle_3 "Trailer 3 style";
CM_ SG_ 1470 TrlrStyle_4 "Trailer 4 style";
CM_ SG_ 1470 TrlrTripDist "Trip distance of the current Trailer";
CM_ SG_ 1470 UCONREQ_TBM_TrailerLightCheck_FB "Uconnect Trailer Light Check Request Feedback";
CM_ SG_ 750 Battery_Volt_1 "Battery Volt 1 signal";
CM_ SG_ 750 Battery_Volt_2 "Battery Volt 2 signal";
CM_ SG_ 750 CRC_BCM3 "CRC according to SAE J1850 standard at each frame transmission.";
CM_ SG_ 750 FronWiperFailSts "Wiper System fault Present.";
CM_ SG_ 750 MessageCounter_BCM3 "This signal is a counter used for safety checks strategies. This counter is incremented of 1 (one) unit at each frame transmission.";
CM_ SG_ 1051 AM_ECM_Trace "Aftermarket ECM trace";
CM_ SG_ 1051 BCMSAMFailSts "This signal indicates a fault present in BCM related to the SAM strategy.";
CM_ SG_ 1051 CRC_BCM4 "CRC according to SAE J1850 standard at each frame transmission.";
CM_ SG_ 1051 EVAP_TEMP_P1C "Evaporator Temperature";
CM_ SG_ 1051 ExternalTemperatureAD_Voltage "Indicates the raw voltage of the ambient temp sensor";
CM_ SG_ 1051 FUEL_VOLT "Used to give information about the not filtered fuell level value in volt.";
CM_ SG_ 1051 MessageCounter_BCM4 "This signal is a counter used for safety checks strategies. This counter is incremented of 1 (one) unit at each frame transmission.";
CM_ SG_ 1051 PitchAngle "This signal provides the calculation of the pitch angle by BCM";
CM_ SG_ 1051 RollAngle "This signal provides the calculation  of the roll angle by BCM";
CM_ SG_ 1051 VoltageMax "This signal indicates the maximum regulation voltage permitted by BCM in the SAM strategy.";
CM_ SG_ 1051 VoltageMin "This signal indicates the minimum regulation voltage permitted by BCM in the SAM strategy.";
CM_ SG_ 1375 ChkFuelLevelSts "Used to give information about the diagnostic of CILC.";
CM_ SG_ 1375 CRC_BCM6 "CRC according to SAE J1850 standard at each frame transmission.";
CM_ SG_ 1375 MessageCounter_BCM6 "This signal is a counter used for safety checks strategies. This counter is incremented of 1 (one) unit at each frame transmission.";
CM_ SG_ 1375 SysEOLSts "EOL Status";
CM_ SG_ 1827 CRC_BCM7 "CRC according to SAE J1850 standard at each frame transmission.";
CM_ SG_ 1827 MessageCounter_BCM7 "This signal is a counter used for safety checks strategies. This counter is incremented of 1 (one) unit at each frame transmission.";
CM_ SG_ 1066 AHBFeature "This signal indicates the Auto High Beam Feature status";
CM_ SG_ 1066 BonnetSts "Used to indicate the status of the bonnet";
CM_ SG_ 1066 CRC_BCM9 "CRC according to SAE J1850 standard at each frame transmission.";
CM_ SG_ 1066 DoorLockLastElSts "Reports the last knonw eletrical request for the doors to lock or unlock.";
CM_ SG_ 1066 DriverDoorSts "Used to indicate the status of driver door";
CM_ SG_ 1066 FrontWiperMoveSts "This signal indicates the position of the front wiper (contact cam open or close).";
CM_ SG_ 1066 FuelLevel2 "Average fuel level";
CM_ SG_ 1066 HDCFnRqstSts "This signal is used by BCM to inicate the status of HDC switch";
CM_ SG_ 1066 LHRDoorSts "Used to indicate the status of left rear door";
CM_ SG_ 1066 LnchCtrl_FnRqstSts "Launch Control hard button status";
CM_ SG_ 1066 LowFuelWarningSts "Used to give information about the status of the low fuel warning.";
CM_ SG_ 1066 MessageCounter_BCM9 "This signal is a counter used for safety checks strategies. This counter is incremented of 1 (one) unit at each frame transmission.";
CM_ SG_ 1066 ParkBrakeSts "Status of Park Brake";
CM_ SG_ 1066 PowerPanelMsg "Power panel pop ups for the 2kW Inverter";
CM_ SG_ 1066 PsngrDoorSts "Used to indicate the status of passenger door";
CM_ SG_ 1066 RainSensorFailSts "This signal indicates a Rain sensor fail.";
CM_ SG_ 1066 RearTrunkEnableLastElSts "It specifies the electric status of the rear trunk switch";
CM_ SG_ 1066 RHatchSts "Used to indicate the status of the trunk liftgate";
CM_ SG_ 1066 RHRDoorSts "Used to indicate the status of right rear door";
CM_ SG_ 1066 StopLightSts "Request of Stop Lights activation";
CM_ SG_ 1066 TheftAlarmStatus "VTA Status";
CM_ SG_ 1066 TrunkHandleReleaseSts "Trunk Handle Release Status";
CM_ SG_ 245 MinicryptReceptionSts "This signal is used to give an acknowledge on specific message reception.";
CM_ SG_ 513 ACCFSafe "0";
CM_ SG_ 513 Brk_Jrk_Resp "0";
CM_ SG_ 513 Brk_Thermdl "This signal indicate when the estimated brake temperature is over a predefined threshold.";
CM_ SG_ 513 BrkTrq "0";
CM_ SG_ 513 BrkTrq_Driver "0";
CM_ SG_ 513 CRC_BRAKE1 "CRC according to SAE J1850 standard at each frame transmission.";
CM_ SG_ 513 DASEngReqPos "0";
CM_ SG_ 513 eBurn_Stages "This signal will use 3 stages to trigger brakes overheat indications";
CM_ SG_ 513 EngSpdInterv "Engine speed intervention value";
CM_ SG_ 513 EngSpdIntervReq "Engine speed intervention request (1=active)";
CM_ SG_ 513 ExternalBrkRequestsDisabled "0";
CM_ SG_ 513 Ft_RrAxleCoupling_TrqRq "Desired Torque for Center Diff";
CM_ SG_ 513 Ft_RrTrqCoupling_ModeRq "ESP Requested Center Differential State";
CM_ SG_ 513 GrMax_Rq_BSM "Requested gear, upper limit";
CM_ SG_ 513 GrMin_Rq_BSM "Requested gear, lower limit";
CM_ SG_ 513 MessageCounter_BRAKE1 "This signal is a counter used for safety checks strategies. This counter is incremented of 1 (one) unit at each frame transmission.";
CM_ SG_ 513 REF_VEH_SPEED "0";
CM_ SG_ 513 SelectSpdSts "0";
CM_ SG_ 513 SelSpdLmp "Select speed lamp status";
CM_ SG_ 513 ShftChrDsp_Rq_ESC "0";
CM_ SG_ 513 VehicleStandStillSts "This signal indicates if the car is in stand still condition";
CM_ SG_ 258 ABSActive "This signal is set to Active when the ABS functionality is active.";
CM_ SG_ 258 BrakeBoostPressure "Pressure Information from Brake Booster Pressure Sensor";
CM_ SG_ 258 BrakeBoostStat "eBoost System Status INIT, eBOOST, PUSH-THROUGH, SNA";
CM_ SG_ 258 BrakeInterventionSts "This signal is ?active? when the brake intervention is due to BSM events and ?not active? when the brake intervention is due to the driver";
CM_ SG_ 258 BrakePedalPressure "Pressure Information from Brake Pedal Simulator Pressure Sensor";
CM_ SG_ 258 Brk_Stat "Brake state";
CM_ SG_ 258 BSM_ESASystemSts "Brake System ESA Status";
CM_ SG_ 258 BSM_RequesterFunction "BSM Requester function";
CM_ SG_ 258 CRC_BRAKE2 "CRC according to SAE J1850 standard at each frame transmission.";
CM_ SG_ 258 ESCActive "This signal is set to Active when the brake intervention by ESC is active.";
CM_ SG_ 258 ESP_Sys_Stat "0";
CM_ SG_ 258 HBAActive "0";
CM_ SG_ 258 HillHolderActive "0";
CM_ SG_ 258 ImpendingSkid "Impending Skid; impending skid false = [0], impending skid true = [1]";
CM_ SG_ 258 InternalError_BSM "This signal indicates if an internal error has been processed";
CM_ SG_ 258 LatAcceleration_BSM "This signal indicates the Lateral Acceleration Value";
CM_ SG_ 258 LatAccelerationFailSts_BSM "This signal indicates the status of Lateral Acceleration Signal";
CM_ SG_ 258 LongAcceleration_BSM "This signal indicates the Longitudinal Acceleration Value";
CM_ SG_ 258 LongAccelerationFailSts_BSM "This signal indicates the status of Longitudinal acceleration signal";
CM_ SG_ 258 MessageCounter_BRAKE2 "This signal is a counter used for safety checks strategies. This counter is incremented of 1 (one) unit at each frame transmission.";
CM_ SG_ 258 MuSplit "0";
CM_ SG_ 258 OverSteering "0";
CM_ SG_ 258 ParkingGearShiftReq_BSM "CVPAM Request to autonomously shift gears";
CM_ SG_ 258 PrefillActive "This signal indicates the prefill function status.";
CM_ SG_ 258 Slope "Slope value detected by BSM";
CM_ SG_ 258 UnderSteering "0";
CM_ SG_ 258 VehicleSpeedVSOSig "It is the average vehicle speed calculated.";
CM_ SG_ 258 WheelRPM_FL "Wheel RPM front left";
CM_ SG_ 258 WheelRPM_FR "Wheel RPM front right";
CM_ SG_ 258 YawRate_BSM "This signal indicates the Yaw Rate Value";
CM_ SG_ 258 YawRateFailSts_BSM "This signal indicates the Status of Yaw Rate Signal";
CM_ SG_ 259 CRC__BRAKE3 "CRC according to SAE J1850 standard at each frame transmission.";
CM_ SG_ 259 LatAccelerationOffset_BSM "LatAccelerationOffset_BSM";
CM_ SG_ 259 LHF_FastPulseCounter "This signal is the left front wheel pulse counter.";
CM_ SG_ 259 LHF_Spin "This signal indicates the left hand front wheel status";
CM_ SG_ 259 LHF_WheelSensorFailSts "This signal indicates the fail status of LHF sensor";
CM_ SG_ 259 LHFWheelSpeed "This is the value of the left front wheel speed";
CM_ SG_ 259 LHR_FastPulseCounter "This signal is the left rear wheel pulse counter.";
CM_ SG_ 259 LHR_Spin "This signal indicates the left hand rear wheel status";
CM_ SG_ 259 LHR_WheelSensorFailSts "This signal indicates the fail status of LHR sensor";
CM_ SG_ 259 LHRWheelSpeed "This is the value of the left rear wheel speed";
CM_ SG_ 259 LongAccelerationOffset_BSM "LongAccelerationOffset_BSM";
CM_ SG_ 259 LwsAngleOffset_BSM "LwsAngleOffset_BSM";
CM_ SG_ 259 MessageCounter_BRAKE3 "This signal is a counter used for safety checks strategies. This counter is incremented of 1 (one) unit at each frame transmission.";
CM_ SG_ 259 RHF_FastPulseCounter "This signal is the right front wheel pulse counter.";
CM_ SG_ 259 RHF_Spin "This signal indicates the right hand front wheel status";
CM_ SG_ 259 RHF_WheelSensorFailSts "This signal indicates the fail status of RHF sensor";
CM_ SG_ 259 RHFWheelSpeed "This is the value of the right front wheel speed";
CM_ SG_ 259 RHR_FastPulseCounter "This signal is the right rear wheel pulse counter.";
CM_ SG_ 259 RHR_Spin "This signal indicates the right hand rear wheel status";
CM_ SG_ 259 RHR_WheelSensorFailSts "This signal indicates the fail status of RHR sensor";
CM_ SG_ 259 RHRWheelSpeed "This is the value of the right rear wheel speed";

BA_DEF_ SG_ "GenSigStartValue" INT 0 2147483647;
BA_DEF_ SG_ "GenSigInactiveValue" INT 0 2147483647;
BA_DEF_ SG_ "GenSigSendType" ENUM "NotUsed","OnWrite","OnWriteWithRepetition","OnChange","OnChangeWithRepetition","IfActive","IfActiveWithRepetition","NoSigSendType";
BA_DEF_ SG_ "SystemSignalLongSymbol" STRING ;
BA_DEF_ SG_ "GenSigTimeoutTime_AGSM" INT 0 65535;
BA_DEF_ SG_ "GenSigTimeoutTime_BCM" INT 0 65535;
BA_DEF_ SG_ "GenSigTimeoutTime_BSM" INT 0 65535;
BA_DEF_ SG_ "GenSigTimeoutTime_CADM" INT 0 65535;
BA_DEF_ SG_ "GenSigTimeoutTime_DMSM" INT 0 65535;
BA_DEF_ SG_ "GenSigTimeoutTime_DTCM" INT 0 65535;
BA_DEF_ SG_ "GenSigTimeoutTime_ECM" INT 0 65535;
BA_DEF_ SG_ "GenSigTimeoutTime_EVCU2" INT 0 65535;
BA_DEF_ SG_ "GenSigTimeoutTime_GNMM" INT 0 65535;
BA_DEF_ SG_ "GenSigTimeoutTime_HCP" INT 0 65535;
BA_DEF_ SG_ "GenSigTimeoutTime_IPC" INT 0 65535;
BA_DEF_ SG_ "GenSigTimeoutTime_RFHM" INT 0 65535;
BA_DEF_ SG_ "GenSigTimeoutTime_SGW" INT 0 65535;
BA_DEF_ SG_ "GenSigTimeoutTime_TCM" INT 0 65535;
BA_DEF_ BO_ "DiagRequest" ENUM "No","Yes";
BA_DEF_ BO_ "Type" ENUM "P","C","PE","COC","PE_Cntrl","E","E_Cntrl","OC","S","BAF","DC","EM","MM","ISO-TP","-";
BA_DEF_ BO_ "DiagResponse" ENUM "No","Yes";
BA_DEF_ BO_ "NmMessage" ENUM "No","Yes";
BA_DEF_ BO_ "GenMsgSendType" ENUM "Cyclic","NotUsed","NotUsed","NotUsed","NotUsed","NotUsed","NotUsed","NotUsed","NoMsgSendType";
BA_DEF_ BO_ "GenMsgNrOfRepetition" INT 0 255;
BA_DEF_ BO_ "GenMsgILSupport" ENUM "No","Yes";
BA_DEF_ BO_ "GenMsgStartDelayTime" INT 0 65535;
BA_DEF_ BO_ "GenMsgCycleTimeFast" INT 0 65535;
BA_DEF_ BO_ "GenMsgCycleTime" INT 0 65535;
BA_DEF_ BO_ "GenMsgDelayTime" INT 0 65535;
BA_DEF_ BO_ "NmAsrMessage" ENUM "No","Yes";
BA_DEF_ BO_ "DiagState" ENUM "No","Yes";
BA_DEF_ BO_ "DiagConnection" HEX 0 65535;
BA_DEF_ BO_ "VFrameFormat" ENUM "StandardCAN","ExtendedCAN","reserved","reserved","reserved","reserved","reserved","reserved","reserved","reserved","reserved","reserved","reserved","reserved","StandardCAN_FD","ExtendedCAN_FD";
BA_DEF_ BO_ "CANFD_BRS" ENUM "No","Yes";
BA_DEF_DEF_ "DiagRequest" "No";
BA_DEF_DEF_ "Type" "-";
BA_DEF_DEF_ "DiagResponse" "No";
BA_DEF_DEF_ "NmMessage" "No";
BA_DEF_DEF_ "GenMsgSendType" "NoMsgSendType";
BA_DEF_DEF_ "GenMsgNrOfRepetition" 0;
BA_DEF_DEF_ "GenMsgILSupport" "No";
BA_DEF_DEF_ "GenMsgStartDelayTime" 0;
BA_DEF_DEF_ "GenMsgCycleTimeFast" 0;
BA_DEF_DEF_ "GenMsgCycleTime" 0;
BA_DEF_DEF_ "GenMsgDelayTime" 0;
BA_DEF_DEF_ "NmAsrMessage" "No";
BA_DEF_DEF_ "DiagState" "No";
BA_DEF_DEF_ "DiagConnection" 0;
BA_DEF_DEF_ "VFrameFormat" "StandardCAN_FD";
BA_DEF_DEF_ "CANFD_BRS" "No";
BA_DEF_DEF_ "GenSigStartValue" 0;
BA_DEF_DEF_ "GenSigInactiveValue" 0;
BA_DEF_DEF_ "GenSigSendType" "NoSigSendType";
BA_DEF_DEF_ "SystemSignalLongSymbol" "";
BA_DEF_DEF_ "GenSigTimeoutTime_AGSM" 2500;
BA_DEF_DEF_ "GenSigTimeoutTime_BCM" 2500;
BA_DEF_DEF_ "GenSigTimeoutTime_BSM" 2500;
BA_DEF_DEF_ "GenSigTimeoutTime_CADM" 2500;
BA_DEF_DEF_ "GenSigTimeoutTime_DMSM" 2500;
BA_DEF_DEF_ "GenSigTimeoutTime_DTCM" 2500;
BA_DEF_DEF_ "GenSigTimeoutTime_ECM" 2500;
BA_DEF_DEF_ "GenSigTimeoutTime_EVCU2" 2500;
BA_DEF_DEF_ "GenSigTimeoutTime_GNMM" 2500;
BA_DEF_DEF_ "GenSigTimeoutTime_HCP" 2500;
BA_DEF_DEF_ "GenSigTimeoutTime_IPC" 2500;
BA_DEF_DEF_ "GenSigTimeoutTime_RFHM" 2500;
BA_DEF_DEF_ "GenSigTimeoutTime_SGW" 2500;
BA_DEF_DEF_ "GenSigTimeoutTime_TCM" 2500;
BA_ "Type" BO_ 1435 3;
BA_ "GenMsgSendType" BO_ 1435 0;
BA_ "GenMsgNrOfRepetition" BO_ 1435 2;
BA_ "GenMsgILSupport" BO_ 1435 1;
BA_ "GenMsgStartDelayTime" BO_ 1435 395;
BA_ "GenMsgCycleTimeFast" BO_ 1435 20;
BA_ "GenMsgCycleTime" BO_ 1435 1000;
BA_ "GenMsgDelayTime" BO_ 1435 20;
BA_ "CANFD_BRS" BO_ 1435 1;
BA_ "Type" BO_ 1436 3;
BA_ "GenMsgSendType" BO_ 1436 0;
BA_ "GenMsgNrOfRepetition" BO_ 1436 2;
BA_ "GenMsgILSupport" BO_ 1436 1;
BA_ "GenMsgStartDelayTime" BO_ 1436 400;
BA_ "GenMsgCycleTimeFast" BO_ 1436 20;
BA_ "GenMsgCycleTime" BO_ 1436 1000;
BA_ "GenMsgDelayTime" BO_ 1436 20;
BA_ "CANFD_BRS" BO_ 1436 1;
BA_ "Type" BO_ 1470 3;
BA_ "GenMsgSendType" BO_ 1470 0;
BA_ "GenMsgILSupport" BO_ 1470 1;
BA_ "GenMsgStartDelayTime" BO_ 1470 405;
BA_ "GenMsgCycleTime" BO_ 1470 1000;
BA_ "CANFD_BRS" BO_ 1470 1;
BA_ "Type" BO_ 750 1;
BA_ "GenMsgSendType" BO_ 750 0;
BA_ "GenMsgILSupport" BO_ 750 1;
BA_ "GenMsgStartDelayTime" BO_ 750 35;
BA_ "GenMsgCycleTime" BO_ 750 50;
BA_ "CANFD_BRS" BO_ 750 1;
BA_ "Type" BO_ 1051 1;
BA_ "GenMsgSendType" BO_ 1051 0;
BA_ "GenMsgILSupport" BO_ 1051 1;
BA_ "GenMsgStartDelayTime" BO_ 1051 65;
BA_ "GenMsgCycleTime" BO_ 1051 100;
BA_ "CANFD_BRS" BO_ 1051 1;
BA_ "Type" BO_ 1375 1;
BA_ "GenMsgSendType" BO_ 1375 0;
BA_ "GenMsgILSupport" BO_ 1375 1;
BA_ "GenMsgStartDelayTime" BO_ 1375 55;
BA_ "GenMsgCycleTime" BO_ 1375 250;
BA_ "CANFD_BRS" BO_ 1375 1;
BA_ "Type" BO_ 1827 1;
BA_ "GenMsgSendType" BO_ 1827 0;
BA_ "GenMsgILSupport" BO_ 1827 1;
BA_ "GenMsgStartDelayTime" BO_ 1827 410;
BA_ "GenMsgCycleTime" BO_ 1827 1000;
BA_ "CANFD_BRS" BO_ 1827 1;
BA_ "Type" BO_ 1066 3;
BA_ "GenMsgSendType" BO_ 1066 0;
BA_ "GenMsgNrOfRepetition" BO_ 1066 2;
BA_ "GenMsgILSupport" BO_ 1066 1;
BA_ "GenMsgStartDelayTime" BO_ 1066 50;
BA_ "GenMsgCycleTimeFast" BO_ 1066 20;
BA_ "GenMsgCycleTime" BO_ 1066 250;
BA_ "GenMsgDelayTime" BO_ 1066 20;
BA_ "CANFD_BRS" BO_ 1066 1;
BA_ "Type" BO_ 245 8;
BA_ "GenMsgILSupport" BO_ 245 1;
BA_ "CANFD_BRS" BO_ 245 1;
BA_ "Type" BO_ 513 1;
BA_ "GenMsgSendType" BO_ 513 0;
BA_ "GenMsgILSupport" BO_ 513 1;
BA_ "GenMsgCycleTime" BO_ 513 20;
BA_ "CANFD_BRS" BO_ 513 1;
BA_ "Type" BO_ 258 1;
BA_ "GenMsgSendType" BO_ 258 0;
BA_ "GenMsgILSupport" BO_ 258 1;
BA_ "GenMsgCycleTime" BO_ 258 10;
BA_ "CANFD_BRS" BO_ 258 1;
BA_ "Type" BO_ 259 1;
BA_ "GenMsgSendType" BO_ 259 0;
BA_ "GenMsgILSupport" BO_ 259 1;
BA_ "GenMsgCycleTime" BO_ 259 10;
BA_ "CANFD_BRS" BO_ 259 1;
BA_ "GenSigSendType" SG_ 1435 ACV_FailType 3;
BA_ "GenSigTimeoutTime_AGSM" SG_ 1435 ACV_FailType 0;
BA_ "GenSigTimeoutTime_BCM" SG_ 1435 ACV_FailType 0;
BA_ "GenSigTimeoutTime_BSM" SG_ 1435 ACV_FailType 0;
BA_ "GenSigTimeoutTime_CADM" SG_ 1435 ACV_FailType 0;
BA_ "GenSigTimeoutTime_DMSM" SG_ 1435 ACV_FailType 0;
BA_ "GenSigTimeoutTime_DTCM" SG_ 1435 ACV_FailType 0;
BA_ "GenSigTimeoutTime_ECM" SG_ 1435 ACV_FailType 0;
BA_ "GenSigTimeoutTime_EVCU2" SG_ 1435 ACV_FailType 0;
BA_ "GenSigTimeoutTime_GNMM" SG_ 1435 ACV_FailType 0;
BA_ "GenSigTimeoutTime_HCP" SG_ 1435 ACV_FailType 0;
BA_ "GenSigTimeoutTime_IPC" SG_ 1435 ACV_FailType 0;
BA_ "GenSigTimeoutTime_RFHM" SG_ 1435 ACV_FailType 0;
BA_ "GenSigTimeoutTime_TCM" SG_ 1435 ACV_FailType 0;
BA_ "GenSigTimeoutTime_AGSM" SG_ 1435 ACV_Status 0;
BA_ "GenSigTimeoutTime_BCM" SG_ 1435 ACV_Status 0;
BA_ "GenSigTimeoutTime_BSM" SG_ 1435 ACV_Status 0;
BA_ "GenSigTimeoutTime_CADM" SG_ 1435 ACV_Status 0;
BA_ "GenSigTimeoutTime_DMSM" SG_ 1435 ACV_Status 0;
BA_ "GenSigTimeoutTime_DTCM" SG_ 1435 ACV_Status 0;
BA_ "GenSigTimeoutTime_ECM" SG_ 1435 ACV_Status 0;
BA_ "GenSigTimeoutTime_EVCU2" SG_ 1435 ACV_Status 0;
BA_ "GenSigTimeoutTime_GNMM" SG_ 1435 ACV_Status 0;
BA_ "GenSigTimeoutTime_HCP" SG_ 1435 ACV_Status 0;
BA_ "GenSigTimeoutTime_IPC" SG_ 1435 ACV_Status 0;
BA_ "GenSigTimeoutTime_RFHM" SG_ 1435 ACV_Status 0;
BA_ "GenSigTimeoutTime_TCM" SG_ 1435 ACV_Status 0;
BA_ "GenSigSendType" SG_ 1435 AHP_EnblReq 3;
BA_ "GenSigTimeoutTime_AGSM" SG_ 1435 AHP_EnblReq 0;
BA_ "GenSigTimeoutTime_BCM" SG_ 1435 AHP_EnblReq 0;
BA_ "GenSigTimeoutTime_BSM" SG_ 1435 AHP_EnblReq 0;
BA_ "GenSigTimeoutTime_CADM" SG_ 1435 AHP_EnblReq 0;
BA_ "GenSigTimeoutTime_DMSM" SG_ 1435 AHP_EnblReq 0;
BA_ "GenSigTimeoutTime_DTCM" SG_ 1435 AHP_EnblReq 0;
BA_ "GenSigTimeoutTime_ECM" SG_ 1435 AHP_EnblReq 0;
BA_ "GenSigTimeoutTime_GNMM" SG_ 1435 AHP_EnblReq 0;
BA_ "GenSigTimeoutTime_HCP" SG_ 1435 AHP_EnblReq 0;
BA_ "GenSigTimeoutTime_IPC" SG_ 1435 AHP_EnblReq 0;
BA_ "GenSigTimeoutTime_RFHM" SG_ 1435 AHP_EnblReq 0;
BA_ "GenSigTimeoutTime_SGW" SG_ 1435 AHP_EnblReq 0;
BA_ "GenSigTimeoutTime_TCM" SG_ 1435 AHP_EnblReq 0;
BA_ "GenSigSendType" SG_ 1435 BSD_FAIL_D 3;
BA_ "GenSigTimeoutTime_AGSM" SG_ 1435 BSD_FAIL_D 0;
BA_ "GenSigTimeoutTime_BCM" SG_ 1435 BSD_FAIL_D 0;
BA_ "GenSigTimeoutTime_BSM" SG_ 1435 BSD_FAIL_D 0;
BA_ "GenSigTimeoutTime_DMSM" SG_ 1435 BSD_FAIL_D 0;
BA_ "GenSigTimeoutTime_DTCM" SG_ 1435 BSD_FAIL_D 0;
BA_ "GenSigTimeoutTime_ECM" SG_ 1435 BSD_FAIL_D 0;
BA_ "GenSigTimeoutTime_EVCU2" SG_ 1435 BSD_FAIL_D 0;
BA_ "GenSigTimeoutTime_GNMM" SG_ 1435 BSD_FAIL_D 0;
BA_ "GenSigTimeoutTime_HCP" SG_ 1435 BSD_FAIL_D 0;
BA_ "GenSigTimeoutTime_IPC" SG_ 1435 BSD_FAIL_D 0;
BA_ "GenSigTimeoutTime_RFHM" SG_ 1435 BSD_FAIL_D 0;
BA_ "GenSigTimeoutTime_SGW" SG_ 1435 BSD_FAIL_D 0;
BA_ "GenSigTimeoutTime_TCM" SG_ 1435 BSD_FAIL_D 0;
BA_ "GenSigSendType" SG_ 1435 BSD_FAIL_P 3;
BA_ "GenSigTimeoutTime_AGSM" SG_ 1435 BSD_FAIL_P 0;
BA_ "GenSigTimeoutTime_BCM" SG_ 1435 BSD_FAIL_P 0;
BA_ "GenSigTimeoutTime_BSM" SG_ 1435 BSD_FAIL_P 0;
BA_ "GenSigTimeoutTime_DMSM" SG_ 1435 BSD_FAIL_P 0;
BA_ "GenSigTimeoutTime_DTCM" SG_ 1435 BSD_FAIL_P 0;
BA_ "GenSigTimeoutTime_ECM" SG_ 1435 BSD_FAIL_P 0;
BA_ "GenSigTimeoutTime_EVCU2" SG_ 1435 BSD_FAIL_P 0;
BA_ "GenSigTimeoutTime_GNMM" SG_ 1435 BSD_FAIL_P 0;
BA_ "GenSigTimeoutTime_HCP" SG_ 1435 BSD_FAIL_P 0;
BA_ "GenSigTimeoutTime_IPC" SG_ 1435 BSD_FAIL_P 0;
BA_ "GenSigTimeoutTime_RFHM" SG_ 1435 BSD_FAIL_P 0;
BA_ "GenSigTimeoutTime_SGW" SG_ 1435 BSD_FAIL_P 0;
BA_ "GenSigTimeoutTime_TCM" SG_ 1435 BSD_FAIL_P 0;
BA_ "GenSigTimeoutTime_AGSM" SG_ 1435 CRC_BCM26 0;
BA_ "GenSigTimeoutTime_BCM" SG_ 1435 CRC_BCM26 0;
BA_ "GenSigTimeoutTime_BSM" SG_ 1435 CRC_BCM26 0;
BA_ "GenSigTimeoutTime_DMSM" SG_ 1435 CRC_BCM26 0;
BA_ "GenSigTimeoutTime_DTCM" SG_ 1435 CRC_BCM26 0;
BA_ "GenSigTimeoutTime_ECM" SG_ 1435 CRC_BCM26 0;
BA_ "GenSigTimeoutTime_EVCU2" SG_ 1435 CRC_BCM26 0;
BA_ "GenSigTimeoutTime_GNMM" SG_ 1435 CRC_BCM26 0;
BA_ "GenSigTimeoutTime_HCP" SG_ 1435 CRC_BCM26 0;
BA_ "GenSigTimeoutTime_RFHM" SG_ 1435 CRC_BCM26 0;
BA_ "GenSigTimeoutTime_SGW" SG_ 1435 CRC_BCM26 0;
BA_ "GenSigTimeoutTime_TCM" SG_ 1435 CRC_BCM26 0;
BA_ "GenSigTimeoutTime_AGSM" SG_ 1435 DEFROST_SEL 0;
BA_ "GenSigTimeoutTime_BCM" SG_ 1435 DEFROST_SEL 0;
BA_ "GenSigTimeoutTime_BSM" SG_ 1435 DEFROST_SEL 0;
BA_ "GenSigTimeoutTime_CADM" SG_ 1435 DEFROST_SEL 0;
BA_ "GenSigTimeoutTime_DMSM" SG_ 1435 DEFROST_SEL 0;
BA_ "GenSigTimeoutTime_DTCM" SG_ 1435 DEFROST_SEL 0;
BA_ "GenSigTimeoutTime_ECM" SG_ 1435 DEFROST_SEL 0;
BA_ "GenSigTimeoutTime_GNMM" SG_ 1435 DEFROST_SEL 0;
BA_ "GenSigTimeoutTime_HCP" SG_ 1435 DEFROST_SEL 0;
BA_ "GenSigTimeoutTime_IPC" SG_ 1435 DEFROST_SEL 0;
BA_ "GenSigTimeoutTime_RFHM" SG_ 1435 DEFROST_SEL 0;
BA_ "GenSigTimeoutTime_SGW" SG_ 1435 DEFROST_SEL 0;
BA_ "GenSigTimeoutTime_TCM" SG_ 1435 DEFROST_SEL 0;
BA_ "GenSigStartValue" SG_ 1435 DRV_TEMP_DR_POS 127;
BA_ "GenSigTimeoutTime_AGSM" SG_ 1435 DRV_TEMP_DR_POS 0;
BA_ "GenSigTimeoutTime_BCM" SG_ 1435 DRV_TEMP_DR_POS 0;
BA_ "GenSigTimeoutTime_BSM" SG_ 1435 DRV_TEMP_DR_POS 0;
BA_ "GenSigTimeoutTime_CADM" SG_ 1435 DRV_TEMP_DR_POS 0;
BA_ "GenSigTimeoutTime_DMSM" SG_ 1435 DRV_TEMP_DR_POS 0;
BA_ "GenSigTimeoutTime_DTCM" SG_ 1435 DRV_TEMP_DR_POS 0;
BA_ "GenSigTimeoutTime_ECM" SG_ 1435 DRV_TEMP_DR_POS 0;
BA_ "GenSigTimeoutTime_GNMM" SG_ 1435 DRV_TEMP_DR_POS 0;
BA_ "GenSigTimeoutTime_HCP" SG_ 1435 DRV_TEMP_DR_POS 0;
BA_ "GenSigTimeoutTime_IPC" SG_ 1435 DRV_TEMP_DR_POS 0;
BA_ "GenSigTimeoutTime_RFHM" SG_ 1435 DRV_TEMP_DR_POS 0;
BA_ "GenSigTimeoutTime_SGW" SG_ 1435 DRV_TEMP_DR_POS 0;
BA_ "GenSigTimeoutTime_TCM" SG_ 1435 DRV_TEMP_DR_POS 0;
BA_ "GenSigStartValue" SG_ 1435 ESC_Mode_Req 4;
BA_ "GenSigSendType" SG_ 1435 ESC_Mode_Req 3;
BA_ "GenSigTimeoutTime_AGSM" SG_ 1435 ESC_Mode_Req 0;
BA_ "GenSigTimeoutTime_BCM" SG_ 1435 ESC_Mode_Req 0;
BA_ "GenSigTimeoutTime_CADM" SG_ 1435 ESC_Mode_Req 0;
BA_ "GenSigTimeoutTime_DMSM" SG_ 1435 ESC_Mode_Req 0;
BA_ "GenSigTimeoutTime_DTCM" SG_ 1435 ESC_Mode_Req 0;
BA_ "GenSigTimeoutTime_ECM" SG_ 1435 ESC_Mode_Req 0;
BA_ "GenSigTimeoutTime_EVCU2" SG_ 1435 ESC_Mode_Req 0;
BA_ "GenSigTimeoutTime_GNMM" SG_ 1435 ESC_Mode_Req 0;
BA_ "GenSigTimeoutTime_HCP" SG_ 1435 ESC_Mode_Req 0;
BA_ "GenSigTimeoutTime_IPC" SG_ 1435 ESC_Mode_Req 0;
BA_ "GenSigTimeoutTime_RFHM" SG_ 1435 ESC_Mode_Req 0;
BA_ "GenSigTimeoutTime_SGW" SG_ 1435 ESC_Mode_Req 0;
BA_ "GenSigTimeoutTime_TCM" SG_ 1435 ESC_Mode_Req 0;
BA_ "GenSigTimeoutTime_AGSM" SG_ 1435 EvapTempTar 0;
BA_ "GenSigTimeoutTime_BCM" SG_ 1435 EvapTempTar 0;
BA_ "GenSigTimeoutTime_BSM" SG_ 1435 EvapTempTar 0;
BA_ "GenSigTimeoutTime_CADM" SG_ 1435 EvapTempTar 0;
BA_ "GenSigTimeoutTime_DMSM" SG_ 1435 EvapTempTar 0;
BA_ "GenSigTimeoutTime_DTCM" SG_ 1435 EvapTempTar 0;
BA_ "GenSigTimeoutTime_ECM" SG_ 1435 EvapTempTar 0;
BA_ "GenSigTimeoutTime_GNMM" SG_ 1435 EvapTempTar 0;
BA_ "GenSigTimeoutTime_HCP" SG_ 1435 EvapTempTar 0;
BA_ "GenSigTimeoutTime_IPC" SG_ 1435 EvapTempTar 0;
BA_ "GenSigTimeoutTime_RFHM" SG_ 1435 EvapTempTar 0;
BA_ "GenSigTimeoutTime_SGW" SG_ 1435 EvapTempTar 0;
BA_ "GenSigTimeoutTime_TCM" SG_ 1435 EvapTempTar 0;
BA_ "GenSigSendType" SG_ 1435 FLTurnLampFault 3;
BA_ "GenSigTimeoutTime_AGSM" SG_ 1435 FLTurnLampFault 0;
BA_ "GenSigTimeoutTime_BCM" SG_ 1435 FLTurnLampFault 0;
BA_ "GenSigTimeoutTime_BSM" SG_ 1435 FLTurnLampFault 0;
BA_ "GenSigTimeoutTime_DMSM" SG_ 1435 FLTurnLampFault 0;
BA_ "GenSigTimeoutTime_DTCM" SG_ 1435 FLTurnLampFault 0;
BA_ "GenSigTimeoutTime_ECM" SG_ 1435 FLTurnLampFault 0;
BA_ "GenSigTimeoutTime_EVCU2" SG_ 1435 FLTurnLampFault 0;
BA_ "GenSigTimeoutTime_GNMM" SG_ 1435 FLTurnLampFault 0;
BA_ "GenSigTimeoutTime_HCP" SG_ 1435 FLTurnLampFault 0;
BA_ "GenSigTimeoutTime_RFHM" SG_ 1435 FLTurnLampFault 0;
BA_ "GenSigTimeoutTime_SGW" SG_ 1435 FLTurnLampFault 0;
BA_ "GenSigTimeoutTime_TCM" SG_ 1435 FLTurnLampFault 0;
BA_ "GenSigSendType" SG_ 1435 FrontFogLightFault 4;
BA_ "GenSigTimeoutTime_AGSM" SG_ 1435 FrontFogLightFault 0;
BA_ "GenSigTimeoutTime_BCM" SG_ 1435 FrontFogLightFault 0;
BA_ "GenSigTimeoutTime_BSM" SG_ 1435 FrontFogLightFault 0;
BA_ "GenSigTimeoutTime_CADM" SG_ 1435 FrontFogLightFault 0;
BA_ "GenSigTimeoutTime_DMSM" SG_ 1435 FrontFogLightFault 0;
BA_ "GenSigTimeoutTime_DTCM" SG_ 1435 FrontFogLightFault 0;
BA_ "GenSigTimeoutTime_ECM" SG_ 1435 FrontFogLightFault 0;
BA_ "GenSigTimeoutTime_EVCU2" SG_ 1435 FrontFogLightFault 0;
BA_ "GenSigTimeoutTime_GNMM" SG_ 1435 FrontFogLightFault 0;
BA_ "GenSigTimeoutTime_HCP" SG_ 1435 FrontFogLightFault 0;
BA_ "GenSigTimeoutTime_RFHM" SG_ 1435 FrontFogLightFault 0;
BA_ "GenSigTimeoutTime_SGW" SG_ 1435 FrontFogLightFault 0;
BA_ "GenSigTimeoutTime_TCM" SG_ 1435 FrontFogLightFault 0;
BA_ "GenSigSendType" SG_ 1435 FrontFogPressed 3;
BA_ "GenSigTimeoutTime_AGSM" SG_ 1435 FrontFogPressed 0;
BA_ "GenSigTimeoutTime_BCM" SG_ 1435 FrontFogPressed 0;
BA_ "GenSigTimeoutTime_BSM" SG_ 1435 FrontFogPressed 0;
BA_ "GenSigTimeoutTime_DMSM" SG_ 1435 FrontFogPressed 0;
BA_ "GenSigTimeoutTime_DTCM" SG_ 1435 FrontFogPressed 0;
BA_ "GenSigTimeoutTime_ECM" SG_ 1435 FrontFogPressed 0;
BA_ "GenSigTimeoutTime_EVCU2" SG_ 1435 FrontFogPressed 0;
BA_ "GenSigTimeoutTime_GNMM" SG_ 1435 FrontFogPressed 0;
BA_ "GenSigTimeoutTime_HCP" SG_ 1435 FrontFogPressed 0;
BA_ "GenSigTimeoutTime_IPC" SG_ 1435 FrontFogPressed 0;
BA_ "GenSigTimeoutTime_RFHM" SG_ 1435 FrontFogPressed 0;
BA_ "GenSigTimeoutTime_SGW" SG_ 1435 FrontFogPressed 0;
BA_ "GenSigTimeoutTime_TCM" SG_ 1435 FrontFogPressed 0;
BA_ "GenSigSendType" SG_ 1435 FRTurnLampFault 3;
BA_ "GenSigTimeoutTime_AGSM" SG_ 1435 FRTurnLampFault 0;
BA_ "GenSigTimeoutTime_BCM" SG_ 1435 FRTurnLampFault 0;
BA_ "GenSigTimeoutTime_BSM" SG_ 1435 FRTurnLampFault 0;
BA_ "GenSigTimeoutTime_DMSM" SG_ 1435 FRTurnLampFault 0;
BA_ "GenSigTimeoutTime_DTCM" SG_ 1435 FRTurnLampFault 0;
BA_ "GenSigTimeoutTime_ECM" SG_ 1435 FRTurnLampFault 0;
BA_ "GenSigTimeoutTime_EVCU2" SG_ 1435 FRTurnLampFault 0;
BA_ "GenSigTimeoutTime_GNMM" SG_ 1435 FRTurnLampFault 0;
BA_ "GenSigTimeoutTime_HCP" SG_ 1435 FRTurnLampFault 0;
BA_ "GenSigTimeoutTime_RFHM" SG_ 1435 FRTurnLampFault 0;
BA_ "GenSigTimeoutTime_SGW" SG_ 1435 FRTurnLampFault 0;
BA_ "GenSigTimeoutTime_TCM" SG_ 1435 FRTurnLampFault 0;
BA_ "GenSigSendType" SG_ 1435 HAS_OnOffSts 3;
BA_ "GenSigTimeoutTime_AGSM" SG_ 1435 HAS_OnOffSts 0;
BA_ "GenSigTimeoutTime_BCM" SG_ 1435 HAS_OnOffSts 0;
BA_ "GenSigTimeoutTime_BSM" SG_ 1435 HAS_OnOffSts 0;
BA_ "GenSigTimeoutTime_DMSM" SG_ 1435 HAS_OnOffSts 0;
BA_ "GenSigTimeoutTime_DTCM" SG_ 1435 HAS_OnOffSts 0;
BA_ "GenSigTimeoutTime_ECM" SG_ 1435 HAS_OnOffSts 0;
BA_ "GenSigTimeoutTime_EVCU2" SG_ 1435 HAS_OnOffSts 0;
BA_ "GenSigTimeoutTime_GNMM" SG_ 1435 HAS_OnOffSts 0;
BA_ "GenSigTimeoutTime_HCP" SG_ 1435 HAS_OnOffSts 0;
BA_ "GenSigTimeoutTime_IPC" SG_ 1435 HAS_OnOffSts 0;
BA_ "GenSigTimeoutTime_RFHM" SG_ 1435 HAS_OnOffSts 0;
BA_ "GenSigTimeoutTime_SGW" SG_ 1435 HAS_OnOffSts 0;
BA_ "GenSigTimeoutTime_TCM" SG_ 1435 HAS_OnOffSts 0;
BA_ "GenSigSendType" SG_ 1435 HazardSwitchPressed 3;
BA_ "GenSigTimeoutTime_AGSM" SG_ 1435 HazardSwitchPressed 0;
BA_ "GenSigTimeoutTime_BCM" SG_ 1435 HazardSwitchPressed 0;
BA_ "GenSigTimeoutTime_BSM" SG_ 1435 HazardSwitchPressed 0;
BA_ "GenSigTimeoutTime_DMSM" SG_ 1435 HazardSwitchPressed 0;
BA_ "GenSigTimeoutTime_DTCM" SG_ 1435 HazardSwitchPressed 0;
BA_ "GenSigTimeoutTime_ECM" SG_ 1435 HazardSwitchPressed 0;
BA_ "GenSigTimeoutTime_EVCU2" SG_ 1435 HazardSwitchPressed 0;
BA_ "GenSigTimeoutTime_GNMM" SG_ 1435 HazardSwitchPressed 0;
BA_ "GenSigTimeoutTime_HCP" SG_ 1435 HazardSwitchPressed 0;
BA_ "GenSigTimeoutTime_IPC" SG_ 1435 HazardSwitchPressed 0;
BA_ "GenSigTimeoutTime_RFHM" SG_ 1435 HazardSwitchPressed 0;
BA_ "GenSigTimeoutTime_TCM" SG_ 1435 HazardSwitchPressed 0;
BA_ "GenSigSendType" SG_ 1435 HLSPosition 3;
BA_ "GenSigTimeoutTime_AGSM" SG_ 1435 HLSPosition 0;
BA_ "GenSigTimeoutTime_BCM" SG_ 1435 HLSPosition 0;
BA_ "GenSigTimeoutTime_BSM" SG_ 1435 HLSPosition 0;
BA_ "GenSigTimeoutTime_DMSM" SG_ 1435 HLSPosition 0;
BA_ "GenSigTimeoutTime_DTCM" SG_ 1435 HLSPosition 0;
BA_ "GenSigTimeoutTime_ECM" SG_ 1435 HLSPosition 0;
BA_ "GenSigTimeoutTime_EVCU2" SG_ 1435 HLSPosition 0;
BA_ "GenSigTimeoutTime_GNMM" SG_ 1435 HLSPosition 0;
BA_ "GenSigTimeoutTime_HCP" SG_ 1435 HLSPosition 0;
BA_ "GenSigTimeoutTime_RFHM" SG_ 1435 HLSPosition 0;
BA_ "GenSigTimeoutTime_SGW" SG_ 1435 HLSPosition 0;
BA_ "GenSigTimeoutTime_TCM" SG_ 1435 HLSPosition 0;
BA_ "GenSigStartValue" SG_ 1435 HtrCorTmp_InTgt 255;
BA_ "GenSigTimeoutTime_AGSM" SG_ 1435 HtrCorTmp_InTgt 0;
BA_ "GenSigTimeoutTime_BCM" SG_ 1435 HtrCorTmp_InTgt 0;
BA_ "GenSigTimeoutTime_BSM" SG_ 1435 HtrCorTmp_InTgt 0;
BA_ "GenSigTimeoutTime_CADM" SG_ 1435 HtrCorTmp_InTgt 0;
BA_ "GenSigTimeoutTime_DMSM" SG_ 1435 HtrCorTmp_InTgt 0;
BA_ "GenSigTimeoutTime_DTCM" SG_ 1435 HtrCorTmp_InTgt 0;
BA_ "GenSigTimeoutTime_ECM" SG_ 1435 HtrCorTmp_InTgt 0;
BA_ "GenSigTimeoutTime_GNMM" SG_ 1435 HtrCorTmp_InTgt 0;
BA_ "GenSigTimeoutTime_HCP" SG_ 1435 HtrCorTmp_InTgt 0;
BA_ "GenSigTimeoutTime_IPC" SG_ 1435 HtrCorTmp_InTgt 0;
BA_ "GenSigTimeoutTime_RFHM" SG_ 1435 HtrCorTmp_InTgt 0;
BA_ "GenSigTimeoutTime_SGW" SG_ 1435 HtrCorTmp_InTgt 0;
BA_ "GenSigTimeoutTime_TCM" SG_ 1435 HtrCorTmp_InTgt 0;
BA_ "GenSigStartValue" SG_ 1435 HVAC_Blwr_Perct 127;
BA_ "GenSigTimeoutTime_AGSM" SG_ 1435 HVAC_Blwr_Perct 0;
BA_ "GenSigTimeoutTime_BCM" SG_ 1435 HVAC_Blwr_Perct 0;
BA_ "GenSigTimeoutTime_BSM" SG_ 1435 HVAC_Blwr_Perct 0;
BA_ "GenSigTimeoutTime_CADM" SG_ 1435 HVAC_Blwr_Perct 0;
BA_ "GenSigTimeoutTime_DMSM" SG_ 1435 HVAC_Blwr_Perct 0;
BA_ "GenSigTimeoutTime_DTCM" SG_ 1435 HVAC_Blwr_Perct 0;
BA_ "GenSigTimeoutTime_ECM" SG_ 1435 HVAC_Blwr_Perct 0;
BA_ "GenSigTimeoutTime_GNMM" SG_ 1435 HVAC_Blwr_Perct 0;
BA_ "GenSigTimeoutTime_HCP" SG_ 1435 HVAC_Blwr_Perct 0;
BA_ "GenSigTimeoutTime_IPC" SG_ 1435 HVAC_Blwr_Perct 0;
BA_ "GenSigTimeoutTime_RFHM" SG_ 1435 HVAC_Blwr_Perct 0;
BA_ "GenSigTimeoutTime_SGW" SG_ 1435 HVAC_Blwr_Perct 0;
BA_ "GenSigTimeoutTime_TCM" SG_ 1435 HVAC_Blwr_Perct 0;
BA_ "GenSigStartValue" SG_ 1435 HVAC_CLNT_FLW_MIN 255;
BA_ "GenSigSendType" SG_ 1435 HVAC_CLNT_FLW_MIN 3;
BA_ "GenSigTimeoutTime_AGSM" SG_ 1435 HVAC_CLNT_FLW_MIN 0;
BA_ "GenSigTimeoutTime_BCM" SG_ 1435 HVAC_CLNT_FLW_MIN 0;
BA_ "GenSigTimeoutTime_BSM" SG_ 1435 HVAC_CLNT_FLW_MIN 0;
BA_ "GenSigTimeoutTime_CADM" SG_ 1435 HVAC_CLNT_FLW_MIN 0;
BA_ "GenSigTimeoutTime_DMSM" SG_ 1435 HVAC_CLNT_FLW_MIN 0;
BA_ "GenSigTimeoutTime_DTCM" SG_ 1435 HVAC_CLNT_FLW_MIN 0;
BA_ "GenSigTimeoutTime_EVCU2" SG_ 1435 HVAC_CLNT_FLW_MIN 0;
BA_ "GenSigTimeoutTime_GNMM" SG_ 1435 HVAC_CLNT_FLW_MIN 0;
BA_ "GenSigTimeoutTime_HCP" SG_ 1435 HVAC_CLNT_FLW_MIN 0;
BA_ "GenSigTimeoutTime_IPC" SG_ 1435 HVAC_CLNT_FLW_MIN 0;
BA_ "GenSigTimeoutTime_RFHM" SG_ 1435 HVAC_CLNT_FLW_MIN 0;
BA_ "GenSigTimeoutTime_SGW" SG_ 1435 HVAC_CLNT_FLW_MIN 0;
BA_ "GenSigTimeoutTime_TCM" SG_ 1435 HVAC_CLNT_FLW_MIN 0;
BA_ "GenSigSendType" SG_ 1435 L_TurnCluster 3;
BA_ "GenSigTimeoutTime_AGSM" SG_ 1435 L_TurnCluster 0;
BA_ "GenSigTimeoutTime_BCM" SG_ 1435 L_TurnCluster 0;
BA_ "GenSigTimeoutTime_BSM" SG_ 1435 L_TurnCluster 0;
BA_ "GenSigTimeoutTime_CADM" SG_ 1435 L_TurnCluster 0;
BA_ "GenSigTimeoutTime_DMSM" SG_ 1435 L_TurnCluster 0;
BA_ "GenSigTimeoutTime_DTCM" SG_ 1435 L_TurnCluster 0;
BA_ "GenSigTimeoutTime_ECM" SG_ 1435 L_TurnCluster 0;
BA_ "GenSigTimeoutTime_EVCU2" SG_ 1435 L_TurnCluster 0;
BA_ "GenSigTimeoutTime_GNMM" SG_ 1435 L_TurnCluster 0;
BA_ "GenSigTimeoutTime_HCP" SG_ 1435 L_TurnCluster 0;
BA_ "GenSigTimeoutTime_RFHM" SG_ 1435 L_TurnCluster 0;
BA_ "GenSigTimeoutTime_SGW" SG_ 1435 L_TurnCluster 0;
BA_ "GenSigTimeoutTime_TCM" SG_ 1435 L_TurnCluster 0;
BA_ "GenSigSendType" SG_ 1435 LKA_RequestSts 3;
BA_ "GenSigTimeoutTime_AGSM" SG_ 1435 LKA_RequestSts 0;
BA_ "GenSigTimeoutTime_BCM" SG_ 1435 LKA_RequestSts 0;
BA_ "GenSigTimeoutTime_BSM" SG_ 1435 LKA_RequestSts 0;
BA_ "GenSigTimeoutTime_DMSM" SG_ 1435 LKA_RequestSts 0;
BA_ "GenSigTimeoutTime_DTCM" SG_ 1435 LKA_RequestSts 0;
BA_ "GenSigTimeoutTime_ECM" SG_ 1435 LKA_RequestSts 0;
BA_ "GenSigTimeoutTime_EVCU2" SG_ 1435 LKA_RequestSts 0;
BA_ "GenSigTimeoutTime_GNMM" SG_ 1435 LKA_RequestSts 0;
BA_ "GenSigTimeoutTime_HCP" SG_ 1435 LKA_RequestSts 0;
BA_ "GenSigTimeoutTime_IPC" SG_ 1435 LKA_RequestSts 0;
BA_ "GenSigTimeoutTime_RFHM" SG_ 1435 LKA_RequestSts 0;
BA_ "GenSigTimeoutTime_SGW" SG_ 1435 LKA_RequestSts 0;
BA_ "GenSigTimeoutTime_TCM" SG_ 1435 LKA_RequestSts 0;
BA_ "GenSigTimeoutTime_AGSM" SG_ 1435 MessageCounter_BCM26 0;
BA_ "GenSigTimeoutTime_BCM" SG_ 1435 MessageCounter_BCM26 0;
BA_ "GenSigTimeoutTime_BSM" SG_ 1435 MessageCounter_BCM26 0;
BA_ "GenSigTimeoutTime_DMSM" SG_ 1435 MessageCounter_BCM26 0;
BA_ "GenSigTimeoutTime_DTCM" SG_ 1435 MessageCounter_BCM26 0;
BA_ "GenSigTimeoutTime_ECM" SG_ 1435 MessageCounter_BCM26 0;
BA_ "GenSigTimeoutTime_EVCU2" SG_ 1435 MessageCounter_BCM26 0;
BA_ "GenSigTimeoutTime_GNMM" SG_ 1435 MessageCounter_BCM26 0;
BA_ "GenSigTimeoutTime_HCP" SG_ 1435 MessageCounter_BCM26 0;
BA_ "GenSigTimeoutTime_RFHM" SG_ 1435 MessageCounter_BCM26 0;
BA_ "GenSigTimeoutTime_SGW" SG_ 1435 MessageCounter_BCM26 0;
BA_ "GenSigTimeoutTime_TCM" SG_ 1435 MessageCounter_BCM26 0;
BA_ "GenSigSendType" SG_ 1435 Paddles_DrvMd_CfgSts_TMI 4;
BA_ "GenSigTimeoutTime_AGSM" SG_ 1435 Paddles_DrvMd_CfgSts_TMI 0;
BA_ "GenSigTimeoutTime_BCM" SG_ 1435 Paddles_DrvMd_CfgSts_TMI 0;
BA_ "GenSigTimeoutTime_BSM" SG_ 1435 Paddles_DrvMd_CfgSts_TMI 0;
BA_ "GenSigTimeoutTime_CADM" SG_ 1435 Paddles_DrvMd_CfgSts_TMI 0;
BA_ "GenSigTimeoutTime_DMSM" SG_ 1435 Paddles_DrvMd_CfgSts_TMI 0;
BA_ "GenSigTimeoutTime_DTCM" SG_ 1435 Paddles_DrvMd_CfgSts_TMI 0;
BA_ "GenSigTimeoutTime_ECM" SG_ 1435 Paddles_DrvMd_CfgSts_TMI 0;
BA_ "GenSigTimeoutTime_EVCU2" SG_ 1435 Paddles_DrvMd_CfgSts_TMI 0;
BA_ "GenSigTimeoutTime_GNMM" SG_ 1435 Paddles_DrvMd_CfgSts_TMI 0;
BA_ "GenSigTimeoutTime_HCP" SG_ 1435 Paddles_DrvMd_CfgSts_TMI 0;
BA_ "GenSigTimeoutTime_IPC" SG_ 1435 Paddles_DrvMd_CfgSts_TMI 0;
BA_ "GenSigTimeoutTime_RFHM" SG_ 1435 Paddles_DrvMd_CfgSts_TMI 0;
BA_ "GenSigTimeoutTime_SGW" SG_ 1435 Paddles_DrvMd_CfgSts_TMI 0;
BA_ "GenSigTimeoutTime_TCM" SG_ 1435 Paddles_DrvMd_CfgSts_TMI 0;
BA_ "GenSigSendType" SG_ 1435 PADL_MODE_CFG_STAT 3;
BA_ "GenSigTimeoutTime_AGSM" SG_ 1435 PADL_MODE_CFG_STAT 0;
BA_ "GenSigTimeoutTime_BCM" SG_ 1435 PADL_MODE_CFG_STAT 0;
BA_ "GenSigTimeoutTime_BSM" SG_ 1435 PADL_MODE_CFG_STAT 0;
BA_ "GenSigTimeoutTime_CADM" SG_ 1435 PADL_MODE_CFG_STAT 0;
BA_ "GenSigTimeoutTime_DMSM" SG_ 1435 PADL_MODE_CFG_STAT 0;
BA_ "GenSigTimeoutTime_DTCM" SG_ 1435 PADL_MODE_CFG_STAT 0;
BA_ "GenSigTimeoutTime_ECM" SG_ 1435 PADL_MODE_CFG_STAT 0;
BA_ "GenSigTimeoutTime_EVCU2" SG_ 1435 PADL_MODE_CFG_STAT 0;
BA_ "GenSigTimeoutTime_GNMM" SG_ 1435 PADL_MODE_CFG_STAT 0;
BA_ "GenSigTimeoutTime_HCP" SG_ 1435 PADL_MODE_CFG_STAT 0;
BA_ "GenSigTimeoutTime_IPC" SG_ 1435 PADL_MODE_CFG_STAT 0;
BA_ "GenSigTimeoutTime_RFHM" SG_ 1435 PADL_MODE_CFG_STAT 0;
BA_ "GenSigTimeoutTime_SGW" SG_ 1435 PADL_MODE_CFG_STAT 0;
BA_ "GenSigTimeoutTime_TCM" SG_ 1435 PADL_MODE_CFG_STAT 0;
BA_ "GenSigStartValue" SG_ 1435 PAS_TEMP_DR_POS 127;
BA_ "GenSigTimeoutTime_AGSM" SG_ 1435 PAS_TEMP_DR_POS 0;
BA_ "GenSigTimeoutTime_BCM" SG_ 1435 PAS_TEMP_DR_POS 0;
BA_ "GenSigTimeoutTime_BSM" SG_ 1435 PAS_TEMP_DR_POS 0;
BA_ "GenSigTimeoutTime_CADM" SG_ 1435 PAS_TEMP_DR_POS 0;
BA_ "GenSigTimeoutTime_DMSM" SG_ 1435 PAS_TEMP_DR_POS 0;
BA_ "GenSigTimeoutTime_DTCM" SG_ 1435 PAS_TEMP_DR_POS 0;
BA_ "GenSigTimeoutTime_ECM" SG_ 1435 PAS_TEMP_DR_POS 0;
BA_ "GenSigTimeoutTime_GNMM" SG_ 1435 PAS_TEMP_DR_POS 0;
BA_ "GenSigTimeoutTime_HCP" SG_ 1435 PAS_TEMP_DR_POS 0;
BA_ "GenSigTimeoutTime_IPC" SG_ 1435 PAS_TEMP_DR_POS 0;
BA_ "GenSigTimeoutTime_RFHM" SG_ 1435 PAS_TEMP_DR_POS 0;
BA_ "GenSigTimeoutTime_SGW" SG_ 1435 PAS_TEMP_DR_POS 0;
BA_ "GenSigTimeoutTime_TCM" SG_ 1435 PAS_TEMP_DR_POS 0;
BA_ "GenSigSendType" SG_ 1435 PssgrScreenOn_Off_RequestSts 3;
BA_ "GenSigTimeoutTime_AGSM" SG_ 1435 PssgrScreenOn_Off_RequestSts 0;
BA_ "GenSigTimeoutTime_BCM" SG_ 1435 PssgrScreenOn_Off_RequestSts 0;
BA_ "GenSigTimeoutTime_BSM" SG_ 1435 PssgrScreenOn_Off_RequestSts 0;
BA_ "GenSigTimeoutTime_CADM" SG_ 1435 PssgrScreenOn_Off_RequestSts 0;
BA_ "GenSigTimeoutTime_DMSM" SG_ 1435 PssgrScreenOn_Off_RequestSts 0;
BA_ "GenSigTimeoutTime_DTCM" SG_ 1435 PssgrScreenOn_Off_RequestSts 0;
BA_ "GenSigTimeoutTime_ECM" SG_ 1435 PssgrScreenOn_Off_RequestSts 0;
BA_ "GenSigTimeoutTime_EVCU2" SG_ 1435 PssgrScreenOn_Off_RequestSts 0;
BA_ "GenSigTimeoutTime_GNMM" SG_ 1435 PssgrScreenOn_Off_RequestSts 0;
BA_ "GenSigTimeoutTime_HCP" SG_ 1435 PssgrScreenOn_Off_RequestSts 0;
BA_ "GenSigTimeoutTime_IPC" SG_ 1435 PssgrScreenOn_Off_RequestSts 0;
BA_ "GenSigTimeoutTime_RFHM" SG_ 1435 PssgrScreenOn_Off_RequestSts 0;
BA_ "GenSigTimeoutTime_TCM" SG_ 1435 PssgrScreenOn_Off_RequestSts 0;
BA_ "GenSigSendType" SG_ 1435 R_TurnCluster 3;
BA_ "GenSigTimeoutTime_AGSM" SG_ 1435 R_TurnCluster 0;
BA_ "GenSigTimeoutTime_BCM" SG_ 1435 R_TurnCluster 0;
BA_ "GenSigTimeoutTime_BSM" SG_ 1435 R_TurnCluster 0;
BA_ "GenSigTimeoutTime_CADM" SG_ 1435 R_TurnCluster 0;
BA_ "GenSigTimeoutTime_DMSM" SG_ 1435 R_TurnCluster 0;
BA_ "GenSigTimeoutTime_DTCM" SG_ 1435 R_TurnCluster 0;
BA_ "GenSigTimeoutTime_ECM" SG_ 1435 R_TurnCluster 0;
BA_ "GenSigTimeoutTime_EVCU2" SG_ 1435 R_TurnCluster 0;
BA_ "GenSigTimeoutTime_GNMM" SG_ 1435 R_TurnCluster 0;
BA_ "GenSigTimeoutTime_HCP" SG_ 1435 R_TurnCluster 0;
BA_ "GenSigTimeoutTime_RFHM" SG_ 1435 R_TurnCluster 0;
BA_ "GenSigTimeoutTime_SGW" SG_ 1435 R_TurnCluster 0;
BA_ "GenSigTimeoutTime_TCM" SG_ 1435 R_TurnCluster 0;
BA_ "GenSigSendType" SG_ 1435 RearFogPressed 3;
BA_ "GenSigTimeoutTime_AGSM" SG_ 1435 RearFogPressed 0;
BA_ "GenSigTimeoutTime_BCM" SG_ 1435 RearFogPressed 0;
BA_ "GenSigTimeoutTime_BSM" SG_ 1435 RearFogPressed 0;
BA_ "GenSigTimeoutTime_DMSM" SG_ 1435 RearFogPressed 0;
BA_ "GenSigTimeoutTime_DTCM" SG_ 1435 RearFogPressed 0;
BA_ "GenSigTimeoutTime_ECM" SG_ 1435 RearFogPressed 0;
BA_ "GenSigTimeoutTime_EVCU2" SG_ 1435 RearFogPressed 0;
BA_ "GenSigTimeoutTime_GNMM" SG_ 1435 RearFogPressed 0;
BA_ "GenSigTimeoutTime_HCP" SG_ 1435 RearFogPressed 0;
BA_ "GenSigTimeoutTime_IPC" SG_ 1435 RearFogPressed 0;
BA_ "GenSigTimeoutTime_RFHM" SG_ 1435 RearFogPressed 0;
BA_ "GenSigTimeoutTime_SGW" SG_ 1435 RearFogPressed 0;
BA_ "GenSigTimeoutTime_TCM" SG_ 1435 RearFogPressed 0;
BA_ "GenSigSendType" SG_ 1435 RLTurnLampFault 3;
BA_ "GenSigTimeoutTime_AGSM" SG_ 1435 RLTurnLampFault 0;
BA_ "GenSigTimeoutTime_BCM" SG_ 1435 RLTurnLampFault 0;
BA_ "GenSigTimeoutTime_BSM" SG_ 1435 RLTurnLampFault 0;
BA_ "GenSigTimeoutTime_DMSM" SG_ 1435 RLTurnLampFault 0;
BA_ "GenSigTimeoutTime_DTCM" SG_ 1435 RLTurnLampFault 0;
BA_ "GenSigTimeoutTime_ECM" SG_ 1435 RLTurnLampFault 0;
BA_ "GenSigTimeoutTime_EVCU2" SG_ 1435 RLTurnLampFault 0;
BA_ "GenSigTimeoutTime_GNMM" SG_ 1435 RLTurnLampFault 0;
BA_ "GenSigTimeoutTime_HCP" SG_ 1435 RLTurnLampFault 0;
BA_ "GenSigTimeoutTime_RFHM" SG_ 1435 RLTurnLampFault 0;
BA_ "GenSigTimeoutTime_TCM" SG_ 1435 RLTurnLampFault 0;
BA_ "GenSigSendType" SG_ 1435 RRTurnLampFault 3;
BA_ "GenSigTimeoutTime_AGSM" SG_ 1435 RRTurnLampFault 0;
BA_ "GenSigTimeoutTime_BCM" SG_ 1435 RRTurnLampFault 0;
BA_ "GenSigTimeoutTime_BSM" SG_ 1435 RRTurnLampFault 0;
BA_ "GenSigTimeoutTime_DMSM" SG_ 1435 RRTurnLampFault 0;
BA_ "GenSigTimeoutTime_DTCM" SG_ 1435 RRTurnLampFault 0;
BA_ "GenSigTimeoutTime_ECM" SG_ 1435 RRTurnLampFault 0;
BA_ "GenSigTimeoutTime_EVCU2" SG_ 1435 RRTurnLampFault 0;
BA_ "GenSigTimeoutTime_GNMM" SG_ 1435 RRTurnLampFault 0;
BA_ "GenSigTimeoutTime_HCP" SG_ 1435 RRTurnLampFault 0;
BA_ "GenSigTimeoutTime_RFHM" SG_ 1435 RRTurnLampFault 0;
BA_ "GenSigTimeoutTime_TCM" SG_ 1435 RRTurnLampFault 0;
BA_ "GenSigTimeoutTime_AGSM" SG_ 1435 VEH_INT_TEMP 0;
BA_ "GenSigTimeoutTime_BCM" SG_ 1435 VEH_INT_TEMP 0;
BA_ "GenSigTimeoutTime_BSM" SG_ 1435 VEH_INT_TEMP 0;
BA_ "GenSigTimeoutTime_CADM" SG_ 1435 VEH_INT_TEMP 0;
BA_ "GenSigTimeoutTime_DMSM" SG_ 1435 VEH_INT_TEMP 0;
BA_ "GenSigTimeoutTime_DTCM" SG_ 1435 VEH_INT_TEMP 0;
BA_ "GenSigTimeoutTime_ECM" SG_ 1435 VEH_INT_TEMP 0;
BA_ "GenSigTimeoutTime_GNMM" SG_ 1435 VEH_INT_TEMP 0;
BA_ "GenSigTimeoutTime_HCP" SG_ 1435 VEH_INT_TEMP 0;
BA_ "GenSigTimeoutTime_IPC" SG_ 1435 VEH_INT_TEMP 0;
BA_ "GenSigTimeoutTime_RFHM" SG_ 1435 VEH_INT_TEMP 0;
BA_ "GenSigTimeoutTime_SGW" SG_ 1435 VEH_INT_TEMP 0;
BA_ "GenSigTimeoutTime_TCM" SG_ 1435 VEH_INT_TEMP 0;
BA_ "GenSigSendType" SG_ 1436 ATMM_PopUpRqst 3;
BA_ "GenSigTimeoutTime_AGSM" SG_ 1436 ATMM_PopUpRqst 0;
BA_ "GenSigTimeoutTime_BCM" SG_ 1436 ATMM_PopUpRqst 0;
BA_ "GenSigTimeoutTime_BSM" SG_ 1436 ATMM_PopUpRqst 0;
BA_ "GenSigTimeoutTime_CADM" SG_ 1436 ATMM_PopUpRqst 0;
BA_ "GenSigTimeoutTime_DMSM" SG_ 1436 ATMM_PopUpRqst 0;
BA_ "GenSigTimeoutTime_DTCM" SG_ 1436 ATMM_PopUpRqst 0;
BA_ "GenSigTimeoutTime_ECM" SG_ 1436 ATMM_PopUpRqst 0;
BA_ "GenSigTimeoutTime_EVCU2" SG_ 1436 ATMM_PopUpRqst 0;
BA_ "GenSigTimeoutTime_GNMM" SG_ 1436 ATMM_PopUpRqst 0;
BA_ "GenSigTimeoutTime_HCP" SG_ 1436 ATMM_PopUpRqst 0;
BA_ "GenSigTimeoutTime_RFHM" SG_ 1436 ATMM_PopUpRqst 0;
BA_ "GenSigTimeoutTime_SGW" SG_ 1436 ATMM_PopUpRqst 0;
BA_ "GenSigTimeoutTime_TCM" SG_ 1436 ATMM_PopUpRqst 0;
BA_ "GenSigSendType" SG_ 1436 Blower_Diagnostics 3;
BA_ "GenSigTimeoutTime_AGSM" SG_ 1436 Blower_Diagnostics 0;
BA_ "GenSigTimeoutTime_BCM" SG_ 1436 Blower_Diagnostics 0;
BA_ "GenSigTimeoutTime_BSM" SG_ 1436 Blower_Diagnostics 0;
BA_ "GenSigTimeoutTime_CADM" SG_ 1436 Blower_Diagnostics 0;
BA_ "GenSigTimeoutTime_DMSM" SG_ 1436 Blower_Diagnostics 0;
BA_ "GenSigTimeoutTime_DTCM" SG_ 1436 Blower_Diagnostics 0;
BA_ "GenSigTimeoutTime_EVCU2" SG_ 1436 Blower_Diagnostics 0;
BA_ "GenSigTimeoutTime_GNMM" SG_ 1436 Blower_Diagnostics 0;
BA_ "GenSigTimeoutTime_HCP" SG_ 1436 Blower_Diagnostics 0;
BA_ "GenSigTimeoutTime_IPC" SG_ 1436 Blower_Diagnostics 0;
BA_ "GenSigTimeoutTime_RFHM" SG_ 1436 Blower_Diagnostics 0;
BA_ "GenSigTimeoutTime_SGW" SG_ 1436 Blower_Diagnostics 0;
BA_ "GenSigTimeoutTime_TCM" SG_ 1436 Blower_Diagnostics 0;
BA_ "GenSigSendType" SG_ 1436 Blower_Speed 3;
BA_ "GenSigTimeoutTime_AGSM" SG_ 1436 Blower_Speed 0;
BA_ "GenSigTimeoutTime_BCM" SG_ 1436 Blower_Speed 0;
BA_ "GenSigTimeoutTime_BSM" SG_ 1436 Blower_Speed 0;
BA_ "GenSigTimeoutTime_CADM" SG_ 1436 Blower_Speed 0;
BA_ "GenSigTimeoutTime_DMSM" SG_ 1436 Blower_Speed 0;
BA_ "GenSigTimeoutTime_DTCM" SG_ 1436 Blower_Speed 0;
BA_ "GenSigTimeoutTime_EVCU2" SG_ 1436 Blower_Speed 0;
BA_ "GenSigTimeoutTime_GNMM" SG_ 1436 Blower_Speed 0;
BA_ "GenSigTimeoutTime_IPC" SG_ 1436 Blower_Speed 0;
BA_ "GenSigTimeoutTime_RFHM" SG_ 1436 Blower_Speed 0;
BA_ "GenSigTimeoutTime_SGW" SG_ 1436 Blower_Speed 0;
BA_ "GenSigTimeoutTime_TCM" SG_ 1436 Blower_Speed 0;
BA_ "GenSigSendType" SG_ 1436 Comfort_Enable_Act 3;
BA_ "GenSigTimeoutTime_AGSM" SG_ 1436 Comfort_Enable_Act 0;
BA_ "GenSigTimeoutTime_BCM" SG_ 1436 Comfort_Enable_Act 0;
BA_ "GenSigTimeoutTime_BSM" SG_ 1436 Comfort_Enable_Act 0;
BA_ "GenSigTimeoutTime_CADM" SG_ 1436 Comfort_Enable_Act 0;
BA_ "GenSigTimeoutTime_DMSM" SG_ 1436 Comfort_Enable_Act 0;
BA_ "GenSigTimeoutTime_DTCM" SG_ 1436 Comfort_Enable_Act 0;
BA_ "GenSigTimeoutTime_ECM" SG_ 1436 Comfort_Enable_Act 0;
BA_ "GenSigTimeoutTime_EVCU2" SG_ 1436 Comfort_Enable_Act 0;
BA_ "GenSigTimeoutTime_GNMM" SG_ 1436 Comfort_Enable_Act 0;
BA_ "GenSigTimeoutTime_HCP" SG_ 1436 Comfort_Enable_Act 0;
BA_ "GenSigTimeoutTime_RFHM" SG_ 1436 Comfort_Enable_Act 0;
BA_ "GenSigTimeoutTime_TCM" SG_ 1436 Comfort_Enable_Act 0;
BA_ "GenSigStartValue" SG_ 1436 Comfort_Enable_Time 65535;
BA_ "GenSigSendType" SG_ 1436 Comfort_Enable_Time 3;
BA_ "GenSigTimeoutTime_AGSM" SG_ 1436 Comfort_Enable_Time 0;
BA_ "GenSigTimeoutTime_BCM" SG_ 1436 Comfort_Enable_Time 0;
BA_ "GenSigTimeoutTime_BSM" SG_ 1436 Comfort_Enable_Time 0;
BA_ "GenSigTimeoutTime_CADM" SG_ 1436 Comfort_Enable_Time 0;
BA_ "GenSigTimeoutTime_DMSM" SG_ 1436 Comfort_Enable_Time 0;
BA_ "GenSigTimeoutTime_DTCM" SG_ 1436 Comfort_Enable_Time 0;
BA_ "GenSigTimeoutTime_ECM" SG_ 1436 Comfort_Enable_Time 0;
BA_ "GenSigTimeoutTime_EVCU2" SG_ 1436 Comfort_Enable_Time 0;
BA_ "GenSigTimeoutTime_GNMM" SG_ 1436 Comfort_Enable_Time 0;
BA_ "GenSigTimeoutTime_HCP" SG_ 1436 Comfort_Enable_Time 0;
BA_ "GenSigTimeoutTime_IPC" SG_ 1436 Comfort_Enable_Time 0;
BA_ "GenSigTimeoutTime_RFHM" SG_ 1436 Comfort_Enable_Time 0;
BA_ "GenSigTimeoutTime_TCM" SG_ 1436 Comfort_Enable_Time 0;
BA_ "GenSigSendType" SG_ 1436 COMM_Fault 3;
BA_ "GenSigTimeoutTime_AGSM" SG_ 1436 COMM_Fault 0;
BA_ "GenSigTimeoutTime_BCM" SG_ 1436 COMM_Fault 0;
BA_ "GenSigTimeoutTime_BSM" SG_ 1436 COMM_Fault 0;
BA_ "GenSigTimeoutTime_CADM" SG_ 1436 COMM_Fault 0;
BA_ "GenSigTimeoutTime_DMSM" SG_ 1436 COMM_Fault 0;
BA_ "GenSigTimeoutTime_DTCM" SG_ 1436 COMM_Fault 0;
BA_ "GenSigTimeoutTime_ECM" SG_ 1436 COMM_Fault 0;
BA_ "GenSigTimeoutTime_EVCU2" SG_ 1436 COMM_Fault 0;
BA_ "GenSigTimeoutTime_GNMM" SG_ 1436 COMM_Fault 0;
BA_ "GenSigTimeoutTime_HCP" SG_ 1436 COMM_Fault 0;
BA_ "GenSigTimeoutTime_RFHM" SG_ 1436 COMM_Fault 0;
BA_ "GenSigTimeoutTime_SGW" SG_ 1436 COMM_Fault 0;
BA_ "GenSigTimeoutTime_TCM" SG_ 1436 COMM_Fault 0;
BA_ "GenSigTimeoutTime_AGSM" SG_ 1436 CRC_BCM27 0;
BA_ "GenSigTimeoutTime_BCM" SG_ 1436 CRC_BCM27 0;
BA_ "GenSigTimeoutTime_DMSM" SG_ 1436 CRC_BCM27 0;
BA_ "GenSigTimeoutTime_DTCM" SG_ 1436 CRC_BCM27 0;
BA_ "GenSigTimeoutTime_ECM" SG_ 1436 CRC_BCM27 0;
BA_ "GenSigTimeoutTime_EVCU2" SG_ 1436 CRC_BCM27 0;
BA_ "GenSigTimeoutTime_GNMM" SG_ 1436 CRC_BCM27 0;
BA_ "GenSigTimeoutTime_HCP" SG_ 1436 CRC_BCM27 0;
BA_ "GenSigTimeoutTime_RFHM" SG_ 1436 CRC_BCM27 0;
BA_ "GenSigTimeoutTime_SGW" SG_ 1436 CRC_BCM27 0;
BA_ "GenSigTimeoutTime_TCM" SG_ 1436 CRC_BCM27 0;
BA_ "GenSigSendType" SG_ 1436 DAY_LGT_MD_DISP 3;
BA_ "GenSigTimeoutTime_BCM" SG_ 1436 DAY_LGT_MD_DISP 0;
BA_ "GenSigTimeoutTime_BSM" SG_ 1436 DAY_LGT_MD_DISP 0;
BA_ "GenSigTimeoutTime_CADM" SG_ 1436 DAY_LGT_MD_DISP 0;
BA_ "GenSigTimeoutTime_DMSM" SG_ 1436 DAY_LGT_MD_DISP 0;
BA_ "GenSigTimeoutTime_DTCM" SG_ 1436 DAY_LGT_MD_DISP 0;
BA_ "GenSigTimeoutTime_ECM" SG_ 1436 DAY_LGT_MD_DISP 0;
BA_ "GenSigTimeoutTime_EVCU2" SG_ 1436 DAY_LGT_MD_DISP 0;
BA_ "GenSigTimeoutTime_GNMM" SG_ 1436 DAY_LGT_MD_DISP 0;
BA_ "GenSigTimeoutTime_HCP" SG_ 1436 DAY_LGT_MD_DISP 0;
BA_ "GenSigTimeoutTime_RFHM" SG_ 1436 DAY_LGT_MD_DISP 0;
BA_ "GenSigTimeoutTime_TCM" SG_ 1436 DAY_LGT_MD_DISP 0;
BA_ "GenSigSendType" SG_ 1436 E_Call_Button 3;
BA_ "GenSigTimeoutTime_AGSM" SG_ 1436 E_Call_Button 0;
BA_ "GenSigTimeoutTime_BCM" SG_ 1436 E_Call_Button 0;
BA_ "GenSigTimeoutTime_BSM" SG_ 1436 E_Call_Button 0;
BA_ "GenSigTimeoutTime_CADM" SG_ 1436 E_Call_Button 0;
BA_ "GenSigTimeoutTime_DMSM" SG_ 1436 E_Call_Button 0;
BA_ "GenSigTimeoutTime_DTCM" SG_ 1436 E_Call_Button 0;
BA_ "GenSigTimeoutTime_ECM" SG_ 1436 E_Call_Button 0;
BA_ "GenSigTimeoutTime_EVCU2" SG_ 1436 E_Call_Button 0;
BA_ "GenSigTimeoutTime_GNMM" SG_ 1436 E_Call_Button 0;
BA_ "GenSigTimeoutTime_HCP" SG_ 1436 E_Call_Button 0;
BA_ "GenSigTimeoutTime_IPC" SG_ 1436 E_Call_Button 0;
BA_ "GenSigTimeoutTime_RFHM" SG_ 1436 E_Call_Button 0;
BA_ "GenSigTimeoutTime_TCM" SG_ 1436 E_Call_Button 0;
BA_ "GenSigSendType" SG_ 1436 EBL_Stat 3;
BA_ "GenSigTimeoutTime_AGSM" SG_ 1436 EBL_Stat 0;
BA_ "GenSigTimeoutTime_BCM" SG_ 1436 EBL_Stat 0;
BA_ "GenSigTimeoutTime_BSM" SG_ 1436 EBL_Stat 0;
BA_ "GenSigTimeoutTime_CADM" SG_ 1436 EBL_Stat 0;
BA_ "GenSigTimeoutTime_DMSM" SG_ 1436 EBL_Stat 0;
BA_ "GenSigTimeoutTime_DTCM" SG_ 1436 EBL_Stat 0;
BA_ "GenSigTimeoutTime_ECM" SG_ 1436 EBL_Stat 0;
BA_ "GenSigTimeoutTime_EVCU2" SG_ 1436 EBL_Stat 0;
BA_ "GenSigTimeoutTime_GNMM" SG_ 1436 EBL_Stat 0;
BA_ "GenSigTimeoutTime_HCP" SG_ 1436 EBL_Stat 0;
BA_ "GenSigTimeoutTime_IPC" SG_ 1436 EBL_Stat 0;
BA_ "GenSigTimeoutTime_RFHM" SG_ 1436 EBL_Stat 0;
BA_ "GenSigTimeoutTime_TCM" SG_ 1436 EBL_Stat 0;
BA_ "GenSigSendType" SG_ 1436 Internal_Fault 3;
BA_ "GenSigTimeoutTime_AGSM" SG_ 1436 Internal_Fault 0;
BA_ "GenSigTimeoutTime_BCM" SG_ 1436 Internal_Fault 0;
BA_ "GenSigTimeoutTime_BSM" SG_ 1436 Internal_Fault 0;
BA_ "GenSigTimeoutTime_CADM" SG_ 1436 Internal_Fault 0;
BA_ "GenSigTimeoutTime_DMSM" SG_ 1436 Internal_Fault 0;
BA_ "GenSigTimeoutTime_DTCM" SG_ 1436 Internal_Fault 0;
BA_ "GenSigTimeoutTime_ECM" SG_ 1436 Internal_Fault 0;
BA_ "GenSigTimeoutTime_EVCU2" SG_ 1436 Internal_Fault 0;
BA_ "GenSigTimeoutTime_GNMM" SG_ 1436 Internal_Fault 0;
BA_ "GenSigTimeoutTime_HCP" SG_ 1436 Internal_Fault 0;
BA_ "GenSigTimeoutTime_RFHM" SG_ 1436 Internal_Fault 0;
BA_ "GenSigTimeoutTime_SGW" SG_ 1436 Internal_Fault 0;
BA_ "GenSigTimeoutTime_TCM" SG_ 1436 Internal_Fault 0;
BA_ "GenSigSendType" SG_ 1436 Mem_D_Pos_Rq 3;
BA_ "GenSigTimeoutTime_AGSM" SG_ 1436 Mem_D_Pos_Rq 0;
BA_ "GenSigTimeoutTime_BCM" SG_ 1436 Mem_D_Pos_Rq 0;
BA_ "GenSigTimeoutTime_BSM" SG_ 1436 Mem_D_Pos_Rq 0;
BA_ "GenSigTimeoutTime_CADM" SG_ 1436 Mem_D_Pos_Rq 0;
BA_ "GenSigTimeoutTime_DMSM" SG_ 1436 Mem_D_Pos_Rq 0;
BA_ "GenSigTimeoutTime_DTCM" SG_ 1436 Mem_D_Pos_Rq 0;
BA_ "GenSigTimeoutTime_ECM" SG_ 1436 Mem_D_Pos_Rq 0;
BA_ "GenSigTimeoutTime_EVCU2" SG_ 1436 Mem_D_Pos_Rq 0;
BA_ "GenSigTimeoutTime_GNMM" SG_ 1436 Mem_D_Pos_Rq 0;
BA_ "GenSigTimeoutTime_HCP" SG_ 1436 Mem_D_Pos_Rq 0;
BA_ "GenSigTimeoutTime_RFHM" SG_ 1436 Mem_D_Pos_Rq 0;
BA_ "GenSigTimeoutTime_SGW" SG_ 1436 Mem_D_Pos_Rq 0;
BA_ "GenSigTimeoutTime_TCM" SG_ 1436 Mem_D_Pos_Rq 0;
BA_ "GenSigSendType" SG_ 1436 Mem_D_Rc_Rq 3;
BA_ "GenSigTimeoutTime_AGSM" SG_ 1436 Mem_D_Rc_Rq 0;
BA_ "GenSigTimeoutTime_BCM" SG_ 1436 Mem_D_Rc_Rq 0;
BA_ "GenSigTimeoutTime_BSM" SG_ 1436 Mem_D_Rc_Rq 0;
BA_ "GenSigTimeoutTime_CADM" SG_ 1436 Mem_D_Rc_Rq 0;
BA_ "GenSigTimeoutTime_DMSM" SG_ 1436 Mem_D_Rc_Rq 0;
BA_ "GenSigTimeoutTime_DTCM" SG_ 1436 Mem_D_Rc_Rq 0;
BA_ "GenSigTimeoutTime_ECM" SG_ 1436 Mem_D_Rc_Rq 0;
BA_ "GenSigTimeoutTime_EVCU2" SG_ 1436 Mem_D_Rc_Rq 0;
BA_ "GenSigTimeoutTime_GNMM" SG_ 1436 Mem_D_Rc_Rq 0;
BA_ "GenSigTimeoutTime_HCP" SG_ 1436 Mem_D_Rc_Rq 0;
BA_ "GenSigTimeoutTime_RFHM" SG_ 1436 Mem_D_Rc_Rq 0;
BA_ "GenSigTimeoutTime_SGW" SG_ 1436 Mem_D_Rc_Rq 0;
BA_ "GenSigTimeoutTime_TCM" SG_ 1436 Mem_D_Rc_Rq 0;
BA_ "GenSigSendType" SG_ 1436 Mem_D_Sv_Rq 3;
BA_ "GenSigTimeoutTime_AGSM" SG_ 1436 Mem_D_Sv_Rq 0;
BA_ "GenSigTimeoutTime_BCM" SG_ 1436 Mem_D_Sv_Rq 0;
BA_ "GenSigTimeoutTime_BSM" SG_ 1436 Mem_D_Sv_Rq 0;
BA_ "GenSigTimeoutTime_CADM" SG_ 1436 Mem_D_Sv_Rq 0;
BA_ "GenSigTimeoutTime_DMSM" SG_ 1436 Mem_D_Sv_Rq 0;
BA_ "GenSigTimeoutTime_DTCM" SG_ 1436 Mem_D_Sv_Rq 0;
BA_ "GenSigTimeoutTime_ECM" SG_ 1436 Mem_D_Sv_Rq 0;
BA_ "GenSigTimeoutTime_EVCU2" SG_ 1436 Mem_D_Sv_Rq 0;
BA_ "GenSigTimeoutTime_GNMM" SG_ 1436 Mem_D_Sv_Rq 0;
BA_ "GenSigTimeoutTime_HCP" SG_ 1436 Mem_D_Sv_Rq 0;
BA_ "GenSigTimeoutTime_RFHM" SG_ 1436 Mem_D_Sv_Rq 0;
BA_ "GenSigTimeoutTime_SGW" SG_ 1436 Mem_D_Sv_Rq 0;
BA_ "GenSigTimeoutTime_TCM" SG_ 1436 Mem_D_Sv_Rq 0;
BA_ "GenSigSendType" SG_ 1436 MEM_RC_STAT 3;
BA_ "GenSigTimeoutTime_AGSM" SG_ 1436 MEM_RC_STAT 0;
BA_ "GenSigTimeoutTime_BCM" SG_ 1436 MEM_RC_STAT 0;
BA_ "GenSigTimeoutTime_BSM" SG_ 1436 MEM_RC_STAT 0;
BA_ "GenSigTimeoutTime_CADM" SG_ 1436 MEM_RC_STAT 0;
BA_ "GenSigTimeoutTime_DMSM" SG_ 1436 MEM_RC_STAT 0;
BA_ "GenSigTimeoutTime_DTCM" SG_ 1436 MEM_RC_STAT 0;
BA_ "GenSigTimeoutTime_ECM" SG_ 1436 MEM_RC_STAT 0;
BA_ "GenSigTimeoutTime_EVCU2" SG_ 1436 MEM_RC_STAT 0;
BA_ "GenSigTimeoutTime_GNMM" SG_ 1436 MEM_RC_STAT 0;
BA_ "GenSigTimeoutTime_HCP" SG_ 1436 MEM_RC_STAT 0;
BA_ "GenSigTimeoutTime_RFHM" SG_ 1436 MEM_RC_STAT 0;
BA_ "GenSigTimeoutTime_SGW" SG_ 1436 MEM_RC_STAT 0;
BA_ "GenSigTimeoutTime_TCM" SG_ 1436 MEM_RC_STAT 0;
BA_ "GenSigTimeoutTime_AGSM" SG_ 1436 MessageCounter_BCM27 0;
BA_ "GenSigTimeoutTime_BCM" SG_ 1436 MessageCounter_BCM27 0;
BA_ "GenSigTimeoutTime_DMSM" SG_ 1436 MessageCounter_BCM27 0;
BA_ "GenSigTimeoutTime_DTCM" SG_ 1436 MessageCounter_BCM27 0;
BA_ "GenSigTimeoutTime_ECM" SG_ 1436 MessageCounter_BCM27 0;
BA_ "GenSigTimeoutTime_EVCU2" SG_ 1436 MessageCounter_BCM27 0;
BA_ "GenSigTimeoutTime_GNMM" SG_ 1436 MessageCounter_BCM27 0;
BA_ "GenSigTimeoutTime_HCP" SG_ 1436 MessageCounter_BCM27 0;
BA_ "GenSigTimeoutTime_RFHM" SG_ 1436 MessageCounter_BCM27 0;
BA_ "GenSigTimeoutTime_SGW" SG_ 1436 MessageCounter_BCM27 0;
BA_ "GenSigTimeoutTime_TCM" SG_ 1436 MessageCounter_BCM27 0;
BA_ "GenSigSendType" SG_ 1436 MOOD_LGT_INTS 3;
BA_ "GenSigTimeoutTime_AGSM" SG_ 1436 MOOD_LGT_INTS 0;
BA_ "GenSigTimeoutTime_BCM" SG_ 1436 MOOD_LGT_INTS 0;
BA_ "GenSigTimeoutTime_BSM" SG_ 1436 MOOD_LGT_INTS 0;
BA_ "GenSigTimeoutTime_CADM" SG_ 1436 MOOD_LGT_INTS 0;
BA_ "GenSigTimeoutTime_DMSM" SG_ 1436 MOOD_LGT_INTS 0;
BA_ "GenSigTimeoutTime_DTCM" SG_ 1436 MOOD_LGT_INTS 0;
BA_ "GenSigTimeoutTime_ECM" SG_ 1436 MOOD_LGT_INTS 0;
BA_ "GenSigTimeoutTime_EVCU2" SG_ 1436 MOOD_LGT_INTS 0;
BA_ "GenSigTimeoutTime_GNMM" SG_ 1436 MOOD_LGT_INTS 0;
BA_ "GenSigTimeoutTime_HCP" SG_ 1436 MOOD_LGT_INTS 0;
BA_ "GenSigTimeoutTime_IPC" SG_ 1436 MOOD_LGT_INTS 0;
BA_ "GenSigTimeoutTime_RFHM" SG_ 1436 MOOD_LGT_INTS 0;
BA_ "GenSigTimeoutTime_TCM" SG_ 1436 MOOD_LGT_INTS 0;
BA_ "GenSigSendType" SG_ 1436 PANEL_INTS_DISP 3;
BA_ "GenSigTimeoutTime_BCM" SG_ 1436 PANEL_INTS_DISP 0;
BA_ "GenSigTimeoutTime_BSM" SG_ 1436 PANEL_INTS_DISP 0;
BA_ "GenSigTimeoutTime_CADM" SG_ 1436 PANEL_INTS_DISP 0;
BA_ "GenSigTimeoutTime_DMSM" SG_ 1436 PANEL_INTS_DISP 0;
BA_ "GenSigTimeoutTime_DTCM" SG_ 1436 PANEL_INTS_DISP 0;
BA_ "GenSigTimeoutTime_ECM" SG_ 1436 PANEL_INTS_DISP 0;
BA_ "GenSigTimeoutTime_EVCU2" SG_ 1436 PANEL_INTS_DISP 0;
BA_ "GenSigTimeoutTime_GNMM" SG_ 1436 PANEL_INTS_DISP 0;
BA_ "GenSigTimeoutTime_HCP" SG_ 1436 PANEL_INTS_DISP 0;
BA_ "GenSigTimeoutTime_RFHM" SG_ 1436 PANEL_INTS_DISP 0;
BA_ "GenSigTimeoutTime_TCM" SG_ 1436 PANEL_INTS_DISP 0;
BA_ "GenSigTimeoutTime_AGSM" SG_ 1436 TrailerConnectionSts 0;
BA_ "GenSigTimeoutTime_BCM" SG_ 1436 TrailerConnectionSts 0;
BA_ "GenSigTimeoutTime_DMSM" SG_ 1436 TrailerConnectionSts 0;
BA_ "GenSigTimeoutTime_DTCM" SG_ 1436 TrailerConnectionSts 0;
BA_ "GenSigTimeoutTime_ECM" SG_ 1436 TrailerConnectionSts 0;
BA_ "GenSigTimeoutTime_GNMM" SG_ 1436 TrailerConnectionSts 0;
BA_ "GenSigTimeoutTime_HCP" SG_ 1436 TrailerConnectionSts 0;
BA_ "GenSigTimeoutTime_RFHM" SG_ 1436 TrailerConnectionSts 0;
BA_ "GenSigTimeoutTime_TCM" SG_ 1436 TrailerConnectionSts 0;
BA_ "GenSigTimeoutTime_AGSM" SG_ 1436 TrailerGenericFailSts 0;
BA_ "GenSigTimeoutTime_BCM" SG_ 1436 TrailerGenericFailSts 0;
BA_ "GenSigTimeoutTime_BSM" SG_ 1436 TrailerGenericFailSts 0;
BA_ "GenSigTimeoutTime_CADM" SG_ 1436 TrailerGenericFailSts 0;
BA_ "GenSigTimeoutTime_DMSM" SG_ 1436 TrailerGenericFailSts 0;
BA_ "GenSigTimeoutTime_DTCM" SG_ 1436 TrailerGenericFailSts 0;
BA_ "GenSigTimeoutTime_ECM" SG_ 1436 TrailerGenericFailSts 0;
BA_ "GenSigTimeoutTime_EVCU2" SG_ 1436 TrailerGenericFailSts 0;
BA_ "GenSigTimeoutTime_GNMM" SG_ 1436 TrailerGenericFailSts 0;
BA_ "GenSigTimeoutTime_HCP" SG_ 1436 TrailerGenericFailSts 0;
BA_ "GenSigTimeoutTime_RFHM" SG_ 1436 TrailerGenericFailSts 0;
BA_ "GenSigTimeoutTime_SGW" SG_ 1436 TrailerGenericFailSts 0;
BA_ "GenSigTimeoutTime_TCM" SG_ 1436 TrailerGenericFailSts 0;
BA_ "GenSigTimeoutTime_AGSM" SG_ 1436 TrailerLHParkingLightFailSts 0;
BA_ "GenSigTimeoutTime_BCM" SG_ 1436 TrailerLHParkingLightFailSts 0;
BA_ "GenSigTimeoutTime_BSM" SG_ 1436 TrailerLHParkingLightFailSts 0;
BA_ "GenSigTimeoutTime_CADM" SG_ 1436 TrailerLHParkingLightFailSts 0;
BA_ "GenSigTimeoutTime_DMSM" SG_ 1436 TrailerLHParkingLightFailSts 0;
BA_ "GenSigTimeoutTime_DTCM" SG_ 1436 TrailerLHParkingLightFailSts 0;
BA_ "GenSigTimeoutTime_ECM" SG_ 1436 TrailerLHParkingLightFailSts 0;
BA_ "GenSigTimeoutTime_EVCU2" SG_ 1436 TrailerLHParkingLightFailSts 0;
BA_ "GenSigTimeoutTime_GNMM" SG_ 1436 TrailerLHParkingLightFailSts 0;
BA_ "GenSigTimeoutTime_HCP" SG_ 1436 TrailerLHParkingLightFailSts 0;
BA_ "GenSigTimeoutTime_RFHM" SG_ 1436 TrailerLHParkingLightFailSts 0;
BA_ "GenSigTimeoutTime_SGW" SG_ 1436 TrailerLHParkingLightFailSts 0;
BA_ "GenSigTimeoutTime_TCM" SG_ 1436 TrailerLHParkingLightFailSts 0;
BA_ "GenSigTimeoutTime_AGSM" SG_ 1436 TrailerLHTurnSignalFailSts 0;
BA_ "GenSigTimeoutTime_BCM" SG_ 1436 TrailerLHTurnSignalFailSts 0;
BA_ "GenSigTimeoutTime_BSM" SG_ 1436 TrailerLHTurnSignalFailSts 0;
BA_ "GenSigTimeoutTime_CADM" SG_ 1436 TrailerLHTurnSignalFailSts 0;
BA_ "GenSigTimeoutTime_DMSM" SG_ 1436 TrailerLHTurnSignalFailSts 0;
BA_ "GenSigTimeoutTime_DTCM" SG_ 1436 TrailerLHTurnSignalFailSts 0;
BA_ "GenSigTimeoutTime_ECM" SG_ 1436 TrailerLHTurnSignalFailSts 0;
BA_ "GenSigTimeoutTime_EVCU2" SG_ 1436 TrailerLHTurnSignalFailSts 0;
BA_ "GenSigTimeoutTime_GNMM" SG_ 1436 TrailerLHTurnSignalFailSts 0;
BA_ "GenSigTimeoutTime_HCP" SG_ 1436 TrailerLHTurnSignalFailSts 0;
BA_ "GenSigTimeoutTime_RFHM" SG_ 1436 TrailerLHTurnSignalFailSts 0;
BA_ "GenSigTimeoutTime_SGW" SG_ 1436 TrailerLHTurnSignalFailSts 0;
BA_ "GenSigTimeoutTime_TCM" SG_ 1436 TrailerLHTurnSignalFailSts 0;
BA_ "GenSigTimeoutTime_AGSM" SG_ 1436 TrailerRHParkingLightFailSts 0;
BA_ "GenSigTimeoutTime_BCM" SG_ 1436 TrailerRHParkingLightFailSts 0;
BA_ "GenSigTimeoutTime_BSM" SG_ 1436 TrailerRHParkingLightFailSts 0;
BA_ "GenSigTimeoutTime_CADM" SG_ 1436 TrailerRHParkingLightFailSts 0;
BA_ "GenSigTimeoutTime_DMSM" SG_ 1436 TrailerRHParkingLightFailSts 0;
BA_ "GenSigTimeoutTime_DTCM" SG_ 1436 TrailerRHParkingLightFailSts 0;
BA_ "GenSigTimeoutTime_ECM" SG_ 1436 TrailerRHParkingLightFailSts 0;
BA_ "GenSigTimeoutTime_EVCU2" SG_ 1436 TrailerRHParkingLightFailSts 0;
BA_ "GenSigTimeoutTime_GNMM" SG_ 1436 TrailerRHParkingLightFailSts 0;
BA_ "GenSigTimeoutTime_HCP" SG_ 1436 TrailerRHParkingLightFailSts 0;
BA_ "GenSigTimeoutTime_RFHM" SG_ 1436 TrailerRHParkingLightFailSts 0;
BA_ "GenSigTimeoutTime_SGW" SG_ 1436 TrailerRHParkingLightFailSts 0;
BA_ "GenSigTimeoutTime_TCM" SG_ 1436 TrailerRHParkingLightFailSts 0;
BA_ "GenSigTimeoutTime_AGSM" SG_ 1436 TrailerRHTurnSignalFailSts 0;
BA_ "GenSigTimeoutTime_BCM" SG_ 1436 TrailerRHTurnSignalFailSts 0;
BA_ "GenSigTimeoutTime_BSM" SG_ 1436 TrailerRHTurnSignalFailSts 0;
BA_ "GenSigTimeoutTime_CADM" SG_ 1436 TrailerRHTurnSignalFailSts 0;
BA_ "GenSigTimeoutTime_DMSM" SG_ 1436 TrailerRHTurnSignalFailSts 0;
BA_ "GenSigTimeoutTime_DTCM" SG_ 1436 TrailerRHTurnSignalFailSts 0;
BA_ "GenSigTimeoutTime_ECM" SG_ 1436 TrailerRHTurnSignalFailSts 0;
BA_ "GenSigTimeoutTime_EVCU2" SG_ 1436 TrailerRHTurnSignalFailSts 0;
BA_ "GenSigTimeoutTime_GNMM" SG_ 1436 TrailerRHTurnSignalFailSts 0;
BA_ "GenSigTimeoutTime_HCP" SG_ 1436 TrailerRHTurnSignalFailSts 0;
BA_ "GenSigTimeoutTime_RFHM" SG_ 1436 TrailerRHTurnSignalFailSts 0;
BA_ "GenSigTimeoutTime_SGW" SG_ 1436 TrailerRHTurnSignalFailSts 0;
BA_ "GenSigTimeoutTime_TCM" SG_ 1436 TrailerRHTurnSignalFailSts 0;
BA_ "GenSigSendType" SG_ 1436 Turn_Lever_Unlatch_Resp 4;
BA_ "GenSigTimeoutTime_AGSM" SG_ 1436 Turn_Lever_Unlatch_Resp 0;
BA_ "GenSigTimeoutTime_BCM" SG_ 1436 Turn_Lever_Unlatch_Resp 0;
BA_ "GenSigTimeoutTime_BSM" SG_ 1436 Turn_Lever_Unlatch_Resp 0;
BA_ "GenSigTimeoutTime_DMSM" SG_ 1436 Turn_Lever_Unlatch_Resp 0;
BA_ "GenSigTimeoutTime_DTCM" SG_ 1436 Turn_Lever_Unlatch_Resp 0;
BA_ "GenSigTimeoutTime_ECM" SG_ 1436 Turn_Lever_Unlatch_Resp 0;
BA_ "GenSigTimeoutTime_EVCU2" SG_ 1436 Turn_Lever_Unlatch_Resp 0;
BA_ "GenSigTimeoutTime_GNMM" SG_ 1436 Turn_Lever_Unlatch_Resp 0;
BA_ "GenSigTimeoutTime_HCP" SG_ 1436 Turn_Lever_Unlatch_Resp 0;
BA_ "GenSigTimeoutTime_IPC" SG_ 1436 Turn_Lever_Unlatch_Resp 0;
BA_ "GenSigTimeoutTime_RFHM" SG_ 1436 Turn_Lever_Unlatch_Resp 0;
BA_ "GenSigTimeoutTime_SGW" SG_ 1436 Turn_Lever_Unlatch_Resp 0;
BA_ "GenSigTimeoutTime_TCM" SG_ 1436 Turn_Lever_Unlatch_Resp 0;
BA_ "GenSigSendType" SG_ 1436 U_Call_Button 3;
BA_ "GenSigTimeoutTime_AGSM" SG_ 1436 U_Call_Button 0;
BA_ "GenSigTimeoutTime_BCM" SG_ 1436 U_Call_Button 0;
BA_ "GenSigTimeoutTime_BSM" SG_ 1436 U_Call_Button 0;
BA_ "GenSigTimeoutTime_CADM" SG_ 1436 U_Call_Button 0;
BA_ "GenSigTimeoutTime_DMSM" SG_ 1436 U_Call_Button 0;
BA_ "GenSigTimeoutTime_DTCM" SG_ 1436 U_Call_Button 0;
BA_ "GenSigTimeoutTime_ECM" SG_ 1436 U_Call_Button 0;
BA_ "GenSigTimeoutTime_EVCU2" SG_ 1436 U_Call_Button 0;
BA_ "GenSigTimeoutTime_GNMM" SG_ 1436 U_Call_Button 0;
BA_ "GenSigTimeoutTime_HCP" SG_ 1436 U_Call_Button 0;
BA_ "GenSigTimeoutTime_IPC" SG_ 1436 U_Call_Button 0;
BA_ "GenSigTimeoutTime_RFHM" SG_ 1436 U_Call_Button 0;
BA_ "GenSigTimeoutTime_TCM" SG_ 1436 U_Call_Button 0;
BA_ "GenSigTimeoutTime_AGSM" SG_ 1470 CRC_BCM29 0;
BA_ "GenSigTimeoutTime_BCM" SG_ 1470 CRC_BCM29 0;
BA_ "GenSigTimeoutTime_BSM" SG_ 1470 CRC_BCM29 0;
BA_ "GenSigTimeoutTime_DMSM" SG_ 1470 CRC_BCM29 0;
BA_ "GenSigTimeoutTime_DTCM" SG_ 1470 CRC_BCM29 0;
BA_ "GenSigTimeoutTime_ECM" SG_ 1470 CRC_BCM29 0;
BA_ "GenSigTimeoutTime_EVCU2" SG_ 1470 CRC_BCM29 0;
BA_ "GenSigTimeoutTime_GNMM" SG_ 1470 CRC_BCM29 0;
BA_ "GenSigTimeoutTime_HCP" SG_ 1470 CRC_BCM29 0;
BA_ "GenSigTimeoutTime_RFHM" SG_ 1470 CRC_BCM29 0;
BA_ "GenSigTimeoutTime_SGW" SG_ 1470 CRC_BCM29 0;
BA_ "GenSigTimeoutTime_TCM" SG_ 1470 CRC_BCM29 0;
BA_ "GenSigSendType" SG_ 1470 DriverReclineRelativePosition 3;
BA_ "GenSigTimeoutTime_AGSM" SG_ 1470 DriverReclineRelativePosition 0;
BA_ "GenSigTimeoutTime_BCM" SG_ 1470 DriverReclineRelativePosition 0;
BA_ "GenSigTimeoutTime_BSM" SG_ 1470 DriverReclineRelativePosition 0;
BA_ "GenSigTimeoutTime_DMSM" SG_ 1470 DriverReclineRelativePosition 0;
BA_ "GenSigTimeoutTime_DTCM" SG_ 1470 DriverReclineRelativePosition 0;
BA_ "GenSigTimeoutTime_ECM" SG_ 1470 DriverReclineRelativePosition 0;
BA_ "GenSigTimeoutTime_EVCU2" SG_ 1470 DriverReclineRelativePosition 0;
BA_ "GenSigTimeoutTime_GNMM" SG_ 1470 DriverReclineRelativePosition 0;
BA_ "GenSigTimeoutTime_HCP" SG_ 1470 DriverReclineRelativePosition 0;
BA_ "GenSigTimeoutTime_IPC" SG_ 1470 DriverReclineRelativePosition 0;
BA_ "GenSigTimeoutTime_RFHM" SG_ 1470 DriverReclineRelativePosition 0;
BA_ "GenSigTimeoutTime_SGW" SG_ 1470 DriverReclineRelativePosition 0;
BA_ "GenSigTimeoutTime_TCM" SG_ 1470 DriverReclineRelativePosition 0;
BA_ "GenSigSendType" SG_ 1470 DriverSeatHorizontalButton 3;
BA_ "GenSigTimeoutTime_AGSM" SG_ 1470 DriverSeatHorizontalButton 0;
BA_ "GenSigTimeoutTime_BCM" SG_ 1470 DriverSeatHorizontalButton 0;
BA_ "GenSigTimeoutTime_BSM" SG_ 1470 DriverSeatHorizontalButton 0;
BA_ "GenSigTimeoutTime_DMSM" SG_ 1470 DriverSeatHorizontalButton 0;
BA_ "GenSigTimeoutTime_DTCM" SG_ 1470 DriverSeatHorizontalButton 0;
BA_ "GenSigTimeoutTime_ECM" SG_ 1470 DriverSeatHorizontalButton 0;
BA_ "GenSigTimeoutTime_EVCU2" SG_ 1470 DriverSeatHorizontalButton 0;
BA_ "GenSigTimeoutTime_GNMM" SG_ 1470 DriverSeatHorizontalButton 0;
BA_ "GenSigTimeoutTime_HCP" SG_ 1470 DriverSeatHorizontalButton 0;
BA_ "GenSigTimeoutTime_IPC" SG_ 1470 DriverSeatHorizontalButton 0;
BA_ "GenSigTimeoutTime_RFHM" SG_ 1470 DriverSeatHorizontalButton 0;
BA_ "GenSigTimeoutTime_SGW" SG_ 1470 DriverSeatHorizontalButton 0;
BA_ "GenSigTimeoutTime_TCM" SG_ 1470 DriverSeatHorizontalButton 0;
BA_ "GenSigSendType" SG_ 1470 DriverSeatReclinerButton 3;
BA_ "GenSigTimeoutTime_AGSM" SG_ 1470 DriverSeatReclinerButton 0;
BA_ "GenSigTimeoutTime_BCM" SG_ 1470 DriverSeatReclinerButton 0;
BA_ "GenSigTimeoutTime_BSM" SG_ 1470 DriverSeatReclinerButton 0;
BA_ "GenSigTimeoutTime_DMSM" SG_ 1470 DriverSeatReclinerButton 0;
BA_ "GenSigTimeoutTime_DTCM" SG_ 1470 DriverSeatReclinerButton 0;
BA_ "GenSigTimeoutTime_ECM" SG_ 1470 DriverSeatReclinerButton 0;
BA_ "GenSigTimeoutTime_EVCU2" SG_ 1470 DriverSeatReclinerButton 0;
BA_ "GenSigTimeoutTime_GNMM" SG_ 1470 DriverSeatReclinerButton 0;
BA_ "GenSigTimeoutTime_HCP" SG_ 1470 DriverSeatReclinerButton 0;
BA_ "GenSigTimeoutTime_IPC" SG_ 1470 DriverSeatReclinerButton 0;
BA_ "GenSigTimeoutTime_RFHM" SG_ 1470 DriverSeatReclinerButton 0;
BA_ "GenSigTimeoutTime_SGW" SG_ 1470 DriverSeatReclinerButton 0;
BA_ "GenSigTimeoutTime_TCM" SG_ 1470 DriverSeatReclinerButton 0;
BA_ "GenSigSendType" SG_ 1470 DriverSeatRelativePosition 3;
BA_ "GenSigTimeoutTime_AGSM" SG_ 1470 DriverSeatRelativePosition 0;
BA_ "GenSigTimeoutTime_BCM" SG_ 1470 DriverSeatRelativePosition 0;
BA_ "GenSigTimeoutTime_BSM" SG_ 1470 DriverSeatRelativePosition 0;
BA_ "GenSigTimeoutTime_DMSM" SG_ 1470 DriverSeatRelativePosition 0;
BA_ "GenSigTimeoutTime_DTCM" SG_ 1470 DriverSeatRelativePosition 0;
BA_ "GenSigTimeoutTime_ECM" SG_ 1470 DriverSeatRelativePosition 0;
BA_ "GenSigTimeoutTime_EVCU2" SG_ 1470 DriverSeatRelativePosition 0;
BA_ "GenSigTimeoutTime_GNMM" SG_ 1470 DriverSeatRelativePosition 0;
BA_ "GenSigTimeoutTime_HCP" SG_ 1470 DriverSeatRelativePosition 0;
BA_ "GenSigTimeoutTime_IPC" SG_ 1470 DriverSeatRelativePosition 0;
BA_ "GenSigTimeoutTime_RFHM" SG_ 1470 DriverSeatRelativePosition 0;
BA_ "GenSigTimeoutTime_SGW" SG_ 1470 DriverSeatRelativePosition 0;
BA_ "GenSigTimeoutTime_TCM" SG_ 1470 DriverSeatRelativePosition 0;
BA_ "GenSigStartValue" SG_ 1470 ITBM_BRK_SW 3;
BA_ "GenSigSendType" SG_ 1470 ITBM_BRK_SW 3;
BA_ "GenSigTimeoutTime_AGSM" SG_ 1470 ITBM_BRK_SW 0;
BA_ "GenSigTimeoutTime_BCM" SG_ 1470 ITBM_BRK_SW 0;
BA_ "GenSigTimeoutTime_BSM" SG_ 1470 ITBM_BRK_SW 0;
BA_ "GenSigTimeoutTime_DMSM" SG_ 1470 ITBM_BRK_SW 0;
BA_ "GenSigTimeoutTime_DTCM" SG_ 1470 ITBM_BRK_SW 0;
BA_ "GenSigTimeoutTime_ECM" SG_ 1470 ITBM_BRK_SW 0;
BA_ "GenSigTimeoutTime_EVCU2" SG_ 1470 ITBM_BRK_SW 0;
BA_ "GenSigTimeoutTime_GNMM" SG_ 1470 ITBM_BRK_SW 0;
BA_ "GenSigTimeoutTime_HCP" SG_ 1470 ITBM_BRK_SW 0;
BA_ "GenSigTimeoutTime_RFHM" SG_ 1470 ITBM_BRK_SW 0;
BA_ "GenSigTimeoutTime_SGW" SG_ 1470 ITBM_BRK_SW 0;
BA_ "GenSigTimeoutTime_TCM" SG_ 1470 ITBM_BRK_SW 0;
BA_ "GenSigSendType" SG_ 1470 ITBM_BrkStyle 3;
BA_ "GenSigTimeoutTime_AGSM" SG_ 1470 ITBM_BrkStyle 0;
BA_ "GenSigTimeoutTime_BCM" SG_ 1470 ITBM_BrkStyle 0;
BA_ "GenSigTimeoutTime_BSM" SG_ 1470 ITBM_BrkStyle 0;
BA_ "GenSigTimeoutTime_CADM" SG_ 1470 ITBM_BrkStyle 0;
BA_ "GenSigTimeoutTime_DMSM" SG_ 1470 ITBM_BrkStyle 0;
BA_ "GenSigTimeoutTime_DTCM" SG_ 1470 ITBM_BrkStyle 0;
BA_ "GenSigTimeoutTime_ECM" SG_ 1470 ITBM_BrkStyle 0;
BA_ "GenSigTimeoutTime_EVCU2" SG_ 1470 ITBM_BrkStyle 0;
BA_ "GenSigTimeoutTime_GNMM" SG_ 1470 ITBM_BrkStyle 0;
BA_ "GenSigTimeoutTime_HCP" SG_ 1470 ITBM_BrkStyle 0;
BA_ "GenSigTimeoutTime_RFHM" SG_ 1470 ITBM_BrkStyle 0;
BA_ "GenSigTimeoutTime_TCM" SG_ 1470 ITBM_BrkStyle 0;
BA_ "GenSigSendType" SG_ 1470 ITBM_CHM_RQ 3;
BA_ "GenSigTimeoutTime_AGSM" SG_ 1470 ITBM_CHM_RQ 0;
BA_ "GenSigTimeoutTime_BCM" SG_ 1470 ITBM_CHM_RQ 0;
BA_ "GenSigTimeoutTime_BSM" SG_ 1470 ITBM_CHM_RQ 0;
BA_ "GenSigTimeoutTime_CADM" SG_ 1470 ITBM_CHM_RQ 0;
BA_ "GenSigTimeoutTime_DMSM" SG_ 1470 ITBM_CHM_RQ 0;
BA_ "GenSigTimeoutTime_DTCM" SG_ 1470 ITBM_CHM_RQ 0;
BA_ "GenSigTimeoutTime_ECM" SG_ 1470 ITBM_CHM_RQ 0;
BA_ "GenSigTimeoutTime_EVCU2" SG_ 1470 ITBM_CHM_RQ 0;
BA_ "GenSigTimeoutTime_GNMM" SG_ 1470 ITBM_CHM_RQ 0;
BA_ "GenSigTimeoutTime_HCP" SG_ 1470 ITBM_CHM_RQ 0;
BA_ "GenSigTimeoutTime_RFHM" SG_ 1470 ITBM_CHM_RQ 0;
BA_ "GenSigTimeoutTime_SGW" SG_ 1470 ITBM_CHM_RQ 0;
BA_ "GenSigTimeoutTime_TCM" SG_ 1470 ITBM_CHM_RQ 0;
BA_ "GenSigSendType" SG_ 1470 ITBM_DSP_RQ 3;
BA_ "GenSigTimeoutTime_AGSM" SG_ 1470 ITBM_DSP_RQ 0;
BA_ "GenSigTimeoutTime_BCM" SG_ 1470 ITBM_DSP_RQ 0;
BA_ "GenSigTimeoutTime_BSM" SG_ 1470 ITBM_DSP_RQ 0;
BA_ "GenSigTimeoutTime_CADM" SG_ 1470 ITBM_DSP_RQ 0;
BA_ "GenSigTimeoutTime_DMSM" SG_ 1470 ITBM_DSP_RQ 0;
BA_ "GenSigTimeoutTime_DTCM" SG_ 1470 ITBM_DSP_RQ 0;
BA_ "GenSigTimeoutTime_ECM" SG_ 1470 ITBM_DSP_RQ 0;
BA_ "GenSigTimeoutTime_EVCU2" SG_ 1470 ITBM_DSP_RQ 0;
BA_ "GenSigTimeoutTime_GNMM" SG_ 1470 ITBM_DSP_RQ 0;
BA_ "GenSigTimeoutTime_HCP" SG_ 1470 ITBM_DSP_RQ 0;
BA_ "GenSigTimeoutTime_RFHM" SG_ 1470 ITBM_DSP_RQ 0;
BA_ "GenSigTimeoutTime_SGW" SG_ 1470 ITBM_DSP_RQ 0;
BA_ "GenSigTimeoutTime_TCM" SG_ 1470 ITBM_DSP_RQ 0;
BA_ "GenSigSendType" SG_ 1470 ITBM_GAIN_STAT 3;
BA_ "GenSigTimeoutTime_AGSM" SG_ 1470 ITBM_GAIN_STAT 0;
BA_ "GenSigTimeoutTime_BCM" SG_ 1470 ITBM_GAIN_STAT 0;
BA_ "GenSigTimeoutTime_BSM" SG_ 1470 ITBM_GAIN_STAT 0;
BA_ "GenSigTimeoutTime_CADM" SG_ 1470 ITBM_GAIN_STAT 0;
BA_ "GenSigTimeoutTime_DMSM" SG_ 1470 ITBM_GAIN_STAT 0;
BA_ "GenSigTimeoutTime_DTCM" SG_ 1470 ITBM_GAIN_STAT 0;
BA_ "GenSigTimeoutTime_ECM" SG_ 1470 ITBM_GAIN_STAT 0;
BA_ "GenSigTimeoutTime_EVCU2" SG_ 1470 ITBM_GAIN_STAT 0;
BA_ "GenSigTimeoutTime_GNMM" SG_ 1470 ITBM_GAIN_STAT 0;
BA_ "GenSigTimeoutTime_HCP" SG_ 1470 ITBM_GAIN_STAT 0;
BA_ "GenSigTimeoutTime_RFHM" SG_ 1470 ITBM_GAIN_STAT 0;
BA_ "GenSigTimeoutTime_TCM" SG_ 1470 ITBM_GAIN_STAT 0;
BA_ "GenSigSendType" SG_ 1470 ITBM_OP_PWR 3;
BA_ "GenSigTimeoutTime_AGSM" SG_ 1470 ITBM_OP_PWR 0;
BA_ "GenSigTimeoutTime_BCM" SG_ 1470 ITBM_OP_PWR 0;
BA_ "GenSigTimeoutTime_BSM" SG_ 1470 ITBM_OP_PWR 0;
BA_ "GenSigTimeoutTime_CADM" SG_ 1470 ITBM_OP_PWR 0;
BA_ "GenSigTimeoutTime_DMSM" SG_ 1470 ITBM_OP_PWR 0;
BA_ "GenSigTimeoutTime_DTCM" SG_ 1470 ITBM_OP_PWR 0;
BA_ "GenSigTimeoutTime_ECM" SG_ 1470 ITBM_OP_PWR 0;
BA_ "GenSigTimeoutTime_EVCU2" SG_ 1470 ITBM_OP_PWR 0;
BA_ "GenSigTimeoutTime_GNMM" SG_ 1470 ITBM_OP_PWR 0;
BA_ "GenSigTimeoutTime_HCP" SG_ 1470 ITBM_OP_PWR 0;
BA_ "GenSigTimeoutTime_RFHM" SG_ 1470 ITBM_OP_PWR 0;
BA_ "GenSigTimeoutTime_TCM" SG_ 1470 ITBM_OP_PWR 0;
BA_ "GenSigSendType" SG_ 1470 ITBM_TrlrStat 3;
BA_ "GenSigTimeoutTime_AGSM" SG_ 1470 ITBM_TrlrStat 0;
BA_ "GenSigTimeoutTime_BCM" SG_ 1470 ITBM_TrlrStat 0;
BA_ "GenSigTimeoutTime_BSM" SG_ 1470 ITBM_TrlrStat 0;
BA_ "GenSigTimeoutTime_DMSM" SG_ 1470 ITBM_TrlrStat 0;
BA_ "GenSigTimeoutTime_DTCM" SG_ 1470 ITBM_TrlrStat 0;
BA_ "GenSigTimeoutTime_ECM" SG_ 1470 ITBM_TrlrStat 0;
BA_ "GenSigTimeoutTime_EVCU2" SG_ 1470 ITBM_TrlrStat 0;
BA_ "GenSigTimeoutTime_GNMM" SG_ 1470 ITBM_TrlrStat 0;
BA_ "GenSigTimeoutTime_HCP" SG_ 1470 ITBM_TrlrStat 0;
BA_ "GenSigTimeoutTime_RFHM" SG_ 1470 ITBM_TrlrStat 0;
BA_ "GenSigTimeoutTime_TCM" SG_ 1470 ITBM_TrlrStat 0;
BA_ "GenSigSendType" SG_ 1470 ITBM_WarnRq 3;
BA_ "GenSigTimeoutTime_AGSM" SG_ 1470 ITBM_WarnRq 0;
BA_ "GenSigTimeoutTime_BCM" SG_ 1470 ITBM_WarnRq 0;
BA_ "GenSigTimeoutTime_BSM" SG_ 1470 ITBM_WarnRq 0;
BA_ "GenSigTimeoutTime_CADM" SG_ 1470 ITBM_WarnRq 0;
BA_ "GenSigTimeoutTime_DMSM" SG_ 1470 ITBM_WarnRq 0;
BA_ "GenSigTimeoutTime_DTCM" SG_ 1470 ITBM_WarnRq 0;
BA_ "GenSigTimeoutTime_ECM" SG_ 1470 ITBM_WarnRq 0;
BA_ "GenSigTimeoutTime_EVCU2" SG_ 1470 ITBM_WarnRq 0;
BA_ "GenSigTimeoutTime_GNMM" SG_ 1470 ITBM_WarnRq 0;
BA_ "GenSigTimeoutTime_HCP" SG_ 1470 ITBM_WarnRq 0;
BA_ "GenSigTimeoutTime_RFHM" SG_ 1470 ITBM_WarnRq 0;
BA_ "GenSigTimeoutTime_SGW" SG_ 1470 ITBM_WarnRq 0;
BA_ "GenSigTimeoutTime_TCM" SG_ 1470 ITBM_WarnRq 0;
BA_ "GenSigTimeoutTime_AGSM" SG_ 1470 MessageCounter_BCM29 0;
BA_ "GenSigTimeoutTime_BCM" SG_ 1470 MessageCounter_BCM29 0;
BA_ "GenSigTimeoutTime_BSM" SG_ 1470 MessageCounter_BCM29 0;
BA_ "GenSigTimeoutTime_DMSM" SG_ 1470 MessageCounter_BCM29 0;
BA_ "GenSigTimeoutTime_DTCM" SG_ 1470 MessageCounter_BCM29 0;
BA_ "GenSigTimeoutTime_ECM" SG_ 1470 MessageCounter_BCM29 0;
BA_ "GenSigTimeoutTime_EVCU2" SG_ 1470 MessageCounter_BCM29 0;
BA_ "GenSigTimeoutTime_GNMM" SG_ 1470 MessageCounter_BCM29 0;
BA_ "GenSigTimeoutTime_HCP" SG_ 1470 MessageCounter_BCM29 0;
BA_ "GenSigTimeoutTime_RFHM" SG_ 1470 MessageCounter_BCM29 0;
BA_ "GenSigTimeoutTime_SGW" SG_ 1470 MessageCounter_BCM29 0;
BA_ "GenSigTimeoutTime_TCM" SG_ 1470 MessageCounter_BCM29 0;
BA_ "GenSigSendType" SG_ 1470 SeatPosHAS 3;
BA_ "GenSigTimeoutTime_AGSM" SG_ 1470 SeatPosHAS 0;
BA_ "GenSigTimeoutTime_BCM" SG_ 1470 SeatPosHAS 0;
BA_ "GenSigTimeoutTime_BSM" SG_ 1470 SeatPosHAS 0;
BA_ "GenSigTimeoutTime_DMSM" SG_ 1470 SeatPosHAS 0;
BA_ "GenSigTimeoutTime_DTCM" SG_ 1470 SeatPosHAS 0;
BA_ "GenSigTimeoutTime_ECM" SG_ 1470 SeatPosHAS 0;
BA_ "GenSigTimeoutTime_EVCU2" SG_ 1470 SeatPosHAS 0;
BA_ "GenSigTimeoutTime_GNMM" SG_ 1470 SeatPosHAS 0;
BA_ "GenSigTimeoutTime_HCP" SG_ 1470 SeatPosHAS 0;
BA_ "GenSigTimeoutTime_IPC" SG_ 1470 SeatPosHAS 0;
BA_ "GenSigTimeoutTime_RFHM" SG_ 1470 SeatPosHAS 0;
BA_ "GenSigTimeoutTime_SGW" SG_ 1470 SeatPosHAS 0;
BA_ "GenSigTimeoutTime_TCM" SG_ 1470 SeatPosHAS 0;
BA_ "GenSigStartValue" SG_ 1470 SelTrlrNum 1;
BA_ "GenSigSendType" SG_ 1470 SelTrlrNum 3;
BA_ "GenSigTimeoutTime_AGSM" SG_ 1470 SelTrlrNum 0;
BA_ "GenSigTimeoutTime_BCM" SG_ 1470 SelTrlrNum 0;
BA_ "GenSigTimeoutTime_BSM" SG_ 1470 SelTrlrNum 0;
BA_ "GenSigTimeoutTime_CADM" SG_ 1470 SelTrlrNum 0;
BA_ "GenSigTimeoutTime_DMSM" SG_ 1470 SelTrlrNum 0;
BA_ "GenSigTimeoutTime_DTCM" SG_ 1470 SelTrlrNum 0;
BA_ "GenSigTimeoutTime_ECM" SG_ 1470 SelTrlrNum 0;
BA_ "GenSigTimeoutTime_EVCU2" SG_ 1470 SelTrlrNum 0;
BA_ "GenSigTimeoutTime_GNMM" SG_ 1470 SelTrlrNum 0;
BA_ "GenSigTimeoutTime_HCP" SG_ 1470 SelTrlrNum 0;
BA_ "GenSigTimeoutTime_RFHM" SG_ 1470 SelTrlrNum 0;
BA_ "GenSigTimeoutTime_TCM" SG_ 1470 SelTrlrNum 0;
BA_ "GenSigStartValue" SG_ 1470 SelTrlrStyle 1;
BA_ "GenSigSendType" SG_ 1470 SelTrlrStyle 3;
BA_ "GenSigTimeoutTime_AGSM" SG_ 1470 SelTrlrStyle 0;
BA_ "GenSigTimeoutTime_BCM" SG_ 1470 SelTrlrStyle 0;
BA_ "GenSigTimeoutTime_BSM" SG_ 1470 SelTrlrStyle 0;
BA_ "GenSigTimeoutTime_CADM" SG_ 1470 SelTrlrStyle 0;
BA_ "GenSigTimeoutTime_DMSM" SG_ 1470 SelTrlrStyle 0;
BA_ "GenSigTimeoutTime_DTCM" SG_ 1470 SelTrlrStyle 0;
BA_ "GenSigTimeoutTime_ECM" SG_ 1470 SelTrlrStyle 0;
BA_ "GenSigTimeoutTime_EVCU2" SG_ 1470 SelTrlrStyle 0;
BA_ "GenSigTimeoutTime_GNMM" SG_ 1470 SelTrlrStyle 0;
BA_ "GenSigTimeoutTime_HCP" SG_ 1470 SelTrlrStyle 0;
BA_ "GenSigTimeoutTime_RFHM" SG_ 1470 SelTrlrStyle 0;
BA_ "GenSigTimeoutTime_TCM" SG_ 1470 SelTrlrStyle 0;
BA_ "GenSigSendType" SG_ 1470 Trailer_Light_Check_Status 3;
BA_ "GenSigTimeoutTime_AGSM" SG_ 1470 Trailer_Light_Check_Status 0;
BA_ "GenSigTimeoutTime_BCM" SG_ 1470 Trailer_Light_Check_Status 0;
BA_ "GenSigTimeoutTime_BSM" SG_ 1470 Trailer_Light_Check_Status 0;
BA_ "GenSigTimeoutTime_CADM" SG_ 1470 Trailer_Light_Check_Status 0;
BA_ "GenSigTimeoutTime_DMSM" SG_ 1470 Trailer_Light_Check_Status 0;
BA_ "GenSigTimeoutTime_DTCM" SG_ 1470 Trailer_Light_Check_Status 0;
BA_ "GenSigTimeoutTime_ECM" SG_ 1470 Trailer_Light_Check_Status 0;
BA_ "GenSigTimeoutTime_EVCU2" SG_ 1470 Trailer_Light_Check_Status 0;
BA_ "GenSigTimeoutTime_GNMM" SG_ 1470 Trailer_Light_Check_Status 0;
BA_ "GenSigTimeoutTime_HCP" SG_ 1470 Trailer_Light_Check_Status 0;
BA_ "GenSigTimeoutTime_IPC" SG_ 1470 Trailer_Light_Check_Status 0;
BA_ "GenSigTimeoutTime_RFHM" SG_ 1470 Trailer_Light_Check_Status 0;
BA_ "GenSigTimeoutTime_TCM" SG_ 1470 Trailer_Light_Check_Status 0;
BA_ "GenSigStartValue" SG_ 1470 TrlrStyle_1 1;
BA_ "GenSigSendType" SG_ 1470 TrlrStyle_1 3;
BA_ "GenSigTimeoutTime_AGSM" SG_ 1470 TrlrStyle_1 0;
BA_ "GenSigTimeoutTime_BCM" SG_ 1470 TrlrStyle_1 0;
BA_ "GenSigTimeoutTime_BSM" SG_ 1470 TrlrStyle_1 0;
BA_ "GenSigTimeoutTime_CADM" SG_ 1470 TrlrStyle_1 0;
BA_ "GenSigTimeoutTime_DMSM" SG_ 1470 TrlrStyle_1 0;
BA_ "GenSigTimeoutTime_DTCM" SG_ 1470 TrlrStyle_1 0;
BA_ "GenSigTimeoutTime_ECM" SG_ 1470 TrlrStyle_1 0;
BA_ "GenSigTimeoutTime_EVCU2" SG_ 1470 TrlrStyle_1 0;
BA_ "GenSigTimeoutTime_GNMM" SG_ 1470 TrlrStyle_1 0;
BA_ "GenSigTimeoutTime_HCP" SG_ 1470 TrlrStyle_1 0;
BA_ "GenSigTimeoutTime_RFHM" SG_ 1470 TrlrStyle_1 0;
BA_ "GenSigTimeoutTime_TCM" SG_ 1470 TrlrStyle_1 0;
BA_ "GenSigStartValue" SG_ 1470 TrlrStyle_2 1;
BA_ "GenSigSendType" SG_ 1470 TrlrStyle_2 3;
BA_ "GenSigTimeoutTime_AGSM" SG_ 1470 TrlrStyle_2 0;
BA_ "GenSigTimeoutTime_BCM" SG_ 1470 TrlrStyle_2 0;
BA_ "GenSigTimeoutTime_BSM" SG_ 1470 TrlrStyle_2 0;
BA_ "GenSigTimeoutTime_CADM" SG_ 1470 TrlrStyle_2 0;
BA_ "GenSigTimeoutTime_DMSM" SG_ 1470 TrlrStyle_2 0;
BA_ "GenSigTimeoutTime_DTCM" SG_ 1470 TrlrStyle_2 0;
BA_ "GenSigTimeoutTime_ECM" SG_ 1470 TrlrStyle_2 0;
BA_ "GenSigTimeoutTime_EVCU2" SG_ 1470 TrlrStyle_2 0;
BA_ "GenSigTimeoutTime_GNMM" SG_ 1470 TrlrStyle_2 0;
BA_ "GenSigTimeoutTime_HCP" SG_ 1470 TrlrStyle_2 0;
BA_ "GenSigTimeoutTime_RFHM" SG_ 1470 TrlrStyle_2 0;
BA_ "GenSigTimeoutTime_TCM" SG_ 1470 TrlrStyle_2 0;
BA_ "GenSigStartValue" SG_ 1470 TrlrStyle_3 1;
BA_ "GenSigSendType" SG_ 1470 TrlrStyle_3 3;
BA_ "GenSigTimeoutTime_AGSM" SG_ 1470 TrlrStyle_3 0;
BA_ "GenSigTimeoutTime_BCM" SG_ 1470 TrlrStyle_3 0;
BA_ "GenSigTimeoutTime_BSM" SG_ 1470 TrlrStyle_3 0;
BA_ "GenSigTimeoutTime_CADM" SG_ 1470 TrlrStyle_3 0;
BA_ "GenSigTimeoutTime_DMSM" SG_ 1470 TrlrStyle_3 0;
BA_ "GenSigTimeoutTime_DTCM" SG_ 1470 TrlrStyle_3 0;
BA_ "GenSigTimeoutTime_ECM" SG_ 1470 TrlrStyle_3 0;
BA_ "GenSigTimeoutTime_EVCU2" SG_ 1470 TrlrStyle_3 0;
BA_ "GenSigTimeoutTime_GNMM" SG_ 1470 TrlrStyle_3 0;
BA_ "GenSigTimeoutTime_HCP" SG_ 1470 TrlrStyle_3 0;
BA_ "GenSigTimeoutTime_RFHM" SG_ 1470 TrlrStyle_3 0;
BA_ "GenSigTimeoutTime_TCM" SG_ 1470 TrlrStyle_3 0;
BA_ "GenSigStartValue" SG_ 1470 TrlrStyle_4 1;
BA_ "GenSigSendType" SG_ 1470 TrlrStyle_4 3;
BA_ "GenSigTimeoutTime_AGSM" SG_ 1470 TrlrStyle_4 0;
BA_ "GenSigTimeoutTime_BCM" SG_ 1470 TrlrStyle_4 0;
BA_ "GenSigTimeoutTime_BSM" SG_ 1470 TrlrStyle_4 0;
BA_ "GenSigTimeoutTime_CADM" SG_ 1470 TrlrStyle_4 0;
BA_ "GenSigTimeoutTime_DMSM" SG_ 1470 TrlrStyle_4 0;
BA_ "GenSigTimeoutTime_DTCM" SG_ 1470 TrlrStyle_4 0;
BA_ "GenSigTimeoutTime_ECM" SG_ 1470 TrlrStyle_4 0;
BA_ "GenSigTimeoutTime_EVCU2" SG_ 1470 TrlrStyle_4 0;
BA_ "GenSigTimeoutTime_GNMM" SG_ 1470 TrlrStyle_4 0;
BA_ "GenSigTimeoutTime_HCP" SG_ 1470 TrlrStyle_4 0;
BA_ "GenSigTimeoutTime_RFHM" SG_ 1470 TrlrStyle_4 0;
BA_ "GenSigTimeoutTime_TCM" SG_ 1470 TrlrStyle_4 0;
BA_ "GenSigStartValue" SG_ 1470 TrlrTripDist 16777215;
BA_ "GenSigSendType" SG_ 1470 TrlrTripDist 3;
BA_ "GenSigTimeoutTime_AGSM" SG_ 1470 TrlrTripDist 0;
BA_ "GenSigTimeoutTime_BCM" SG_ 1470 TrlrTripDist 0;
BA_ "GenSigTimeoutTime_BSM" SG_ 1470 TrlrTripDist 0;
BA_ "GenSigTimeoutTime_CADM" SG_ 1470 TrlrTripDist 0;
BA_ "GenSigTimeoutTime_DMSM" SG_ 1470 TrlrTripDist 0;
BA_ "GenSigTimeoutTime_DTCM" SG_ 1470 TrlrTripDist 0;
BA_ "GenSigTimeoutTime_ECM" SG_ 1470 TrlrTripDist 0;
BA_ "GenSigTimeoutTime_EVCU2" SG_ 1470 TrlrTripDist 0;
BA_ "GenSigTimeoutTime_GNMM" SG_ 1470 TrlrTripDist 0;
BA_ "GenSigTimeoutTime_HCP" SG_ 1470 TrlrTripDist 0;
BA_ "GenSigTimeoutTime_RFHM" SG_ 1470 TrlrTripDist 0;
BA_ "GenSigTimeoutTime_TCM" SG_ 1470 TrlrTripDist 0;
BA_ "GenSigSendType" SG_ 1470 UCONREQ_TBM_TrailerLightCheck_FB 3;
BA_ "GenSigTimeoutTime_AGSM" SG_ 1470 UCONREQ_TBM_TrailerLightCheck_FB 0;
BA_ "GenSigTimeoutTime_BCM" SG_ 1470 UCONREQ_TBM_TrailerLightCheck_FB 0;
BA_ "GenSigTimeoutTime_BSM" SG_ 1470 UCONREQ_TBM_TrailerLightCheck_FB 0;
BA_ "GenSigTimeoutTime_CADM" SG_ 1470 UCONREQ_TBM_TrailerLightCheck_FB 0;
BA_ "GenSigTimeoutTime_DMSM" SG_ 1470 UCONREQ_TBM_TrailerLightCheck_FB 0;
BA_ "GenSigTimeoutTime_DTCM" SG_ 1470 UCONREQ_TBM_TrailerLightCheck_FB 0;
BA_ "GenSigTimeoutTime_ECM" SG_ 1470 UCONREQ_TBM_TrailerLightCheck_FB 0;
BA_ "GenSigTimeoutTime_EVCU2" SG_ 1470 UCONREQ_TBM_TrailerLightCheck_FB 0;
BA_ "GenSigTimeoutTime_GNMM" SG_ 1470 UCONREQ_TBM_TrailerLightCheck_FB 0;
BA_ "GenSigTimeoutTime_HCP" SG_ 1470 UCONREQ_TBM_TrailerLightCheck_FB 0;
BA_ "GenSigTimeoutTime_IPC" SG_ 1470 UCONREQ_TBM_TrailerLightCheck_FB 0;
BA_ "GenSigTimeoutTime_RFHM" SG_ 1470 UCONREQ_TBM_TrailerLightCheck_FB 0;
BA_ "GenSigTimeoutTime_TCM" SG_ 1470 UCONREQ_TBM_TrailerLightCheck_FB 0;
BA_ "GenSigTimeoutTime_BCM" SG_ 750 Battery_Volt_1 0;
BA_ "GenSigTimeoutTime_AGSM" SG_ 750 Battery_Volt_2 0;
BA_ "GenSigTimeoutTime_BCM" SG_ 750 Battery_Volt_2 0;
BA_ "GenSigTimeoutTime_CADM" SG_ 750 Battery_Volt_2 0;
BA_ "GenSigTimeoutTime_DMSM" SG_ 750 Battery_Volt_2 0;
BA_ "GenSigTimeoutTime_DTCM" SG_ 750 Battery_Volt_2 0;
BA_ "GenSigTimeoutTime_GNMM" SG_ 750 Battery_Volt_2 0;
BA_ "GenSigTimeoutTime_HCP" SG_ 750 Battery_Volt_2 0;
BA_ "GenSigTimeoutTime_IPC" SG_ 750 Battery_Volt_2 0;
BA_ "GenSigTimeoutTime_RFHM" SG_ 750 Battery_Volt_2 0;
BA_ "GenSigTimeoutTime_TCM" SG_ 750 Battery_Volt_2 0;
BA_ "GenSigTimeoutTime_AGSM" SG_ 750 CRC_BCM3 0;
BA_ "GenSigTimeoutTime_BCM" SG_ 750 CRC_BCM3 0;
BA_ "GenSigTimeoutTime_DTCM" SG_ 750 CRC_BCM3 0;
BA_ "GenSigTimeoutTime_ECM" SG_ 750 CRC_BCM3 0;
BA_ "GenSigTimeoutTime_EVCU2" SG_ 750 CRC_BCM3 0;
BA_ "GenSigTimeoutTime_GNMM" SG_ 750 CRC_BCM3 0;
BA_ "GenSigTimeoutTime_HCP" SG_ 750 CRC_BCM3 0;
BA_ "GenSigTimeoutTime_IPC" SG_ 750 CRC_BCM3 0;
BA_ "GenSigTimeoutTime_RFHM" SG_ 750 CRC_BCM3 0;
BA_ "GenSigTimeoutTime_SGW" SG_ 750 CRC_BCM3 0;
BA_ "GenSigTimeoutTime_AGSM" SG_ 750 FronWiperFailSts 0;
BA_ "GenSigTimeoutTime_BCM" SG_ 750 FronWiperFailSts 0;
BA_ "GenSigTimeoutTime_BSM" SG_ 750 FronWiperFailSts 0;
BA_ "GenSigTimeoutTime_DMSM" SG_ 750 FronWiperFailSts 0;
BA_ "GenSigTimeoutTime_ECM" SG_ 750 FronWiperFailSts 0;
BA_ "GenSigTimeoutTime_EVCU2" SG_ 750 FronWiperFailSts 0;
BA_ "GenSigTimeoutTime_GNMM" SG_ 750 FronWiperFailSts 0;
BA_ "GenSigTimeoutTime_HCP" SG_ 750 FronWiperFailSts 0;
BA_ "GenSigTimeoutTime_IPC" SG_ 750 FronWiperFailSts 0;
BA_ "GenSigTimeoutTime_RFHM" SG_ 750 FronWiperFailSts 0;
BA_ "GenSigTimeoutTime_SGW" SG_ 750 FronWiperFailSts 0;
BA_ "GenSigTimeoutTime_TCM" SG_ 750 FronWiperFailSts 0;
BA_ "GenSigTimeoutTime_AGSM" SG_ 750 MessageCounter_BCM3 0;
BA_ "GenSigTimeoutTime_BCM" SG_ 750 MessageCounter_BCM3 0;
BA_ "GenSigTimeoutTime_DTCM" SG_ 750 MessageCounter_BCM3 0;
BA_ "GenSigTimeoutTime_ECM" SG_ 750 MessageCounter_BCM3 0;
BA_ "GenSigTimeoutTime_EVCU2" SG_ 750 MessageCounter_BCM3 0;
BA_ "GenSigTimeoutTime_GNMM" SG_ 750 MessageCounter_BCM3 0;
BA_ "GenSigTimeoutTime_HCP" SG_ 750 MessageCounter_BCM3 0;
BA_ "GenSigTimeoutTime_IPC" SG_ 750 MessageCounter_BCM3 0;
BA_ "GenSigTimeoutTime_RFHM" SG_ 750 MessageCounter_BCM3 0;
BA_ "GenSigTimeoutTime_SGW" SG_ 750 MessageCounter_BCM3 0;
BA_ "GenSigTimeoutTime_AGSM" SG_ 1051 AM_ECM_Trace 0;
BA_ "GenSigTimeoutTime_BCM" SG_ 1051 AM_ECM_Trace 0;
BA_ "GenSigTimeoutTime_BSM" SG_ 1051 AM_ECM_Trace 0;
BA_ "GenSigTimeoutTime_CADM" SG_ 1051 AM_ECM_Trace 0;
BA_ "GenSigTimeoutTime_DMSM" SG_ 1051 AM_ECM_Trace 0;
BA_ "GenSigTimeoutTime_DTCM" SG_ 1051 AM_ECM_Trace 0;
BA_ "GenSigTimeoutTime_EVCU2" SG_ 1051 AM_ECM_Trace 0;
BA_ "GenSigTimeoutTime_GNMM" SG_ 1051 AM_ECM_Trace 0;
BA_ "GenSigTimeoutTime_HCP" SG_ 1051 AM_ECM_Trace 0;
BA_ "GenSigTimeoutTime_IPC" SG_ 1051 AM_ECM_Trace 0;
BA_ "GenSigTimeoutTime_RFHM" SG_ 1051 AM_ECM_Trace 0;
BA_ "GenSigTimeoutTime_SGW" SG_ 1051 AM_ECM_Trace 0;
BA_ "GenSigTimeoutTime_TCM" SG_ 1051 AM_ECM_Trace 0;
BA_ "GenSigTimeoutTime_AGSM" SG_ 1051 BCMSAMFailSts 0;
BA_ "GenSigTimeoutTime_BCM" SG_ 1051 BCMSAMFailSts 0;
BA_ "GenSigTimeoutTime_BSM" SG_ 1051 BCMSAMFailSts 0;
BA_ "GenSigTimeoutTime_CADM" SG_ 1051 BCMSAMFailSts 0;
BA_ "GenSigTimeoutTime_DMSM" SG_ 1051 BCMSAMFailSts 0;
BA_ "GenSigTimeoutTime_DTCM" SG_ 1051 BCMSAMFailSts 0;
BA_ "GenSigTimeoutTime_EVCU2" SG_ 1051 BCMSAMFailSts 0;
BA_ "GenSigTimeoutTime_GNMM" SG_ 1051 BCMSAMFailSts 0;
BA_ "GenSigTimeoutTime_HCP" SG_ 1051 BCMSAMFailSts 0;
BA_ "GenSigTimeoutTime_IPC" SG_ 1051 BCMSAMFailSts 0;
BA_ "GenSigTimeoutTime_RFHM" SG_ 1051 BCMSAMFailSts 0;
BA_ "GenSigTimeoutTime_SGW" SG_ 1051 BCMSAMFailSts 0;
BA_ "GenSigTimeoutTime_TCM" SG_ 1051 BCMSAMFailSts 0;
BA_ "GenSigTimeoutTime_AGSM" SG_ 1051 CRC_BCM4 0;
BA_ "GenSigTimeoutTime_BCM" SG_ 1051 CRC_BCM4 0;
BA_ "GenSigTimeoutTime_BSM" SG_ 1051 CRC_BCM4 0;
BA_ "GenSigTimeoutTime_CADM" SG_ 1051 CRC_BCM4 0;
BA_ "GenSigTimeoutTime_DMSM" SG_ 1051 CRC_BCM4 0;
BA_ "GenSigTimeoutTime_DTCM" SG_ 1051 CRC_BCM4 0;
BA_ "GenSigTimeoutTime_GNMM" SG_ 1051 CRC_BCM4 0;
BA_ "GenSigTimeoutTime_HCP" SG_ 1051 CRC_BCM4 0;
BA_ "GenSigTimeoutTime_IPC" SG_ 1051 CRC_BCM4 0;
BA_ "GenSigTimeoutTime_RFHM" SG_ 1051 CRC_BCM4 0;
BA_ "GenSigTimeoutTime_SGW" SG_ 1051 CRC_BCM4 0;
BA_ "GenSigTimeoutTime_TCM" SG_ 1051 CRC_BCM4 0;
BA_ "GenSigSendType" SG_ 1051 EVAP_TEMP_P1C 3;
BA_ "GenSigTimeoutTime_AGSM" SG_ 1051 EVAP_TEMP_P1C 0;
BA_ "GenSigTimeoutTime_BCM" SG_ 1051 EVAP_TEMP_P1C 0;
BA_ "GenSigTimeoutTime_BSM" SG_ 1051 EVAP_TEMP_P1C 0;
BA_ "GenSigTimeoutTime_CADM" SG_ 1051 EVAP_TEMP_P1C 0;
BA_ "GenSigTimeoutTime_DMSM" SG_ 1051 EVAP_TEMP_P1C 0;
BA_ "GenSigTimeoutTime_DTCM" SG_ 1051 EVAP_TEMP_P1C 0;
BA_ "GenSigTimeoutTime_ECM" SG_ 1051 EVAP_TEMP_P1C 0;
BA_ "GenSigTimeoutTime_GNMM" SG_ 1051 EVAP_TEMP_P1C 0;
BA_ "GenSigTimeoutTime_HCP" SG_ 1051 EVAP_TEMP_P1C 0;
BA_ "GenSigTimeoutTime_IPC" SG_ 1051 EVAP_TEMP_P1C 0;
BA_ "GenSigTimeoutTime_RFHM" SG_ 1051 EVAP_TEMP_P1C 0;
BA_ "GenSigTimeoutTime_SGW" SG_ 1051 EVAP_TEMP_P1C 0;
BA_ "GenSigTimeoutTime_TCM" SG_ 1051 EVAP_TEMP_P1C 0;
BA_ "GenSigStartValue" SG_ 1051 ExternalTemperatureAD_Voltage 255;
BA_ "GenSigTimeoutTime_AGSM" SG_ 1051 ExternalTemperatureAD_Voltage 0;
BA_ "GenSigTimeoutTime_BCM" SG_ 1051 ExternalTemperatureAD_Voltage 0;
BA_ "GenSigTimeoutTime_BSM" SG_ 1051 ExternalTemperatureAD_Voltage 0;
BA_ "GenSigTimeoutTime_CADM" SG_ 1051 ExternalTemperatureAD_Voltage 0;
BA_ "GenSigTimeoutTime_DMSM" SG_ 1051 ExternalTemperatureAD_Voltage 0;
BA_ "GenSigTimeoutTime_DTCM" SG_ 1051 ExternalTemperatureAD_Voltage 0;
BA_ "GenSigTimeoutTime_GNMM" SG_ 1051 ExternalTemperatureAD_Voltage 0;
BA_ "GenSigTimeoutTime_IPC" SG_ 1051 ExternalTemperatureAD_Voltage 0;
BA_ "GenSigTimeoutTime_RFHM" SG_ 1051 ExternalTemperatureAD_Voltage 0;
BA_ "GenSigTimeoutTime_SGW" SG_ 1051 ExternalTemperatureAD_Voltage 0;
BA_ "GenSigTimeoutTime_TCM" SG_ 1051 ExternalTemperatureAD_Voltage 0;
BA_ "GenSigStartValue" SG_ 1051 FUEL_VOLT 255;
BA_ "GenSigTimeoutTime_AGSM" SG_ 1051 FUEL_VOLT 0;
BA_ "GenSigTimeoutTime_BCM" SG_ 1051 FUEL_VOLT 0;
BA_ "GenSigTimeoutTime_BSM" SG_ 1051 FUEL_VOLT 0;
BA_ "GenSigTimeoutTime_CADM" SG_ 1051 FUEL_VOLT 0;
BA_ "GenSigTimeoutTime_DMSM" SG_ 1051 FUEL_VOLT 0;
BA_ "GenSigTimeoutTime_DTCM" SG_ 1051 FUEL_VOLT 0;
BA_ "GenSigTimeoutTime_EVCU2" SG_ 1051 FUEL_VOLT 0;
BA_ "GenSigTimeoutTime_GNMM" SG_ 1051 FUEL_VOLT 0;
BA_ "GenSigTimeoutTime_HCP" SG_ 1051 FUEL_VOLT 0;
BA_ "GenSigTimeoutTime_IPC" SG_ 1051 FUEL_VOLT 0;
BA_ "GenSigTimeoutTime_RFHM" SG_ 1051 FUEL_VOLT 0;
BA_ "GenSigTimeoutTime_SGW" SG_ 1051 FUEL_VOLT 0;
BA_ "GenSigTimeoutTime_TCM" SG_ 1051 FUEL_VOLT 0;
BA_ "GenSigTimeoutTime_AGSM" SG_ 1051 MessageCounter_BCM4 0;
BA_ "GenSigTimeoutTime_BCM" SG_ 1051 MessageCounter_BCM4 0;
BA_ "GenSigTimeoutTime_BSM" SG_ 1051 MessageCounter_BCM4 0;
BA_ "GenSigTimeoutTime_CADM" SG_ 1051 MessageCounter_BCM4 0;
BA_ "GenSigTimeoutTime_DMSM" SG_ 1051 MessageCounter_BCM4 0;
BA_ "GenSigTimeoutTime_DTCM" SG_ 1051 MessageCounter_BCM4 0;
BA_ "GenSigTimeoutTime_GNMM" SG_ 1051 MessageCounter_BCM4 0;
BA_ "GenSigTimeoutTime_HCP" SG_ 1051 MessageCounter_BCM4 0;
BA_ "GenSigTimeoutTime_IPC" SG_ 1051 MessageCounter_BCM4 0;
BA_ "GenSigTimeoutTime_RFHM" SG_ 1051 MessageCounter_BCM4 0;
BA_ "GenSigTimeoutTime_SGW" SG_ 1051 MessageCounter_BCM4 0;
BA_ "GenSigTimeoutTime_TCM" SG_ 1051 MessageCounter_BCM4 0;
BA_ "GenSigTimeoutTime_AGSM" SG_ 1051 PitchAngle 0;
BA_ "GenSigTimeoutTime_BCM" SG_ 1051 PitchAngle 0;
BA_ "GenSigTimeoutTime_BSM" SG_ 1051 PitchAngle 0;
BA_ "GenSigTimeoutTime_CADM" SG_ 1051 PitchAngle 0;
BA_ "GenSigTimeoutTime_DMSM" SG_ 1051 PitchAngle 0;
BA_ "GenSigTimeoutTime_DTCM" SG_ 1051 PitchAngle 0;
BA_ "GenSigTimeoutTime_ECM" SG_ 1051 PitchAngle 0;
BA_ "GenSigTimeoutTime_EVCU2" SG_ 1051 PitchAngle 0;
BA_ "GenSigTimeoutTime_GNMM" SG_ 1051 PitchAngle 0;
BA_ "GenSigTimeoutTime_HCP" SG_ 1051 PitchAngle 0;
BA_ "GenSigTimeoutTime_RFHM" SG_ 1051 PitchAngle 0;
BA_ "GenSigTimeoutTime_TCM" SG_ 1051 PitchAngle 0;
BA_ "GenSigTimeoutTime_AGSM" SG_ 1051 RollAngle 0;
BA_ "GenSigTimeoutTime_BCM" SG_ 1051 RollAngle 0;
BA_ "GenSigTimeoutTime_BSM" SG_ 1051 RollAngle 0;
BA_ "GenSigTimeoutTime_CADM" SG_ 1051 RollAngle 0;
BA_ "GenSigTimeoutTime_DMSM" SG_ 1051 RollAngle 0;
BA_ "GenSigTimeoutTime_DTCM" SG_ 1051 RollAngle 0;
BA_ "GenSigTimeoutTime_ECM" SG_ 1051 RollAngle 0;
BA_ "GenSigTimeoutTime_EVCU2" SG_ 1051 RollAngle 0;
BA_ "GenSigTimeoutTime_GNMM" SG_ 1051 RollAngle 0;
BA_ "GenSigTimeoutTime_HCP" SG_ 1051 RollAngle 0;
BA_ "GenSigTimeoutTime_RFHM" SG_ 1051 RollAngle 0;
BA_ "GenSigTimeoutTime_TCM" SG_ 1051 RollAngle 0;
BA_ "GenSigTimeoutTime_AGSM" SG_ 1051 VoltageMax 0;
BA_ "GenSigTimeoutTime_BCM" SG_ 1051 VoltageMax 0;
BA_ "GenSigTimeoutTime_BSM" SG_ 1051 VoltageMax 0;
BA_ "GenSigTimeoutTime_CADM" SG_ 1051 VoltageMax 0;
BA_ "GenSigTimeoutTime_DMSM" SG_ 1051 VoltageMax 0;
BA_ "GenSigTimeoutTime_DTCM" SG_ 1051 VoltageMax 0;
BA_ "GenSigTimeoutTime_EVCU2" SG_ 1051 VoltageMax 0;
BA_ "GenSigTimeoutTime_GNMM" SG_ 1051 VoltageMax 0;
BA_ "GenSigTimeoutTime_HCP" SG_ 1051 VoltageMax 0;
BA_ "GenSigTimeoutTime_IPC" SG_ 1051 VoltageMax 0;
BA_ "GenSigTimeoutTime_RFHM" SG_ 1051 VoltageMax 0;
BA_ "GenSigTimeoutTime_SGW" SG_ 1051 VoltageMax 0;
BA_ "GenSigTimeoutTime_TCM" SG_ 1051 VoltageMax 0;
BA_ "GenSigTimeoutTime_AGSM" SG_ 1051 VoltageMin 0;
BA_ "GenSigTimeoutTime_BCM" SG_ 1051 VoltageMin 0;
BA_ "GenSigTimeoutTime_BSM" SG_ 1051 VoltageMin 0;
BA_ "GenSigTimeoutTime_CADM" SG_ 1051 VoltageMin 0;
BA_ "GenSigTimeoutTime_DMSM" SG_ 1051 VoltageMin 0;
BA_ "GenSigTimeoutTime_DTCM" SG_ 1051 VoltageMin 0;
BA_ "GenSigTimeoutTime_EVCU2" SG_ 1051 VoltageMin 0;
BA_ "GenSigTimeoutTime_GNMM" SG_ 1051 VoltageMin 0;
BA_ "GenSigTimeoutTime_HCP" SG_ 1051 VoltageMin 0;
BA_ "GenSigTimeoutTime_IPC" SG_ 1051 VoltageMin 0;
BA_ "GenSigTimeoutTime_RFHM" SG_ 1051 VoltageMin 0;
BA_ "GenSigTimeoutTime_SGW" SG_ 1051 VoltageMin 0;
BA_ "GenSigTimeoutTime_TCM" SG_ 1051 VoltageMin 0;
BA_ "GenSigTimeoutTime_AGSM" SG_ 1375 ChkFuelLevelSts 0;
BA_ "GenSigTimeoutTime_BCM" SG_ 1375 ChkFuelLevelSts 0;
BA_ "GenSigTimeoutTime_BSM" SG_ 1375 ChkFuelLevelSts 0;
BA_ "GenSigTimeoutTime_CADM" SG_ 1375 ChkFuelLevelSts 0;
BA_ "GenSigTimeoutTime_DMSM" SG_ 1375 ChkFuelLevelSts 0;
BA_ "GenSigTimeoutTime_DTCM" SG_ 1375 ChkFuelLevelSts 0;
BA_ "GenSigTimeoutTime_EVCU2" SG_ 1375 ChkFuelLevelSts 0;
BA_ "GenSigTimeoutTime_GNMM" SG_ 1375 ChkFuelLevelSts 0;
BA_ "GenSigTimeoutTime_HCP" SG_ 1375 ChkFuelLevelSts 0;
BA_ "GenSigTimeoutTime_RFHM" SG_ 1375 ChkFuelLevelSts 0;
BA_ "GenSigTimeoutTime_TCM" SG_ 1375 ChkFuelLevelSts 0;
BA_ "GenSigTimeoutTime_AGSM" SG_ 1375 CRC_BCM6 0;
BA_ "GenSigTimeoutTime_BCM" SG_ 1375 CRC_BCM6 0;
BA_ "GenSigTimeoutTime_DMSM" SG_ 1375 CRC_BCM6 0;
BA_ "GenSigTimeoutTime_DTCM" SG_ 1375 CRC_BCM6 0;
BA_ "GenSigTimeoutTime_ECM" SG_ 1375 CRC_BCM6 0;
BA_ "GenSigTimeoutTime_EVCU2" SG_ 1375 CRC_BCM6 0;
BA_ "GenSigTimeoutTime_GNMM" SG_ 1375 CRC_BCM6 0;
BA_ "GenSigTimeoutTime_HCP" SG_ 1375 CRC_BCM6 0;
BA_ "GenSigTimeoutTime_IPC" SG_ 1375 CRC_BCM6 0;
BA_ "GenSigTimeoutTime_RFHM" SG_ 1375 CRC_BCM6 0;
BA_ "GenSigTimeoutTime_SGW" SG_ 1375 CRC_BCM6 0;
BA_ "GenSigTimeoutTime_TCM" SG_ 1375 CRC_BCM6 0;
BA_ "GenSigTimeoutTime_AGSM" SG_ 1375 FrontWiperReq 0;
BA_ "GenSigTimeoutTime_BCM" SG_ 1375 FrontWiperReq 0;
BA_ "GenSigTimeoutTime_DMSM" SG_ 1375 FrontWiperReq 0;
BA_ "GenSigTimeoutTime_ECM" SG_ 1375 FrontWiperReq 0;
BA_ "GenSigTimeoutTime_GNMM" SG_ 1375 FrontWiperReq 0;
BA_ "GenSigTimeoutTime_HCP" SG_ 1375 FrontWiperReq 0;
BA_ "GenSigTimeoutTime_IPC" SG_ 1375 FrontWiperReq 0;
BA_ "GenSigTimeoutTime_RFHM" SG_ 1375 FrontWiperReq 0;
BA_ "GenSigTimeoutTime_TCM" SG_ 1375 FrontWiperReq 0;
BA_ "GenSigTimeoutTime_AGSM" SG_ 1375 MessageCounter_BCM6 0;
BA_ "GenSigTimeoutTime_BCM" SG_ 1375 MessageCounter_BCM6 0;
BA_ "GenSigTimeoutTime_DMSM" SG_ 1375 MessageCounter_BCM6 0;
BA_ "GenSigTimeoutTime_DTCM" SG_ 1375 MessageCounter_BCM6 0;
BA_ "GenSigTimeoutTime_ECM" SG_ 1375 MessageCounter_BCM6 0;
BA_ "GenSigTimeoutTime_EVCU2" SG_ 1375 MessageCounter_BCM6 0;
BA_ "GenSigTimeoutTime_GNMM" SG_ 1375 MessageCounter_BCM6 0;
BA_ "GenSigTimeoutTime_HCP" SG_ 1375 MessageCounter_BCM6 0;
BA_ "GenSigTimeoutTime_IPC" SG_ 1375 MessageCounter_BCM6 0;
BA_ "GenSigTimeoutTime_RFHM" SG_ 1375 MessageCounter_BCM6 0;
BA_ "GenSigTimeoutTime_SGW" SG_ 1375 MessageCounter_BCM6 0;
BA_ "GenSigTimeoutTime_TCM" SG_ 1375 MessageCounter_BCM6 0;
BA_ "GenSigTimeoutTime_AGSM" SG_ 1375 SysEOLSts 0;
BA_ "GenSigTimeoutTime_BCM" SG_ 1375 SysEOLSts 0;
BA_ "GenSigTimeoutTime_BSM" SG_ 1375 SysEOLSts 0;
BA_ "GenSigTimeoutTime_DMSM" SG_ 1375 SysEOLSts 0;
BA_ "GenSigTimeoutTime_DTCM" SG_ 1375 SysEOLSts 0;
BA_ "GenSigTimeoutTime_ECM" SG_ 1375 SysEOLSts 0;
BA_ "GenSigTimeoutTime_EVCU2" SG_ 1375 SysEOLSts 0;
BA_ "GenSigTimeoutTime_GNMM" SG_ 1375 SysEOLSts 0;
BA_ "GenSigTimeoutTime_HCP" SG_ 1375 SysEOLSts 0;
BA_ "GenSigTimeoutTime_RFHM" SG_ 1375 SysEOLSts 0;
BA_ "GenSigTimeoutTime_SGW" SG_ 1375 SysEOLSts 0;
BA_ "GenSigTimeoutTime_TCM" SG_ 1375 SysEOLSts 0;
BA_ "GenSigTimeoutTime_AGSM" SG_ 1827 CRC_BCM7 0;
BA_ "GenSigTimeoutTime_BCM" SG_ 1827 CRC_BCM7 0;
BA_ "GenSigTimeoutTime_DTCM" SG_ 1827 CRC_BCM7 0;
BA_ "GenSigTimeoutTime_ECM" SG_ 1827 CRC_BCM7 0;
BA_ "GenSigTimeoutTime_EVCU2" SG_ 1827 CRC_BCM7 0;
BA_ "GenSigTimeoutTime_GNMM" SG_ 1827 CRC_BCM7 0;
BA_ "GenSigTimeoutTime_HCP" SG_ 1827 CRC_BCM7 0;
BA_ "GenSigTimeoutTime_IPC" SG_ 1827 CRC_BCM7 0;
BA_ "GenSigTimeoutTime_RFHM" SG_ 1827 CRC_BCM7 0;
BA_ "GenSigTimeoutTime_SGW" SG_ 1827 CRC_BCM7 0;
BA_ "GenSigTimeoutTime_BCM" SG_ 1827 IgnitionOnCounter 0;
BA_ "GenSigTimeoutTime_AGSM" SG_ 1827 MessageCounter_BCM7 0;
BA_ "GenSigTimeoutTime_BCM" SG_ 1827 MessageCounter_BCM7 0;
BA_ "GenSigTimeoutTime_DTCM" SG_ 1827 MessageCounter_BCM7 0;
BA_ "GenSigTimeoutTime_ECM" SG_ 1827 MessageCounter_BCM7 0;
BA_ "GenSigTimeoutTime_EVCU2" SG_ 1827 MessageCounter_BCM7 0;
BA_ "GenSigTimeoutTime_GNMM" SG_ 1827 MessageCounter_BCM7 0;
BA_ "GenSigTimeoutTime_HCP" SG_ 1827 MessageCounter_BCM7 0;
BA_ "GenSigTimeoutTime_IPC" SG_ 1827 MessageCounter_BCM7 0;
BA_ "GenSigTimeoutTime_RFHM" SG_ 1827 MessageCounter_BCM7 0;
BA_ "GenSigTimeoutTime_SGW" SG_ 1827 MessageCounter_BCM7 0;
BA_ "GenSigSendType" SG_ 1066 AHBFeature 3;
BA_ "GenSigTimeoutTime_AGSM" SG_ 1066 AHBFeature 0;
BA_ "GenSigTimeoutTime_BCM" SG_ 1066 AHBFeature 0;
BA_ "GenSigTimeoutTime_BSM" SG_ 1066 AHBFeature 0;
BA_ "GenSigTimeoutTime_CADM" SG_ 1066 AHBFeature 0;
BA_ "GenSigTimeoutTime_DMSM" SG_ 1066 AHBFeature 0;
BA_ "GenSigTimeoutTime_DTCM" SG_ 1066 AHBFeature 0;
BA_ "GenSigTimeoutTime_ECM" SG_ 1066 AHBFeature 0;
BA_ "GenSigTimeoutTime_EVCU2" SG_ 1066 AHBFeature 0;
BA_ "GenSigTimeoutTime_GNMM" SG_ 1066 AHBFeature 0;
BA_ "GenSigTimeoutTime_HCP" SG_ 1066 AHBFeature 0;
BA_ "GenSigTimeoutTime_RFHM" SG_ 1066 AHBFeature 0;
BA_ "GenSigTimeoutTime_TCM" SG_ 1066 AHBFeature 0;
BA_ "GenSigSendType" SG_ 1066 BonnetSts 3;
BA_ "GenSigTimeoutTime_AGSM" SG_ 1066 BonnetSts 0;
BA_ "GenSigTimeoutTime_BCM" SG_ 1066 BonnetSts 0;
BA_ "GenSigTimeoutTime_CADM" SG_ 1066 BonnetSts 0;
BA_ "GenSigTimeoutTime_DMSM" SG_ 1066 BonnetSts 0;
BA_ "GenSigTimeoutTime_DTCM" SG_ 1066 BonnetSts 0;
BA_ "GenSigTimeoutTime_ECM" SG_ 1066 BonnetSts 0;
BA_ "GenSigTimeoutTime_GNMM" SG_ 1066 BonnetSts 0;
BA_ "GenSigTimeoutTime_HCP" SG_ 1066 BonnetSts 0;
BA_ "GenSigTimeoutTime_RFHM" SG_ 1066 BonnetSts 0;
BA_ "GenSigTimeoutTime_TCM" SG_ 1066 BonnetSts 0;
BA_ "GenSigTimeoutTime_AGSM" SG_ 1066 BrakeFluidLevelSts 0;
BA_ "GenSigTimeoutTime_BCM" SG_ 1066 BrakeFluidLevelSts 0;
BA_ "GenSigTimeoutTime_CADM" SG_ 1066 BrakeFluidLevelSts 0;
BA_ "GenSigTimeoutTime_DMSM" SG_ 1066 BrakeFluidLevelSts 0;
BA_ "GenSigTimeoutTime_DTCM" SG_ 1066 BrakeFluidLevelSts 0;
BA_ "GenSigTimeoutTime_ECM" SG_ 1066 BrakeFluidLevelSts 0;
BA_ "GenSigTimeoutTime_EVCU2" SG_ 1066 BrakeFluidLevelSts 0;
BA_ "GenSigTimeoutTime_GNMM" SG_ 1066 BrakeFluidLevelSts 0;
BA_ "GenSigTimeoutTime_HCP" SG_ 1066 BrakeFluidLevelSts 0;
BA_ "GenSigTimeoutTime_RFHM" SG_ 1066 BrakeFluidLevelSts 0;
BA_ "GenSigTimeoutTime_TCM" SG_ 1066 BrakeFluidLevelSts 0;
BA_ "GenSigTimeoutTime_AGSM" SG_ 1066 CRC_BCM9 0;
BA_ "GenSigTimeoutTime_BCM" SG_ 1066 CRC_BCM9 0;
BA_ "GenSigTimeoutTime_DMSM" SG_ 1066 CRC_BCM9 0;
BA_ "GenSigTimeoutTime_DTCM" SG_ 1066 CRC_BCM9 0;
BA_ "GenSigTimeoutTime_RFHM" SG_ 1066 CRC_BCM9 0;
BA_ "GenSigTimeoutTime_AGSM" SG_ 1066 DoorLockLastElSts 0;
BA_ "GenSigTimeoutTime_BCM" SG_ 1066 DoorLockLastElSts 0;
BA_ "GenSigTimeoutTime_BSM" SG_ 1066 DoorLockLastElSts 0;
BA_ "GenSigTimeoutTime_CADM" SG_ 1066 DoorLockLastElSts 0;
BA_ "GenSigTimeoutTime_DMSM" SG_ 1066 DoorLockLastElSts 0;
BA_ "GenSigTimeoutTime_DTCM" SG_ 1066 DoorLockLastElSts 0;
BA_ "GenSigTimeoutTime_ECM" SG_ 1066 DoorLockLastElSts 0;
BA_ "GenSigTimeoutTime_GNMM" SG_ 1066 DoorLockLastElSts 0;
BA_ "GenSigTimeoutTime_HCP" SG_ 1066 DoorLockLastElSts 0;
BA_ "GenSigTimeoutTime_IPC" SG_ 1066 DoorLockLastElSts 0;
BA_ "GenSigTimeoutTime_TCM" SG_ 1066 DoorLockLastElSts 0;
BA_ "GenSigSendType" SG_ 1066 DriverDoorSts 3;
BA_ "GenSigTimeoutTime_BCM" SG_ 1066 DriverDoorSts 0;
BA_ "GenSigTimeoutTime_DMSM" SG_ 1066 DriverDoorSts 0;
BA_ "GenSigTimeoutTime_DTCM" SG_ 1066 DriverDoorSts 0;
BA_ "GenSigTimeoutTime_GNMM" SG_ 1066 DriverDoorSts 0;
BA_ "GenSigTimeoutTime_HCP" SG_ 1066 DriverDoorSts 0;
BA_ "GenSigTimeoutTime_AGSM" SG_ 1066 ExternalTemperature 0;
BA_ "GenSigTimeoutTime_BCM" SG_ 1066 ExternalTemperature 0;
BA_ "GenSigTimeoutTime_DMSM" SG_ 1066 ExternalTemperature 0;
BA_ "GenSigTimeoutTime_ECM" SG_ 1066 ExternalTemperature 0;
BA_ "GenSigTimeoutTime_GNMM" SG_ 1066 ExternalTemperature 0;
BA_ "GenSigTimeoutTime_IPC" SG_ 1066 ExternalTemperature 0;
BA_ "GenSigSendType" SG_ 1066 FrontFogLightSts 3;
BA_ "GenSigTimeoutTime_AGSM" SG_ 1066 FrontFogLightSts 0;
BA_ "GenSigTimeoutTime_BCM" SG_ 1066 FrontFogLightSts 0;
BA_ "GenSigTimeoutTime_BSM" SG_ 1066 FrontFogLightSts 0;
BA_ "GenSigTimeoutTime_CADM" SG_ 1066 FrontFogLightSts 0;
BA_ "GenSigTimeoutTime_DMSM" SG_ 1066 FrontFogLightSts 0;
BA_ "GenSigTimeoutTime_DTCM" SG_ 1066 FrontFogLightSts 0;
BA_ "GenSigTimeoutTime_ECM" SG_ 1066 FrontFogLightSts 0;
BA_ "GenSigTimeoutTime_EVCU2" SG_ 1066 FrontFogLightSts 0;
BA_ "GenSigTimeoutTime_GNMM" SG_ 1066 FrontFogLightSts 0;
BA_ "GenSigTimeoutTime_HCP" SG_ 1066 FrontFogLightSts 0;
BA_ "GenSigTimeoutTime_RFHM" SG_ 1066 FrontFogLightSts 0;
BA_ "GenSigTimeoutTime_TCM" SG_ 1066 FrontFogLightSts 0;
BA_ "GenSigTimeoutTime_AGSM" SG_ 1066 FrontWiperMoveSts 0;
BA_ "GenSigTimeoutTime_BCM" SG_ 1066 FrontWiperMoveSts 0;
BA_ "GenSigTimeoutTime_BSM" SG_ 1066 FrontWiperMoveSts 0;
BA_ "GenSigTimeoutTime_DMSM" SG_ 1066 FrontWiperMoveSts 0;
BA_ "GenSigTimeoutTime_GNMM" SG_ 1066 FrontWiperMoveSts 0;
BA_ "GenSigTimeoutTime_HCP" SG_ 1066 FrontWiperMoveSts 0;
BA_ "GenSigTimeoutTime_IPC" SG_ 1066 FrontWiperMoveSts 0;
BA_ "GenSigTimeoutTime_RFHM" SG_ 1066 FrontWiperMoveSts 0;
BA_ "GenSigTimeoutTime_SGW" SG_ 1066 FrontWiperMoveSts 0;
BA_ "GenSigTimeoutTime_TCM" SG_ 1066 FrontWiperMoveSts 0;
BA_ "GenSigTimeoutTime_AGSM" SG_ 1066 FuelLevel2 0;
BA_ "GenSigTimeoutTime_BCM" SG_ 1066 FuelLevel2 0;
BA_ "GenSigTimeoutTime_BSM" SG_ 1066 FuelLevel2 0;
BA_ "GenSigTimeoutTime_CADM" SG_ 1066 FuelLevel2 0;
BA_ "GenSigTimeoutTime_DMSM" SG_ 1066 FuelLevel2 0;
BA_ "GenSigTimeoutTime_DTCM" SG_ 1066 FuelLevel2 0;
BA_ "GenSigTimeoutTime_GNMM" SG_ 1066 FuelLevel2 0;
BA_ "GenSigTimeoutTime_HCP" SG_ 1066 FuelLevel2 0;
BA_ "GenSigTimeoutTime_RFHM" SG_ 1066 FuelLevel2 0;
BA_ "GenSigTimeoutTime_TCM" SG_ 1066 FuelLevel2 0;
BA_ "GenSigSendType" SG_ 1066 HDCFnRqstSts 3;
BA_ "GenSigTimeoutTime_AGSM" SG_ 1066 HDCFnRqstSts 0;
BA_ "GenSigTimeoutTime_BCM" SG_ 1066 HDCFnRqstSts 0;
BA_ "GenSigTimeoutTime_DMSM" SG_ 1066 HDCFnRqstSts 0;
BA_ "GenSigTimeoutTime_DTCM" SG_ 1066 HDCFnRqstSts 0;
BA_ "GenSigTimeoutTime_ECM" SG_ 1066 HDCFnRqstSts 0;
BA_ "GenSigTimeoutTime_EVCU2" SG_ 1066 HDCFnRqstSts 0;
BA_ "GenSigTimeoutTime_GNMM" SG_ 1066 HDCFnRqstSts 0;
BA_ "GenSigTimeoutTime_HCP" SG_ 1066 HDCFnRqstSts 0;
BA_ "GenSigTimeoutTime_IPC" SG_ 1066 HDCFnRqstSts 0;
BA_ "GenSigTimeoutTime_RFHM" SG_ 1066 HDCFnRqstSts 0;
BA_ "GenSigTimeoutTime_SGW" SG_ 1066 HDCFnRqstSts 0;
BA_ "GenSigTimeoutTime_TCM" SG_ 1066 HDCFnRqstSts 0;
BA_ "GenSigSendType" SG_ 1066 HighBeamSts 3;
BA_ "GenSigTimeoutTime_AGSM" SG_ 1066 HighBeamSts 0;
BA_ "GenSigTimeoutTime_BCM" SG_ 1066 HighBeamSts 0;
BA_ "GenSigTimeoutTime_BSM" SG_ 1066 HighBeamSts 0;
BA_ "GenSigTimeoutTime_DMSM" SG_ 1066 HighBeamSts 0;
BA_ "GenSigTimeoutTime_DTCM" SG_ 1066 HighBeamSts 0;
BA_ "GenSigTimeoutTime_ECM" SG_ 1066 HighBeamSts 0;
BA_ "GenSigTimeoutTime_EVCU2" SG_ 1066 HighBeamSts 0;
BA_ "GenSigTimeoutTime_GNMM" SG_ 1066 HighBeamSts 0;
BA_ "GenSigTimeoutTime_HCP" SG_ 1066 HighBeamSts 0;
BA_ "GenSigTimeoutTime_RFHM" SG_ 1066 HighBeamSts 0;
BA_ "GenSigTimeoutTime_TCM" SG_ 1066 HighBeamSts 0;
BA_ "GenSigSendType" SG_ 1066 LHParkingLightSts 3;
BA_ "GenSigTimeoutTime_AGSM" SG_ 1066 LHParkingLightSts 0;
BA_ "GenSigTimeoutTime_BCM" SG_ 1066 LHParkingLightSts 0;
BA_ "GenSigTimeoutTime_BSM" SG_ 1066 LHParkingLightSts 0;
BA_ "GenSigTimeoutTime_CADM" SG_ 1066 LHParkingLightSts 0;
BA_ "GenSigTimeoutTime_DMSM" SG_ 1066 LHParkingLightSts 0;
BA_ "GenSigTimeoutTime_DTCM" SG_ 1066 LHParkingLightSts 0;
BA_ "GenSigTimeoutTime_ECM" SG_ 1066 LHParkingLightSts 0;
BA_ "GenSigTimeoutTime_EVCU2" SG_ 1066 LHParkingLightSts 0;
BA_ "GenSigTimeoutTime_GNMM" SG_ 1066 LHParkingLightSts 0;
BA_ "GenSigTimeoutTime_HCP" SG_ 1066 LHParkingLightSts 0;
BA_ "GenSigTimeoutTime_RFHM" SG_ 1066 LHParkingLightSts 0;
BA_ "GenSigTimeoutTime_TCM" SG_ 1066 LHParkingLightSts 0;
BA_ "GenSigSendType" SG_ 1066 LHRDoorSts 3;
BA_ "GenSigTimeoutTime_AGSM" SG_ 1066 LHRDoorSts 0;
BA_ "GenSigTimeoutTime_BCM" SG_ 1066 LHRDoorSts 0;
BA_ "GenSigTimeoutTime_BSM" SG_ 1066 LHRDoorSts 0;
BA_ "GenSigTimeoutTime_CADM" SG_ 1066 LHRDoorSts 0;
BA_ "GenSigTimeoutTime_DMSM" SG_ 1066 LHRDoorSts 0;
BA_ "GenSigTimeoutTime_DTCM" SG_ 1066 LHRDoorSts 0;
BA_ "GenSigTimeoutTime_ECM" SG_ 1066 LHRDoorSts 0;
BA_ "GenSigTimeoutTime_EVCU2" SG_ 1066 LHRDoorSts 0;
BA_ "GenSigTimeoutTime_GNMM" SG_ 1066 LHRDoorSts 0;
BA_ "GenSigTimeoutTime_HCP" SG_ 1066 LHRDoorSts 0;
BA_ "GenSigTimeoutTime_TCM" SG_ 1066 LHRDoorSts 0;
BA_ "GenSigSendType" SG_ 1066 LHTurnSignalSts 3;
BA_ "GenSigTimeoutTime_AGSM" SG_ 1066 LHTurnSignalSts 0;
BA_ "GenSigTimeoutTime_BCM" SG_ 1066 LHTurnSignalSts 0;
BA_ "GenSigTimeoutTime_BSM" SG_ 1066 LHTurnSignalSts 0;
BA_ "GenSigTimeoutTime_CADM" SG_ 1066 LHTurnSignalSts 0;
BA_ "GenSigTimeoutTime_DMSM" SG_ 1066 LHTurnSignalSts 0;
BA_ "GenSigTimeoutTime_DTCM" SG_ 1066 LHTurnSignalSts 0;
BA_ "GenSigTimeoutTime_ECM" SG_ 1066 LHTurnSignalSts 0;
BA_ "GenSigTimeoutTime_EVCU2" SG_ 1066 LHTurnSignalSts 0;
BA_ "GenSigTimeoutTime_GNMM" SG_ 1066 LHTurnSignalSts 0;
BA_ "GenSigTimeoutTime_HCP" SG_ 1066 LHTurnSignalSts 0;
BA_ "GenSigTimeoutTime_IPC" SG_ 1066 LHTurnSignalSts 0;
BA_ "GenSigTimeoutTime_RFHM" SG_ 1066 LHTurnSignalSts 0;
BA_ "GenSigTimeoutTime_TCM" SG_ 1066 LHTurnSignalSts 0;
BA_ "GenSigSendType" SG_ 1066 LnchCtrl_FnRqstSts 3;
BA_ "GenSigTimeoutTime_AGSM" SG_ 1066 LnchCtrl_FnRqstSts 0;
BA_ "GenSigTimeoutTime_BCM" SG_ 1066 LnchCtrl_FnRqstSts 0;
BA_ "GenSigTimeoutTime_CADM" SG_ 1066 LnchCtrl_FnRqstSts 0;
BA_ "GenSigTimeoutTime_DMSM" SG_ 1066 LnchCtrl_FnRqstSts 0;
BA_ "GenSigTimeoutTime_DTCM" SG_ 1066 LnchCtrl_FnRqstSts 0;
BA_ "GenSigTimeoutTime_ECM" SG_ 1066 LnchCtrl_FnRqstSts 0;
BA_ "GenSigTimeoutTime_EVCU2" SG_ 1066 LnchCtrl_FnRqstSts 0;
BA_ "GenSigTimeoutTime_GNMM" SG_ 1066 LnchCtrl_FnRqstSts 0;
BA_ "GenSigTimeoutTime_HCP" SG_ 1066 LnchCtrl_FnRqstSts 0;
BA_ "GenSigTimeoutTime_IPC" SG_ 1066 LnchCtrl_FnRqstSts 0;
BA_ "GenSigTimeoutTime_RFHM" SG_ 1066 LnchCtrl_FnRqstSts 0;
BA_ "GenSigTimeoutTime_SGW" SG_ 1066 LnchCtrl_FnRqstSts 0;
BA_ "GenSigTimeoutTime_TCM" SG_ 1066 LnchCtrl_FnRqstSts 0;
BA_ "GenSigTimeoutTime_AGSM" SG_ 1066 LowBeamSts 0;
BA_ "GenSigTimeoutTime_BCM" SG_ 1066 LowBeamSts 0;
BA_ "GenSigTimeoutTime_BSM" SG_ 1066 LowBeamSts 0;
BA_ "GenSigTimeoutTime_DMSM" SG_ 1066 LowBeamSts 0;
BA_ "GenSigTimeoutTime_DTCM" SG_ 1066 LowBeamSts 0;
BA_ "GenSigTimeoutTime_ECM" SG_ 1066 LowBeamSts 0;
BA_ "GenSigTimeoutTime_EVCU2" SG_ 1066 LowBeamSts 0;
BA_ "GenSigTimeoutTime_GNMM" SG_ 1066 LowBeamSts 0;
BA_ "GenSigTimeoutTime_HCP" SG_ 1066 LowBeamSts 0;
BA_ "GenSigTimeoutTime_IPC" SG_ 1066 LowBeamSts 0;
BA_ "GenSigTimeoutTime_RFHM" SG_ 1066 LowBeamSts 0;
BA_ "GenSigTimeoutTime_TCM" SG_ 1066 LowBeamSts 0;
BA_ "GenSigSendType" SG_ 1066 LowFuelWarningSts 3;
BA_ "GenSigTimeoutTime_AGSM" SG_ 1066 LowFuelWarningSts 0;
BA_ "GenSigTimeoutTime_BCM" SG_ 1066 LowFuelWarningSts 0;
BA_ "GenSigTimeoutTime_BSM" SG_ 1066 LowFuelWarningSts 0;
BA_ "GenSigTimeoutTime_CADM" SG_ 1066 LowFuelWarningSts 0;
BA_ "GenSigTimeoutTime_DMSM" SG_ 1066 LowFuelWarningSts 0;
BA_ "GenSigTimeoutTime_DTCM" SG_ 1066 LowFuelWarningSts 0;
BA_ "GenSigTimeoutTime_GNMM" SG_ 1066 LowFuelWarningSts 0;
BA_ "GenSigTimeoutTime_HCP" SG_ 1066 LowFuelWarningSts 0;
BA_ "GenSigTimeoutTime_RFHM" SG_ 1066 LowFuelWarningSts 0;
BA_ "GenSigTimeoutTime_TCM" SG_ 1066 LowFuelWarningSts 0;
BA_ "GenSigTimeoutTime_AGSM" SG_ 1066 MessageCounter_BCM9 0;
BA_ "GenSigTimeoutTime_BCM" SG_ 1066 MessageCounter_BCM9 0;
BA_ "GenSigTimeoutTime_DMSM" SG_ 1066 MessageCounter_BCM9 0;
BA_ "GenSigTimeoutTime_DTCM" SG_ 1066 MessageCounter_BCM9 0;
BA_ "GenSigTimeoutTime_RFHM" SG_ 1066 MessageCounter_BCM9 0;
BA_ "GenSigSendType" SG_ 1066 ParkBrakeSts 3;
BA_ "GenSigTimeoutTime_AGSM" SG_ 1066 ParkBrakeSts 0;
BA_ "GenSigTimeoutTime_BCM" SG_ 1066 ParkBrakeSts 0;
BA_ "GenSigTimeoutTime_BSM" SG_ 1066 ParkBrakeSts 0;
BA_ "GenSigTimeoutTime_CADM" SG_ 1066 ParkBrakeSts 0;
BA_ "GenSigTimeoutTime_DMSM" SG_ 1066 ParkBrakeSts 0;
BA_ "GenSigTimeoutTime_DTCM" SG_ 1066 ParkBrakeSts 0;
BA_ "GenSigTimeoutTime_ECM" SG_ 1066 ParkBrakeSts 0;
BA_ "GenSigTimeoutTime_EVCU2" SG_ 1066 ParkBrakeSts 0;
BA_ "GenSigTimeoutTime_GNMM" SG_ 1066 ParkBrakeSts 0;
BA_ "GenSigTimeoutTime_HCP" SG_ 1066 ParkBrakeSts 0;
BA_ "GenSigTimeoutTime_IPC" SG_ 1066 ParkBrakeSts 0;
BA_ "GenSigTimeoutTime_RFHM" SG_ 1066 ParkBrakeSts 0;
BA_ "GenSigTimeoutTime_TCM" SG_ 1066 ParkBrakeSts 0;
BA_ "GenSigTimeoutTime_AGSM" SG_ 1066 PowerModeSts 0;
BA_ "GenSigTimeoutTime_BCM" SG_ 1066 PowerModeSts 0;
BA_ "GenSigTimeoutTime_DMSM" SG_ 1066 PowerModeSts 0;
BA_ "GenSigTimeoutTime_DTCM" SG_ 1066 PowerModeSts 0;
BA_ "GenSigTimeoutTime_HCP" SG_ 1066 PowerModeSts 0;
BA_ "GenSigTimeoutTime_TCM" SG_ 1066 PowerModeSts 0;
BA_ "GenSigSendType" SG_ 1066 PowerPanelMsg 3;
BA_ "GenSigTimeoutTime_AGSM" SG_ 1066 PowerPanelMsg 0;
BA_ "GenSigTimeoutTime_BCM" SG_ 1066 PowerPanelMsg 0;
BA_ "GenSigTimeoutTime_BSM" SG_ 1066 PowerPanelMsg 0;
BA_ "GenSigTimeoutTime_CADM" SG_ 1066 PowerPanelMsg 0;
BA_ "GenSigTimeoutTime_DMSM" SG_ 1066 PowerPanelMsg 0;
BA_ "GenSigTimeoutTime_DTCM" SG_ 1066 PowerPanelMsg 0;
BA_ "GenSigTimeoutTime_ECM" SG_ 1066 PowerPanelMsg 0;
BA_ "GenSigTimeoutTime_EVCU2" SG_ 1066 PowerPanelMsg 0;
BA_ "GenSigTimeoutTime_GNMM" SG_ 1066 PowerPanelMsg 0;
BA_ "GenSigTimeoutTime_HCP" SG_ 1066 PowerPanelMsg 0;
BA_ "GenSigTimeoutTime_IPC" SG_ 1066 PowerPanelMsg 0;
BA_ "GenSigTimeoutTime_RFHM" SG_ 1066 PowerPanelMsg 0;
BA_ "GenSigTimeoutTime_TCM" SG_ 1066 PowerPanelMsg 0;
BA_ "GenSigSendType" SG_ 1066 PsngrDoorSts 3;
BA_ "GenSigTimeoutTime_AGSM" SG_ 1066 PsngrDoorSts 0;
BA_ "GenSigTimeoutTime_BCM" SG_ 1066 PsngrDoorSts 0;
BA_ "GenSigTimeoutTime_BSM" SG_ 1066 PsngrDoorSts 0;
BA_ "GenSigTimeoutTime_CADM" SG_ 1066 PsngrDoorSts 0;
BA_ "GenSigTimeoutTime_DMSM" SG_ 1066 PsngrDoorSts 0;
BA_ "GenSigTimeoutTime_DTCM" SG_ 1066 PsngrDoorSts 0;
BA_ "GenSigTimeoutTime_ECM" SG_ 1066 PsngrDoorSts 0;
BA_ "GenSigTimeoutTime_EVCU2" SG_ 1066 PsngrDoorSts 0;
BA_ "GenSigTimeoutTime_GNMM" SG_ 1066 PsngrDoorSts 0;
BA_ "GenSigTimeoutTime_HCP" SG_ 1066 PsngrDoorSts 0;
BA_ "GenSigTimeoutTime_TCM" SG_ 1066 PsngrDoorSts 0;
BA_ "GenSigTimeoutTime_AGSM" SG_ 1066 RainSensorFailSts 0;
BA_ "GenSigTimeoutTime_BCM" SG_ 1066 RainSensorFailSts 0;
BA_ "GenSigTimeoutTime_BSM" SG_ 1066 RainSensorFailSts 0;
BA_ "GenSigTimeoutTime_CADM" SG_ 1066 RainSensorFailSts 0;
BA_ "GenSigTimeoutTime_DMSM" SG_ 1066 RainSensorFailSts 0;
BA_ "GenSigTimeoutTime_DTCM" SG_ 1066 RainSensorFailSts 0;
BA_ "GenSigTimeoutTime_ECM" SG_ 1066 RainSensorFailSts 0;
BA_ "GenSigTimeoutTime_EVCU2" SG_ 1066 RainSensorFailSts 0;
BA_ "GenSigTimeoutTime_GNMM" SG_ 1066 RainSensorFailSts 0;
BA_ "GenSigTimeoutTime_HCP" SG_ 1066 RainSensorFailSts 0;
BA_ "GenSigTimeoutTime_RFHM" SG_ 1066 RainSensorFailSts 0;
BA_ "GenSigTimeoutTime_SGW" SG_ 1066 RainSensorFailSts 0;
BA_ "GenSigTimeoutTime_TCM" SG_ 1066 RainSensorFailSts 0;
BA_ "GenSigSendType" SG_ 1066 RearFogLightFault 3;
BA_ "GenSigTimeoutTime_AGSM" SG_ 1066 RearFogLightFault 0;
BA_ "GenSigTimeoutTime_BCM" SG_ 1066 RearFogLightFault 0;
BA_ "GenSigTimeoutTime_BSM" SG_ 1066 RearFogLightFault 0;
BA_ "GenSigTimeoutTime_CADM" SG_ 1066 RearFogLightFault 0;
BA_ "GenSigTimeoutTime_DMSM" SG_ 1066 RearFogLightFault 0;
BA_ "GenSigTimeoutTime_DTCM" SG_ 1066 RearFogLightFault 0;
BA_ "GenSigTimeoutTime_ECM" SG_ 1066 RearFogLightFault 0;
BA_ "GenSigTimeoutTime_EVCU2" SG_ 1066 RearFogLightFault 0;
BA_ "GenSigTimeoutTime_GNMM" SG_ 1066 RearFogLightFault 0;
BA_ "GenSigTimeoutTime_HCP" SG_ 1066 RearFogLightFault 0;
BA_ "GenSigTimeoutTime_RFHM" SG_ 1066 RearFogLightFault 0;
BA_ "GenSigTimeoutTime_SGW" SG_ 1066 RearFogLightFault 0;
BA_ "GenSigTimeoutTime_TCM" SG_ 1066 RearFogLightFault 0;
BA_ "GenSigSendType" SG_ 1066 RearFogLightSts 3;
BA_ "GenSigTimeoutTime_AGSM" SG_ 1066 RearFogLightSts 0;
BA_ "GenSigTimeoutTime_BCM" SG_ 1066 RearFogLightSts 0;
BA_ "GenSigTimeoutTime_BSM" SG_ 1066 RearFogLightSts 0;
BA_ "GenSigTimeoutTime_CADM" SG_ 1066 RearFogLightSts 0;
BA_ "GenSigTimeoutTime_DMSM" SG_ 1066 RearFogLightSts 0;
BA_ "GenSigTimeoutTime_DTCM" SG_ 1066 RearFogLightSts 0;
BA_ "GenSigTimeoutTime_ECM" SG_ 1066 RearFogLightSts 0;
BA_ "GenSigTimeoutTime_EVCU2" SG_ 1066 RearFogLightSts 0;
BA_ "GenSigTimeoutTime_GNMM" SG_ 1066 RearFogLightSts 0;
BA_ "GenSigTimeoutTime_HCP" SG_ 1066 RearFogLightSts 0;
BA_ "GenSigTimeoutTime_RFHM" SG_ 1066 RearFogLightSts 0;
BA_ "GenSigTimeoutTime_TCM" SG_ 1066 RearFogLightSts 0;
BA_ "GenSigTimeoutTime_AGSM" SG_ 1066 RearTrunkEnableLastElSts 0;
BA_ "GenSigTimeoutTime_BCM" SG_ 1066 RearTrunkEnableLastElSts 0;
BA_ "GenSigTimeoutTime_BSM" SG_ 1066 RearTrunkEnableLastElSts 0;
BA_ "GenSigTimeoutTime_CADM" SG_ 1066 RearTrunkEnableLastElSts 0;
BA_ "GenSigTimeoutTime_DMSM" SG_ 1066 RearTrunkEnableLastElSts 0;
BA_ "GenSigTimeoutTime_DTCM" SG_ 1066 RearTrunkEnableLastElSts 0;
BA_ "GenSigTimeoutTime_ECM" SG_ 1066 RearTrunkEnableLastElSts 0;
BA_ "GenSigTimeoutTime_EVCU2" SG_ 1066 RearTrunkEnableLastElSts 0;
BA_ "GenSigTimeoutTime_GNMM" SG_ 1066 RearTrunkEnableLastElSts 0;
BA_ "GenSigTimeoutTime_HCP" SG_ 1066 RearTrunkEnableLastElSts 0;
BA_ "GenSigTimeoutTime_IPC" SG_ 1066 RearTrunkEnableLastElSts 0;
BA_ "GenSigTimeoutTime_RFHM" SG_ 1066 RearTrunkEnableLastElSts 0;
BA_ "GenSigTimeoutTime_TCM" SG_ 1066 RearTrunkEnableLastElSts 0;
BA_ "GenSigSendType" SG_ 1066 RHatchSts 3;
BA_ "GenSigTimeoutTime_AGSM" SG_ 1066 RHatchSts 0;
BA_ "GenSigTimeoutTime_BCM" SG_ 1066 RHatchSts 0;
BA_ "GenSigTimeoutTime_BSM" SG_ 1066 RHatchSts 0;
BA_ "GenSigTimeoutTime_CADM" SG_ 1066 RHatchSts 0;
BA_ "GenSigTimeoutTime_DMSM" SG_ 1066 RHatchSts 0;
BA_ "GenSigTimeoutTime_DTCM" SG_ 1066 RHatchSts 0;
BA_ "GenSigTimeoutTime_ECM" SG_ 1066 RHatchSts 0;
BA_ "GenSigTimeoutTime_GNMM" SG_ 1066 RHatchSts 0;
BA_ "GenSigTimeoutTime_HCP" SG_ 1066 RHatchSts 0;
BA_ "GenSigTimeoutTime_TCM" SG_ 1066 RHatchSts 0;
BA_ "GenSigSendType" SG_ 1066 RHParkingLightSts 3;
BA_ "GenSigTimeoutTime_AGSM" SG_ 1066 RHParkingLightSts 0;
BA_ "GenSigTimeoutTime_BCM" SG_ 1066 RHParkingLightSts 0;
BA_ "GenSigTimeoutTime_BSM" SG_ 1066 RHParkingLightSts 0;
BA_ "GenSigTimeoutTime_CADM" SG_ 1066 RHParkingLightSts 0;
BA_ "GenSigTimeoutTime_DMSM" SG_ 1066 RHParkingLightSts 0;
BA_ "GenSigTimeoutTime_DTCM" SG_ 1066 RHParkingLightSts 0;
BA_ "GenSigTimeoutTime_ECM" SG_ 1066 RHParkingLightSts 0;
BA_ "GenSigTimeoutTime_EVCU2" SG_ 1066 RHParkingLightSts 0;
BA_ "GenSigTimeoutTime_GNMM" SG_ 1066 RHParkingLightSts 0;
BA_ "GenSigTimeoutTime_HCP" SG_ 1066 RHParkingLightSts 0;
BA_ "GenSigTimeoutTime_RFHM" SG_ 1066 RHParkingLightSts 0;
BA_ "GenSigTimeoutTime_TCM" SG_ 1066 RHParkingLightSts 0;
BA_ "GenSigSendType" SG_ 1066 RHRDoorSts 3;
BA_ "GenSigTimeoutTime_AGSM" SG_ 1066 RHRDoorSts 0;
BA_ "GenSigTimeoutTime_BCM" SG_ 1066 RHRDoorSts 0;
BA_ "GenSigTimeoutTime_BSM" SG_ 1066 RHRDoorSts 0;
BA_ "GenSigTimeoutTime_CADM" SG_ 1066 RHRDoorSts 0;
BA_ "GenSigTimeoutTime_DMSM" SG_ 1066 RHRDoorSts 0;
BA_ "GenSigTimeoutTime_DTCM" SG_ 1066 RHRDoorSts 0;
BA_ "GenSigTimeoutTime_ECM" SG_ 1066 RHRDoorSts 0;
BA_ "GenSigTimeoutTime_EVCU2" SG_ 1066 RHRDoorSts 0;
BA_ "GenSigTimeoutTime_GNMM" SG_ 1066 RHRDoorSts 0;
BA_ "GenSigTimeoutTime_HCP" SG_ 1066 RHRDoorSts 0;
BA_ "GenSigTimeoutTime_TCM" SG_ 1066 RHRDoorSts 0;
BA_ "GenSigSendType" SG_ 1066 RHTurnSignalSts 3;
BA_ "GenSigTimeoutTime_AGSM" SG_ 1066 RHTurnSignalSts 0;
BA_ "GenSigTimeoutTime_BCM" SG_ 1066 RHTurnSignalSts 0;
BA_ "GenSigTimeoutTime_BSM" SG_ 1066 RHTurnSignalSts 0;
BA_ "GenSigTimeoutTime_CADM" SG_ 1066 RHTurnSignalSts 0;
BA_ "GenSigTimeoutTime_DMSM" SG_ 1066 RHTurnSignalSts 0;
BA_ "GenSigTimeoutTime_DTCM" SG_ 1066 RHTurnSignalSts 0;
BA_ "GenSigTimeoutTime_ECM" SG_ 1066 RHTurnSignalSts 0;
BA_ "GenSigTimeoutTime_EVCU2" SG_ 1066 RHTurnSignalSts 0;
BA_ "GenSigTimeoutTime_GNMM" SG_ 1066 RHTurnSignalSts 0;
BA_ "GenSigTimeoutTime_HCP" SG_ 1066 RHTurnSignalSts 0;
BA_ "GenSigTimeoutTime_IPC" SG_ 1066 RHTurnSignalSts 0;
BA_ "GenSigTimeoutTime_RFHM" SG_ 1066 RHTurnSignalSts 0;
BA_ "GenSigTimeoutTime_TCM" SG_ 1066 RHTurnSignalSts 0;
BA_ "GenSigTimeoutTime_AGSM" SG_ 1066 StopLightFault 0;
BA_ "GenSigTimeoutTime_BCM" SG_ 1066 StopLightFault 0;
BA_ "GenSigTimeoutTime_BSM" SG_ 1066 StopLightFault 0;
BA_ "GenSigTimeoutTime_DMSM" SG_ 1066 StopLightFault 0;
BA_ "GenSigTimeoutTime_DTCM" SG_ 1066 StopLightFault 0;
BA_ "GenSigTimeoutTime_ECM" SG_ 1066 StopLightFault 0;
BA_ "GenSigTimeoutTime_EVCU2" SG_ 1066 StopLightFault 0;
BA_ "GenSigTimeoutTime_GNMM" SG_ 1066 StopLightFault 0;
BA_ "GenSigTimeoutTime_HCP" SG_ 1066 StopLightFault 0;
BA_ "GenSigTimeoutTime_IPC" SG_ 1066 StopLightFault 0;
BA_ "GenSigTimeoutTime_RFHM" SG_ 1066 StopLightFault 0;
BA_ "GenSigTimeoutTime_TCM" SG_ 1066 StopLightFault 0;
BA_ "GenSigSendType" SG_ 1066 StopLightSts 3;
BA_ "GenSigTimeoutTime_AGSM" SG_ 1066 StopLightSts 0;
BA_ "GenSigTimeoutTime_BCM" SG_ 1066 StopLightSts 0;
BA_ "GenSigTimeoutTime_BSM" SG_ 1066 StopLightSts 0;
BA_ "GenSigTimeoutTime_CADM" SG_ 1066 StopLightSts 0;
BA_ "GenSigTimeoutTime_DMSM" SG_ 1066 StopLightSts 0;
BA_ "GenSigTimeoutTime_DTCM" SG_ 1066 StopLightSts 0;
BA_ "GenSigTimeoutTime_ECM" SG_ 1066 StopLightSts 0;
BA_ "GenSigTimeoutTime_EVCU2" SG_ 1066 StopLightSts 0;
BA_ "GenSigTimeoutTime_GNMM" SG_ 1066 StopLightSts 0;
BA_ "GenSigTimeoutTime_HCP" SG_ 1066 StopLightSts 0;
BA_ "GenSigTimeoutTime_IPC" SG_ 1066 StopLightSts 0;
BA_ "GenSigTimeoutTime_RFHM" SG_ 1066 StopLightSts 0;
BA_ "GenSigTimeoutTime_TCM" SG_ 1066 StopLightSts 0;
BA_ "GenSigSendType" SG_ 1066 TheftAlarmStatus 3;
BA_ "GenSigTimeoutTime_AGSM" SG_ 1066 TheftAlarmStatus 0;
BA_ "GenSigTimeoutTime_BCM" SG_ 1066 TheftAlarmStatus 0;
BA_ "GenSigTimeoutTime_BSM" SG_ 1066 TheftAlarmStatus 0;
BA_ "GenSigTimeoutTime_CADM" SG_ 1066 TheftAlarmStatus 0;
BA_ "GenSigTimeoutTime_DMSM" SG_ 1066 TheftAlarmStatus 0;
BA_ "GenSigTimeoutTime_DTCM" SG_ 1066 TheftAlarmStatus 0;
BA_ "GenSigTimeoutTime_ECM" SG_ 1066 TheftAlarmStatus 0;
BA_ "GenSigTimeoutTime_EVCU2" SG_ 1066 TheftAlarmStatus 0;
BA_ "GenSigTimeoutTime_GNMM" SG_ 1066 TheftAlarmStatus 0;
BA_ "GenSigTimeoutTime_HCP" SG_ 1066 TheftAlarmStatus 0;
BA_ "GenSigTimeoutTime_IPC" SG_ 1066 TheftAlarmStatus 0;
BA_ "GenSigTimeoutTime_TCM" SG_ 1066 TheftAlarmStatus 0;
BA_ "GenSigSendType" SG_ 1066 TrunkHandleReleaseSts 3;
BA_ "GenSigTimeoutTime_AGSM" SG_ 1066 TrunkHandleReleaseSts 0;
BA_ "GenSigTimeoutTime_BCM" SG_ 1066 TrunkHandleReleaseSts 0;
BA_ "GenSigTimeoutTime_BSM" SG_ 1066 TrunkHandleReleaseSts 0;
BA_ "GenSigTimeoutTime_CADM" SG_ 1066 TrunkHandleReleaseSts 0;
BA_ "GenSigTimeoutTime_DMSM" SG_ 1066 TrunkHandleReleaseSts 0;
BA_ "GenSigTimeoutTime_DTCM" SG_ 1066 TrunkHandleReleaseSts 0;
BA_ "GenSigTimeoutTime_ECM" SG_ 1066 TrunkHandleReleaseSts 0;
BA_ "GenSigTimeoutTime_EVCU2" SG_ 1066 TrunkHandleReleaseSts 0;
BA_ "GenSigTimeoutTime_GNMM" SG_ 1066 TrunkHandleReleaseSts 0;
BA_ "GenSigTimeoutTime_HCP" SG_ 1066 TrunkHandleReleaseSts 0;
BA_ "GenSigTimeoutTime_IPC" SG_ 1066 TrunkHandleReleaseSts 0;
BA_ "GenSigTimeoutTime_RFHM" SG_ 1066 TrunkHandleReleaseSts 0;
BA_ "GenSigTimeoutTime_TCM" SG_ 1066 TrunkHandleReleaseSts 0;
BA_ "GenSigTimeoutTime_AGSM" SG_ 1066 WashLightWarningSts 0;
BA_ "GenSigTimeoutTime_BCM" SG_ 1066 WashLightWarningSts 0;
BA_ "GenSigTimeoutTime_BSM" SG_ 1066 WashLightWarningSts 0;
BA_ "GenSigTimeoutTime_CADM" SG_ 1066 WashLightWarningSts 0;
BA_ "GenSigTimeoutTime_DMSM" SG_ 1066 WashLightWarningSts 0;
BA_ "GenSigTimeoutTime_DTCM" SG_ 1066 WashLightWarningSts 0;
BA_ "GenSigTimeoutTime_ECM" SG_ 1066 WashLightWarningSts 0;
BA_ "GenSigTimeoutTime_EVCU2" SG_ 1066 WashLightWarningSts 0;
BA_ "GenSigTimeoutTime_GNMM" SG_ 1066 WashLightWarningSts 0;
BA_ "GenSigTimeoutTime_HCP" SG_ 1066 WashLightWarningSts 0;
BA_ "GenSigTimeoutTime_RFHM" SG_ 1066 WashLightWarningSts 0;
BA_ "GenSigTimeoutTime_TCM" SG_ 1066 WashLightWarningSts 0;
BA_ "GenSigSendType" SG_ 245 MinicryptReceptionSts 1;
BA_ "GenSigTimeoutTime_AGSM" SG_ 245 MinicryptReceptionSts 0;
BA_ "GenSigTimeoutTime_BCM" SG_ 245 MinicryptReceptionSts 0;
BA_ "GenSigTimeoutTime_BSM" SG_ 245 MinicryptReceptionSts 0;
BA_ "GenSigTimeoutTime_CADM" SG_ 245 MinicryptReceptionSts 0;
BA_ "GenSigTimeoutTime_DMSM" SG_ 245 MinicryptReceptionSts 0;
BA_ "GenSigTimeoutTime_DTCM" SG_ 245 MinicryptReceptionSts 0;
BA_ "GenSigTimeoutTime_ECM" SG_ 245 MinicryptReceptionSts 0;
BA_ "GenSigTimeoutTime_EVCU2" SG_ 245 MinicryptReceptionSts 0;
BA_ "GenSigTimeoutTime_GNMM" SG_ 245 MinicryptReceptionSts 0;
BA_ "GenSigTimeoutTime_HCP" SG_ 245 MinicryptReceptionSts 0;
BA_ "GenSigTimeoutTime_IPC" SG_ 245 MinicryptReceptionSts 0;
BA_ "GenSigTimeoutTime_SGW" SG_ 245 MinicryptReceptionSts 0;
BA_ "GenSigTimeoutTime_TCM" SG_ 245 MinicryptReceptionSts 0;
BA_ "GenSigTimeoutTime_AGSM" SG_ 513 ACCFSafe 0;
BA_ "GenSigTimeoutTime_BSM" SG_ 513 ACCFSafe 0;
BA_ "GenSigTimeoutTime_DMSM" SG_ 513 ACCFSafe 0;
BA_ "GenSigTimeoutTime_DTCM" SG_ 513 ACCFSafe 0;
BA_ "GenSigTimeoutTime_ECM" SG_ 513 ACCFSafe 0;
BA_ "GenSigTimeoutTime_EVCU2" SG_ 513 ACCFSafe 0;
BA_ "GenSigTimeoutTime_GNMM" SG_ 513 ACCFSafe 0;
BA_ "GenSigTimeoutTime_HCP" SG_ 513 ACCFSafe 0;
BA_ "GenSigTimeoutTime_IPC" SG_ 513 ACCFSafe 0;
BA_ "GenSigTimeoutTime_RFHM" SG_ 513 ACCFSafe 0;
BA_ "GenSigTimeoutTime_SGW" SG_ 513 ACCFSafe 0;
BA_ "GenSigTimeoutTime_TCM" SG_ 513 ACCFSafe 0;
BA_ "GenSigTimeoutTime_AGSM" SG_ 513 Brk_Jrk_Resp 0;
BA_ "GenSigTimeoutTime_BCM" SG_ 513 Brk_Jrk_Resp 0;
BA_ "GenSigTimeoutTime_BSM" SG_ 513 Brk_Jrk_Resp 0;
BA_ "GenSigTimeoutTime_DMSM" SG_ 513 Brk_Jrk_Resp 0;
BA_ "GenSigTimeoutTime_DTCM" SG_ 513 Brk_Jrk_Resp 0;
BA_ "GenSigTimeoutTime_ECM" SG_ 513 Brk_Jrk_Resp 0;
BA_ "GenSigTimeoutTime_EVCU2" SG_ 513 Brk_Jrk_Resp 0;
BA_ "GenSigTimeoutTime_GNMM" SG_ 513 Brk_Jrk_Resp 0;
BA_ "GenSigTimeoutTime_HCP" SG_ 513 Brk_Jrk_Resp 0;
BA_ "GenSigTimeoutTime_IPC" SG_ 513 Brk_Jrk_Resp 0;
BA_ "GenSigTimeoutTime_RFHM" SG_ 513 Brk_Jrk_Resp 0;
BA_ "GenSigTimeoutTime_SGW" SG_ 513 Brk_Jrk_Resp 0;
BA_ "GenSigTimeoutTime_TCM" SG_ 513 Brk_Jrk_Resp 0;
BA_ "GenSigTimeoutTime_AGSM" SG_ 513 Brk_Thermdl 0;
BA_ "GenSigTimeoutTime_BCM" SG_ 513 Brk_Thermdl 0;
BA_ "GenSigTimeoutTime_BSM" SG_ 513 Brk_Thermdl 0;
BA_ "GenSigTimeoutTime_CADM" SG_ 513 Brk_Thermdl 0;
BA_ "GenSigTimeoutTime_DMSM" SG_ 513 Brk_Thermdl 0;
BA_ "GenSigTimeoutTime_DTCM" SG_ 513 Brk_Thermdl 0;
BA_ "GenSigTimeoutTime_ECM" SG_ 513 Brk_Thermdl 0;
BA_ "GenSigTimeoutTime_GNMM" SG_ 513 Brk_Thermdl 0;
BA_ "GenSigTimeoutTime_HCP" SG_ 513 Brk_Thermdl 0;
BA_ "GenSigTimeoutTime_IPC" SG_ 513 Brk_Thermdl 0;
BA_ "GenSigTimeoutTime_RFHM" SG_ 513 Brk_Thermdl 0;
BA_ "GenSigTimeoutTime_TCM" SG_ 513 Brk_Thermdl 0;
BA_ "GenSigStartValue" SG_ 513 BrkTrq 32767;
BA_ "GenSigTimeoutTime_AGSM" SG_ 513 BrkTrq 0;
BA_ "GenSigTimeoutTime_BSM" SG_ 513 BrkTrq 0;
BA_ "GenSigTimeoutTime_CADM" SG_ 513 BrkTrq 0;
BA_ "GenSigTimeoutTime_DMSM" SG_ 513 BrkTrq 0;
BA_ "GenSigTimeoutTime_GNMM" SG_ 513 BrkTrq 0;
BA_ "GenSigTimeoutTime_HCP" SG_ 513 BrkTrq 0;
BA_ "GenSigTimeoutTime_RFHM" SG_ 513 BrkTrq 0;
BA_ "GenSigStartValue" SG_ 513 BrkTrq_Driver 32767;
BA_ "GenSigTimeoutTime_AGSM" SG_ 513 BrkTrq_Driver 0;
BA_ "GenSigTimeoutTime_BSM" SG_ 513 BrkTrq_Driver 0;
BA_ "GenSigTimeoutTime_CADM" SG_ 513 BrkTrq_Driver 0;
BA_ "GenSigTimeoutTime_DMSM" SG_ 513 BrkTrq_Driver 0;
BA_ "GenSigTimeoutTime_GNMM" SG_ 513 BrkTrq_Driver 0;
BA_ "GenSigTimeoutTime_HCP" SG_ 513 BrkTrq_Driver 0;
BA_ "GenSigTimeoutTime_IPC" SG_ 513 BrkTrq_Driver 0;
BA_ "GenSigTimeoutTime_RFHM" SG_ 513 BrkTrq_Driver 0;
BA_ "GenSigTimeoutTime_SGW" SG_ 513 BrkTrq_Driver 0;
BA_ "GenSigTimeoutTime_AGSM" SG_ 513 CRC_BRAKE1 0;
BA_ "GenSigTimeoutTime_BSM" SG_ 513 CRC_BRAKE1 0;
BA_ "GenSigTimeoutTime_DMSM" SG_ 513 CRC_BRAKE1 0;
BA_ "GenSigTimeoutTime_GNMM" SG_ 513 CRC_BRAKE1 0;
BA_ "GenSigTimeoutTime_RFHM" SG_ 513 CRC_BRAKE1 0;
BA_ "GenSigTimeoutTime_SGW" SG_ 513 CRC_BRAKE1 0;
BA_ "GenSigTimeoutTime_AGSM" SG_ 513 DASEngReqPos 0;
BA_ "GenSigTimeoutTime_BCM" SG_ 513 DASEngReqPos 0;
BA_ "GenSigTimeoutTime_BSM" SG_ 513 DASEngReqPos 0;
BA_ "GenSigTimeoutTime_DMSM" SG_ 513 DASEngReqPos 0;
BA_ "GenSigTimeoutTime_DTCM" SG_ 513 DASEngReqPos 0;
BA_ "GenSigTimeoutTime_ECM" SG_ 513 DASEngReqPos 0;
BA_ "GenSigTimeoutTime_EVCU2" SG_ 513 DASEngReqPos 0;
BA_ "GenSigTimeoutTime_GNMM" SG_ 513 DASEngReqPos 0;
BA_ "GenSigTimeoutTime_HCP" SG_ 513 DASEngReqPos 0;
BA_ "GenSigTimeoutTime_IPC" SG_ 513 DASEngReqPos 0;
BA_ "GenSigTimeoutTime_RFHM" SG_ 513 DASEngReqPos 0;
BA_ "GenSigTimeoutTime_SGW" SG_ 513 DASEngReqPos 0;
BA_ "GenSigTimeoutTime_TCM" SG_ 513 DASEngReqPos 0;
BA_ "GenSigTimeoutTime_AGSM" SG_ 513 eBurn_Stages 0;
BA_ "GenSigTimeoutTime_BCM" SG_ 513 eBurn_Stages 0;
BA_ "GenSigTimeoutTime_BSM" SG_ 513 eBurn_Stages 0;
BA_ "GenSigTimeoutTime_CADM" SG_ 513 eBurn_Stages 0;
BA_ "GenSigTimeoutTime_DMSM" SG_ 513 eBurn_Stages 0;
BA_ "GenSigTimeoutTime_DTCM" SG_ 513 eBurn_Stages 0;
BA_ "GenSigTimeoutTime_ECM" SG_ 513 eBurn_Stages 0;
BA_ "GenSigTimeoutTime_EVCU2" SG_ 513 eBurn_Stages 0;
BA_ "GenSigTimeoutTime_GNMM" SG_ 513 eBurn_Stages 0;
BA_ "GenSigTimeoutTime_HCP" SG_ 513 eBurn_Stages 0;
BA_ "GenSigTimeoutTime_IPC" SG_ 513 eBurn_Stages 0;
BA_ "GenSigTimeoutTime_RFHM" SG_ 513 eBurn_Stages 0;
BA_ "GenSigTimeoutTime_SGW" SG_ 513 eBurn_Stages 0;
BA_ "GenSigTimeoutTime_TCM" SG_ 513 eBurn_Stages 0;
BA_ "GenSigStartValue" SG_ 513 EngSpdInterv 65535;
BA_ "GenSigTimeoutTime_AGSM" SG_ 513 EngSpdInterv 0;
BA_ "GenSigTimeoutTime_BCM" SG_ 513 EngSpdInterv 0;
BA_ "GenSigTimeoutTime_BSM" SG_ 513 EngSpdInterv 0;
BA_ "GenSigTimeoutTime_CADM" SG_ 513 EngSpdInterv 0;
BA_ "GenSigTimeoutTime_DMSM" SG_ 513 EngSpdInterv 0;
BA_ "GenSigTimeoutTime_DTCM" SG_ 513 EngSpdInterv 0;
BA_ "GenSigTimeoutTime_EVCU2" SG_ 513 EngSpdInterv 0;
BA_ "GenSigTimeoutTime_GNMM" SG_ 513 EngSpdInterv 0;
BA_ "GenSigTimeoutTime_HCP" SG_ 513 EngSpdInterv 0;
BA_ "GenSigTimeoutTime_IPC" SG_ 513 EngSpdInterv 0;
BA_ "GenSigTimeoutTime_RFHM" SG_ 513 EngSpdInterv 0;
BA_ "GenSigTimeoutTime_SGW" SG_ 513 EngSpdInterv 0;
BA_ "GenSigTimeoutTime_TCM" SG_ 513 EngSpdInterv 0;
BA_ "GenSigTimeoutTime_AGSM" SG_ 513 EngSpdIntervReq 0;
BA_ "GenSigTimeoutTime_BCM" SG_ 513 EngSpdIntervReq 0;
BA_ "GenSigTimeoutTime_BSM" SG_ 513 EngSpdIntervReq 0;
BA_ "GenSigTimeoutTime_CADM" SG_ 513 EngSpdIntervReq 0;
BA_ "GenSigTimeoutTime_DMSM" SG_ 513 EngSpdIntervReq 0;
BA_ "GenSigTimeoutTime_DTCM" SG_ 513 EngSpdIntervReq 0;
BA_ "GenSigTimeoutTime_EVCU2" SG_ 513 EngSpdIntervReq 0;
BA_ "GenSigTimeoutTime_GNMM" SG_ 513 EngSpdIntervReq 0;
BA_ "GenSigTimeoutTime_HCP" SG_ 513 EngSpdIntervReq 0;
BA_ "GenSigTimeoutTime_IPC" SG_ 513 EngSpdIntervReq 0;
BA_ "GenSigTimeoutTime_RFHM" SG_ 513 EngSpdIntervReq 0;
BA_ "GenSigTimeoutTime_SGW" SG_ 513 EngSpdIntervReq 0;
BA_ "GenSigTimeoutTime_TCM" SG_ 513 EngSpdIntervReq 0;
BA_ "GenSigTimeoutTime_AGSM" SG_ 513 ExternalBrkRequestsDisabled 0;
BA_ "GenSigTimeoutTime_BCM" SG_ 513 ExternalBrkRequestsDisabled 0;
BA_ "GenSigTimeoutTime_BSM" SG_ 513 ExternalBrkRequestsDisabled 0;
BA_ "GenSigTimeoutTime_DMSM" SG_ 513 ExternalBrkRequestsDisabled 0;
BA_ "GenSigTimeoutTime_DTCM" SG_ 513 ExternalBrkRequestsDisabled 0;
BA_ "GenSigTimeoutTime_ECM" SG_ 513 ExternalBrkRequestsDisabled 0;
BA_ "GenSigTimeoutTime_GNMM" SG_ 513 ExternalBrkRequestsDisabled 0;
BA_ "GenSigTimeoutTime_HCP" SG_ 513 ExternalBrkRequestsDisabled 0;
BA_ "GenSigTimeoutTime_IPC" SG_ 513 ExternalBrkRequestsDisabled 0;
BA_ "GenSigTimeoutTime_RFHM" SG_ 513 ExternalBrkRequestsDisabled 0;
BA_ "GenSigTimeoutTime_SGW" SG_ 513 ExternalBrkRequestsDisabled 0;
BA_ "GenSigStartValue" SG_ 513 Ft_RrAxleCoupling_TrqRq 254;
BA_ "GenSigTimeoutTime_AGSM" SG_ 513 Ft_RrAxleCoupling_TrqRq 0;
BA_ "GenSigTimeoutTime_BCM" SG_ 513 Ft_RrAxleCoupling_TrqRq 0;
BA_ "GenSigTimeoutTime_BSM" SG_ 513 Ft_RrAxleCoupling_TrqRq 0;
BA_ "GenSigTimeoutTime_CADM" SG_ 513 Ft_RrAxleCoupling_TrqRq 0;
BA_ "GenSigTimeoutTime_DMSM" SG_ 513 Ft_RrAxleCoupling_TrqRq 0;
BA_ "GenSigTimeoutTime_ECM" SG_ 513 Ft_RrAxleCoupling_TrqRq 0;
BA_ "GenSigTimeoutTime_EVCU2" SG_ 513 Ft_RrAxleCoupling_TrqRq 0;
BA_ "GenSigTimeoutTime_GNMM" SG_ 513 Ft_RrAxleCoupling_TrqRq 0;
BA_ "GenSigTimeoutTime_HCP" SG_ 513 Ft_RrAxleCoupling_TrqRq 0;
BA_ "GenSigTimeoutTime_IPC" SG_ 513 Ft_RrAxleCoupling_TrqRq 0;
BA_ "GenSigTimeoutTime_RFHM" SG_ 513 Ft_RrAxleCoupling_TrqRq 0;
BA_ "GenSigTimeoutTime_SGW" SG_ 513 Ft_RrAxleCoupling_TrqRq 0;
BA_ "GenSigTimeoutTime_TCM" SG_ 513 Ft_RrAxleCoupling_TrqRq 0;
BA_ "GenSigTimeoutTime_AGSM" SG_ 513 Ft_RrTrqCoupling_ModeRq 0;
BA_ "GenSigTimeoutTime_BCM" SG_ 513 Ft_RrTrqCoupling_ModeRq 0;
BA_ "GenSigTimeoutTime_BSM" SG_ 513 Ft_RrTrqCoupling_ModeRq 0;
BA_ "GenSigTimeoutTime_CADM" SG_ 513 Ft_RrTrqCoupling_ModeRq 0;
BA_ "GenSigTimeoutTime_DMSM" SG_ 513 Ft_RrTrqCoupling_ModeRq 0;
BA_ "GenSigTimeoutTime_ECM" SG_ 513 Ft_RrTrqCoupling_ModeRq 0;
BA_ "GenSigTimeoutTime_EVCU2" SG_ 513 Ft_RrTrqCoupling_ModeRq 0;
BA_ "GenSigTimeoutTime_GNMM" SG_ 513 Ft_RrTrqCoupling_ModeRq 0;
BA_ "GenSigTimeoutTime_HCP" SG_ 513 Ft_RrTrqCoupling_ModeRq 0;
BA_ "GenSigTimeoutTime_IPC" SG_ 513 Ft_RrTrqCoupling_ModeRq 0;
BA_ "GenSigTimeoutTime_RFHM" SG_ 513 Ft_RrTrqCoupling_ModeRq 0;
BA_ "GenSigTimeoutTime_SGW" SG_ 513 Ft_RrTrqCoupling_ModeRq 0;
BA_ "GenSigTimeoutTime_TCM" SG_ 513 Ft_RrTrqCoupling_ModeRq 0;
BA_ "GenSigTimeoutTime_AGSM" SG_ 513 GrMax_Rq_BSM 0;
BA_ "GenSigTimeoutTime_BCM" SG_ 513 GrMax_Rq_BSM 0;
BA_ "GenSigTimeoutTime_BSM" SG_ 513 GrMax_Rq_BSM 0;
BA_ "GenSigTimeoutTime_CADM" SG_ 513 GrMax_Rq_BSM 0;
BA_ "GenSigTimeoutTime_DMSM" SG_ 513 GrMax_Rq_BSM 0;
BA_ "GenSigTimeoutTime_ECM" SG_ 513 GrMax_Rq_BSM 0;
BA_ "GenSigTimeoutTime_GNMM" SG_ 513 GrMax_Rq_BSM 0;
BA_ "GenSigTimeoutTime_HCP" SG_ 513 GrMax_Rq_BSM 0;
BA_ "GenSigTimeoutTime_IPC" SG_ 513 GrMax_Rq_BSM 0;
BA_ "GenSigTimeoutTime_RFHM" SG_ 513 GrMax_Rq_BSM 0;
BA_ "GenSigTimeoutTime_SGW" SG_ 513 GrMax_Rq_BSM 0;
BA_ "GenSigTimeoutTime_AGSM" SG_ 513 GrMin_Rq_BSM 0;
BA_ "GenSigTimeoutTime_BCM" SG_ 513 GrMin_Rq_BSM 0;
BA_ "GenSigTimeoutTime_BSM" SG_ 513 GrMin_Rq_BSM 0;
BA_ "GenSigTimeoutTime_CADM" SG_ 513 GrMin_Rq_BSM 0;
BA_ "GenSigTimeoutTime_DMSM" SG_ 513 GrMin_Rq_BSM 0;
BA_ "GenSigTimeoutTime_DTCM" SG_ 513 GrMin_Rq_BSM 0;
BA_ "GenSigTimeoutTime_ECM" SG_ 513 GrMin_Rq_BSM 0;
BA_ "GenSigTimeoutTime_GNMM" SG_ 513 GrMin_Rq_BSM 0;
BA_ "GenSigTimeoutTime_HCP" SG_ 513 GrMin_Rq_BSM 0;
BA_ "GenSigTimeoutTime_IPC" SG_ 513 GrMin_Rq_BSM 0;
BA_ "GenSigTimeoutTime_RFHM" SG_ 513 GrMin_Rq_BSM 0;
BA_ "GenSigTimeoutTime_SGW" SG_ 513 GrMin_Rq_BSM 0;
BA_ "GenSigTimeoutTime_AGSM" SG_ 513 MessageCounter_BRAKE1 0;
BA_ "GenSigTimeoutTime_BSM" SG_ 513 MessageCounter_BRAKE1 0;
BA_ "GenSigTimeoutTime_DMSM" SG_ 513 MessageCounter_BRAKE1 0;
BA_ "GenSigTimeoutTime_GNMM" SG_ 513 MessageCounter_BRAKE1 0;
BA_ "GenSigTimeoutTime_RFHM" SG_ 513 MessageCounter_BRAKE1 0;
BA_ "GenSigTimeoutTime_SGW" SG_ 513 MessageCounter_BRAKE1 0;
BA_ "GenSigStartValue" SG_ 513 REF_VEH_SPEED 1023;
BA_ "GenSigTimeoutTime_AGSM" SG_ 513 REF_VEH_SPEED 0;
BA_ "GenSigTimeoutTime_BSM" SG_ 513 REF_VEH_SPEED 0;
BA_ "GenSigTimeoutTime_CADM" SG_ 513 REF_VEH_SPEED 0;
BA_ "GenSigTimeoutTime_DMSM" SG_ 513 REF_VEH_SPEED 0;
BA_ "GenSigTimeoutTime_DTCM" SG_ 513 REF_VEH_SPEED 0;
BA_ "GenSigTimeoutTime_ECM" SG_ 513 REF_VEH_SPEED 0;
BA_ "GenSigTimeoutTime_GNMM" SG_ 513 REF_VEH_SPEED 0;
BA_ "GenSigTimeoutTime_HCP" SG_ 513 REF_VEH_SPEED 0;
BA_ "GenSigTimeoutTime_RFHM" SG_ 513 REF_VEH_SPEED 0;
BA_ "GenSigTimeoutTime_SGW" SG_ 513 REF_VEH_SPEED 0;
BA_ "GenSigTimeoutTime_TCM" SG_ 513 REF_VEH_SPEED 0;
BA_ "GenSigTimeoutTime_AGSM" SG_ 513 SelectSpdSts 0;
BA_ "GenSigTimeoutTime_BCM" SG_ 513 SelectSpdSts 0;
BA_ "GenSigTimeoutTime_BSM" SG_ 513 SelectSpdSts 0;
BA_ "GenSigTimeoutTime_CADM" SG_ 513 SelectSpdSts 0;
BA_ "GenSigTimeoutTime_DMSM" SG_ 513 SelectSpdSts 0;
BA_ "GenSigTimeoutTime_DTCM" SG_ 513 SelectSpdSts 0;
BA_ "GenSigTimeoutTime_ECM" SG_ 513 SelectSpdSts 0;
BA_ "GenSigTimeoutTime_GNMM" SG_ 513 SelectSpdSts 0;
BA_ "GenSigTimeoutTime_HCP" SG_ 513 SelectSpdSts 0;
BA_ "GenSigTimeoutTime_RFHM" SG_ 513 SelectSpdSts 0;
BA_ "GenSigTimeoutTime_AGSM" SG_ 513 SelSpdLmp 0;
BA_ "GenSigTimeoutTime_BSM" SG_ 513 SelSpdLmp 0;
BA_ "GenSigTimeoutTime_CADM" SG_ 513 SelSpdLmp 0;
BA_ "GenSigTimeoutTime_DMSM" SG_ 513 SelSpdLmp 0;
BA_ "GenSigTimeoutTime_DTCM" SG_ 513 SelSpdLmp 0;
BA_ "GenSigTimeoutTime_ECM" SG_ 513 SelSpdLmp 0;
BA_ "GenSigTimeoutTime_EVCU2" SG_ 513 SelSpdLmp 0;
BA_ "GenSigTimeoutTime_GNMM" SG_ 513 SelSpdLmp 0;
BA_ "GenSigTimeoutTime_HCP" SG_ 513 SelSpdLmp 0;
BA_ "GenSigTimeoutTime_RFHM" SG_ 513 SelSpdLmp 0;
BA_ "GenSigTimeoutTime_TCM" SG_ 513 SelSpdLmp 0;
BA_ "GenSigTimeoutTime_AGSM" SG_ 513 ShftChrDsp_Rq_ESC 0;
BA_ "GenSigTimeoutTime_BCM" SG_ 513 ShftChrDsp_Rq_ESC 0;
BA_ "GenSigTimeoutTime_BSM" SG_ 513 ShftChrDsp_Rq_ESC 0;
BA_ "GenSigTimeoutTime_CADM" SG_ 513 ShftChrDsp_Rq_ESC 0;
BA_ "GenSigTimeoutTime_DMSM" SG_ 513 ShftChrDsp_Rq_ESC 0;
BA_ "GenSigTimeoutTime_DTCM" SG_ 513 ShftChrDsp_Rq_ESC 0;
BA_ "GenSigTimeoutTime_ECM" SG_ 513 ShftChrDsp_Rq_ESC 0;
BA_ "GenSigTimeoutTime_EVCU2" SG_ 513 ShftChrDsp_Rq_ESC 0;
BA_ "GenSigTimeoutTime_GNMM" SG_ 513 ShftChrDsp_Rq_ESC 0;
BA_ "GenSigTimeoutTime_HCP" SG_ 513 ShftChrDsp_Rq_ESC 0;
BA_ "GenSigTimeoutTime_IPC" SG_ 513 ShftChrDsp_Rq_ESC 0;
BA_ "GenSigTimeoutTime_RFHM" SG_ 513 ShftChrDsp_Rq_ESC 0;
BA_ "GenSigTimeoutTime_SGW" SG_ 513 ShftChrDsp_Rq_ESC 0;
BA_ "GenSigStartValue" SG_ 513 VehicleStandStillSts 1;
BA_ "GenSigTimeoutTime_AGSM" SG_ 513 VehicleStandStillSts 0;
BA_ "GenSigTimeoutTime_BSM" SG_ 513 VehicleStandStillSts 0;
BA_ "GenSigTimeoutTime_DMSM" SG_ 513 VehicleStandStillSts 0;
BA_ "GenSigTimeoutTime_DTCM" SG_ 513 VehicleStandStillSts 0;
BA_ "GenSigTimeoutTime_ECM" SG_ 513 VehicleStandStillSts 0;
BA_ "GenSigTimeoutTime_EVCU2" SG_ 513 VehicleStandStillSts 0;
BA_ "GenSigTimeoutTime_GNMM" SG_ 513 VehicleStandStillSts 0;
BA_ "GenSigTimeoutTime_HCP" SG_ 513 VehicleStandStillSts 0;
BA_ "GenSigTimeoutTime_IPC" SG_ 513 VehicleStandStillSts 0;
BA_ "GenSigTimeoutTime_RFHM" SG_ 513 VehicleStandStillSts 0;
BA_ "GenSigTimeoutTime_SGW" SG_ 513 VehicleStandStillSts 0;
BA_ "GenSigTimeoutTime_TCM" SG_ 513 VehicleStandStillSts 0;
BA_ "GenSigTimeoutTime_AGSM" SG_ 258 ABSActive 0;
BA_ "GenSigTimeoutTime_BSM" SG_ 258 ABSActive 0;
BA_ "GenSigTimeoutTime_CADM" SG_ 258 ABSActive 0;
BA_ "GenSigTimeoutTime_DMSM" SG_ 258 ABSActive 0;
BA_ "GenSigTimeoutTime_ECM" SG_ 258 ABSActive 0;
BA_ "GenSigTimeoutTime_GNMM" SG_ 258 ABSActive 0;
BA_ "GenSigTimeoutTime_IPC" SG_ 258 ABSActive 0;
BA_ "GenSigTimeoutTime_RFHM" SG_ 258 ABSActive 0;
BA_ "GenSigStartValue" SG_ 258 BrakeBoostPressure 2047;
BA_ "GenSigTimeoutTime_AGSM" SG_ 258 BrakeBoostPressure 0;
BA_ "GenSigTimeoutTime_BSM" SG_ 258 BrakeBoostPressure 0;
BA_ "GenSigTimeoutTime_CADM" SG_ 258 BrakeBoostPressure 0;
BA_ "GenSigTimeoutTime_DMSM" SG_ 258 BrakeBoostPressure 0;
BA_ "GenSigTimeoutTime_DTCM" SG_ 258 BrakeBoostPressure 0;
BA_ "GenSigTimeoutTime_GNMM" SG_ 258 BrakeBoostPressure 0;
BA_ "GenSigTimeoutTime_HCP" SG_ 258 BrakeBoostPressure 0;
BA_ "GenSigTimeoutTime_RFHM" SG_ 258 BrakeBoostPressure 0;
BA_ "GenSigTimeoutTime_AGSM" SG_ 258 BrakeBoostStat 0;
BA_ "GenSigTimeoutTime_BCM" SG_ 258 BrakeBoostStat 0;
BA_ "GenSigTimeoutTime_BSM" SG_ 258 BrakeBoostStat 0;
BA_ "GenSigTimeoutTime_CADM" SG_ 258 BrakeBoostStat 0;
BA_ "GenSigTimeoutTime_DMSM" SG_ 258 BrakeBoostStat 0;
BA_ "GenSigTimeoutTime_DTCM" SG_ 258 BrakeBoostStat 0;
BA_ "GenSigTimeoutTime_ECM" SG_ 258 BrakeBoostStat 0;
BA_ "GenSigTimeoutTime_EVCU2" SG_ 258 BrakeBoostStat 0;
BA_ "GenSigTimeoutTime_GNMM" SG_ 258 BrakeBoostStat 0;
BA_ "GenSigTimeoutTime_HCP" SG_ 258 BrakeBoostStat 0;
BA_ "GenSigTimeoutTime_IPC" SG_ 258 BrakeBoostStat 0;
BA_ "GenSigTimeoutTime_RFHM" SG_ 258 BrakeBoostStat 0;
BA_ "GenSigTimeoutTime_TCM" SG_ 258 BrakeBoostStat 0;
BA_ "GenSigTimeoutTime_AGSM" SG_ 258 BrakeInterventionSts 0;
BA_ "GenSigTimeoutTime_BSM" SG_ 258 BrakeInterventionSts 0;
BA_ "GenSigTimeoutTime_CADM" SG_ 258 BrakeInterventionSts 0;
BA_ "GenSigTimeoutTime_DMSM" SG_ 258 BrakeInterventionSts 0;
BA_ "GenSigTimeoutTime_EVCU2" SG_ 258 BrakeInterventionSts 0;
BA_ "GenSigTimeoutTime_GNMM" SG_ 258 BrakeInterventionSts 0;
BA_ "GenSigTimeoutTime_IPC" SG_ 258 BrakeInterventionSts 0;
BA_ "GenSigTimeoutTime_RFHM" SG_ 258 BrakeInterventionSts 0;
BA_ "GenSigTimeoutTime_SGW" SG_ 258 BrakeInterventionSts 0;
BA_ "GenSigStartValue" SG_ 258 BrakePedalPressure 2047;
BA_ "GenSigTimeoutTime_AGSM" SG_ 258 BrakePedalPressure 0;
BA_ "GenSigTimeoutTime_BSM" SG_ 258 BrakePedalPressure 0;
BA_ "GenSigTimeoutTime_CADM" SG_ 258 BrakePedalPressure 0;
BA_ "GenSigTimeoutTime_DMSM" SG_ 258 BrakePedalPressure 0;
BA_ "GenSigTimeoutTime_DTCM" SG_ 258 BrakePedalPressure 0;
BA_ "GenSigTimeoutTime_GNMM" SG_ 258 BrakePedalPressure 0;
BA_ "GenSigTimeoutTime_HCP" SG_ 258 BrakePedalPressure 0;
BA_ "GenSigTimeoutTime_IPC" SG_ 258 BrakePedalPressure 0;
BA_ "GenSigTimeoutTime_RFHM" SG_ 258 BrakePedalPressure 0;
BA_ "GenSigTimeoutTime_AGSM" SG_ 258 Brk_Stat 0;
BA_ "GenSigTimeoutTime_BSM" SG_ 258 Brk_Stat 0;
BA_ "GenSigTimeoutTime_CADM" SG_ 258 Brk_Stat 0;
BA_ "GenSigTimeoutTime_DMSM" SG_ 258 Brk_Stat 0;
BA_ "GenSigTimeoutTime_DTCM" SG_ 258 Brk_Stat 0;
BA_ "GenSigTimeoutTime_EVCU2" SG_ 258 Brk_Stat 0;
BA_ "GenSigTimeoutTime_GNMM" SG_ 258 Brk_Stat 0;
BA_ "GenSigTimeoutTime_HCP" SG_ 258 Brk_Stat 0;
BA_ "GenSigTimeoutTime_RFHM" SG_ 258 Brk_Stat 0;
BA_ "GenSigTimeoutTime_TCM" SG_ 258 Brk_Stat 0;
BA_ "GenSigTimeoutTime_AGSM" SG_ 258 BSM_ESASystemSts 0;
BA_ "GenSigTimeoutTime_BSM" SG_ 258 BSM_ESASystemSts 0;
BA_ "GenSigTimeoutTime_CADM" SG_ 258 BSM_ESASystemSts 0;
BA_ "GenSigTimeoutTime_DMSM" SG_ 258 BSM_ESASystemSts 0;
BA_ "GenSigTimeoutTime_DTCM" SG_ 258 BSM_ESASystemSts 0;
BA_ "GenSigTimeoutTime_ECM" SG_ 258 BSM_ESASystemSts 0;
BA_ "GenSigTimeoutTime_EVCU2" SG_ 258 BSM_ESASystemSts 0;
BA_ "GenSigTimeoutTime_GNMM" SG_ 258 BSM_ESASystemSts 0;
BA_ "GenSigTimeoutTime_HCP" SG_ 258 BSM_ESASystemSts 0;
BA_ "GenSigTimeoutTime_IPC" SG_ 258 BSM_ESASystemSts 0;
BA_ "GenSigTimeoutTime_RFHM" SG_ 258 BSM_ESASystemSts 0;
BA_ "GenSigTimeoutTime_SGW" SG_ 258 BSM_ESASystemSts 0;
BA_ "GenSigTimeoutTime_TCM" SG_ 258 BSM_ESASystemSts 0;
BA_ "GenSigTimeoutTime_AGSM" SG_ 258 BSM_RequesterFunction 0;
BA_ "GenSigTimeoutTime_BCM" SG_ 258 BSM_RequesterFunction 0;
BA_ "GenSigTimeoutTime_BSM" SG_ 258 BSM_RequesterFunction 0;
BA_ "GenSigTimeoutTime_CADM" SG_ 258 BSM_RequesterFunction 0;
BA_ "GenSigTimeoutTime_DMSM" SG_ 258 BSM_RequesterFunction 0;
BA_ "GenSigTimeoutTime_DTCM" SG_ 258 BSM_RequesterFunction 0;
BA_ "GenSigTimeoutTime_ECM" SG_ 258 BSM_RequesterFunction 0;
BA_ "GenSigTimeoutTime_EVCU2" SG_ 258 BSM_RequesterFunction 0;
BA_ "GenSigTimeoutTime_GNMM" SG_ 258 BSM_RequesterFunction 0;
BA_ "GenSigTimeoutTime_HCP" SG_ 258 BSM_RequesterFunction 0;
BA_ "GenSigTimeoutTime_RFHM" SG_ 258 BSM_RequesterFunction 0;
BA_ "GenSigTimeoutTime_SGW" SG_ 258 BSM_RequesterFunction 0;
BA_ "GenSigTimeoutTime_TCM" SG_ 258 BSM_RequesterFunction 0;
BA_ "GenSigTimeoutTime_BSM" SG_ 258 CRC_BRAKE2 0;
BA_ "GenSigTimeoutTime_AGSM" SG_ 258 ESCActive 0;
BA_ "GenSigTimeoutTime_BSM" SG_ 258 ESCActive 0;
BA_ "GenSigTimeoutTime_CADM" SG_ 258 ESCActive 0;
BA_ "GenSigTimeoutTime_DMSM" SG_ 258 ESCActive 0;
BA_ "GenSigTimeoutTime_DTCM" SG_ 258 ESCActive 0;
BA_ "GenSigTimeoutTime_ECM" SG_ 258 ESCActive 0;
BA_ "GenSigTimeoutTime_GNMM" SG_ 258 ESCActive 0;
BA_ "GenSigTimeoutTime_HCP" SG_ 258 ESCActive 0;
BA_ "GenSigTimeoutTime_IPC" SG_ 258 ESCActive 0;
BA_ "GenSigTimeoutTime_RFHM" SG_ 258 ESCActive 0;
BA_ "GenSigStartValue" SG_ 258 ESP_Sys_Stat 1;
BA_ "GenSigTimeoutTime_AGSM" SG_ 258 ESP_Sys_Stat 0;
BA_ "GenSigTimeoutTime_BCM" SG_ 258 ESP_Sys_Stat 0;
BA_ "GenSigTimeoutTime_BSM" SG_ 258 ESP_Sys_Stat 0;
BA_ "GenSigTimeoutTime_CADM" SG_ 258 ESP_Sys_Stat 0;
BA_ "GenSigTimeoutTime_DMSM" SG_ 258 ESP_Sys_Stat 0;
BA_ "GenSigTimeoutTime_DTCM" SG_ 258 ESP_Sys_Stat 0;
BA_ "GenSigTimeoutTime_EVCU2" SG_ 258 ESP_Sys_Stat 0;
BA_ "GenSigTimeoutTime_GNMM" SG_ 258 ESP_Sys_Stat 0;
BA_ "GenSigTimeoutTime_IPC" SG_ 258 ESP_Sys_Stat 0;
BA_ "GenSigTimeoutTime_RFHM" SG_ 258 ESP_Sys_Stat 0;
BA_ "GenSigTimeoutTime_SGW" SG_ 258 ESP_Sys_Stat 0;
BA_ "GenSigTimeoutTime_AGSM" SG_ 258 HBAActive 0;
BA_ "GenSigTimeoutTime_BSM" SG_ 258 HBAActive 0;
BA_ "GenSigTimeoutTime_CADM" SG_ 258 HBAActive 0;
BA_ "GenSigTimeoutTime_DMSM" SG_ 258 HBAActive 0;
BA_ "GenSigTimeoutTime_DTCM" SG_ 258 HBAActive 0;
BA_ "GenSigTimeoutTime_ECM" SG_ 258 HBAActive 0;
BA_ "GenSigTimeoutTime_EVCU2" SG_ 258 HBAActive 0;
BA_ "GenSigTimeoutTime_GNMM" SG_ 258 HBAActive 0;
BA_ "GenSigTimeoutTime_HCP" SG_ 258 HBAActive 0;
BA_ "GenSigTimeoutTime_IPC" SG_ 258 HBAActive 0;
BA_ "GenSigTimeoutTime_RFHM" SG_ 258 HBAActive 0;
BA_ "GenSigTimeoutTime_SGW" SG_ 258 HBAActive 0;
BA_ "GenSigTimeoutTime_TCM" SG_ 258 HBAActive 0;
BA_ "GenSigTimeoutTime_AGSM" SG_ 258 HillHolderActive 0;
BA_ "GenSigTimeoutTime_BSM" SG_ 258 HillHolderActive 0;
BA_ "GenSigTimeoutTime_CADM" SG_ 258 HillHolderActive 0;
BA_ "GenSigTimeoutTime_DMSM" SG_ 258 HillHolderActive 0;
BA_ "GenSigTimeoutTime_DTCM" SG_ 258 HillHolderActive 0;
BA_ "GenSigTimeoutTime_ECM" SG_ 258 HillHolderActive 0;
BA_ "GenSigTimeoutTime_EVCU2" SG_ 258 HillHolderActive 0;
BA_ "GenSigTimeoutTime_GNMM" SG_ 258 HillHolderActive 0;
BA_ "GenSigTimeoutTime_HCP" SG_ 258 HillHolderActive 0;
BA_ "GenSigTimeoutTime_IPC" SG_ 258 HillHolderActive 0;
BA_ "GenSigTimeoutTime_RFHM" SG_ 258 HillHolderActive 0;
BA_ "GenSigTimeoutTime_SGW" SG_ 258 HillHolderActive 0;
BA_ "GenSigTimeoutTime_TCM" SG_ 258 HillHolderActive 0;
BA_ "GenSigTimeoutTime_AGSM" SG_ 258 ImpendingSkid 0;
BA_ "GenSigTimeoutTime_BCM" SG_ 258 ImpendingSkid 0;
BA_ "GenSigTimeoutTime_BSM" SG_ 258 ImpendingSkid 0;
BA_ "GenSigTimeoutTime_CADM" SG_ 258 ImpendingSkid 0;
BA_ "GenSigTimeoutTime_DMSM" SG_ 258 ImpendingSkid 0;
BA_ "GenSigTimeoutTime_DTCM" SG_ 258 ImpendingSkid 0;
BA_ "GenSigTimeoutTime_ECM" SG_ 258 ImpendingSkid 0;
BA_ "GenSigTimeoutTime_GNMM" SG_ 258 ImpendingSkid 0;
BA_ "GenSigTimeoutTime_HCP" SG_ 258 ImpendingSkid 0;
BA_ "GenSigTimeoutTime_IPC" SG_ 258 ImpendingSkid 0;
BA_ "GenSigTimeoutTime_RFHM" SG_ 258 ImpendingSkid 0;
BA_ "GenSigTimeoutTime_SGW" SG_ 258 ImpendingSkid 0;
BA_ "GenSigTimeoutTime_TCM" SG_ 258 ImpendingSkid 0;
BA_ "GenSigTimeoutTime_AGSM" SG_ 258 InternalError_BSM 0;
BA_ "GenSigTimeoutTime_BCM" SG_ 258 InternalError_BSM 0;
BA_ "GenSigTimeoutTime_BSM" SG_ 258 InternalError_BSM 0;
BA_ "GenSigTimeoutTime_CADM" SG_ 258 InternalError_BSM 0;
BA_ "GenSigTimeoutTime_DMSM" SG_ 258 InternalError_BSM 0;
BA_ "GenSigTimeoutTime_DTCM" SG_ 258 InternalError_BSM 0;
BA_ "GenSigTimeoutTime_ECM" SG_ 258 InternalError_BSM 0;
BA_ "GenSigTimeoutTime_EVCU2" SG_ 258 InternalError_BSM 0;
BA_ "GenSigTimeoutTime_GNMM" SG_ 258 InternalError_BSM 0;
BA_ "GenSigTimeoutTime_HCP" SG_ 258 InternalError_BSM 0;
BA_ "GenSigTimeoutTime_IPC" SG_ 258 InternalError_BSM 0;
BA_ "GenSigTimeoutTime_RFHM" SG_ 258 InternalError_BSM 0;
BA_ "GenSigTimeoutTime_SGW" SG_ 258 InternalError_BSM 0;
BA_ "GenSigTimeoutTime_TCM" SG_ 258 InternalError_BSM 0;
BA_ "GenSigStartValue" SG_ 258 LatAcceleration_BSM 4095;
BA_ "GenSigTimeoutTime_AGSM" SG_ 258 LatAcceleration_BSM 0;
BA_ "GenSigTimeoutTime_BSM" SG_ 258 LatAcceleration_BSM 0;
BA_ "GenSigTimeoutTime_DMSM" SG_ 258 LatAcceleration_BSM 0;
BA_ "GenSigTimeoutTime_GNMM" SG_ 258 LatAcceleration_BSM 0;
BA_ "GenSigTimeoutTime_RFHM" SG_ 258 LatAcceleration_BSM 0;
BA_ "GenSigTimeoutTime_TCM" SG_ 258 LatAcceleration_BSM 0;
BA_ "GenSigTimeoutTime_AGSM" SG_ 258 LatAccelerationFailSts_BSM 0;
BA_ "GenSigTimeoutTime_BSM" SG_ 258 LatAccelerationFailSts_BSM 0;
BA_ "GenSigTimeoutTime_DMSM" SG_ 258 LatAccelerationFailSts_BSM 0;
BA_ "GenSigTimeoutTime_EVCU2" SG_ 258 LatAccelerationFailSts_BSM 0;
BA_ "GenSigTimeoutTime_GNMM" SG_ 258 LatAccelerationFailSts_BSM 0;
BA_ "GenSigTimeoutTime_RFHM" SG_ 258 LatAccelerationFailSts_BSM 0;
BA_ "GenSigTimeoutTime_TCM" SG_ 258 LatAccelerationFailSts_BSM 0;
BA_ "GenSigStartValue" SG_ 258 LongAcceleration_BSM 4095;
BA_ "GenSigTimeoutTime_AGSM" SG_ 258 LongAcceleration_BSM 0;
BA_ "GenSigTimeoutTime_BSM" SG_ 258 LongAcceleration_BSM 0;
BA_ "GenSigTimeoutTime_DMSM" SG_ 258 LongAcceleration_BSM 0;
BA_ "GenSigTimeoutTime_GNMM" SG_ 258 LongAcceleration_BSM 0;
BA_ "GenSigTimeoutTime_RFHM" SG_ 258 LongAcceleration_BSM 0;
BA_ "GenSigTimeoutTime_TCM" SG_ 258 LongAcceleration_BSM 0;
BA_ "GenSigTimeoutTime_AGSM" SG_ 258 LongAccelerationFailSts_BSM 0;
BA_ "GenSigTimeoutTime_BSM" SG_ 258 LongAccelerationFailSts_BSM 0;
BA_ "GenSigTimeoutTime_DMSM" SG_ 258 LongAccelerationFailSts_BSM 0;
BA_ "GenSigTimeoutTime_GNMM" SG_ 258 LongAccelerationFailSts_BSM 0;
BA_ "GenSigTimeoutTime_RFHM" SG_ 258 LongAccelerationFailSts_BSM 0;
BA_ "GenSigTimeoutTime_TCM" SG_ 258 LongAccelerationFailSts_BSM 0;
BA_ "GenSigTimeoutTime_BSM" SG_ 258 MessageCounter_BRAKE2 0;
BA_ "GenSigStartValue" SG_ 258 MuSplit 3;
BA_ "GenSigTimeoutTime_AGSM" SG_ 258 MuSplit 0;
BA_ "GenSigTimeoutTime_BCM" SG_ 258 MuSplit 0;
BA_ "GenSigTimeoutTime_BSM" SG_ 258 MuSplit 0;
BA_ "GenSigTimeoutTime_CADM" SG_ 258 MuSplit 0;
BA_ "GenSigTimeoutTime_DMSM" SG_ 258 MuSplit 0;
BA_ "GenSigTimeoutTime_DTCM" SG_ 258 MuSplit 0;
BA_ "GenSigTimeoutTime_ECM" SG_ 258 MuSplit 0;
BA_ "GenSigTimeoutTime_EVCU2" SG_ 258 MuSplit 0;
BA_ "GenSigTimeoutTime_GNMM" SG_ 258 MuSplit 0;
BA_ "GenSigTimeoutTime_HCP" SG_ 258 MuSplit 0;
BA_ "GenSigTimeoutTime_IPC" SG_ 258 MuSplit 0;
BA_ "GenSigTimeoutTime_RFHM" SG_ 258 MuSplit 0;
BA_ "GenSigTimeoutTime_SGW" SG_ 258 MuSplit 0;
BA_ "GenSigTimeoutTime_TCM" SG_ 258 MuSplit 0;
BA_ "GenSigStartValue" SG_ 258 OverSteering 63;
BA_ "GenSigTimeoutTime_AGSM" SG_ 258 OverSteering 0;
BA_ "GenSigTimeoutTime_BCM" SG_ 258 OverSteering 0;
BA_ "GenSigTimeoutTime_BSM" SG_ 258 OverSteering 0;
BA_ "GenSigTimeoutTime_CADM" SG_ 258 OverSteering 0;
BA_ "GenSigTimeoutTime_DMSM" SG_ 258 OverSteering 0;
BA_ "GenSigTimeoutTime_ECM" SG_ 258 OverSteering 0;
BA_ "GenSigTimeoutTime_EVCU2" SG_ 258 OverSteering 0;
BA_ "GenSigTimeoutTime_GNMM" SG_ 258 OverSteering 0;
BA_ "GenSigTimeoutTime_HCP" SG_ 258 OverSteering 0;
BA_ "GenSigTimeoutTime_IPC" SG_ 258 OverSteering 0;
BA_ "GenSigTimeoutTime_RFHM" SG_ 258 OverSteering 0;
BA_ "GenSigTimeoutTime_SGW" SG_ 258 OverSteering 0;
BA_ "GenSigTimeoutTime_TCM" SG_ 258 OverSteering 0;
BA_ "GenSigTimeoutTime_BCM" SG_ 258 ParkingGearShiftReq_BSM 0;
BA_ "GenSigTimeoutTime_BSM" SG_ 258 ParkingGearShiftReq_BSM 0;
BA_ "GenSigTimeoutTime_CADM" SG_ 258 ParkingGearShiftReq_BSM 0;
BA_ "GenSigTimeoutTime_DMSM" SG_ 258 ParkingGearShiftReq_BSM 0;
BA_ "GenSigTimeoutTime_DTCM" SG_ 258 ParkingGearShiftReq_BSM 0;
BA_ "GenSigTimeoutTime_ECM" SG_ 258 ParkingGearShiftReq_BSM 0;
BA_ "GenSigTimeoutTime_EVCU2" SG_ 258 ParkingGearShiftReq_BSM 0;
BA_ "GenSigTimeoutTime_GNMM" SG_ 258 ParkingGearShiftReq_BSM 0;
BA_ "GenSigTimeoutTime_HCP" SG_ 258 ParkingGearShiftReq_BSM 0;
BA_ "GenSigTimeoutTime_IPC" SG_ 258 ParkingGearShiftReq_BSM 0;
BA_ "GenSigTimeoutTime_RFHM" SG_ 258 ParkingGearShiftReq_BSM 0;
BA_ "GenSigTimeoutTime_SGW" SG_ 258 ParkingGearShiftReq_BSM 0;
BA_ "GenSigTimeoutTime_TCM" SG_ 258 ParkingGearShiftReq_BSM 0;
BA_ "GenSigTimeoutTime_AGSM" SG_ 258 PrefillActive 0;
BA_ "GenSigTimeoutTime_BCM" SG_ 258 PrefillActive 0;
BA_ "GenSigTimeoutTime_BSM" SG_ 258 PrefillActive 0;
BA_ "GenSigTimeoutTime_DMSM" SG_ 258 PrefillActive 0;
BA_ "GenSigTimeoutTime_DTCM" SG_ 258 PrefillActive 0;
BA_ "GenSigTimeoutTime_ECM" SG_ 258 PrefillActive 0;
BA_ "GenSigTimeoutTime_EVCU2" SG_ 258 PrefillActive 0;
BA_ "GenSigTimeoutTime_GNMM" SG_ 258 PrefillActive 0;
BA_ "GenSigTimeoutTime_HCP" SG_ 258 PrefillActive 0;
BA_ "GenSigTimeoutTime_IPC" SG_ 258 PrefillActive 0;
BA_ "GenSigTimeoutTime_RFHM" SG_ 258 PrefillActive 0;
BA_ "GenSigTimeoutTime_SGW" SG_ 258 PrefillActive 0;
BA_ "GenSigTimeoutTime_TCM" SG_ 258 PrefillActive 0;
BA_ "GenSigTimeoutTime_AGSM" SG_ 258 Slope 0;
BA_ "GenSigTimeoutTime_BCM" SG_ 258 Slope 0;
BA_ "GenSigTimeoutTime_BSM" SG_ 258 Slope 0;
BA_ "GenSigTimeoutTime_CADM" SG_ 258 Slope 0;
BA_ "GenSigTimeoutTime_DMSM" SG_ 258 Slope 0;
BA_ "GenSigTimeoutTime_ECM" SG_ 258 Slope 0;
BA_ "GenSigTimeoutTime_EVCU2" SG_ 258 Slope 0;
BA_ "GenSigTimeoutTime_GNMM" SG_ 258 Slope 0;
BA_ "GenSigTimeoutTime_HCP" SG_ 258 Slope 0;
BA_ "GenSigTimeoutTime_IPC" SG_ 258 Slope 0;
BA_ "GenSigTimeoutTime_RFHM" SG_ 258 Slope 0;
BA_ "GenSigTimeoutTime_SGW" SG_ 258 Slope 0;
BA_ "GenSigTimeoutTime_TCM" SG_ 258 Slope 0;
BA_ "GenSigStartValue" SG_ 258 UnderSteering 63;
BA_ "GenSigTimeoutTime_AGSM" SG_ 258 UnderSteering 0;
BA_ "GenSigTimeoutTime_BCM" SG_ 258 UnderSteering 0;
BA_ "GenSigTimeoutTime_BSM" SG_ 258 UnderSteering 0;
BA_ "GenSigTimeoutTime_CADM" SG_ 258 UnderSteering 0;
BA_ "GenSigTimeoutTime_DMSM" SG_ 258 UnderSteering 0;
BA_ "GenSigTimeoutTime_ECM" SG_ 258 UnderSteering 0;
BA_ "GenSigTimeoutTime_EVCU2" SG_ 258 UnderSteering 0;
BA_ "GenSigTimeoutTime_GNMM" SG_ 258 UnderSteering 0;
BA_ "GenSigTimeoutTime_HCP" SG_ 258 UnderSteering 0;
BA_ "GenSigTimeoutTime_IPC" SG_ 258 UnderSteering 0;
BA_ "GenSigTimeoutTime_RFHM" SG_ 258 UnderSteering 0;
BA_ "GenSigTimeoutTime_SGW" SG_ 258 UnderSteering 0;
BA_ "GenSigTimeoutTime_TCM" SG_ 258 UnderSteering 0;
BA_ "GenSigTimeoutTime_BSM" SG_ 258 VehicleSpeedVSOSig 0;
BA_ "GenSigStartValue" SG_ 258 WheelRPM_FL 65535;
BA_ "GenSigTimeoutTime_AGSM" SG_ 258 WheelRPM_FL 0;
BA_ "GenSigTimeoutTime_BSM" SG_ 258 WheelRPM_FL 0;
BA_ "GenSigTimeoutTime_CADM" SG_ 258 WheelRPM_FL 0;
BA_ "GenSigTimeoutTime_DMSM" SG_ 258 WheelRPM_FL 0;
BA_ "GenSigTimeoutTime_DTCM" SG_ 258 WheelRPM_FL 0;
BA_ "GenSigTimeoutTime_ECM" SG_ 258 WheelRPM_FL 0;
BA_ "GenSigTimeoutTime_EVCU2" SG_ 258 WheelRPM_FL 0;
BA_ "GenSigTimeoutTime_GNMM" SG_ 258 WheelRPM_FL 0;
BA_ "GenSigTimeoutTime_HCP" SG_ 258 WheelRPM_FL 0;
BA_ "GenSigTimeoutTime_IPC" SG_ 258 WheelRPM_FL 0;
BA_ "GenSigTimeoutTime_RFHM" SG_ 258 WheelRPM_FL 0;
BA_ "GenSigTimeoutTime_SGW" SG_ 258 WheelRPM_FL 0;
BA_ "GenSigTimeoutTime_TCM" SG_ 258 WheelRPM_FL 0;
BA_ "GenSigStartValue" SG_ 258 WheelRPM_FR 65535;
BA_ "GenSigTimeoutTime_AGSM" SG_ 258 WheelRPM_FR 0;
BA_ "GenSigTimeoutTime_BSM" SG_ 258 WheelRPM_FR 0;
BA_ "GenSigTimeoutTime_CADM" SG_ 258 WheelRPM_FR 0;
BA_ "GenSigTimeoutTime_DMSM" SG_ 258 WheelRPM_FR 0;
BA_ "GenSigTimeoutTime_DTCM" SG_ 258 WheelRPM_FR 0;
BA_ "GenSigTimeoutTime_ECM" SG_ 258 WheelRPM_FR 0;
BA_ "GenSigTimeoutTime_EVCU2" SG_ 258 WheelRPM_FR 0;
BA_ "GenSigTimeoutTime_GNMM" SG_ 258 WheelRPM_FR 0;
BA_ "GenSigTimeoutTime_HCP" SG_ 258 WheelRPM_FR 0;
BA_ "GenSigTimeoutTime_IPC" SG_ 258 WheelRPM_FR 0;
BA_ "GenSigTimeoutTime_RFHM" SG_ 258 WheelRPM_FR 0;
BA_ "GenSigTimeoutTime_SGW" SG_ 258 WheelRPM_FR 0;
BA_ "GenSigTimeoutTime_TCM" SG_ 258 WheelRPM_FR 0;
BA_ "GenSigStartValue" SG_ 258 YawRate_BSM 4095;
BA_ "GenSigTimeoutTime_AGSM" SG_ 258 YawRate_BSM 0;
BA_ "GenSigTimeoutTime_BSM" SG_ 258 YawRate_BSM 0;
BA_ "GenSigTimeoutTime_DMSM" SG_ 258 YawRate_BSM 0;
BA_ "GenSigTimeoutTime_ECM" SG_ 258 YawRate_BSM 0;
BA_ "GenSigTimeoutTime_EVCU2" SG_ 258 YawRate_BSM 0;
BA_ "GenSigTimeoutTime_GNMM" SG_ 258 YawRate_BSM 0;
BA_ "GenSigTimeoutTime_HCP" SG_ 258 YawRate_BSM 0;
BA_ "GenSigTimeoutTime_IPC" SG_ 258 YawRate_BSM 0;
BA_ "GenSigTimeoutTime_RFHM" SG_ 258 YawRate_BSM 0;
BA_ "GenSigTimeoutTime_TCM" SG_ 258 YawRate_BSM 0;
BA_ "GenSigTimeoutTime_AGSM" SG_ 258 YawRateFailSts_BSM 0;
BA_ "GenSigTimeoutTime_BSM" SG_ 258 YawRateFailSts_BSM 0;
BA_ "GenSigTimeoutTime_DMSM" SG_ 258 YawRateFailSts_BSM 0;
BA_ "GenSigTimeoutTime_ECM" SG_ 258 YawRateFailSts_BSM 0;
BA_ "GenSigTimeoutTime_EVCU2" SG_ 258 YawRateFailSts_BSM 0;
BA_ "GenSigTimeoutTime_GNMM" SG_ 258 YawRateFailSts_BSM 0;
BA_ "GenSigTimeoutTime_HCP" SG_ 258 YawRateFailSts_BSM 0;
BA_ "GenSigTimeoutTime_IPC" SG_ 258 YawRateFailSts_BSM 0;
BA_ "GenSigTimeoutTime_RFHM" SG_ 258 YawRateFailSts_BSM 0;
BA_ "GenSigTimeoutTime_TCM" SG_ 258 YawRateFailSts_BSM 0;
BA_ "GenSigTimeoutTime_AGSM" SG_ 259 CRC__BRAKE3 0;
BA_ "GenSigTimeoutTime_BSM" SG_ 259 CRC__BRAKE3 0;
BA_ "GenSigTimeoutTime_DMSM" SG_ 259 CRC__BRAKE3 0;
BA_ "GenSigTimeoutTime_IPC" SG_ 259 CRC__BRAKE3 0;
BA_ "GenSigTimeoutTime_RFHM" SG_ 259 CRC__BRAKE3 0;
BA_ "GenSigTimeoutTime_SGW" SG_ 259 CRC__BRAKE3 0;
BA_ "GenSigStartValue" SG_ 259 LatAccelerationOffset_BSM 255;
BA_ "GenSigTimeoutTime_AGSM" SG_ 259 LatAccelerationOffset_BSM 0;
BA_ "GenSigTimeoutTime_BSM" SG_ 259 LatAccelerationOffset_BSM 0;
BA_ "GenSigTimeoutTime_CADM" SG_ 259 LatAccelerationOffset_BSM 0;
BA_ "GenSigTimeoutTime_DMSM" SG_ 259 LatAccelerationOffset_BSM 0;
BA_ "GenSigTimeoutTime_DTCM" SG_ 259 LatAccelerationOffset_BSM 0;
BA_ "GenSigTimeoutTime_ECM" SG_ 259 LatAccelerationOffset_BSM 0;
BA_ "GenSigTimeoutTime_EVCU2" SG_ 259 LatAccelerationOffset_BSM 0;
BA_ "GenSigTimeoutTime_GNMM" SG_ 259 LatAccelerationOffset_BSM 0;
BA_ "GenSigTimeoutTime_HCP" SG_ 259 LatAccelerationOffset_BSM 0;
BA_ "GenSigTimeoutTime_IPC" SG_ 259 LatAccelerationOffset_BSM 0;
BA_ "GenSigTimeoutTime_RFHM" SG_ 259 LatAccelerationOffset_BSM 0;
BA_ "GenSigTimeoutTime_SGW" SG_ 259 LatAccelerationOffset_BSM 0;
BA_ "GenSigTimeoutTime_TCM" SG_ 259 LatAccelerationOffset_BSM 0;
BA_ "GenSigTimeoutTime_AGSM" SG_ 259 LHF_FastPulseCounter 0;
BA_ "GenSigTimeoutTime_BSM" SG_ 259 LHF_FastPulseCounter 0;
BA_ "GenSigTimeoutTime_DMSM" SG_ 259 LHF_FastPulseCounter 0;
BA_ "GenSigTimeoutTime_DTCM" SG_ 259 LHF_FastPulseCounter 0;
BA_ "GenSigTimeoutTime_HCP" SG_ 259 LHF_FastPulseCounter 0;
BA_ "GenSigTimeoutTime_IPC" SG_ 259 LHF_FastPulseCounter 0;
BA_ "GenSigTimeoutTime_TCM" SG_ 259 LHF_FastPulseCounter 0;
BA_ "GenSigTimeoutTime_AGSM" SG_ 259 LHF_Spin 0;
BA_ "GenSigTimeoutTime_BSM" SG_ 259 LHF_Spin 0;
BA_ "GenSigTimeoutTime_DMSM" SG_ 259 LHF_Spin 0;
BA_ "GenSigTimeoutTime_GNMM" SG_ 259 LHF_Spin 0;
BA_ "GenSigTimeoutTime_IPC" SG_ 259 LHF_Spin 0;
BA_ "GenSigTimeoutTime_RFHM" SG_ 259 LHF_Spin 0;
BA_ "GenSigTimeoutTime_AGSM" SG_ 259 LHF_WheelSensorFailSts 0;
BA_ "GenSigTimeoutTime_BSM" SG_ 259 LHF_WheelSensorFailSts 0;
BA_ "GenSigTimeoutTime_DMSM" SG_ 259 LHF_WheelSensorFailSts 0;
BA_ "GenSigTimeoutTime_GNMM" SG_ 259 LHF_WheelSensorFailSts 0;
BA_ "GenSigTimeoutTime_HCP" SG_ 259 LHF_WheelSensorFailSts 0;
BA_ "GenSigTimeoutTime_IPC" SG_ 259 LHF_WheelSensorFailSts 0;
BA_ "GenSigTimeoutTime_RFHM" SG_ 259 LHF_WheelSensorFailSts 0;
BA_ "GenSigTimeoutTime_TCM" SG_ 259 LHF_WheelSensorFailSts 0;
BA_ "GenSigTimeoutTime_AGSM" SG_ 259 LHFWheelSpeed 0;
BA_ "GenSigTimeoutTime_BSM" SG_ 259 LHFWheelSpeed 0;
BA_ "GenSigTimeoutTime_DMSM" SG_ 259 LHFWheelSpeed 0;
BA_ "GenSigTimeoutTime_IPC" SG_ 259 LHFWheelSpeed 0;
BA_ "GenSigTimeoutTime_RFHM" SG_ 259 LHFWheelSpeed 0;
BA_ "GenSigTimeoutTime_AGSM" SG_ 259 LHR_FastPulseCounter 0;
BA_ "GenSigTimeoutTime_BSM" SG_ 259 LHR_FastPulseCounter 0;
BA_ "GenSigTimeoutTime_DMSM" SG_ 259 LHR_FastPulseCounter 0;
BA_ "GenSigTimeoutTime_DTCM" SG_ 259 LHR_FastPulseCounter 0;
BA_ "GenSigTimeoutTime_HCP" SG_ 259 LHR_FastPulseCounter 0;
BA_ "GenSigTimeoutTime_IPC" SG_ 259 LHR_FastPulseCounter 0;
BA_ "GenSigTimeoutTime_TCM" SG_ 259 LHR_FastPulseCounter 0;
BA_ "GenSigTimeoutTime_AGSM" SG_ 259 LHR_Spin 0;
BA_ "GenSigTimeoutTime_BSM" SG_ 259 LHR_Spin 0;
BA_ "GenSigTimeoutTime_DMSM" SG_ 259 LHR_Spin 0;
BA_ "GenSigTimeoutTime_GNMM" SG_ 259 LHR_Spin 0;
BA_ "GenSigTimeoutTime_IPC" SG_ 259 LHR_Spin 0;
BA_ "GenSigTimeoutTime_RFHM" SG_ 259 LHR_Spin 0;
BA_ "GenSigTimeoutTime_AGSM" SG_ 259 LHR_WheelSensorFailSts 0;
BA_ "GenSigTimeoutTime_BSM" SG_ 259 LHR_WheelSensorFailSts 0;
BA_ "GenSigTimeoutTime_DMSM" SG_ 259 LHR_WheelSensorFailSts 0;
BA_ "GenSigTimeoutTime_GNMM" SG_ 259 LHR_WheelSensorFailSts 0;
BA_ "GenSigTimeoutTime_HCP" SG_ 259 LHR_WheelSensorFailSts 0;
BA_ "GenSigTimeoutTime_IPC" SG_ 259 LHR_WheelSensorFailSts 0;
BA_ "GenSigTimeoutTime_RFHM" SG_ 259 LHR_WheelSensorFailSts 0;
BA_ "GenSigTimeoutTime_TCM" SG_ 259 LHR_WheelSensorFailSts 0;
BA_ "GenSigTimeoutTime_AGSM" SG_ 259 LHRWheelSpeed 0;
BA_ "GenSigTimeoutTime_BSM" SG_ 259 LHRWheelSpeed 0;
BA_ "GenSigTimeoutTime_DMSM" SG_ 259 LHRWheelSpeed 0;
BA_ "GenSigTimeoutTime_IPC" SG_ 259 LHRWheelSpeed 0;
BA_ "GenSigTimeoutTime_RFHM" SG_ 259 LHRWheelSpeed 0;
BA_ "GenSigStartValue" SG_ 259 LongAccelerationOffset_BSM 255;
BA_ "GenSigTimeoutTime_AGSM" SG_ 259 LongAccelerationOffset_BSM 0;
BA_ "GenSigTimeoutTime_BSM" SG_ 259 LongAccelerationOffset_BSM 0;
BA_ "GenSigTimeoutTime_CADM" SG_ 259 LongAccelerationOffset_BSM 0;
BA_ "GenSigTimeoutTime_DMSM" SG_ 259 LongAccelerationOffset_BSM 0;
BA_ "GenSigTimeoutTime_DTCM" SG_ 259 LongAccelerationOffset_BSM 0;
BA_ "GenSigTimeoutTime_ECM" SG_ 259 LongAccelerationOffset_BSM 0;
BA_ "GenSigTimeoutTime_EVCU2" SG_ 259 LongAccelerationOffset_BSM 0;
BA_ "GenSigTimeoutTime_GNMM" SG_ 259 LongAccelerationOffset_BSM 0;
BA_ "GenSigTimeoutTime_HCP" SG_ 259 LongAccelerationOffset_BSM 0;
BA_ "GenSigTimeoutTime_IPC" SG_ 259 LongAccelerationOffset_BSM 0;
BA_ "GenSigTimeoutTime_RFHM" SG_ 259 LongAccelerationOffset_BSM 0;
BA_ "GenSigTimeoutTime_SGW" SG_ 259 LongAccelerationOffset_BSM 0;
BA_ "GenSigTimeoutTime_TCM" SG_ 259 LongAccelerationOffset_BSM 0;
BA_ "GenSigStartValue" SG_ 259 LwsAngleOffset_BSM 1023;
BA_ "GenSigTimeoutTime_AGSM" SG_ 259 LwsAngleOffset_BSM 0;
BA_ "GenSigTimeoutTime_BCM" SG_ 259 LwsAngleOffset_BSM 0;
BA_ "GenSigTimeoutTime_BSM" SG_ 259 LwsAngleOffset_BSM 0;
BA_ "GenSigTimeoutTime_CADM" SG_ 259 LwsAngleOffset_BSM 0;
BA_ "GenSigTimeoutTime_DMSM" SG_ 259 LwsAngleOffset_BSM 0;
BA_ "GenSigTimeoutTime_DTCM" SG_ 259 LwsAngleOffset_BSM 0;
BA_ "GenSigTimeoutTime_ECM" SG_ 259 LwsAngleOffset_BSM 0;
BA_ "GenSigTimeoutTime_EVCU2" SG_ 259 LwsAngleOffset_BSM 0;
BA_ "GenSigTimeoutTime_HCP" SG_ 259 LwsAngleOffset_BSM 0;
BA_ "GenSigTimeoutTime_IPC" SG_ 259 LwsAngleOffset_BSM 0;
BA_ "GenSigTimeoutTime_RFHM" SG_ 259 LwsAngleOffset_BSM 0;
BA_ "GenSigTimeoutTime_SGW" SG_ 259 LwsAngleOffset_BSM 0;
BA_ "GenSigTimeoutTime_TCM" SG_ 259 LwsAngleOffset_BSM 0;
BA_ "GenSigTimeoutTime_AGSM" SG_ 259 MessageCounter_BRAKE3 0;
BA_ "GenSigTimeoutTime_BSM" SG_ 259 MessageCounter_BRAKE3 0;
BA_ "GenSigTimeoutTime_DMSM" SG_ 259 MessageCounter_BRAKE3 0;
BA_ "GenSigTimeoutTime_IPC" SG_ 259 MessageCounter_BRAKE3 0;
BA_ "GenSigTimeoutTime_RFHM" SG_ 259 MessageCounter_BRAKE3 0;
BA_ "GenSigTimeoutTime_SGW" SG_ 259 MessageCounter_BRAKE3 0;
BA_ "GenSigTimeoutTime_AGSM" SG_ 259 RHF_FastPulseCounter 0;
BA_ "GenSigTimeoutTime_BSM" SG_ 259 RHF_FastPulseCounter 0;
BA_ "GenSigTimeoutTime_DMSM" SG_ 259 RHF_FastPulseCounter 0;
BA_ "GenSigTimeoutTime_DTCM" SG_ 259 RHF_FastPulseCounter 0;
BA_ "GenSigTimeoutTime_HCP" SG_ 259 RHF_FastPulseCounter 0;
BA_ "GenSigTimeoutTime_IPC" SG_ 259 RHF_FastPulseCounter 0;
BA_ "GenSigTimeoutTime_TCM" SG_ 259 RHF_FastPulseCounter 0;
BA_ "GenSigTimeoutTime_AGSM" SG_ 259 RHF_Spin 0;
BA_ "GenSigTimeoutTime_BSM" SG_ 259 RHF_Spin 0;
BA_ "GenSigTimeoutTime_DMSM" SG_ 259 RHF_Spin 0;
BA_ "GenSigTimeoutTime_GNMM" SG_ 259 RHF_Spin 0;
BA_ "GenSigTimeoutTime_IPC" SG_ 259 RHF_Spin 0;
BA_ "GenSigTimeoutTime_RFHM" SG_ 259 RHF_Spin 0;
BA_ "GenSigTimeoutTime_AGSM" SG_ 259 RHF_WheelSensorFailSts 0;
BA_ "GenSigTimeoutTime_BSM" SG_ 259 RHF_WheelSensorFailSts 0;
BA_ "GenSigTimeoutTime_DMSM" SG_ 259 RHF_WheelSensorFailSts 0;
BA_ "GenSigTimeoutTime_GNMM" SG_ 259 RHF_WheelSensorFailSts 0;
BA_ "GenSigTimeoutTime_HCP" SG_ 259 RHF_WheelSensorFailSts 0;
BA_ "GenSigTimeoutTime_IPC" SG_ 259 RHF_WheelSensorFailSts 0;
BA_ "GenSigTimeoutTime_RFHM" SG_ 259 RHF_WheelSensorFailSts 0;
BA_ "GenSigTimeoutTime_TCM" SG_ 259 RHF_WheelSensorFailSts 0;
BA_ "GenSigTimeoutTime_AGSM" SG_ 259 RHFWheelSpeed 0;
BA_ "GenSigTimeoutTime_BSM" SG_ 259 RHFWheelSpeed 0;
BA_ "GenSigTimeoutTime_DMSM" SG_ 259 RHFWheelSpeed 0;
BA_ "GenSigTimeoutTime_IPC" SG_ 259 RHFWheelSpeed 0;
BA_ "GenSigTimeoutTime_RFHM" SG_ 259 RHFWheelSpeed 0;
BA_ "GenSigTimeoutTime_AGSM" SG_ 259 RHR_FastPulseCounter 0;
BA_ "GenSigTimeoutTime_BSM" SG_ 259 RHR_FastPulseCounter 0;
BA_ "GenSigTimeoutTime_DMSM" SG_ 259 RHR_FastPulseCounter 0;
BA_ "GenSigTimeoutTime_DTCM" SG_ 259 RHR_FastPulseCounter 0;
BA_ "GenSigTimeoutTime_HCP" SG_ 259 RHR_FastPulseCounter 0;
BA_ "GenSigTimeoutTime_IPC" SG_ 259 RHR_FastPulseCounter 0;
BA_ "GenSigTimeoutTime_TCM" SG_ 259 RHR_FastPulseCounter 0;
BA_ "GenSigTimeoutTime_AGSM" SG_ 259 RHR_Spin 0;
BA_ "GenSigTimeoutTime_BSM" SG_ 259 RHR_Spin 0;
BA_ "GenSigTimeoutTime_DMSM" SG_ 259 RHR_Spin 0;
BA_ "GenSigTimeoutTime_GNMM" SG_ 259 RHR_Spin 0;
BA_ "GenSigTimeoutTime_IPC" SG_ 259 RHR_Spin 0;
BA_ "GenSigTimeoutTime_RFHM" SG_ 259 RHR_Spin 0;
BA_ "GenSigTimeoutTime_AGSM" SG_ 259 RHR_WheelSensorFailSts 0;
BA_ "GenSigTimeoutTime_BSM" SG_ 259 RHR_WheelSensorFailSts 0;
BA_ "GenSigTimeoutTime_DMSM" SG_ 259 RHR_WheelSensorFailSts 0;
BA_ "GenSigTimeoutTime_GNMM" SG_ 259 RHR_WheelSensorFailSts 0;
BA_ "GenSigTimeoutTime_HCP" SG_ 259 RHR_WheelSensorFailSts 0;
BA_ "GenSigTimeoutTime_IPC" SG_ 259 RHR_WheelSensorFailSts 0;
BA_ "GenSigTimeoutTime_RFHM" SG_ 259 RHR_WheelSensorFailSts 0;
BA_ "GenSigTimeoutTime_TCM" SG_ 259 RHR_WheelSensorFailSts 0;
BA_ "GenSigTimeoutTime_AGSM" SG_ 259 RHRWheelSpeed 0;
BA_ "GenSigTimeoutTime_BSM" SG_ 259 RHRWheelSpeed 0;
BA_ "GenSigTimeoutTime_DMSM" SG_ 259 RHRWheelSpeed 0;
BA_ "GenSigTimeoutTime_IPC" SG_ 259 RHRWheelSpeed 0;
BA_ "GenSigTimeoutTime_RFHM" SG_ 259 RHRWheelSpeed 0;
VAL_ 1435 ACV_FailType 0 "None";
VAL_ 1435 ACV_Status 0 "OFF" 1 "ON" 3 "SNA";
VAL_ 1435 AHP_EnblReq 0 "False" 1 "True" 3 "SNA";
VAL_ 1435 BSD_FAIL_D 0 "False" 1 "True";
VAL_ 1435 BSD_FAIL_P 0 "False" 1 "True";
VAL_ 1435 DEFROST_SEL 0 "Not_Active" 1 "Active";
VAL_ 1435 DRV_TEMP_DR_POS 127 "SNA";
VAL_ 1435 ESC_Mode_Req 0 "On" 1 "PARTIAL_1" 2 "PARTIAL_2" 3 "OFF" 4 "NOT_PRESSED" 5 "SNOW" 6 "DRAG" 7 "SNA";
VAL_ 1435 EvapTempTar 255 "SNA";
VAL_ 1435 FLTurnLampFault 0 "NOT_SET" 1 "SET";
VAL_ 1435 FrontFogLightFault 0 "FALSE" 1 "TRUE";
VAL_ 1435 FrontFogPressed 0 "NOT_SET" 1 "SET";
VAL_ 1435 FRTurnLampFault 0 "NOT_SET" 1 "SET";
VAL_ 1435 HAS_OnOffSts 0 "Not_Pressed" 1 "Pressed";
VAL_ 1435 HazardSwitchPressed 0 "NOT_SET" 1 "SET";
VAL_ 1435 HLSPosition 0 "Off_DRL" 1 "Position Lamps" 2 "Low Beam" 3 "Auto" 4 "Short Circuit" 5 "Open Circuit" 7 "SNA";
VAL_ 1435 HtrCorTmp_InTgt 255 "SNA";
VAL_ 1435 HVAC_Blwr_Perct 127 "SNA";
VAL_ 1435 HVAC_CLNT_FLW_MIN 0 "OPEN" 254 "CLOSE" 255 "SNA";
VAL_ 1435 L_TurnCluster 0 "NOT_SET" 1 "SET";
VAL_ 1435 LKA_RequestSts 0 "Not_Pressed" 1 "Pressed";
VAL_ 1435 Paddles_DrvMd_CfgSts_TMI 0 "None" 1 "DIS" 2 "EN" 3 "SNA";
VAL_ 1435 PADL_MODE_CFG_STAT 0 "NONE" 1 "DIS" 2 "EN" 3 "SNA";
VAL_ 1435 PAS_TEMP_DR_POS 127 "SNA";
VAL_ 1435 PssgrScreenOn_Off_RequestSts 0 "Not_Pressed" 1 "Pressed";
VAL_ 1435 R_TurnCluster 0 "NOT_SET" 1 "SET";
VAL_ 1435 RearFogPressed 0 "NOT_SET" 1 "SET";
VAL_ 1435 RLTurnLampFault 0 "NOT_SET" 1 "SET";
VAL_ 1435 RRTurnLampFault 0 "NOT_SET" 1 "SET";
VAL_ 1435 VEH_INT_TEMP 65535 "SNA";
VAL_ 1436 ATMM_PopUpRqst 0 "TM0" 1 "TM1" 2 "TM2" 3 "SNA";
VAL_ 1436 Blower_Diagnostics 1023 "SNA";
VAL_ 1436 Blower_Speed 511 "SNA";
VAL_ 1436 Comfort_Enable_Act 0 "Not_Active" 1 "Active";
VAL_ 1436 Comfort_Enable_Time 65535 "SNA";
VAL_ 1436 COMM_Fault 0 "No_Fault" 1 "Comm_Fault";
VAL_ 1436 DAY_LGT_MD_DISP 0 "Night" 1 "Day";
VAL_ 1436 E_Call_Button 0 "Not_Pressed" 1 "Pressed" 3 "SNA";
VAL_ 1436 EBL_Stat 0 "OFF" 1 "ON" 2 "Blink" 3 "SNA";
VAL_ 1436 Internal_Fault 0 "No_Fault" 1 "Comm_Fault";
VAL_ 1436 Mem_D_Pos_Rq 0 "Not_Pressed" 1 "MemPos1_Pressed" 2 "MemPos2_Pressed" 3 "SNA";
VAL_ 1436 Mem_D_Rc_Rq 0 "Not_Pressed" 1 "Pressed";
VAL_ 1436 Mem_D_Sv_Rq 0 "Not_Pressed" 1 "Pressed";
VAL_ 1436 MEM_RC_STAT 0 "Memory_Enabled" 1 "Vehicle_Not_In_Park" 2 "Vehicle_In_Motion" 3 "SNA";
VAL_ 1436 MOOD_LGT_INTS 255 "SNA";
VAL_ 1436 PANEL_INTS_DISP 255 "SNA";
VAL_ 1436 TrailerConnectionSts 0 "Not_Connected" 1 "Connected" 2 "Not_Used" 3 "SNA";
VAL_ 1436 TrailerGenericFailSts 0 "No_fault_present" 1 "Fault_present";
VAL_ 1436 TrailerLHParkingLightFailSts 0 "No_fault_present" 1 "Fault_present";
VAL_ 1436 TrailerLHTurnSignalFailSts 0 "No_fault_present" 1 "Fault_present";
VAL_ 1436 TrailerRHParkingLightFailSts 0 "No_fault_present" 1 "Fault_present";
VAL_ 1436 TrailerRHTurnSignalFailSts 0 "No_fault_present" 1 "Fault_present";
VAL_ 1436 Turn_Lever_Unlatch_Resp 0 "Latched" 1 "Unlatched_to_Center" 3 "SNA";
VAL_ 1436 U_Call_Button 0 "Not_Pressed" 1 "Pressed" 3 "SNA";
VAL_ 1470 DriverReclineRelativePosition 255 "SNA";
VAL_ 1470 DriverSeatHorizontalButton 0 "Not_Pressed" 1 "Slide_Fore" 2 "Slide_Aft" 3 "SNA";
VAL_ 1470 DriverSeatReclinerButton 0 "Not_Pressed" 1 "Recline_forward" 2 "Recline_back" 3 "SNA";
VAL_ 1470 DriverSeatRelativePosition 255 "SNA";
VAL_ 1470 ITBM_BRK_SW 0 "BRAKE_OFF" 1 "BRAKE_ON" 3 "SNA";
VAL_ 1470 ITBM_BrkStyle 0 "LT_ELECT" 1 "HV_ELECT" 2 "LT_EOH" 3 "HV_EOH";
VAL_ 1470 ITBM_DSP_RQ 0 "NO_DISP_RQ" 1 "FLT_TRLR_WIRE" 2 "FLT_ITBM" 3 "FLT_TRLR_DCONN" 4 "GAIN_ADJ" 5 "FLT_CONN" 6 "TLR_NOT_CONN" 7 "MANUAL" 8 "SAFE" 15 "SNA";
VAL_ 1470 ITBM_GAIN_STAT 31 "SNA";
VAL_ 1470 ITBM_OP_PWR 255 "SNA";
VAL_ 1470 ITBM_TrlrStat 0 "NO_TRLR" 1 "TRLR_PRSNT" 2 "TRLR_DCONN" 3 "SNA";
VAL_ 1470 SeatPosHAS 0 "INIT" 1 "Healthy" 2 "Healthy_Counting" 3 "Faulted";
VAL_ 1470 SelTrlrNum 0 "NONE" 1 "T1" 2 "T2" 3 "T3" 4 "T4" 7 "SNA";
VAL_ 1470 SelTrlrStyle 0 "NONE" 1 "TRAILER" 2 "BOAT" 3 "CAR" 4 "CARGO" 5 "DUMP" 6 "EQUIPMENT" 7 "FLAT" 8 "GOOSE" 9 "LIVESTOCK" 10 "HORSE" 11 "MOTORCYCLE" 12 "SNOWMOBILE" 13 "TRAVEL" 14 "UTILITY" 15 "FIFTH" 31 "SNA";
VAL_ 1470 Trailer_Light_Check_Status 0 "Not_Request" 1 "Request" 2 "In_Progress" 3 "Cancel";
VAL_ 1470 TrlrStyle_1 0 "NONE" 1 "TRAILER" 2 "BOAT" 3 "CAR" 4 "CARGO" 5 "DUMP" 6 "EQUIPMENT" 7 "FLAT" 8 "GOOSE" 9 "LIVESTOCK" 10 "HORSE" 11 "MOTORCYCLE" 12 "SNOWMOBILE" 13 "TRAVEL" 14 "UTILITY" 15 "FIFTH" 31 "SNA";
VAL_ 1470 TrlrStyle_2 0 "NONE" 1 "TRAILER" 2 "BOAT" 3 "CAR" 4 "CARGO" 5 "DUMP" 6 "EQUIPMENT" 7 "FLAT" 8 "GOOSE" 9 "LIVESTOCK" 10 "HORSE" 11 "MOTORCYCLE" 12 "SNOWMOBILE" 13 "TRAVEL" 14 "UTILITY" 15 "FIFTH" 31 "SNA";
VAL_ 1470 TrlrStyle_3 0 "NONE" 1 "TRAILER" 2 "BOAT" 3 "CAR" 4 "CARGO" 5 "DUMP" 6 "EQUIPMENT" 7 "FLAT" 8 "GOOSE" 9 "LIVESTOCK" 10 "HORSE" 11 "MOTORCYCLE" 12 "SNOWMOBILE" 13 "TRAVEL" 14 "UTILITY" 15 "FIFTH" 31 "SNA";
VAL_ 1470 TrlrStyle_4 0 "NONE" 1 "TRAILER" 2 "BOAT" 3 "CAR" 4 "CARGO" 5 "DUMP" 6 "EQUIPMENT" 7 "FLAT" 8 "GOOSE" 9 "LIVESTOCK" 10 "HORSE" 11 "MOTORCYCLE" 12 "SNOWMOBILE" 13 "TRAVEL" 14 "UTILITY" 15 "FIFTH" 31 "SNA";
VAL_ 1470 TrlrTripDist 16777215 "SNA";
VAL_ 1470 UCONREQ_TBM_TrailerLightCheck_FB 0 "Not_Request" 1 "Request" 2 "In_Progress" 3 "Cancel";
VAL_ 750 Battery_Volt_1 511 "SNA";
VAL_ 750 Battery_Volt_2 511 "SNA";
VAL_ 750 FronWiperFailSts 0 "Wiper system Fault Not Present" 1 "Wiper system Fault Present";
VAL_ 1051 AM_ECM_Trace 0 "DEFAULT" 2 "AM_ECM_TRACE" 3 "SNA";
VAL_ 1051 BCMSAMFailSts 0 "Fail_not_present" 1 "Fail_present";
VAL_ 1051 EVAP_TEMP_P1C 2047 "SNA";
VAL_ 1051 FUEL_VOLT 255 "SNA";
VAL_ 1051 PitchAngle 255 "SNA";
VAL_ 1051 RollAngle 255 "SNA";
VAL_ 1375 ChkFuelLevelSts 0 "Fault_Not_Present" 1 "Chk_Code_1" 2 "Chk_Code_2" 3 "Chk_Code_3" 4 "Chk_Code_4" 5 "Not_Used" 6 "Not_Used" 7 "Not_Used";
VAL_ 1375 FrontWiperReq 0 "OFF" 1 "INT" 2 "LOW" 3 "HIGH" 4 "AUTO" 5 "MIST";
VAL_ 1375 SysEOLSts 0 "EOL_Ready" 1 "EOL_Not_Ready";
VAL_ 1066 AHBFeature 0 "OFF" 1 "ON";
VAL_ 1066 BonnetSts 0 "Closed" 1 "Open";
VAL_ 1066 BrakeFluidLevelSts 0 "OK" 1 "Low_level";
VAL_ 1066 DoorLockLastElSts 0 "Locked" 1 "Driver_Door_Unlocked" 2 "All_Door_Unlocked" 3 "SNA";
VAL_ 1066 DriverDoorSts 0 "Closed" 1 "Open";
VAL_ 1066 ExternalTemperature 511 "SNA";
VAL_ 1066 FrontFogLightSts 0 "OFF" 1 "ON";
VAL_ 1066 FrontWiperMoveSts 0 "Stop" 1 "Moving";
VAL_ 1066 HDCFnRqstSts 0 "Open" 1 "Closed" 3 "SNA";
VAL_ 1066 HighBeamSts 0 "OFF" 1 "ON";
VAL_ 1066 LHParkingLightSts 0 "OFF" 1 "ON";
VAL_ 1066 LHRDoorSts 0 "Closed" 1 "Open";
VAL_ 1066 LHTurnSignalSts 0 "OFF" 1 "ON";
VAL_ 1066 LnchCtrl_FnRqstSts 0 "Not_Pressed" 1 "Pressed" 2 "STUCK" 3 "SNA";
VAL_ 1066 LowBeamSts 0 "OFF" 1 "ON";
VAL_ 1066 LowFuelWarningSts 0 "OFF" 1 "ON";
VAL_ 1066 ParkBrakeSts 0 "OFF" 1 "ON";
VAL_ 1066 PowerModeSts 0 "Standard_Power" 1 "Logistic_Mode_ON" 2 "Logistic_Mode_PR" 3 "LogisticModeON_and_EngineON";
VAL_ 1066 PowerPanelMsg 0 "No_Msg" 1 "Low_battery_level" 2 "Low_fuel_level" 3 "System_Fault" 4 "Generator_Mode_enabled" 5 "Engine_must_be_running" 6 "Power_Panel_disabled" 7 "Pwr_Pnl_temporarily_unavailable" 15 "SNA";
VAL_ 1066 PsngrDoorSts 0 "Closed" 1 "Open";
VAL_ 1066 RainSensorFailSts 0 "Fail_not_present" 1 "Fail_present";
VAL_ 1066 RearFogLightFault 0 "False" 1 "True";
VAL_ 1066 RearFogLightSts 0 "OFF" 1 "ON";
VAL_ 1066 RearTrunkEnableLastElSts 0 "Disabled" 1 "Enabled";
VAL_ 1066 RHatchSts 0 "Closed" 1 "Open";
VAL_ 1066 RHParkingLightSts 0 "OFF" 1 "ON";
VAL_ 1066 RHRDoorSts 0 "Closed" 1 "Open";
VAL_ 1066 RHTurnSignalSts 0 "OFF" 1 "ON";
VAL_ 1066 StopLightFault 0 "False" 1 "True";
VAL_ 1066 StopLightSts 0 "OFF" 1 "ON";
VAL_ 1066 TheftAlarmStatus 0 "VTA_DISARM" 1 "VTA_PREARM" 2 "VTA_ARM" 3 "VTA_LGT" 4 "VTA_LGT_HORN" 5 "VTA_TAMP" 6 "VTA_ITM_Alarm" 7 "SNA";
VAL_ 1066 TrunkHandleReleaseSts 0 "Not_Active" 1 "Active";
VAL_ 1066 WashLightWarningSts 0 "Not_Active" 1 "Active";
VAL_ 245 MinicryptReceptionSts 0 "Not_Received" 1 "Received";
VAL_ 513 Brk_Jrk_Resp 0 "Not_Executed" 1 "Executed";
VAL_ 513 Brk_Thermdl 0 "Normal_Temperature" 1 "High_Temperature";
VAL_ 513 BrkTrq 32767 "SNA";
VAL_ 513 BrkTrq_Driver 32767 "SNA";
VAL_ 513 DASEngReqPos 0 "Not_Allowed" 1 "Allowed";
VAL_ 513 eBurn_Stages 0 "Normal_Stage" 1 "Stage_1" 2 "Stage_2" 3 "Stage_3" 7 "SNA";
VAL_ 513 EngSpdIntervReq 0 "False" 1 "True";
VAL_ 513 ExternalBrkRequestsDisabled 0 "No request" 1 "External Systems temporary off" 2 "External Systems continuous off" 3 "SNA";
VAL_ 513 Ft_RrAxleCoupling_TrqRq 255 "SNA";
VAL_ 513 Ft_RrTrqCoupling_ModeRq 0 "FREE" 1 "HOLD" 2 "OPEN" 3 "SNA";
VAL_ 513 GrMax_Rq_BSM 0 "Passive" 1 "G1" 2 "G2" 3 "G3" 4 "G4" 5 "G5" 6 "G6" 7 "G7" 8 "G8" 9 "G9";
VAL_ 513 GrMin_Rq_BSM 0 "Passive" 1 "G1" 2 "G2" 3 "G3" 4 "G4" 5 "G5" 6 "G6" 7 "G7" 8 "G8" 9 "G9";
VAL_ 513 REF_VEH_SPEED 1023 "SNA";
VAL_ 513 SelectSpdSts 0 "OFF" 1 "Select Speed Mode" 2 "Select Speed Mode Inhibit" 3 "SNA";
VAL_ 513 SelSpdLmp 0 "OFF" 1 "CONT" 2 "BLINK" 3 "SNA";
VAL_ 513 ShftChrDsp_Rq_ESC 0 "SKL0" 1 "SKL1" 2 "SKL2" 3 "SKL3" 4 "SKL4" 5 "SKL5" 6 "SKL6" 7 "SKL7" 8 "SKL8" 9 "SKL9" 10 "SKL10" 11 "SKL11" 12 "SKL12" 15 "SNA";
VAL_ 513 VehicleStandStillSts 0 "True" 1 "False" 3 "SNA";
VAL_ 258 ABSActive 0 "Not_active" 1 "Active";
VAL_ 258 BrakeBoostPressure 2047 "SNA";
VAL_ 258 BrakeBoostStat 0 "INIT_Bst" 1 "Normal_Bst" 2 "Limited_Bst" 3 "Shutdown_Bst" 4 "MOCO" 5 "Half_Sys_Bst" 6 "No_Bst" 15 "SNA";
VAL_ 258 BrakeInterventionSts 0 "No_active_brake_intervention" 1 "Active_brake_intervention";
VAL_ 258 BrakePedalPressure 2047 "SNA";
VAL_ 258 Brk_Stat 0 "IDLE" 1 "BRAKING" 2 "NDEF2" 3 "SNA";
VAL_ 258 BSM_ESASystemSts 0 "Not_Enabled" 1 "Pending" 2 "Pre_Active" 3 "Active" 4 "Locked" 5 "Temporarily_Not_Avail" 6 "Permanently_Not_Avail" 7 "SNA";
VAL_ 258 ESCActive 0 "Not_active" 1 "Active";
VAL_ 258 ESP_Sys_Stat 0 "ABSERR_DIAG" 1 "NORM" 2 "HALF" 3 "ABGAS";
VAL_ 258 HBAActive 0 "Not_Active" 1 "Active";
VAL_ 258 HillHolderActive 0 "Not_Active" 1 "Active";
VAL_ 258 ImpendingSkid 0 "Impending_skid_false" 1 "Impending_skid_true";
VAL_ 258 InternalError_BSM 0 "No_int_processing_error_detected" 1 "Int_processing_error_detected";
VAL_ 258 LatAcceleration_BSM 4095 "SNA";
VAL_ 258 LatAccelerationFailSts_BSM 0 "Fail_Not_Present" 1 "Fail_Present";
VAL_ 258 LongAcceleration_BSM 4095 "SNA";
VAL_ 258 LongAccelerationFailSts_BSM 0 "Fail_Not_Present" 1 "Fail_Present";
VAL_ 258 MuSplit 0 "MuSplitOFF" 1 "MuSplitON" 3 "SNA";
VAL_ 258 OverSteering 63 "SNA";
VAL_ 258 ParkingGearShiftReq_BSM 0 "Idle" 1 "P" 2 "R" 3 "N" 4 "D" 7 "SNA";
VAL_ 258 PrefillActive 0 "Not_Active" 1 "Active";
VAL_ 258 Slope 255 "SNA";
VAL_ 258 UnderSteering 63 "SNA";
VAL_ 258 VehicleSpeedVSOSig 8191 "SNA";
VAL_ 258 WheelRPM_FL 65535 "SNA";
VAL_ 258 WheelRPM_FR 65535 "SNA";
VAL_ 258 YawRate_BSM 4095 "SNA";
VAL_ 258 YawRateFailSts_BSM 0 "Fail_Not_Present" 1 "Fail_Present";
VAL_ 259 LatAccelerationOffset_BSM 255 "SNA";
VAL_ 259 LHF_FastPulseCounter 255 "SNA";
VAL_ 259 LHF_Spin 0 "Stand_Still" 1 "Forward" 2 "Backward" 3 "SNA";
VAL_ 259 LHF_WheelSensorFailSts 0 "Fail_Not_Present" 1 "Fail_Present";
VAL_ 259 LHFWheelSpeed 8191 "SNA";
VAL_ 259 LHR_FastPulseCounter 255 "SNA";
VAL_ 259 LHR_Spin 0 "Stand_Still" 1 "Forward" 2 "Backward" 3 "SNA";
VAL_ 259 LHR_WheelSensorFailSts 0 "Fail_Not_Present" 1 "Fail_Present";
VAL_ 259 LHRWheelSpeed 8191 "SNA";
VAL_ 259 LongAccelerationOffset_BSM 255 "SNA";
VAL_ 259 LwsAngleOffset_BSM 1023 "SNA";
VAL_ 259 RHF_FastPulseCounter 255 "SNA";
VAL_ 259 RHF_Spin 0 "Stand_Still" 1 "Forward" 2 "Backward" 3 "SNA";
VAL_ 259 RHF_WheelSensorFailSts 0 "Fail_Not_Present" 1 "Fail_Present";
VAL_ 259 RHFWheelSpeed 8191 "SNA";
VAL_ 259 RHR_FastPulseCounter 255 "SNA";
VAL_ 259 RHR_Spin 0 "Stand_Still" 1 "Forward" 2 "Backward" 3 "SNA";
VAL_ 259 RHR_WheelSensorFailSts 0 "Fail_Not_Present" 1 "Fail_Present";
VAL_ 259 RHRWheelSpeed 8191 "SNA";
