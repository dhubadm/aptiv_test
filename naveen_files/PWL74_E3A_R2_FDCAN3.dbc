VERSION ""

NS_ :

BS_:

BU_: AGSM BCM BSM CADM DMSM DTCM ECM EVCU2 GNMM HCP IPC RFHM SGW TCM
BO_ 517 DRIVETRAIN_FD_1: 32 DTCM
 SG_ AWDSysStat : 87|3@0+ (1,0) [0|7] "-" BCM,BSM,ECM,GNMM,HCP,IPC,RFHM,SGW,TCM
 SG_ CCMFailSts : 83|1@0+ (1,0) [0|1] "-" BCM,BSM,IPC,SGW
 SG_ CRC_DRIVETRAIN1 : 191|8@0+ (1,0) [0|255] "-" BCM,BSM,ECM,GNMM,HCP,TCM
 SG_ DrvLnMinTrqMd : 84|1@0+ (1,0) [0|1] "-" ECM
 SG_ DrvLnTrqRq : 80|9@0+ (2,0) [0|1020] "Nm" ECM
 SG_ Ft_RrCouplingTrq_Actual : 103|8@0+ (12,0) [1|3000] "Nm" BCM,BSM,SGW
 SG_ Ft_RrCouplingTrq_Desired : 111|8@0+ (12,0) [1|3000] "Nm" SGW
 SG_ MessageCounter_DRIVETRAIN1 : 179|4@0+ (1,0) [0|15] "-" BCM,BSM,ECM,GNMM,HCP,TCM

BO_ 1447 DRIVETRAIN_FD_2: 32 DTCM
 SG_ CNT_DIFF_MOD : 123|3@0+ (1,0) [0|7] "-" Vector__XXX
 SG_ DTCM_HMI_Rq : 109|5@0+ (1,0) [0|31] "-" IPC
 SG_ TerSt_SWITCH1 : 85|2@0+ (1,0) [0|3] "-" BCM,IPC,SGW
 SG_ TerSt_SWITCH2 : 87|2@0+ (1,0) [0|3] "-" BCM,IPC,SGW

BO_ 1068 DRIVETRAIN_FD_3: 32 DTCM
 SG_ AxleLckr_SRV_RQ : 1|2@0+ (1,0) [0|2] "" IPC
 SG_ AxleLckr_Stat : 7|2@0+ (1,0) [0|2] "" IPC,SGW
 SG_ AxleLckrEvicDisp : 23|5@0+ (1,0) [0|30] "" IPC
 SG_ CRC__DRIVETRAIN3 : 191|8@0+ (1,0) [0|255] "-" BCM,BSM,CADM,ECM,TCM
 SG_ DTCM_Vehicle_Hold_Rq : 103|1@0+ (1,0) [0|1] "" BSM
 SG_ MessageCounter_DRIVETRAIN3 : 179|4@0+ (1,0) [0|15] "-" BCM,BSM,CADM,ECM,TCM
 SG_ RrAxleLockerIndRq : 5|2@0+ (1,0) [0|2] "" BCM,IPC
 SG_ Tcase2WD_Stat : 91|2@0+ (1,0) [0|3] "" BCM,IPC,SGW
 SG_ Tcase4Lock : 86|2@0+ (1,0) [0|3] "" BCM,IPC,SGW
 SG_ TcaseAWD : 95|2@0+ (1,0) [0|3] "" BCM,IPC,SGW
 SG_ TCASERANGESTATUS : 89|2@0+ (1,0) [0|2] "" BCM,BSM,CADM,ECM,IPC,SGW,TCM

BO_ 1438 DRV_MONITOR1_FD: 32 DMSM
 SG_ CRC_DRV_MONITOR1 : 191|8@0+ (1,0) [0|255] "-" CADM
 SG_ DM_Camera_Blind : 31|2@0+ (1,0) [0|3] "" CADM
 SG_ DM_Distract_Conf : 19|4@0+ (10,0) [0|150] "%" CADM
 SG_ DM_Distract_Instant : 6|7@0+ (1,0) [0|127] "%" CADM
 SG_ DM_Distract_State : 39|2@0+ (1,0) [0|3] "" BCM,CADM,SGW
 SG_ DM_Drowsy_Conf : 23|4@0+ (10,0) [0|150] "%" CADM
 SG_ DM_Drowsy_Instant : 14|7@0+ (1,0) [0|127] "%" CADM
 SG_ DM_Drowsy_Micro : 7|1@0+ (1,0) [0|1] "" CADM
 SG_ DM_Drowsy_State : 37|2@0+ (1,0) [0|3] "" BCM,CADM,SGW
 SG_ DM_Eyes_Tracked : 32|1@0+ (1,0) [0|1] "" CADM
 SG_ DM_Steering_Angle_Blockage : 47|1@0+ (1,0) [0|1] "" CADM
 SG_ DM_Zone_Track : 35|3@0+ (1,0) [0|7] "" BCM,CADM
 SG_ DM_Zone_Track_Conf : 27|4@0+ (10,0) [0|150] "%" CADM
 SG_ DMSM_System_Stat : 29|2@0+ (1,0) [0|3] "" CADM
 SG_ Driver_Presence : 15|1@0+ (1,0) [0|1] "" CADM,SGW
 SG_ MessageCounter_DRV_MONITOR1 : 179|4@0+ (1,0) [0|15] "-" CADM

BO_ 2654814209 ECM_APPL1: 8 ECM
 SG_ ECM_APPL1 : 7|64@0+ (1,0) [0|0] "" SGW

BO_ 2654817823 ECU_APPL_FD_AGSM: 64 AGSM
 SG_ ECU_APPL_FD_AGSM : 455|64@0+ (1,0) [0|0] "" SGW

BO_ 2654817818 ECU_APPL_FD_DTCM: 64 DTCM
 SG_ ECU_APPL_FD_DTCM : 455|64@0+ (1,0) [0|0] "" SGW

BO_ 2654817808 ECU_APPL_FD_ECM: 64 ECM
 SG_ ECU_APPL_FD_ECM : 455|64@0+ (1,0) [0|0] "" SGW

BO_ 2654817991 ECU_APPL_FD_RFHM: 64 RFHM
 SG_ ECU_APPL_FD_RFHM : 455|64@0+ (1,0) [0|0] "" Vector__XXX

BO_ 2654817816 ECU_APPL_FD_TCM: 64 TCM
 SG_ ECU_APPL_FD_TCM : 455|64@0+ (1,0) [0|0] "" SGW

BO_ 1054 ENGINE_FD_1: 32 ECM
 SG_ ACPressure : 88|9@0+ (0.1,0) [0|40] "bar" BCM
 SG_ ACPressureFailSts : 22|1@0+ (1,0) [0|1] "-" Vector__XXX
 SG_ AGS2Posn : 134|7@0+ (1,0) [0|100] "%" Vector__XXX
 SG_ AtmosphericPressure_W : 143|8@0+ (3.6,300) [300|1214.4] "mbar" BCM,BSM,RFHM,SGW,TCM
 SG_ AtmosphericPressureFailSts_W : 0|1@0+ (1,0) [0|1] "-" RFHM,SGW,TCM
 SG_ BoostVacGauge : 71|8@0+ (1,-100) [-100|154] "kPa" IPC,SGW
 SG_ BrkSw1Stat : 4|1@0+ (1,0) [0|1] "-" BCM,SGW
 SG_ BrkSw2Stat : 5|1@0+ (1,0) [0|1] "-" BCM,SGW
 SG_ CRC_ENGINE1 : 191|8@0+ (1,0) [0|255] "-" BCM,HCP,RFHM,TCM
 SG_ EngMaxRPM_W : 127|8@0+ (50,0) [0|10000] "-" TCM
 SG_ ESP_TrqRqEnabl : 6|1@0+ (1,0) [0|1] "-" BCM,SGW
 SG_ HighPressureFuelSystemFailure : 2|1@0+ (1,0) [0|1] "-" IPC
 SG_ Lv1CrsCtrlOff : 7|1@0+ (1,0) [0|1] "-" BCM,SGW
 SG_ MessageCounter_ENGINE1 : 179|4@0+ (1,0) [0|15] "-" BCM,HCP,RFHM,TCM
 SG_ RawPVS1 : 167|8@0+ (0.019607843,0) [0|4.98] "V" BCM,SGW
 SG_ RawPVS2 : 175|8@0+ (0.019607843,0) [0|4.98] "V" BCM,SGW
 SG_ RawTPS1 : 63|8@0+ (0.019607843,0) [0|4.98] "V" BCM,SGW
 SG_ RawTPS2 : 55|8@0+ (0.019607843,0) [0|4.98] "V" BCM,SGW
 SG_ ThermalManagementActive_W : 1|1@0+ (1,0) [0|1] "-" TCM
 SG_ ThrottlePosition : 87|8@0+ (0.392,0) [0|99.96] "%" BCM,SGW
 SG_ TransWarmUpMin_RPM : 159|8@0+ (25,0) [0|6375] "rpm" TCM
 SG_ TransWarmUpReq : 3|1@0+ (1,0) [0|1] "-" TCM

BO_ 262 ENGINE_FD_2: 64 ECM
 SG_ AlternatorFail_W : 114|1@0+ (1,0) [0|1] "-" IPC,SGW
 SG_ CrankHold_W : 179|1@0+ (1,0) [0|1] "-" BCM,SGW
 SG_ CRC_ENGINE2 : 447|8@0+ (1,0) [0|255] "-" BCM,BSM,CADM,DMSM,DTCM,HCP,IPC,TCM
 SG_ ECM_Ack_DriveMode : 52|4@0+ (1,0) [0|15] "-" Vector__XXX
 SG_ ECM_LHOM_Trans_W : 117|2@0+ (1,0) [0|3] "-" TCM
 SG_ ECM_LHOM_W : 188|1@0+ (1,0) [0|1] "-" TCM
 SG_ EngineFrictionTorque_W : 112|9@0+ (1,0) [0|510] "Nm" BCM,SGW
 SG_ EngineIdleRefSpeed : 35|12@0+ (1,0) [0|4094] "1/min" BSM,TCM
 SG_ EngineSailingRq : 185|1@0+ (1,0) [0|1] "-" TCM
 SG_ EngineSpeed_W : 21|14@0+ (1,0) [0|16382] "1/min" AGSM,BCM,BSM,CADM,DMSM,DTCM,ECM,EVCU2,GNMM,HCP,IPC,RFHM,SGW,TCM
 SG_ EngineSpeedFailSts_W : 168|1@0+ (1,0) [0|1] "-" BCM,DTCM,IPC,SGW
 SG_ EngineSts_W : 87|2@0+ (1,0) [0|3] "-" BCM,BSM,ECM,EVCU2,IPC,SGW,TCM
 SG_ EngRPM_Tach : 7|16@0+ (1,0) [0|65534] "rpm" IPC,SGW
 SG_ EngTrq_Enbl_Rq_TCM_W : 178|1@0+ (1,0) [0|1] "-" BCM,TCM
 SG_ ESS_EBOOST_BRKHLD_STATUS : 279|3@0+ (1,0) [0|6] "-" BSM
 SG_ ESS_ENG_ST_W : 175|4@0+ (1,0) [0|15] "-" BCM,BSM,DMSM,DTCM,IPC,SGW,TCM
 SG_ ESS_RqShftPark_W : 115|1@0+ (1,0) [0|0] "-" BCM,BSM,TCM
 SG_ EVRDesiredSetpoint : 135|8@0+ (0.0625,0) [0|15.875] "V" HCP
 SG_ FuelConsumption_GAG_3 : 251|20@0+ (0.0022,0) [0|2306.865] "Liter / hour" EVCU2,IPC,SGW
 SG_ FullOFC_Actv : 183|1@0+ (1,0) [0|1] "" Vector__XXX
 SG_ GasPedalGradient_W : 159|8@0+ (0.195,-25) [-25|24.53] "% /10ms" BCM
 SG_ GasPedalPosition_W : 143|8@0+ (0.392,0) [0|99.568] "%" BCM,BSM,DTCM,ECM,HCP,SGW,TCM
 SG_ GasPedalPositionFailSts_W : 169|1@0+ (1,0) [0|1] "-" BCM,BSM,DTCM,SGW,TCM
 SG_ IntakeAirTemperature_W : 151|8@0+ (1,-40) [-40|214] "C" ECM,IPC,SGW,TCM
 SG_ KickDownRequest_W : 182|1@0+ (1,0) [0|1] "-" TCM
 SG_ LV12PwrFreeRq_W : 176|1@0+ (1,0) [0|1] "-" TCM
 SG_ MessageCounter_ENGINE2 : 435|4@0+ (1,0) [0|15] "-" BCM,BSM,CADM,DMSM,DTCM,HCP,IPC,TCM
 SG_ PowertrainPrplsnActv : 181|1@0+ (1,0) [0|1] "" BCM,BSM,CADM,EVCU2,IPC,RFHM,SGW,TCM
 SG_ StartRelayBCMCmd_W : 187|1@0+ (1,0) [0|1] "-" BCM
 SG_ TRANS_CLU_SLIP_MODE_W : 71|3@0+ (1,0) [0|7] "-" TCM
 SG_ TxAC_EMCC_rq_W : 189|1@0+ (1,0) [0|1] "-" TCM

BO_ 1036 ENGINE_FD_3: 32 ECM
 SG_ AfterRunCoolantPumpFailSts : 166|1@0+ (1,0) [0|1] "-" IPC
 SG_ AxleInAir_Stat : 23|3@0+ (1,0) [0|6] "-" BCM,BSM,DTCM,TCM
 SG_ CoolVlvPos : 31|8@0+ (0.39374,0) [0|100.00996] "%" BCM
 SG_ CRC_ENGINE3 : 191|8@0+ (1,0) [0|255] "-" BSM,TCM
 SG_ DefFuelEcon : 7|8@0+ (0.2,0) [0|50] "kmpl" IPC,SGW
 SG_ DistOilLifeRst : 143|16@0+ (1,0) [0|65535] "km" BCM,IPC
 SG_ ECM_Thermal_AAD_Request : 9|1@0+ (1,0) [0|1] "-" EVCU2
 SG_ EngineOilCritical : 175|1@0+ (1,0) [0|1] "-" IPC
 SG_ EngineOilLevel : 84|5@0+ (1,0) [0|31] "" IPC
 SG_ EngineOilMin : 86|1@0+ (1,0) [0|1] "-" IPC
 SG_ EngineOilOverfill : 85|1@0+ (1,0) [0|1] "-" IPC
 SG_ EngineOilTemperature : 103|8@0+ (1,-40) [-40|214] "°C" EVCU2,IPC,SGW,TCM
 SG_ FANStatus : 174|7@0+ (1,0) [0|100] "%" Vector__XXX
 SG_ MessageCounter_ENGINE3 : 179|4@0+ (1,0) [0|15] "-" BSM,TCM
 SG_ OIL_IND_LMP_FLSH : 154|1@0+ (1,0) [0|1] "-" IPC,SGW
 SG_ OIL_TEMP_CHM_RQ : 156|2@0+ (1,0) [0|3] "-" SGW
 SG_ OIL_TEMP_IND_RQ : 161|2@0+ (1,0) [0|3] "-" IPC,SGW
 SG_ OilLifeLeft : 135|8@0+ (1,0) [0|255] "%" IPC,SGW
 SG_ OilLifeLeftRst : 165|1@0+ (1,0) [0|1] "-" IPC
 SG_ PT_WorkSite_Invtr_Capacity_ECM : 20|5@0+ (100,0) [0|3100] "W" BCM
 SG_ PT_WorkSite_Invtr_Sts_ECM : 153|2@0+ (1,0) [0|3] "-" BCM

BO_ 518 ENGINE_FD_5: 32 ECM
 SG_ AirFuelRatio : 175|8@0+ (0.1,5.5) [5.5|18] "Lambda" IPC,SGW
 SG_ CRC_ENGINE5 : 191|8@0+ (1,0) [0|255] "-" BCM,BSM,CADM,HCP,TCM
 SG_ ECM_CODE_CLR_W : 141|1@0+ (1,0) [0|0] "0" HCP,TCM
 SG_ ECM_READINESS_RESET_W : 140|1@0+ (1,0) [0|0] "0" HCP,TCM
 SG_ EngineReadyForESS_W : 116|1@0+ (1,0) [0|1] "-" TCM
 SG_ EngTrqMaxCorrFctr_W : 127|8@0+ (0.0078,0) [0|1.98] "Nm" TCM
 SG_ GrMin_Rq_ECM_W : 139|4@0+ (1,0) [0|15] "-" TCM
 SG_ IntkAirTempIntrClr : 167|8@0+ (1,-64) [-64|190] "°C" IPC,SGW
 SG_ LTR_CoolantTemp : 71|8@0+ (1,-64) [-64|190] "°C" IPC,SGW
 SG_ MessageCounter_ENGINE5 : 179|4@0+ (1,0) [0|15] "-" BCM,BSM,CADM,HCP,TCM
 SG_ PdlPosActual : 87|8@0+ (0.4,0) [0|100] "%" BCM,BSM,CADM,SGW
 SG_ RPMOverRev_W : 115|1@0+ (1,0) [0|1] "-" Vector__XXX

BO_ 751 ENGINE_FD_6: 32 ECM
 SG_ CRC_ENGINE6 : 191|8@0+ (1,0) [0|255] "-" BCM,BSM,CADM,DTCM,IPC,TCM
 SG_ DrvAway_Alert : 161|1@0+ (1,0) [0|1] "-" IPC
 SG_ DrvAway_Indications : 14|3@0+ (1,0) [0|2] "0" IPC
 SG_ DrvAway_Inhibit : 15|1@0+ (1,0) [0|1] "-" IPC
 SG_ ECM_FOTA_Conflict : 8|1@0+ (1,0) [0|1] "-" SGW
 SG_ ECM_MSG_RQ : 47|5@0+ (1,0) [0|0] "-" SGW
 SG_ EngineWaterTemp : 95|8@0+ (1,-40) [-40|215] "°C" BCM,IPC,SGW,TCM
 SG_ FuelConsumption_GAG : 103|16@0+ (0.0022,0) [0|144.1748] "litres/hour" SGW
 SG_ GearShiftIndication : 157|2@0+ (1,0) [0|3] "-" SGW
 SG_ HP_MODE_STS : 23|3@0+ (1,0) [0|6] "0" Vector__XXX
 SG_ LeakCheckTimerValue : 56|9@0+ (1,0) [0|510] "min" BCM
 SG_ LeakTestRequest : 160|1@0+ (1,0) [0|1] "-" BCM
 SG_ LeakTestSts : 169|2@0+ (1,0) [0|0] "0" BCM
 SG_ MessageCounter_ENGINE6 : 179|4@0+ (1,0) [0|15] "-" BCM,BSM,CADM,DTCM,IPC,TCM
 SG_ SAMInfo : 147|4@0+ (1,0) [0|14] "-" BCM
 SG_ Selector_SystemFailSts : 172|1@0+ (1,0) [0|1] "0" IPC
 SG_ StarterProtectionTime : 7|8@0+ (1,0) [0|254] "sec" IPC
 SG_ StartProtectionInhibit : 183|2@0+ (1,0) [0|0] "-" IPC
 SG_ StartRelayBCMFeedbackFault : 167|1@0+ (1,0) [0|1] "-" BCM
 SG_ StartRelayECMFeedbackFault : 163|1@0+ (1,0) [0|1] "-" BCM,SGW
 SG_ Terrain_HMI_Rq_ECM : 36|5@0+ (1,0) [0|30] "-" IPC
 SG_ TerrainModeDesiredStat : 28|5@0+ (1,0) [0|30] "0" BCM,IPC,SGW
 SG_ TerrainModeInterfaceButton_ECM : 11|3@0+ (1,0) [0|6] "-" SGW
 SG_ TerrainModeStat_ECM : 61|5@0+ (1,0) [0|30] "" BCM,BSM,CADM,DTCM,ECM,IPC,SGW,TCM
 SG_ Trns_DrvMd_CfgSts_ECM : 55|8@0+ (1,0) [0|30] "0" SGW
 SG_ Trns_DrvMdReq_ECM : 77|5@0+ (1,0) [0|30] "-" TCM

BO_ 1448 ENGINE_FD_7: 32 ECM
 SG_ CompressorSts : 85|2@0+ (1,0) [0|3] "-" BCM,SGW,TCM
 SG_ CRC_ENGINE7 : 191|8@0+ (1,0) [0|255] "-" BCM,CADM,IPC,TCM
 SG_ ECM_THA_Resp : 73|2@0+ (1,0) [0|2] "-" BCM
 SG_ ECM_TRSC_Resp : 7|2@0+ (1,0) [0|2] "-" BCM
 SG_ ECM_WARN_BTO : 147|1@0+ (1,0) [0|1] "-" IPC
 SG_ ECM_WARN_BTO_1 : 138|1@0+ (1,0) [0|1] "-" IPC
 SG_ EMSFailSts : 82|2@0+ (1,0) [0|3] "-" BCM,CADM,IPC,SGW
 SG_ EngineOperatingMode : 124|3@0+ (1,0) [0|7] "-" SGW
 SG_ ETCFailSts : 115|2@0+ (1,0) [0|3] "-" BCM,IPC,SGW
 SG_ ExhaustTemperature : 135|8@0+ (4,0) [0|1020] "°C" EVCU2,SGW
 SG_ FuelMM_Sts : 145|2@0+ (1,0) [0|0] "-" IPC
 SG_ HoursOilLifeRst : 35|12@0+ (1,0) [0|4000] "Hours" BCM
 SG_ KNK_MG_TRIGGER : 71|3@0+ (1,0) [0|3] "" IPC
 SG_ MessageCounter_ENGINE7 : 179|4@0+ (1,0) [0|15] "-" BCM,CADM,IPC,TCM
 SG_ MntncSts : 137|2@0+ (1,0) [0|3] "-" IPC,SGW
 SG_ OilLifeSts : 90|2@0+ (1,0) [0|3] "-" SGW
 SG_ OilPressureSts : 119|1@0+ (1,0) [0|1] "-" BCM,IPC,SGW
 SG_ PerfShftRq_HUD : 175|2@0+ (1,0) [0|3] "-" IPC
 SG_ SpStDispstat : 53|6@0+ (1,0) [0|63] "-" BCM,IPC,SGW,TCM
 SG_ SpStIndRq : 58|1@0+ (1,0) [0|1] "-" IPC
 SG_ SpStSwStat : 55|2@0+ (1,0) [0|3] "-" BCM,IPC,SGW

BO_ 1055 ENGINE_FD_8: 32 ECM
 SG_ AFTER_RUN_STATUS : 21|1@0+ (1,0) [0|1] "-" SGW
 SG_ AM_ECM_Prsnt : 103|2@0+ (1,0) [0|2] "-" BCM
 SG_ COOLING_REQUIRED_STATUS : 20|1@0+ (1,0) [0|1] "-" SGW
 SG_ CRC_ENGINE8 : 191|8@0+ (1,0) [0|255] "-" EVCU2,HCP,TCM
 SG_ GF_Charge : 127|16@0+ (0.2,0) [0|13106.8] "mg/cycle/cyl" BCM,SGW
 SG_ HOOD_AJAR_STATUS : 23|1@0+ (1,0) [0|1] "-" SGW
 SG_ LTR_TARGET_TEMP : 95|8@0+ (1,-40) [-40|214] "deg C" SGW
 SG_ MAP_4_BAR : 96|9@0+ (0.8,0) [0|408] "kPa" BCM,BSM,HCP,SGW
 SG_ MdsAct : 25|1@0+ (1,0) [0|1] "-" IPC,SGW,TCM
 SG_ MdsActforANC : 32|1@0+ (1,0) [0|1] "-" BCM
 SG_ MessageCounter_ENGINE8 : 179|4@0+ (1,0) [0|15] "-" EVCU2,HCP,TCM
 SG_ OIL_PRESS : 159|8@0+ (4,0) [0|1016] "kPaG" IPC,SGW
 SG_ PSI_EnableSts : 7|1@0+ (1,0) [0|1] "-" SGW
 SG_ PSI_Gr1_RPM : 87|8@0+ (250,500) [500|7500] "rpm" SGW
 SG_ PSI_Gr2_RPM : 79|8@0+ (250,500) [500|7500] "rpm" SGW
 SG_ PSI_Gr3_RPM : 71|8@0+ (250,500) [500|7500] "rpm" SGW
 SG_ PSI_Gr4_RPM : 63|8@0+ (250,500) [500|7500] "rpm" SGW
 SG_ PSI_Gr5_RPM : 55|8@0+ (250,500) [500|7500] "rpm" SGW
 SG_ PSI_Max_RPM : 101|5@0+ (100,2000) [2000|8000] "rpm" SGW
 SG_ RACE_CLDWN_BATT_STAT : 22|1@0+ (1,0) [0|1] "-" SGW
 SG_ RACE_CLDWN_DEAC_TIME : 137|10@0+ (1,0) [0|1022] "sec" SGW
 SG_ RACE_CLDWN_SEL : 19|1@0+ (1,0) [0|1] "-" SGW
 SG_ RefuelEvent : 44|3@0+ (1,0) [0|0] "-" BCM
 SG_ RefuelIndication : 47|3@0+ (1,0) [0|7] "-" IPC
 SG_ RevOilLifeRst : 167|16@0+ (1000,0) [0|65534000] "Rev's" BCM
 SG_ SYSTEM_STATUS : 26|1@0+ (1,0) [0|1] "-" SGW

BO_TX_BU_ 1068 : DTCM,EVCU2;
BO_TX_BU_ 751 : ECM,EVCU2;
BO_TX_BU_ 1448 : ECM,EVCU2;
CM_ SG_ 517 AWDSysStat "-";
CM_ SG_ 517 CCMFailSts "-";
CM_ SG_ 517 CRC_DRIVETRAIN1 "CRC according to SAE J1850 standard at each frame transmission.";
CM_ SG_ 517 DrvLnMinTrqMd "-";
CM_ SG_ 517 DrvLnTrqRq "-";
CM_ SG_ 517 Ft_RrCouplingTrq_Actual "-";
CM_ SG_ 517 Ft_RrCouplingTrq_Desired "-";
CM_ SG_ 517 MessageCounter_DRIVETRAIN1 "This signal is a counter used for safety checks strategies. This counter is incremented of 1 (one) unit at each frame transmission.";
CM_ SG_ 1447 CNT_DIFF_MOD "Actual mode of center differential";
CM_ SG_ 1447 DTCM_HMI_Rq "DTCM AWD_4WD HMI display request";
CM_ SG_ 1447 TerSt_SWITCH1 "Used to manage the signaling switch status";
CM_ SG_ 1447 TerSt_SWITCH2 "Used to manage the signaling switch status";
CM_ SG_ 1068 AxleLckr_SRV_RQ "Axle Locker Service Request";
CM_ SG_ 1068 AxleLckr_Stat "Axle locker status";
CM_ SG_ 1068 AxleLckrEvicDisp "Axle Locker EVIC Display";
CM_ SG_ 1068 CRC__DRIVETRAIN3 "CRC according to SAE J1850 standard at each frame transmission.";
CM_ SG_ 1068 DTCM_Vehicle_Hold_Rq "DTCM receives EPB status and triggers, then sends EPB hold request.";
CM_ SG_ 1068 MessageCounter_DRIVETRAIN3 "This signal is a counter used for safety checks strategies. This counter is incremented of 1 (one) unit at each frame transmission.";
CM_ SG_ 1068 RrAxleLockerIndRq "Rear Axle Locker LED Indicator";
CM_ SG_ 1068 Tcase2WD_Stat "Transfer case 2 wheel drive status";
CM_ SG_ 1068 Tcase4Lock "Transfer case 4WD locked status";
CM_ SG_ 1068 TcaseAWD "Transfer case High range / AWD LED status";
CM_ SG_ 1068 TCASERANGESTATUS "This signal is used for update the Transfer case Range status";
CM_ SG_ 1438 CRC_DRV_MONITOR1 "CRC according to SAE J1850 standard at each frame transmission.";
CM_ SG_ 1438 DM_Camera_Blind "Degree of driver monitoring camera blindness";
CM_ SG_ 1438 DM_Distract_Conf "Confidence in driver DM_Distract_State value";
CM_ SG_ 1438 DM_Distract_Instant "Instantaneous measurement of driver distraction level";
CM_ SG_ 1438 DM_Distract_State "Classification of driver distraction after debounce and filtering";
CM_ SG_ 1438 DM_Drowsy_Conf "Confidence in driver DM_Drowsy_State value";
CM_ SG_ 1438 DM_Drowsy_Instant "Instantaneous measurement of driver drowsiness level";
CM_ SG_ 1438 DM_Drowsy_Micro "Microsleep detected";
CM_ SG_ 1438 DM_Drowsy_State "Classification of driver drowsiness after debounce and filtering";
CM_ SG_ 1438 DM_Eyes_Tracked "DM_Eyes_Tracked";
CM_ SG_ 1438 DM_Steering_Angle_Blockage "Driver monitoring camera blocked by steering wheel";
CM_ SG_ 1438 DM_Zone_Track "Estimate of where driver is looking";
CM_ SG_ 1438 DM_Zone_Track_Conf "Confidence in DM_Zone_Track value";
CM_ SG_ 1438 DMSM_System_Stat "Reported capability of DMSM to provide monitoring information";
CM_ SG_ 1438 Driver_Presence "Indication of whether driver is detected by the monitoring system";
CM_ SG_ 1438 MessageCounter_DRV_MONITOR1 "This signal is a counter used for safety checks strategies. This counter is incremented of 1 (one) unit at each frame transmission.";
CM_ SG_ 2654817823 ECU_APPL_FD_AGSM "ECU to external application";
CM_ SG_ 2654817818 ECU_APPL_FD_DTCM "ECU to external application";
CM_ SG_ 2654817808 ECU_APPL_FD_ECM "ECU to external application";
CM_ SG_ 2654817991 ECU_APPL_FD_RFHM "ECU to external application";
CM_ SG_ 2654817816 ECU_APPL_FD_TCM "ECU to external application";
CM_ SG_ 1054 ACPressure "It indicates air conditioning pressure read from the AC linear pressure sensor.";
CM_ SG_ 1054 ACPressureFailSts "This signal indicates if the ACpressure sensor is in fail.";
CM_ SG_ 1054 AGS2Posn "ECM AGS2 feedback";
CM_ SG_ 1054 AtmosphericPressure_W "-";
CM_ SG_ 1054 AtmosphericPressureFailSts_W "-";
CM_ SG_ 1054 BoostVacGauge "Gauge input for calculated boost/vacuum pressure";
CM_ SG_ 1054 BrkSw1Stat "EDR ONLY - Brake switch1 status, off = [0]";
CM_ SG_ 1054 BrkSw2Stat "EDR ONLY - Brake switch2 status, off = [0]";
CM_ SG_ 1054 CRC_ENGINE1 "CRC according to SAE J1850 standard at each frame transmission.";
CM_ SG_ 1054 EngMaxRPM_W "-";
CM_ SG_ 1054 ESP_TrqRqEnabl "EDR ONLY - ESP torque requests are allowed = [1]";
CM_ SG_ 1054 HighPressureFuelSystemFailure "High Pressure Fuel Pump (HPFP) system failure where torque is limited to the amount of available fuel from supply pump.";
CM_ SG_ 1054 Lv1CrsCtrlOff "EDR ONLY - Level is requested cruise off";
CM_ SG_ 1054 MessageCounter_ENGINE1 "This signal is a counter used for safety checks strategies. This counter is incremented of 1 (one) unit at each frame transmission.";
CM_ SG_ 1054 RawPVS1 "EDR ONLY - Raw pedal value sensor #1";
CM_ SG_ 1054 RawPVS2 "EDR ONLY - Raw pedal value sensor #2";
CM_ SG_ 1054 RawTPS1 "EDR ONLY - Raw throttle position sensor #1";
CM_ SG_ 1054 RawTPS2 "EDR ONLY - Raw throttle position sensor #2";
CM_ SG_ 1054 ThermalManagementActive_W "-";
CM_ SG_ 1054 ThrottlePosition "GASOLINE APPLICATION ONLY This signal represents throttle position evaluated on the basis of throttle position sensor.";
CM_ SG_ 1054 TransWarmUpMin_RPM "Minimum engine speed for transmission warm-up strategy.";
CM_ SG_ 1054 TransWarmUpReq "ECM enable flag for transmission warm-up strategy.";
CM_ SG_ 262 AlternatorFail_W "Indicates if the alternator is in fail condition";
CM_ SG_ 262 CrankHold_W "Used by ECM to command an action to the BCM cranking relay during cranking phase";
CM_ SG_ 262 CRC_ENGINE2 "CRC according to SAE J1850 standard at each frame transmission.";
CM_ SG_ 262 ECM_Ack_DriveMode "ECM ratio manager acknowledged drive mode status";
CM_ SG_ 262 ECM_LHOM_Trans_W "Indicates to the transmission the Limp Home Status of ECM and Torque Accuracy";
CM_ SG_ 262 ECM_LHOM_W "-";
CM_ SG_ 262 EngineFrictionTorque_W "-";
CM_ SG_ 262 EngineIdleRefSpeed "This signal represents target of engine speed for the idle control function, at the end of dynamic transient conditions. It takes into account changes of idle speed due to temperature and auxiliary loads. It is updated even when the engine is ou(...)";
CM_ SG_ 262 EngineSailingRq "This signal indicates the request for Sailing functionality";
CM_ SG_ 262 EngineSpeed_W "It gives information on C-CAN network about  engine speed";
CM_ SG_ 262 EngineSpeedFailSts_W "Used to indicate if a Fail is present for the engine speed";
CM_ SG_ 262 EngineSts_W "-";
CM_ SG_ 262 EngRPM_Tach "Engine revolutions per minute for indication";
CM_ SG_ 262 EngTrq_Enbl_Rq_TCM_W "Allow TRANS torque request";
CM_ SG_ 262 ESS_EBOOST_BRKHLD_STATUS "ESS brake hold release status";
CM_ SG_ 262 ESS_ENG_ST_W "ESS Engine State";
CM_ SG_ 262 ESS_RqShftPark_W "ESS Request shift to Park.  1 = True, 0 = False";
CM_ SG_ 262 EVRDesiredSetpoint "Electronic Voltage Regulator Desired Voltage Set-Point.";
CM_ SG_ 262 FuelConsumption_GAG_3 "Fuel consumption";
CM_ SG_ 262 FullOFC_Actv "Cylinder cut-out";
CM_ SG_ 262 GasPedalGradient_W "-";
CM_ SG_ 262 GasPedalPosition_W "-";
CM_ SG_ 262 GasPedalPositionFailSts_W "-";
CM_ SG_ 262 KickDownRequest_W "It is set to KD_requested whenever the Kick-Down condition is detected by the ECM.";
CM_ SG_ 262 LV12PwrFreeRq_W "-";
CM_ SG_ 262 MessageCounter_ENGINE2 "This signal is a counter used for safety checks strategies. This counter is incremented of 1 (one) unit at each frame transmission.";
CM_ SG_ 262 PowertrainPrplsnActv "Powertrain Propulsion Status.";
CM_ SG_ 262 StartRelayBCMCmd_W "Used by ECM to command an action to the BCM cranking relay.";
CM_ SG_ 262 TRANS_CLU_SLIP_MODE_W "-";
CM_ SG_ 262 TxAC_EMCC_rq_W "-";
CM_ SG_ 1036 AfterRunCoolantPumpFailSts "The signal indicates a fault on AfterRunCoolant Pump";
CM_ SG_ 1036 AxleInAir_Stat "Used to indicate that the ECM has detected axle(s) in the air";
CM_ SG_ 1036 CoolVlvPos "Coolant Valve Position";
CM_ SG_ 1036 CRC_ENGINE3 "CRC according to SAE J1850 standard at each frame transmission.";
CM_ SG_ 1036 DefFuelEcon "Provides defined fuel economy for display in the cluster";
CM_ SG_ 1036 DistOilLifeRst "This signal sends the distance since oil life reset.";
CM_ SG_ 1036 ECM_Thermal_AAD_Request "This signal is sent from the ECM to EVCU2 indicating an over temperature condition. 0x0 False 0x1 True";
CM_ SG_ 1036 EngineOilCritical "Engine Oil Level Critically low";
CM_ SG_ 1036 EngineOilLevel "Engine Oil Level";
CM_ SG_ 1036 EngineOilMin "Oil Minimum indicator";
CM_ SG_ 1036 EngineOilOverfill "Oil Overfill indicator";
CM_ SG_ 1036 EngineOilTemperature "Engine Oil Temperature";
CM_ SG_ 1036 FANStatus "ECM Fan status feedback";
CM_ SG_ 1036 MessageCounter_ENGINE3 "This signal is a counter used for safety checks strategies. This counter is incremented of 1 (one) unit at each frame transmission.";
CM_ SG_ 1036 OIL_IND_LMP_FLSH "Oil indicator lamp flash (for in plant use)";
CM_ SG_ 1036 OIL_TEMP_CHM_RQ "Oil temperature chime request";
CM_ SG_ 1036 OIL_TEMP_IND_RQ "Oil temperature indicator request";
CM_ SG_ 1036 OilLifeLeft "This signal sends the oil life left percentage.";
CM_ SG_ 1036 OilLifeLeftRst "This signal is the reset acknowledge";
CM_ SG_ 1036 PT_WorkSite_Invtr_Capacity_ECM "Powertrain power support capacity for the 2KW Inverter";
CM_ SG_ 1036 PT_WorkSite_Invtr_Sts_ECM "Powertrain 2KW Inverter support status";
CM_ SG_ 518 AirFuelRatio "Air To fuel ratio";
CM_ SG_ 518 CRC_ENGINE5 "CRC according to SAE J1850 standard at each frame transmission.";
CM_ SG_ 518 ECM_CODE_CLR_W "Handshake for not to send";
CM_ SG_ 518 ECM_READINESS_RESET_W "Handshake for not to send";
CM_ SG_ 518 EngineReadyForESS_W "ESS request HIS charget (1=do charge)";
CM_ SG_ 518 EngTrqMaxCorrFctr_W "Factor of reduction from max torque based on ambient conditions";
CM_ SG_ 518 GrMin_Rq_ECM_W "Target gear lower limit (ECM requested limit)";
CM_ SG_ 518 IntkAirTempIntrClr "Intake air temperature post intercooler";
CM_ SG_ 518 LTR_CoolantTemp "Low temp radiator (intercooler) coolant temperature";
CM_ SG_ 518 MessageCounter_ENGINE5 "This signal is a counter used for safety checks strategies. This counter is incremented of 1 (one) unit at each frame transmission.";
CM_ SG_ 518 PdlPosActual "Actual pedal position.";
CM_ SG_ 518 RPMOverRev_W "-";
CM_ SG_ 751 CRC_ENGINE6 "CRC according to SAE J1850 standard at each frame transmission.";
CM_ SG_ 751 DrvAway_Alert "Drive Away Alert; True = [1]";
CM_ SG_ 751 DrvAway_Indications "Drive Away Inhibit Indications";
CM_ SG_ 751 DrvAway_Inhibit "Drive Away Inhibit; True = [1]";
CM_ SG_ 751 ECM_FOTA_Conflict "ECM Conflict with FOTA";
CM_ SG_ 751 ECM_MSG_RQ "ECM Driver Instruction Messages";
CM_ SG_ 751 EngineWaterTemp "-";
CM_ SG_ 751 FuelConsumption_GAG "It represents istantaneous consumption information sent on network";
CM_ SG_ 751 GearShiftIndication "-";
CM_ SG_ 751 HP_MODE_STS "Engine power mode personalization status";
CM_ SG_ 751 LeakCheckTimerValue "Requested leak test timer value";
CM_ SG_ 751 LeakTestRequest "Leak test is requested after powerdown; No request = [0], Leak test requested = [1]";
CM_ SG_ 751 LeakTestSts "Status of leak test";
CM_ SG_ 751 MessageCounter_ENGINE6 "This signal is a counter used for safety checks strategies. This counter is incremented of 1 (one) unit at each frame transmission.";
CM_ SG_ 751 SAMInfo "-";
CM_ SG_ 751 Selector_SystemFailSts "Used to require a vehicle modality";
CM_ SG_ 751 StarterProtectionTime "Starter protection time";
CM_ SG_ 751 StartProtectionInhibit "Starter protection status";
CM_ SG_ 751 StartRelayBCMFeedbackFault "-";
CM_ SG_ 751 StartRelayECMFeedbackFault "-";
CM_ SG_ 751 TerrainModeDesiredStat "Signal indicates customer desired terrain mode status";
CM_ SG_ 751 TerrainModeInterfaceButton_ECM "Signal Indicates G/T or TRX Button activated or Not Activated by driver";
CM_ SG_ 751 TerrainModeStat_ECM "Used to require a vehicle modality";
CM_ SG_ 751 Trns_DrvMd_CfgSts_ECM "The requested state of the drive mode feature";
CM_ SG_ 751 Trns_DrvMdReq_ECM "The requested state of the drive mode feature";
CM_ SG_ 1448 CompressorSts "This signal gives information about the present status of A/C external request and actual A/C activation by ECM.";
CM_ SG_ 1448 CRC_ENGINE7 "CRC according to SAE J1850 standard at each frame transmission.";
CM_ SG_ 1448 ECM_THA_Resp "ECM speed limiting availability response for trailer hitch assist";
CM_ SG_ 1448 ECM_TRSC_Resp "Engine break activation response";
CM_ SG_ 1448 ECM_WARN_BTO "A new message will be displayed on cluster when both brake and gas pedal are pressed simultaneously";
CM_ SG_ 1448 ECM_WARN_BTO_1 "A new message will be displayed on cluster when both brake and gas pedal are pressed simultaneously - without ETC lamp";
CM_ SG_ 1448 EMSFailSts "This signal is used  to switch on and off the engine control system warning lamp (called MI for EOBD applications)";
CM_ SG_ 1448 EngineOperatingMode "This signal indicates the engine operating mode (normal or after-treatment systems regeneration)";
CM_ SG_ 1448 ETCFailSts "This signal is used  to switch on and off  ETC lamp to give informations about faults not EOBD relevant.";
CM_ SG_ 1448 ExhaustTemperature "This signal indicates the exhaust engine temperature after combustion or after-treatment systems (if applicable)";
CM_ SG_ 1448 FuelMM_Sts "Fuel maintenance mode status";
CM_ SG_ 1448 HoursOilLifeRst "Hours since last oil life reset";
CM_ SG_ 1448 KNK_MG_TRIGGER "Engine is experiencing high levels of LSPI (mega-knock)";
CM_ SG_ 1448 MessageCounter_ENGINE7 "This signal is a counter used for safety checks strategies. This counter is incremented of 1 (one) unit at each frame transmission.";
CM_ SG_ 1448 MntncSts "Maintenance reminder status";
CM_ SG_ 1448 OilLifeSts "This information is related to engine oil life algorithm, currently used on Diesel engines equipped with DPF.";
CM_ SG_ 1448 OilPressureSts "This signal  indicates oil pressure status (High or low).";
CM_ SG_ 1448 PerfShftRq_HUD "Performance transmission shift request HUD";
CM_ SG_ 1448 SpStDispstat "Stop start display status";
CM_ SG_ 1448 SpStIndRq "Stop start indicator request";
CM_ SG_ 1448 SpStSwStat "Stop start switch status";
CM_ SG_ 1055 AFTER_RUN_STATUS "Quick cooldown feature; Active = [1]";
CM_ SG_ 1055 AM_ECM_Prsnt "Aftermarket ECM present";
CM_ SG_ 1055 COOLING_REQUIRED_STATUS "Status of LTR system requiring cooling; Required = [1]";
CM_ SG_ 1055 CRC_ENGINE8 "CRC according to SAE J1850 standard at each frame transmission.";
CM_ SG_ 1055 GF_Charge "EDR ONLY - Port flow per cylinder per stroke";
CM_ SG_ 1055 HOOD_AJAR_STATUS "Hood adjar for cooldown feature; Open = [1]";
CM_ SG_ 1055 LTR_TARGET_TEMP "LTR target temperature in degC";
CM_ SG_ 1055 MAP_4_BAR "Engine manifold pressure (4 bar range)";
CM_ SG_ 1055 MdsAct "MDS Active";
CM_ SG_ 1055 MdsActforANC "MDS active for ANC; Active = [1]";
CM_ SG_ 1055 MessageCounter_ENGINE8 "This signal is a counter used for safety checks strategies. This counter is incremented of 1 (one) unit at each frame transmission.";
CM_ SG_ 1055 OIL_PRESS "Oil pressure";
CM_ SG_ 1055 PSI_EnableSts "Performance shift indication enabled status; enabled = [1]";
CM_ SG_ 1055 PSI_Gr1_RPM "Actual rpm set point for performance shift indication; 500 indicates not set";
CM_ SG_ 1055 PSI_Gr2_RPM "Actual rpm set point for performance shift indication; 500 indicates not set";
CM_ SG_ 1055 PSI_Gr3_RPM "Actual rpm set point for performance shift indication; 500 indicates not set";
CM_ SG_ 1055 PSI_Gr4_RPM "Actual rpm set point for performance shift indication; 500 indicates not set";
CM_ SG_ 1055 PSI_Gr5_RPM "Actual rpm set point for performance shift indication; 500 indicates not set";
CM_ SG_ 1055 PSI_Max_RPM "Maximum selectable RPM for PSI feature";
CM_ SG_ 1055 RACE_CLDWN_BATT_STAT "Battery health for quick cooldown feature; Acceptable = [1]";
CM_ SG_ 1055 RACE_CLDWN_DEAC_TIME "Race cooldown time remaining before deactivation";
CM_ SG_ 1055 RACE_CLDWN_SEL "State of user selected quick cooldown feature; Selected = [1]";
CM_ SG_ 1055 RefuelEvent "Status of refuel event";
CM_ SG_ 1055 RefuelIndication "Indication to the driver about the status of the refuel system";
CM_ SG_ 1055 RevOilLifeRst "Engine revolutions since last oil life reset";
CM_ SG_ 1055 SYSTEM_STATUS "System faults; Acive faults = [1]";

BA_DEF_ SG_ "GenSigStartValue" INT 0 2147483647;
BA_DEF_ SG_ "GenSigInactiveValue" INT 0 2147483647;
BA_DEF_ SG_ "GenSigSendType" ENUM "NotUsed","OnWrite","OnWriteWithRepetition","OnChange","OnChangeWithRepetition","IfActive","IfActiveWithRepetition","NoSigSendType";
BA_DEF_ SG_ "SystemSignalLongSymbol" STRING ;
BA_DEF_ SG_ "GenSigTimeoutTime_AGSM" INT 0 65535;
BA_DEF_ SG_ "GenSigTimeoutTime_BCM" INT 0 65535;
BA_DEF_ SG_ "GenSigTimeoutTime_BSM" INT 0 65535;
BA_DEF_ SG_ "GenSigTimeoutTime_CADM" INT 0 65535;
BA_DEF_ SG_ "GenSigTimeoutTime_DMSM" INT 0 65535;
BA_DEF_ SG_ "GenSigTimeoutTime_DTCM" INT 0 65535;
BA_DEF_ SG_ "GenSigTimeoutTime_ECM" INT 0 65535;
BA_DEF_ SG_ "GenSigTimeoutTime_EVCU2" INT 0 65535;
BA_DEF_ SG_ "GenSigTimeoutTime_GNMM" INT 0 65535;
BA_DEF_ SG_ "GenSigTimeoutTime_HCP" INT 0 65535;
BA_DEF_ SG_ "GenSigTimeoutTime_IPC" INT 0 65535;
BA_DEF_ SG_ "GenSigTimeoutTime_RFHM" INT 0 65535;
BA_DEF_ SG_ "GenSigTimeoutTime_SGW" INT 0 65535;
BA_DEF_ SG_ "GenSigTimeoutTime_TCM" INT 0 65535;
BA_DEF_ BO_ "DiagRequest" ENUM "No","Yes";
BA_DEF_ BO_ "Type" ENUM "P","C","PE","COC","PE_Cntrl","E","E_Cntrl","OC","S","BAF","DC","EM","MM","ISO-TP","-";
BA_DEF_ BO_ "DiagResponse" ENUM "No","Yes";
BA_DEF_ BO_ "NmMessage" ENUM "No","Yes";
BA_DEF_ BO_ "GenMsgSendType" ENUM "Cyclic","NotUsed","NotUsed","NotUsed","NotUsed","NotUsed","NotUsed","NotUsed","NoMsgSendType";
BA_DEF_ BO_ "GenMsgNrOfRepetition" INT 0 255;
BA_DEF_ BO_ "GenMsgILSupport" ENUM "No","Yes";
BA_DEF_ BO_ "GenMsgStartDelayTime" INT 0 65535;
BA_DEF_ BO_ "GenMsgCycleTimeFast" INT 0 65535;
BA_DEF_ BO_ "GenMsgCycleTime" INT 0 65535;
BA_DEF_ BO_ "GenMsgDelayTime" INT 0 65535;
BA_DEF_ BO_ "NmAsrMessage" ENUM "No","Yes";
BA_DEF_ BO_ "DiagState" ENUM "No","Yes";
BA_DEF_ BO_ "DiagConnection" HEX 0 65535;
BA_DEF_ BO_ "VFrameFormat" ENUM "StandardCAN","ExtendedCAN","reserved","reserved","reserved","reserved","reserved","reserved","reserved","reserved","reserved","reserved","reserved","reserved","StandardCAN_FD","ExtendedCAN_FD";
BA_DEF_ BO_ "CANFD_BRS" ENUM "No","Yes";
BA_DEF_DEF_ "DiagRequest" "No";
BA_DEF_DEF_ "Type" "-";
BA_DEF_DEF_ "DiagResponse" "No";
BA_DEF_DEF_ "NmMessage" "No";
BA_DEF_DEF_ "GenMsgSendType" "NoMsgSendType";
BA_DEF_DEF_ "GenMsgNrOfRepetition" 0;
BA_DEF_DEF_ "GenMsgILSupport" "No";
BA_DEF_DEF_ "GenMsgStartDelayTime" 0;
BA_DEF_DEF_ "GenMsgCycleTimeFast" 0;
BA_DEF_DEF_ "GenMsgCycleTime" 0;
BA_DEF_DEF_ "GenMsgDelayTime" 0;
BA_DEF_DEF_ "NmAsrMessage" "No";
BA_DEF_DEF_ "DiagState" "No";
BA_DEF_DEF_ "DiagConnection" 0;
BA_DEF_DEF_ "VFrameFormat" "StandardCAN_FD";
BA_DEF_DEF_ "CANFD_BRS" "No";
BA_DEF_DEF_ "GenSigStartValue" 0;
BA_DEF_DEF_ "GenSigInactiveValue" 0;
BA_DEF_DEF_ "GenSigSendType" "NoSigSendType";
BA_DEF_DEF_ "SystemSignalLongSymbol" "";
BA_DEF_DEF_ "GenSigTimeoutTime_AGSM" 2500;
BA_DEF_DEF_ "GenSigTimeoutTime_BCM" 2500;
BA_DEF_DEF_ "GenSigTimeoutTime_BSM" 2500;
BA_DEF_DEF_ "GenSigTimeoutTime_CADM" 2500;
BA_DEF_DEF_ "GenSigTimeoutTime_DMSM" 2500;
BA_DEF_DEF_ "GenSigTimeoutTime_DTCM" 2500;
BA_DEF_DEF_ "GenSigTimeoutTime_ECM" 2500;
BA_DEF_DEF_ "GenSigTimeoutTime_EVCU2" 2500;
BA_DEF_DEF_ "GenSigTimeoutTime_GNMM" 2500;
BA_DEF_DEF_ "GenSigTimeoutTime_HCP" 2500;
BA_DEF_DEF_ "GenSigTimeoutTime_IPC" 2500;
BA_DEF_DEF_ "GenSigTimeoutTime_RFHM" 2500;
BA_DEF_DEF_ "GenSigTimeoutTime_SGW" 2500;
BA_DEF_DEF_ "GenSigTimeoutTime_TCM" 2500;
BA_ "Type" BO_ 517 1;
BA_ "GenMsgSendType" BO_ 517 0;
BA_ "GenMsgILSupport" BO_ 517 1;
BA_ "GenMsgCycleTime" BO_ 517 20;
BA_ "CANFD_BRS" BO_ 517 1;
BA_ "Type" BO_ 1447 3;
BA_ "GenMsgSendType" BO_ 1447 0;
BA_ "GenMsgNrOfRepetition" BO_ 1447 2;
BA_ "GenMsgILSupport" BO_ 1447 1;
BA_ "GenMsgCycleTimeFast" BO_ 1447 20;
BA_ "GenMsgCycleTime" BO_ 1447 1000;
BA_ "GenMsgDelayTime" BO_ 1447 20;
BA_ "CANFD_BRS" BO_ 1447 1;
BA_ "Type" BO_ 1068 3;
BA_ "GenMsgSendType" BO_ 1068 0;
BA_ "GenMsgNrOfRepetition" BO_ 1068 2;
BA_ "GenMsgILSupport" BO_ 1068 1;
BA_ "GenMsgCycleTimeFast" BO_ 1068 20;
BA_ "GenMsgCycleTime" BO_ 1068 100;
BA_ "GenMsgDelayTime" BO_ 1068 20;
BA_ "CANFD_BRS" BO_ 1068 1;
BA_ "Type" BO_ 1438 3;
BA_ "GenMsgSendType" BO_ 1438 0;
BA_ "GenMsgNrOfRepetition" BO_ 1438 2;
BA_ "GenMsgILSupport" BO_ 1438 1;
BA_ "GenMsgCycleTimeFast" BO_ 1438 20;
BA_ "GenMsgCycleTime" BO_ 1438 1000;
BA_ "GenMsgDelayTime" BO_ 1438 20;
BA_ "CANFD_BRS" BO_ 1438 1;
BA_ "Type" BO_ 2654814209 8;
BA_ "GenMsgILSupport" BO_ 2654814209 1;
BA_ "VFrameFormat" BO_ 2654814209 1;
BA_ "Type" BO_ 2654817823 8;
BA_ "GenMsgILSupport" BO_ 2654817823 1;
BA_ "VFrameFormat" BO_ 2654817823 15;
BA_ "CANFD_BRS" BO_ 2654817823 1;
BA_ "Type" BO_ 2654817818 8;
BA_ "GenMsgILSupport" BO_ 2654817818 1;
BA_ "VFrameFormat" BO_ 2654817818 15;
BA_ "CANFD_BRS" BO_ 2654817818 1;
BA_ "Type" BO_ 2654817808 8;
BA_ "GenMsgILSupport" BO_ 2654817808 1;
BA_ "VFrameFormat" BO_ 2654817808 15;
BA_ "CANFD_BRS" BO_ 2654817808 1;
BA_ "Type" BO_ 2654817991 8;
BA_ "GenMsgILSupport" BO_ 2654817991 1;
BA_ "VFrameFormat" BO_ 2654817991 15;
BA_ "CANFD_BRS" BO_ 2654817991 1;
BA_ "Type" BO_ 2654817816 8;
BA_ "VFrameFormat" BO_ 2654817816 15;
BA_ "CANFD_BRS" BO_ 2654817816 1;
BA_ "Type" BO_ 1054 1;
BA_ "GenMsgSendType" BO_ 1054 0;
BA_ "GenMsgILSupport" BO_ 1054 1;
BA_ "GenMsgCycleTime" BO_ 1054 100;
BA_ "CANFD_BRS" BO_ 1054 1;
BA_ "Type" BO_ 262 1;
BA_ "GenMsgSendType" BO_ 262 0;
BA_ "GenMsgILSupport" BO_ 262 1;
BA_ "GenMsgCycleTime" BO_ 262 10;
BA_ "CANFD_BRS" BO_ 262 1;
BA_ "Type" BO_ 1036 3;
BA_ "GenMsgSendType" BO_ 1036 0;
BA_ "GenMsgNrOfRepetition" BO_ 1036 2;
BA_ "GenMsgILSupport" BO_ 1036 1;
BA_ "GenMsgCycleTimeFast" BO_ 1036 20;
BA_ "GenMsgCycleTime" BO_ 1036 100;
BA_ "GenMsgDelayTime" BO_ 1036 20;
BA_ "CANFD_BRS" BO_ 1036 1;
BA_ "Type" BO_ 518 1;
BA_ "GenMsgSendType" BO_ 518 0;
BA_ "GenMsgILSupport" BO_ 518 1;
BA_ "GenMsgCycleTime" BO_ 518 20;
BA_ "CANFD_BRS" BO_ 518 1;
BA_ "Type" BO_ 751 1;
BA_ "GenMsgSendType" BO_ 751 0;
BA_ "GenMsgILSupport" BO_ 751 1;
BA_ "GenMsgCycleTime" BO_ 751 50;
BA_ "CANFD_BRS" BO_ 751 1;
BA_ "Type" BO_ 1448 3;
BA_ "GenMsgSendType" BO_ 1448 0;
BA_ "GenMsgNrOfRepetition" BO_ 1448 2;
BA_ "GenMsgILSupport" BO_ 1448 1;
BA_ "GenMsgCycleTimeFast" BO_ 1448 20;
BA_ "GenMsgCycleTime" BO_ 1448 1000;
BA_ "GenMsgDelayTime" BO_ 1448 20;
BA_ "CANFD_BRS" BO_ 1448 1;
BA_ "Type" BO_ 1055 1;
BA_ "GenMsgSendType" BO_ 1055 0;
BA_ "GenMsgILSupport" BO_ 1055 1;
BA_ "GenMsgCycleTime" BO_ 1055 100;
BA_ "CANFD_BRS" BO_ 1055 1;
BA_ "GenSigStartValue" SG_ 517 AWDSysStat 7;
BA_ "GenSigTimeoutTime_AGSM" SG_ 517 AWDSysStat 0;
BA_ "GenSigTimeoutTime_CADM" SG_ 517 AWDSysStat 0;
BA_ "GenSigTimeoutTime_DMSM" SG_ 517 AWDSysStat 0;
BA_ "GenSigTimeoutTime_DTCM" SG_ 517 AWDSysStat 0;
BA_ "GenSigTimeoutTime_EVCU2" SG_ 517 AWDSysStat 0;
BA_ "GenSigTimeoutTime_AGSM" SG_ 517 CCMFailSts 0;
BA_ "GenSigTimeoutTime_CADM" SG_ 517 CCMFailSts 0;
BA_ "GenSigTimeoutTime_DMSM" SG_ 517 CCMFailSts 0;
BA_ "GenSigTimeoutTime_DTCM" SG_ 517 CCMFailSts 0;
BA_ "GenSigTimeoutTime_ECM" SG_ 517 CCMFailSts 0;
BA_ "GenSigTimeoutTime_EVCU2" SG_ 517 CCMFailSts 0;
BA_ "GenSigTimeoutTime_GNMM" SG_ 517 CCMFailSts 0;
BA_ "GenSigTimeoutTime_HCP" SG_ 517 CCMFailSts 0;
BA_ "GenSigTimeoutTime_RFHM" SG_ 517 CCMFailSts 0;
BA_ "GenSigTimeoutTime_TCM" SG_ 517 CCMFailSts 0;
BA_ "GenSigTimeoutTime_AGSM" SG_ 517 CRC_DRIVETRAIN1 0;
BA_ "GenSigTimeoutTime_CADM" SG_ 517 CRC_DRIVETRAIN1 0;
BA_ "GenSigTimeoutTime_DMSM" SG_ 517 CRC_DRIVETRAIN1 0;
BA_ "GenSigTimeoutTime_DTCM" SG_ 517 CRC_DRIVETRAIN1 0;
BA_ "GenSigTimeoutTime_EVCU2" SG_ 517 CRC_DRIVETRAIN1 0;
BA_ "GenSigTimeoutTime_IPC" SG_ 517 CRC_DRIVETRAIN1 0;
BA_ "GenSigTimeoutTime_RFHM" SG_ 517 CRC_DRIVETRAIN1 0;
BA_ "GenSigTimeoutTime_SGW" SG_ 517 CRC_DRIVETRAIN1 0;
BA_ "GenSigTimeoutTime_AGSM" SG_ 517 DrvLnMinTrqMd 0;
BA_ "GenSigTimeoutTime_BCM" SG_ 517 DrvLnMinTrqMd 0;
BA_ "GenSigTimeoutTime_BSM" SG_ 517 DrvLnMinTrqMd 0;
BA_ "GenSigTimeoutTime_CADM" SG_ 517 DrvLnMinTrqMd 0;
BA_ "GenSigTimeoutTime_DMSM" SG_ 517 DrvLnMinTrqMd 0;
BA_ "GenSigTimeoutTime_DTCM" SG_ 517 DrvLnMinTrqMd 0;
BA_ "GenSigTimeoutTime_EVCU2" SG_ 517 DrvLnMinTrqMd 0;
BA_ "GenSigTimeoutTime_GNMM" SG_ 517 DrvLnMinTrqMd 0;
BA_ "GenSigTimeoutTime_HCP" SG_ 517 DrvLnMinTrqMd 0;
BA_ "GenSigTimeoutTime_IPC" SG_ 517 DrvLnMinTrqMd 0;
BA_ "GenSigTimeoutTime_RFHM" SG_ 517 DrvLnMinTrqMd 0;
BA_ "GenSigTimeoutTime_SGW" SG_ 517 DrvLnMinTrqMd 0;
BA_ "GenSigTimeoutTime_TCM" SG_ 517 DrvLnMinTrqMd 0;
BA_ "GenSigStartValue" SG_ 517 DrvLnTrqRq 511;
BA_ "GenSigTimeoutTime_AGSM" SG_ 517 DrvLnTrqRq 0;
BA_ "GenSigTimeoutTime_BCM" SG_ 517 DrvLnTrqRq 0;
BA_ "GenSigTimeoutTime_BSM" SG_ 517 DrvLnTrqRq 0;
BA_ "GenSigTimeoutTime_CADM" SG_ 517 DrvLnTrqRq 0;
BA_ "GenSigTimeoutTime_DMSM" SG_ 517 DrvLnTrqRq 0;
BA_ "GenSigTimeoutTime_DTCM" SG_ 517 DrvLnTrqRq 0;
BA_ "GenSigTimeoutTime_EVCU2" SG_ 517 DrvLnTrqRq 0;
BA_ "GenSigTimeoutTime_GNMM" SG_ 517 DrvLnTrqRq 0;
BA_ "GenSigTimeoutTime_HCP" SG_ 517 DrvLnTrqRq 0;
BA_ "GenSigTimeoutTime_IPC" SG_ 517 DrvLnTrqRq 0;
BA_ "GenSigTimeoutTime_RFHM" SG_ 517 DrvLnTrqRq 0;
BA_ "GenSigTimeoutTime_SGW" SG_ 517 DrvLnTrqRq 0;
BA_ "GenSigTimeoutTime_TCM" SG_ 517 DrvLnTrqRq 0;
BA_ "GenSigStartValue" SG_ 517 Ft_RrCouplingTrq_Actual 255;
BA_ "GenSigTimeoutTime_AGSM" SG_ 517 Ft_RrCouplingTrq_Actual 0;
BA_ "GenSigTimeoutTime_CADM" SG_ 517 Ft_RrCouplingTrq_Actual 0;
BA_ "GenSigTimeoutTime_DMSM" SG_ 517 Ft_RrCouplingTrq_Actual 0;
BA_ "GenSigTimeoutTime_DTCM" SG_ 517 Ft_RrCouplingTrq_Actual 0;
BA_ "GenSigTimeoutTime_ECM" SG_ 517 Ft_RrCouplingTrq_Actual 0;
BA_ "GenSigTimeoutTime_EVCU2" SG_ 517 Ft_RrCouplingTrq_Actual 0;
BA_ "GenSigTimeoutTime_GNMM" SG_ 517 Ft_RrCouplingTrq_Actual 0;
BA_ "GenSigTimeoutTime_HCP" SG_ 517 Ft_RrCouplingTrq_Actual 0;
BA_ "GenSigTimeoutTime_IPC" SG_ 517 Ft_RrCouplingTrq_Actual 0;
BA_ "GenSigTimeoutTime_RFHM" SG_ 517 Ft_RrCouplingTrq_Actual 0;
BA_ "GenSigTimeoutTime_TCM" SG_ 517 Ft_RrCouplingTrq_Actual 0;
BA_ "GenSigStartValue" SG_ 517 Ft_RrCouplingTrq_Desired 255;
BA_ "GenSigTimeoutTime_AGSM" SG_ 517 Ft_RrCouplingTrq_Desired 0;
BA_ "GenSigTimeoutTime_BCM" SG_ 517 Ft_RrCouplingTrq_Desired 0;
BA_ "GenSigTimeoutTime_BSM" SG_ 517 Ft_RrCouplingTrq_Desired 0;
BA_ "GenSigTimeoutTime_CADM" SG_ 517 Ft_RrCouplingTrq_Desired 0;
BA_ "GenSigTimeoutTime_DMSM" SG_ 517 Ft_RrCouplingTrq_Desired 0;
BA_ "GenSigTimeoutTime_DTCM" SG_ 517 Ft_RrCouplingTrq_Desired 0;
BA_ "GenSigTimeoutTime_ECM" SG_ 517 Ft_RrCouplingTrq_Desired 0;
BA_ "GenSigTimeoutTime_EVCU2" SG_ 517 Ft_RrCouplingTrq_Desired 0;
BA_ "GenSigTimeoutTime_GNMM" SG_ 517 Ft_RrCouplingTrq_Desired 0;
BA_ "GenSigTimeoutTime_HCP" SG_ 517 Ft_RrCouplingTrq_Desired 0;
BA_ "GenSigTimeoutTime_IPC" SG_ 517 Ft_RrCouplingTrq_Desired 0;
BA_ "GenSigTimeoutTime_RFHM" SG_ 517 Ft_RrCouplingTrq_Desired 0;
BA_ "GenSigTimeoutTime_TCM" SG_ 517 Ft_RrCouplingTrq_Desired 0;
BA_ "GenSigTimeoutTime_AGSM" SG_ 517 MessageCounter_DRIVETRAIN1 0;
BA_ "GenSigTimeoutTime_CADM" SG_ 517 MessageCounter_DRIVETRAIN1 0;
BA_ "GenSigTimeoutTime_DMSM" SG_ 517 MessageCounter_DRIVETRAIN1 0;
BA_ "GenSigTimeoutTime_DTCM" SG_ 517 MessageCounter_DRIVETRAIN1 0;
BA_ "GenSigTimeoutTime_EVCU2" SG_ 517 MessageCounter_DRIVETRAIN1 0;
BA_ "GenSigTimeoutTime_IPC" SG_ 517 MessageCounter_DRIVETRAIN1 0;
BA_ "GenSigTimeoutTime_RFHM" SG_ 517 MessageCounter_DRIVETRAIN1 0;
BA_ "GenSigTimeoutTime_SGW" SG_ 517 MessageCounter_DRIVETRAIN1 0;
BA_ "GenSigSendType" SG_ 1447 CNT_DIFF_MOD 3;
BA_ "GenSigTimeoutTime_AGSM" SG_ 1447 CNT_DIFF_MOD 0;
BA_ "GenSigTimeoutTime_BCM" SG_ 1447 CNT_DIFF_MOD 0;
BA_ "GenSigTimeoutTime_BSM" SG_ 1447 CNT_DIFF_MOD 0;
BA_ "GenSigTimeoutTime_CADM" SG_ 1447 CNT_DIFF_MOD 0;
BA_ "GenSigTimeoutTime_DMSM" SG_ 1447 CNT_DIFF_MOD 0;
BA_ "GenSigTimeoutTime_DTCM" SG_ 1447 CNT_DIFF_MOD 0;
BA_ "GenSigTimeoutTime_ECM" SG_ 1447 CNT_DIFF_MOD 0;
BA_ "GenSigTimeoutTime_EVCU2" SG_ 1447 CNT_DIFF_MOD 0;
BA_ "GenSigTimeoutTime_GNMM" SG_ 1447 CNT_DIFF_MOD 0;
BA_ "GenSigTimeoutTime_HCP" SG_ 1447 CNT_DIFF_MOD 0;
BA_ "GenSigTimeoutTime_IPC" SG_ 1447 CNT_DIFF_MOD 0;
BA_ "GenSigTimeoutTime_RFHM" SG_ 1447 CNT_DIFF_MOD 0;
BA_ "GenSigTimeoutTime_SGW" SG_ 1447 CNT_DIFF_MOD 0;
BA_ "GenSigTimeoutTime_TCM" SG_ 1447 CNT_DIFF_MOD 0;
BA_ "GenSigSendType" SG_ 1447 DTCM_HMI_Rq 3;
BA_ "GenSigTimeoutTime_AGSM" SG_ 1447 DTCM_HMI_Rq 0;
BA_ "GenSigTimeoutTime_BCM" SG_ 1447 DTCM_HMI_Rq 0;
BA_ "GenSigTimeoutTime_BSM" SG_ 1447 DTCM_HMI_Rq 0;
BA_ "GenSigTimeoutTime_CADM" SG_ 1447 DTCM_HMI_Rq 0;
BA_ "GenSigTimeoutTime_DMSM" SG_ 1447 DTCM_HMI_Rq 0;
BA_ "GenSigTimeoutTime_DTCM" SG_ 1447 DTCM_HMI_Rq 0;
BA_ "GenSigTimeoutTime_ECM" SG_ 1447 DTCM_HMI_Rq 0;
BA_ "GenSigTimeoutTime_EVCU2" SG_ 1447 DTCM_HMI_Rq 0;
BA_ "GenSigTimeoutTime_GNMM" SG_ 1447 DTCM_HMI_Rq 0;
BA_ "GenSigTimeoutTime_HCP" SG_ 1447 DTCM_HMI_Rq 0;
BA_ "GenSigTimeoutTime_RFHM" SG_ 1447 DTCM_HMI_Rq 0;
BA_ "GenSigTimeoutTime_SGW" SG_ 1447 DTCM_HMI_Rq 0;
BA_ "GenSigTimeoutTime_TCM" SG_ 1447 DTCM_HMI_Rq 0;
BA_ "GenSigSendType" SG_ 1447 TerSt_SWITCH1 3;
BA_ "GenSigTimeoutTime_AGSM" SG_ 1447 TerSt_SWITCH1 0;
BA_ "GenSigTimeoutTime_BSM" SG_ 1447 TerSt_SWITCH1 0;
BA_ "GenSigTimeoutTime_CADM" SG_ 1447 TerSt_SWITCH1 0;
BA_ "GenSigTimeoutTime_DMSM" SG_ 1447 TerSt_SWITCH1 0;
BA_ "GenSigTimeoutTime_DTCM" SG_ 1447 TerSt_SWITCH1 0;
BA_ "GenSigTimeoutTime_ECM" SG_ 1447 TerSt_SWITCH1 0;
BA_ "GenSigTimeoutTime_EVCU2" SG_ 1447 TerSt_SWITCH1 0;
BA_ "GenSigTimeoutTime_GNMM" SG_ 1447 TerSt_SWITCH1 0;
BA_ "GenSigTimeoutTime_HCP" SG_ 1447 TerSt_SWITCH1 0;
BA_ "GenSigTimeoutTime_RFHM" SG_ 1447 TerSt_SWITCH1 0;
BA_ "GenSigTimeoutTime_TCM" SG_ 1447 TerSt_SWITCH1 0;
BA_ "GenSigSendType" SG_ 1447 TerSt_SWITCH2 3;
BA_ "GenSigTimeoutTime_AGSM" SG_ 1447 TerSt_SWITCH2 0;
BA_ "GenSigTimeoutTime_BSM" SG_ 1447 TerSt_SWITCH2 0;
BA_ "GenSigTimeoutTime_CADM" SG_ 1447 TerSt_SWITCH2 0;
BA_ "GenSigTimeoutTime_DMSM" SG_ 1447 TerSt_SWITCH2 0;
BA_ "GenSigTimeoutTime_DTCM" SG_ 1447 TerSt_SWITCH2 0;
BA_ "GenSigTimeoutTime_ECM" SG_ 1447 TerSt_SWITCH2 0;
BA_ "GenSigTimeoutTime_EVCU2" SG_ 1447 TerSt_SWITCH2 0;
BA_ "GenSigTimeoutTime_GNMM" SG_ 1447 TerSt_SWITCH2 0;
BA_ "GenSigTimeoutTime_HCP" SG_ 1447 TerSt_SWITCH2 0;
BA_ "GenSigTimeoutTime_RFHM" SG_ 1447 TerSt_SWITCH2 0;
BA_ "GenSigTimeoutTime_TCM" SG_ 1447 TerSt_SWITCH2 0;
BA_ "GenSigSendType" SG_ 1068 AxleLckr_SRV_RQ 3;
BA_ "GenSigTimeoutTime_AGSM" SG_ 1068 AxleLckr_SRV_RQ 0;
BA_ "GenSigTimeoutTime_BCM" SG_ 1068 AxleLckr_SRV_RQ 0;
BA_ "GenSigTimeoutTime_BSM" SG_ 1068 AxleLckr_SRV_RQ 0;
BA_ "GenSigTimeoutTime_CADM" SG_ 1068 AxleLckr_SRV_RQ 0;
BA_ "GenSigTimeoutTime_DMSM" SG_ 1068 AxleLckr_SRV_RQ 0;
BA_ "GenSigTimeoutTime_DTCM" SG_ 1068 AxleLckr_SRV_RQ 0;
BA_ "GenSigTimeoutTime_ECM" SG_ 1068 AxleLckr_SRV_RQ 0;
BA_ "GenSigTimeoutTime_EVCU2" SG_ 1068 AxleLckr_SRV_RQ 0;
BA_ "GenSigTimeoutTime_GNMM" SG_ 1068 AxleLckr_SRV_RQ 0;
BA_ "GenSigTimeoutTime_HCP" SG_ 1068 AxleLckr_SRV_RQ 0;
BA_ "GenSigTimeoutTime_RFHM" SG_ 1068 AxleLckr_SRV_RQ 0;
BA_ "GenSigTimeoutTime_SGW" SG_ 1068 AxleLckr_SRV_RQ 0;
BA_ "GenSigTimeoutTime_TCM" SG_ 1068 AxleLckr_SRV_RQ 0;
BA_ "GenSigSendType" SG_ 1068 AxleLckr_Stat 3;
BA_ "GenSigTimeoutTime_AGSM" SG_ 1068 AxleLckr_Stat 0;
BA_ "GenSigTimeoutTime_BCM" SG_ 1068 AxleLckr_Stat 0;
BA_ "GenSigTimeoutTime_BSM" SG_ 1068 AxleLckr_Stat 0;
BA_ "GenSigTimeoutTime_CADM" SG_ 1068 AxleLckr_Stat 0;
BA_ "GenSigTimeoutTime_DMSM" SG_ 1068 AxleLckr_Stat 0;
BA_ "GenSigTimeoutTime_DTCM" SG_ 1068 AxleLckr_Stat 0;
BA_ "GenSigTimeoutTime_ECM" SG_ 1068 AxleLckr_Stat 0;
BA_ "GenSigTimeoutTime_EVCU2" SG_ 1068 AxleLckr_Stat 0;
BA_ "GenSigTimeoutTime_GNMM" SG_ 1068 AxleLckr_Stat 0;
BA_ "GenSigTimeoutTime_HCP" SG_ 1068 AxleLckr_Stat 0;
BA_ "GenSigTimeoutTime_RFHM" SG_ 1068 AxleLckr_Stat 0;
BA_ "GenSigTimeoutTime_TCM" SG_ 1068 AxleLckr_Stat 0;
BA_ "GenSigSendType" SG_ 1068 AxleLckrEvicDisp 3;
BA_ "GenSigTimeoutTime_AGSM" SG_ 1068 AxleLckrEvicDisp 0;
BA_ "GenSigTimeoutTime_BCM" SG_ 1068 AxleLckrEvicDisp 0;
BA_ "GenSigTimeoutTime_BSM" SG_ 1068 AxleLckrEvicDisp 0;
BA_ "GenSigTimeoutTime_CADM" SG_ 1068 AxleLckrEvicDisp 0;
BA_ "GenSigTimeoutTime_DMSM" SG_ 1068 AxleLckrEvicDisp 0;
BA_ "GenSigTimeoutTime_DTCM" SG_ 1068 AxleLckrEvicDisp 0;
BA_ "GenSigTimeoutTime_ECM" SG_ 1068 AxleLckrEvicDisp 0;
BA_ "GenSigTimeoutTime_EVCU2" SG_ 1068 AxleLckrEvicDisp 0;
BA_ "GenSigTimeoutTime_GNMM" SG_ 1068 AxleLckrEvicDisp 0;
BA_ "GenSigTimeoutTime_HCP" SG_ 1068 AxleLckrEvicDisp 0;
BA_ "GenSigTimeoutTime_RFHM" SG_ 1068 AxleLckrEvicDisp 0;
BA_ "GenSigTimeoutTime_SGW" SG_ 1068 AxleLckrEvicDisp 0;
BA_ "GenSigTimeoutTime_TCM" SG_ 1068 AxleLckrEvicDisp 0;
BA_ "GenSigTimeoutTime_AGSM" SG_ 1068 CRC__DRIVETRAIN3 0;
BA_ "GenSigTimeoutTime_DMSM" SG_ 1068 CRC__DRIVETRAIN3 0;
BA_ "GenSigTimeoutTime_DTCM" SG_ 1068 CRC__DRIVETRAIN3 0;
BA_ "GenSigTimeoutTime_EVCU2" SG_ 1068 CRC__DRIVETRAIN3 0;
BA_ "GenSigTimeoutTime_GNMM" SG_ 1068 CRC__DRIVETRAIN3 0;
BA_ "GenSigTimeoutTime_HCP" SG_ 1068 CRC__DRIVETRAIN3 0;
BA_ "GenSigTimeoutTime_IPC" SG_ 1068 CRC__DRIVETRAIN3 0;
BA_ "GenSigTimeoutTime_RFHM" SG_ 1068 CRC__DRIVETRAIN3 0;
BA_ "GenSigTimeoutTime_SGW" SG_ 1068 CRC__DRIVETRAIN3 0;
BA_ "GenSigSendType" SG_ 1068 DTCM_Vehicle_Hold_Rq 3;
BA_ "GenSigTimeoutTime_AGSM" SG_ 1068 DTCM_Vehicle_Hold_Rq 0;
BA_ "GenSigTimeoutTime_BCM" SG_ 1068 DTCM_Vehicle_Hold_Rq 0;
BA_ "GenSigTimeoutTime_CADM" SG_ 1068 DTCM_Vehicle_Hold_Rq 0;
BA_ "GenSigTimeoutTime_DMSM" SG_ 1068 DTCM_Vehicle_Hold_Rq 0;
BA_ "GenSigTimeoutTime_DTCM" SG_ 1068 DTCM_Vehicle_Hold_Rq 0;
BA_ "GenSigTimeoutTime_ECM" SG_ 1068 DTCM_Vehicle_Hold_Rq 0;
BA_ "GenSigTimeoutTime_EVCU2" SG_ 1068 DTCM_Vehicle_Hold_Rq 0;
BA_ "GenSigTimeoutTime_GNMM" SG_ 1068 DTCM_Vehicle_Hold_Rq 0;
BA_ "GenSigTimeoutTime_HCP" SG_ 1068 DTCM_Vehicle_Hold_Rq 0;
BA_ "GenSigTimeoutTime_IPC" SG_ 1068 DTCM_Vehicle_Hold_Rq 0;
BA_ "GenSigTimeoutTime_RFHM" SG_ 1068 DTCM_Vehicle_Hold_Rq 0;
BA_ "GenSigTimeoutTime_SGW" SG_ 1068 DTCM_Vehicle_Hold_Rq 0;
BA_ "GenSigTimeoutTime_TCM" SG_ 1068 DTCM_Vehicle_Hold_Rq 0;
BA_ "GenSigTimeoutTime_AGSM" SG_ 1068 MessageCounter_DRIVETRAIN3 0;
BA_ "GenSigTimeoutTime_DMSM" SG_ 1068 MessageCounter_DRIVETRAIN3 0;
BA_ "GenSigTimeoutTime_DTCM" SG_ 1068 MessageCounter_DRIVETRAIN3 0;
BA_ "GenSigTimeoutTime_EVCU2" SG_ 1068 MessageCounter_DRIVETRAIN3 0;
BA_ "GenSigTimeoutTime_GNMM" SG_ 1068 MessageCounter_DRIVETRAIN3 0;
BA_ "GenSigTimeoutTime_HCP" SG_ 1068 MessageCounter_DRIVETRAIN3 0;
BA_ "GenSigTimeoutTime_IPC" SG_ 1068 MessageCounter_DRIVETRAIN3 0;
BA_ "GenSigTimeoutTime_RFHM" SG_ 1068 MessageCounter_DRIVETRAIN3 0;
BA_ "GenSigTimeoutTime_SGW" SG_ 1068 MessageCounter_DRIVETRAIN3 0;
BA_ "GenSigSendType" SG_ 1068 RrAxleLockerIndRq 3;
BA_ "GenSigTimeoutTime_AGSM" SG_ 1068 RrAxleLockerIndRq 0;
BA_ "GenSigTimeoutTime_BSM" SG_ 1068 RrAxleLockerIndRq 0;
BA_ "GenSigTimeoutTime_CADM" SG_ 1068 RrAxleLockerIndRq 0;
BA_ "GenSigTimeoutTime_DMSM" SG_ 1068 RrAxleLockerIndRq 0;
BA_ "GenSigTimeoutTime_DTCM" SG_ 1068 RrAxleLockerIndRq 0;
BA_ "GenSigTimeoutTime_ECM" SG_ 1068 RrAxleLockerIndRq 0;
BA_ "GenSigTimeoutTime_EVCU2" SG_ 1068 RrAxleLockerIndRq 0;
BA_ "GenSigTimeoutTime_GNMM" SG_ 1068 RrAxleLockerIndRq 0;
BA_ "GenSigTimeoutTime_HCP" SG_ 1068 RrAxleLockerIndRq 0;
BA_ "GenSigTimeoutTime_RFHM" SG_ 1068 RrAxleLockerIndRq 0;
BA_ "GenSigTimeoutTime_SGW" SG_ 1068 RrAxleLockerIndRq 0;
BA_ "GenSigTimeoutTime_TCM" SG_ 1068 RrAxleLockerIndRq 0;
BA_ "GenSigSendType" SG_ 1068 Tcase2WD_Stat 3;
BA_ "GenSigTimeoutTime_AGSM" SG_ 1068 Tcase2WD_Stat 0;
BA_ "GenSigTimeoutTime_BSM" SG_ 1068 Tcase2WD_Stat 0;
BA_ "GenSigTimeoutTime_CADM" SG_ 1068 Tcase2WD_Stat 0;
BA_ "GenSigTimeoutTime_DMSM" SG_ 1068 Tcase2WD_Stat 0;
BA_ "GenSigTimeoutTime_DTCM" SG_ 1068 Tcase2WD_Stat 0;
BA_ "GenSigTimeoutTime_ECM" SG_ 1068 Tcase2WD_Stat 0;
BA_ "GenSigTimeoutTime_EVCU2" SG_ 1068 Tcase2WD_Stat 0;
BA_ "GenSigTimeoutTime_GNMM" SG_ 1068 Tcase2WD_Stat 0;
BA_ "GenSigTimeoutTime_HCP" SG_ 1068 Tcase2WD_Stat 0;
BA_ "GenSigTimeoutTime_RFHM" SG_ 1068 Tcase2WD_Stat 0;
BA_ "GenSigTimeoutTime_TCM" SG_ 1068 Tcase2WD_Stat 0;
BA_ "GenSigSendType" SG_ 1068 Tcase4Lock 3;
BA_ "GenSigTimeoutTime_AGSM" SG_ 1068 Tcase4Lock 0;
BA_ "GenSigTimeoutTime_BSM" SG_ 1068 Tcase4Lock 0;
BA_ "GenSigTimeoutTime_CADM" SG_ 1068 Tcase4Lock 0;
BA_ "GenSigTimeoutTime_DMSM" SG_ 1068 Tcase4Lock 0;
BA_ "GenSigTimeoutTime_DTCM" SG_ 1068 Tcase4Lock 0;
BA_ "GenSigTimeoutTime_ECM" SG_ 1068 Tcase4Lock 0;
BA_ "GenSigTimeoutTime_EVCU2" SG_ 1068 Tcase4Lock 0;
BA_ "GenSigTimeoutTime_GNMM" SG_ 1068 Tcase4Lock 0;
BA_ "GenSigTimeoutTime_HCP" SG_ 1068 Tcase4Lock 0;
BA_ "GenSigTimeoutTime_RFHM" SG_ 1068 Tcase4Lock 0;
BA_ "GenSigTimeoutTime_TCM" SG_ 1068 Tcase4Lock 0;
BA_ "GenSigSendType" SG_ 1068 TcaseAWD 3;
BA_ "GenSigTimeoutTime_AGSM" SG_ 1068 TcaseAWD 0;
BA_ "GenSigTimeoutTime_BSM" SG_ 1068 TcaseAWD 0;
BA_ "GenSigTimeoutTime_CADM" SG_ 1068 TcaseAWD 0;
BA_ "GenSigTimeoutTime_DMSM" SG_ 1068 TcaseAWD 0;
BA_ "GenSigTimeoutTime_DTCM" SG_ 1068 TcaseAWD 0;
BA_ "GenSigTimeoutTime_ECM" SG_ 1068 TcaseAWD 0;
BA_ "GenSigTimeoutTime_EVCU2" SG_ 1068 TcaseAWD 0;
BA_ "GenSigTimeoutTime_GNMM" SG_ 1068 TcaseAWD 0;
BA_ "GenSigTimeoutTime_HCP" SG_ 1068 TcaseAWD 0;
BA_ "GenSigTimeoutTime_RFHM" SG_ 1068 TcaseAWD 0;
BA_ "GenSigTimeoutTime_TCM" SG_ 1068 TcaseAWD 0;
BA_ "GenSigSendType" SG_ 1068 TCASERANGESTATUS 3;
BA_ "GenSigTimeoutTime_AGSM" SG_ 1068 TCASERANGESTATUS 0;
BA_ "GenSigTimeoutTime_DMSM" SG_ 1068 TCASERANGESTATUS 0;
BA_ "GenSigTimeoutTime_DTCM" SG_ 1068 TCASERANGESTATUS 0;
BA_ "GenSigTimeoutTime_EVCU2" SG_ 1068 TCASERANGESTATUS 0;
BA_ "GenSigTimeoutTime_GNMM" SG_ 1068 TCASERANGESTATUS 0;
BA_ "GenSigTimeoutTime_HCP" SG_ 1068 TCASERANGESTATUS 0;
BA_ "GenSigTimeoutTime_RFHM" SG_ 1068 TCASERANGESTATUS 0;
BA_ "GenSigTimeoutTime_AGSM" SG_ 1438 CRC_DRV_MONITOR1 0;
BA_ "GenSigTimeoutTime_BCM" SG_ 1438 CRC_DRV_MONITOR1 0;
BA_ "GenSigTimeoutTime_BSM" SG_ 1438 CRC_DRV_MONITOR1 0;
BA_ "GenSigTimeoutTime_DMSM" SG_ 1438 CRC_DRV_MONITOR1 0;
BA_ "GenSigTimeoutTime_DTCM" SG_ 1438 CRC_DRV_MONITOR1 0;
BA_ "GenSigTimeoutTime_ECM" SG_ 1438 CRC_DRV_MONITOR1 0;
BA_ "GenSigTimeoutTime_EVCU2" SG_ 1438 CRC_DRV_MONITOR1 0;
BA_ "GenSigTimeoutTime_GNMM" SG_ 1438 CRC_DRV_MONITOR1 0;
BA_ "GenSigTimeoutTime_HCP" SG_ 1438 CRC_DRV_MONITOR1 0;
BA_ "GenSigTimeoutTime_IPC" SG_ 1438 CRC_DRV_MONITOR1 0;
BA_ "GenSigTimeoutTime_RFHM" SG_ 1438 CRC_DRV_MONITOR1 0;
BA_ "GenSigTimeoutTime_SGW" SG_ 1438 CRC_DRV_MONITOR1 0;
BA_ "GenSigTimeoutTime_TCM" SG_ 1438 CRC_DRV_MONITOR1 0;
BA_ "GenSigSendType" SG_ 1438 DM_Camera_Blind 3;
BA_ "GenSigTimeoutTime_AGSM" SG_ 1438 DM_Camera_Blind 0;
BA_ "GenSigTimeoutTime_BCM" SG_ 1438 DM_Camera_Blind 0;
BA_ "GenSigTimeoutTime_BSM" SG_ 1438 DM_Camera_Blind 0;
BA_ "GenSigTimeoutTime_DMSM" SG_ 1438 DM_Camera_Blind 0;
BA_ "GenSigTimeoutTime_DTCM" SG_ 1438 DM_Camera_Blind 0;
BA_ "GenSigTimeoutTime_ECM" SG_ 1438 DM_Camera_Blind 0;
BA_ "GenSigTimeoutTime_EVCU2" SG_ 1438 DM_Camera_Blind 0;
BA_ "GenSigTimeoutTime_GNMM" SG_ 1438 DM_Camera_Blind 0;
BA_ "GenSigTimeoutTime_HCP" SG_ 1438 DM_Camera_Blind 0;
BA_ "GenSigTimeoutTime_IPC" SG_ 1438 DM_Camera_Blind 0;
BA_ "GenSigTimeoutTime_RFHM" SG_ 1438 DM_Camera_Blind 0;
BA_ "GenSigTimeoutTime_SGW" SG_ 1438 DM_Camera_Blind 0;
BA_ "GenSigTimeoutTime_TCM" SG_ 1438 DM_Camera_Blind 0;
BA_ "GenSigSendType" SG_ 1438 DM_Distract_Conf 3;
BA_ "GenSigTimeoutTime_AGSM" SG_ 1438 DM_Distract_Conf 0;
BA_ "GenSigTimeoutTime_BCM" SG_ 1438 DM_Distract_Conf 0;
BA_ "GenSigTimeoutTime_BSM" SG_ 1438 DM_Distract_Conf 0;
BA_ "GenSigTimeoutTime_DMSM" SG_ 1438 DM_Distract_Conf 0;
BA_ "GenSigTimeoutTime_DTCM" SG_ 1438 DM_Distract_Conf 0;
BA_ "GenSigTimeoutTime_ECM" SG_ 1438 DM_Distract_Conf 0;
BA_ "GenSigTimeoutTime_EVCU2" SG_ 1438 DM_Distract_Conf 0;
BA_ "GenSigTimeoutTime_GNMM" SG_ 1438 DM_Distract_Conf 0;
BA_ "GenSigTimeoutTime_HCP" SG_ 1438 DM_Distract_Conf 0;
BA_ "GenSigTimeoutTime_IPC" SG_ 1438 DM_Distract_Conf 0;
BA_ "GenSigTimeoutTime_RFHM" SG_ 1438 DM_Distract_Conf 0;
BA_ "GenSigTimeoutTime_SGW" SG_ 1438 DM_Distract_Conf 0;
BA_ "GenSigTimeoutTime_TCM" SG_ 1438 DM_Distract_Conf 0;
BA_ "GenSigTimeoutTime_AGSM" SG_ 1438 DM_Distract_Instant 0;
BA_ "GenSigTimeoutTime_BCM" SG_ 1438 DM_Distract_Instant 0;
BA_ "GenSigTimeoutTime_BSM" SG_ 1438 DM_Distract_Instant 0;
BA_ "GenSigTimeoutTime_DMSM" SG_ 1438 DM_Distract_Instant 0;
BA_ "GenSigTimeoutTime_DTCM" SG_ 1438 DM_Distract_Instant 0;
BA_ "GenSigTimeoutTime_ECM" SG_ 1438 DM_Distract_Instant 0;
BA_ "GenSigTimeoutTime_EVCU2" SG_ 1438 DM_Distract_Instant 0;
BA_ "GenSigTimeoutTime_GNMM" SG_ 1438 DM_Distract_Instant 0;
BA_ "GenSigTimeoutTime_HCP" SG_ 1438 DM_Distract_Instant 0;
BA_ "GenSigTimeoutTime_IPC" SG_ 1438 DM_Distract_Instant 0;
BA_ "GenSigTimeoutTime_RFHM" SG_ 1438 DM_Distract_Instant 0;
BA_ "GenSigTimeoutTime_SGW" SG_ 1438 DM_Distract_Instant 0;
BA_ "GenSigTimeoutTime_TCM" SG_ 1438 DM_Distract_Instant 0;
BA_ "GenSigSendType" SG_ 1438 DM_Distract_State 3;
BA_ "GenSigTimeoutTime_AGSM" SG_ 1438 DM_Distract_State 0;
BA_ "GenSigTimeoutTime_BSM" SG_ 1438 DM_Distract_State 0;
BA_ "GenSigTimeoutTime_DMSM" SG_ 1438 DM_Distract_State 0;
BA_ "GenSigTimeoutTime_DTCM" SG_ 1438 DM_Distract_State 0;
BA_ "GenSigTimeoutTime_ECM" SG_ 1438 DM_Distract_State 0;
BA_ "GenSigTimeoutTime_EVCU2" SG_ 1438 DM_Distract_State 0;
BA_ "GenSigTimeoutTime_GNMM" SG_ 1438 DM_Distract_State 0;
BA_ "GenSigTimeoutTime_HCP" SG_ 1438 DM_Distract_State 0;
BA_ "GenSigTimeoutTime_IPC" SG_ 1438 DM_Distract_State 0;
BA_ "GenSigTimeoutTime_RFHM" SG_ 1438 DM_Distract_State 0;
BA_ "GenSigTimeoutTime_TCM" SG_ 1438 DM_Distract_State 0;
BA_ "GenSigSendType" SG_ 1438 DM_Drowsy_Conf 3;
BA_ "GenSigTimeoutTime_AGSM" SG_ 1438 DM_Drowsy_Conf 0;
BA_ "GenSigTimeoutTime_BCM" SG_ 1438 DM_Drowsy_Conf 0;
BA_ "GenSigTimeoutTime_BSM" SG_ 1438 DM_Drowsy_Conf 0;
BA_ "GenSigTimeoutTime_DMSM" SG_ 1438 DM_Drowsy_Conf 0;
BA_ "GenSigTimeoutTime_DTCM" SG_ 1438 DM_Drowsy_Conf 0;
BA_ "GenSigTimeoutTime_ECM" SG_ 1438 DM_Drowsy_Conf 0;
BA_ "GenSigTimeoutTime_EVCU2" SG_ 1438 DM_Drowsy_Conf 0;
BA_ "GenSigTimeoutTime_GNMM" SG_ 1438 DM_Drowsy_Conf 0;
BA_ "GenSigTimeoutTime_HCP" SG_ 1438 DM_Drowsy_Conf 0;
BA_ "GenSigTimeoutTime_IPC" SG_ 1438 DM_Drowsy_Conf 0;
BA_ "GenSigTimeoutTime_RFHM" SG_ 1438 DM_Drowsy_Conf 0;
BA_ "GenSigTimeoutTime_SGW" SG_ 1438 DM_Drowsy_Conf 0;
BA_ "GenSigTimeoutTime_TCM" SG_ 1438 DM_Drowsy_Conf 0;
BA_ "GenSigTimeoutTime_AGSM" SG_ 1438 DM_Drowsy_Instant 0;
BA_ "GenSigTimeoutTime_BCM" SG_ 1438 DM_Drowsy_Instant 0;
BA_ "GenSigTimeoutTime_BSM" SG_ 1438 DM_Drowsy_Instant 0;
BA_ "GenSigTimeoutTime_DMSM" SG_ 1438 DM_Drowsy_Instant 0;
BA_ "GenSigTimeoutTime_DTCM" SG_ 1438 DM_Drowsy_Instant 0;
BA_ "GenSigTimeoutTime_ECM" SG_ 1438 DM_Drowsy_Instant 0;
BA_ "GenSigTimeoutTime_EVCU2" SG_ 1438 DM_Drowsy_Instant 0;
BA_ "GenSigTimeoutTime_GNMM" SG_ 1438 DM_Drowsy_Instant 0;
BA_ "GenSigTimeoutTime_HCP" SG_ 1438 DM_Drowsy_Instant 0;
BA_ "GenSigTimeoutTime_IPC" SG_ 1438 DM_Drowsy_Instant 0;
BA_ "GenSigTimeoutTime_RFHM" SG_ 1438 DM_Drowsy_Instant 0;
BA_ "GenSigTimeoutTime_SGW" SG_ 1438 DM_Drowsy_Instant 0;
BA_ "GenSigTimeoutTime_TCM" SG_ 1438 DM_Drowsy_Instant 0;
BA_ "GenSigSendType" SG_ 1438 DM_Drowsy_Micro 3;
BA_ "GenSigTimeoutTime_AGSM" SG_ 1438 DM_Drowsy_Micro 0;
BA_ "GenSigTimeoutTime_BCM" SG_ 1438 DM_Drowsy_Micro 0;
BA_ "GenSigTimeoutTime_BSM" SG_ 1438 DM_Drowsy_Micro 0;
BA_ "GenSigTimeoutTime_DMSM" SG_ 1438 DM_Drowsy_Micro 0;
BA_ "GenSigTimeoutTime_DTCM" SG_ 1438 DM_Drowsy_Micro 0;
BA_ "GenSigTimeoutTime_ECM" SG_ 1438 DM_Drowsy_Micro 0;
BA_ "GenSigTimeoutTime_EVCU2" SG_ 1438 DM_Drowsy_Micro 0;
BA_ "GenSigTimeoutTime_GNMM" SG_ 1438 DM_Drowsy_Micro 0;
BA_ "GenSigTimeoutTime_HCP" SG_ 1438 DM_Drowsy_Micro 0;
BA_ "GenSigTimeoutTime_IPC" SG_ 1438 DM_Drowsy_Micro 0;
BA_ "GenSigTimeoutTime_RFHM" SG_ 1438 DM_Drowsy_Micro 0;
BA_ "GenSigTimeoutTime_SGW" SG_ 1438 DM_Drowsy_Micro 0;
BA_ "GenSigTimeoutTime_TCM" SG_ 1438 DM_Drowsy_Micro 0;
BA_ "GenSigSendType" SG_ 1438 DM_Drowsy_State 3;
BA_ "GenSigTimeoutTime_AGSM" SG_ 1438 DM_Drowsy_State 0;
BA_ "GenSigTimeoutTime_BSM" SG_ 1438 DM_Drowsy_State 0;
BA_ "GenSigTimeoutTime_DMSM" SG_ 1438 DM_Drowsy_State 0;
BA_ "GenSigTimeoutTime_DTCM" SG_ 1438 DM_Drowsy_State 0;
BA_ "GenSigTimeoutTime_ECM" SG_ 1438 DM_Drowsy_State 0;
BA_ "GenSigTimeoutTime_EVCU2" SG_ 1438 DM_Drowsy_State 0;
BA_ "GenSigTimeoutTime_GNMM" SG_ 1438 DM_Drowsy_State 0;
BA_ "GenSigTimeoutTime_HCP" SG_ 1438 DM_Drowsy_State 0;
BA_ "GenSigTimeoutTime_IPC" SG_ 1438 DM_Drowsy_State 0;
BA_ "GenSigTimeoutTime_RFHM" SG_ 1438 DM_Drowsy_State 0;
BA_ "GenSigTimeoutTime_TCM" SG_ 1438 DM_Drowsy_State 0;
BA_ "GenSigSendType" SG_ 1438 DM_Eyes_Tracked 3;
BA_ "GenSigTimeoutTime_AGSM" SG_ 1438 DM_Eyes_Tracked 0;
BA_ "GenSigTimeoutTime_BCM" SG_ 1438 DM_Eyes_Tracked 0;
BA_ "GenSigTimeoutTime_BSM" SG_ 1438 DM_Eyes_Tracked 0;
BA_ "GenSigTimeoutTime_DMSM" SG_ 1438 DM_Eyes_Tracked 0;
BA_ "GenSigTimeoutTime_DTCM" SG_ 1438 DM_Eyes_Tracked 0;
BA_ "GenSigTimeoutTime_ECM" SG_ 1438 DM_Eyes_Tracked 0;
BA_ "GenSigTimeoutTime_EVCU2" SG_ 1438 DM_Eyes_Tracked 0;
BA_ "GenSigTimeoutTime_GNMM" SG_ 1438 DM_Eyes_Tracked 0;
BA_ "GenSigTimeoutTime_HCP" SG_ 1438 DM_Eyes_Tracked 0;
BA_ "GenSigTimeoutTime_IPC" SG_ 1438 DM_Eyes_Tracked 0;
BA_ "GenSigTimeoutTime_RFHM" SG_ 1438 DM_Eyes_Tracked 0;
BA_ "GenSigTimeoutTime_SGW" SG_ 1438 DM_Eyes_Tracked 0;
BA_ "GenSigTimeoutTime_TCM" SG_ 1438 DM_Eyes_Tracked 0;
BA_ "GenSigSendType" SG_ 1438 DM_Steering_Angle_Blockage 3;
BA_ "GenSigTimeoutTime_AGSM" SG_ 1438 DM_Steering_Angle_Blockage 0;
BA_ "GenSigTimeoutTime_BCM" SG_ 1438 DM_Steering_Angle_Blockage 0;
BA_ "GenSigTimeoutTime_BSM" SG_ 1438 DM_Steering_Angle_Blockage 0;
BA_ "GenSigTimeoutTime_DMSM" SG_ 1438 DM_Steering_Angle_Blockage 0;
BA_ "GenSigTimeoutTime_DTCM" SG_ 1438 DM_Steering_Angle_Blockage 0;
BA_ "GenSigTimeoutTime_ECM" SG_ 1438 DM_Steering_Angle_Blockage 0;
BA_ "GenSigTimeoutTime_EVCU2" SG_ 1438 DM_Steering_Angle_Blockage 0;
BA_ "GenSigTimeoutTime_GNMM" SG_ 1438 DM_Steering_Angle_Blockage 0;
BA_ "GenSigTimeoutTime_HCP" SG_ 1438 DM_Steering_Angle_Blockage 0;
BA_ "GenSigTimeoutTime_IPC" SG_ 1438 DM_Steering_Angle_Blockage 0;
BA_ "GenSigTimeoutTime_RFHM" SG_ 1438 DM_Steering_Angle_Blockage 0;
BA_ "GenSigTimeoutTime_SGW" SG_ 1438 DM_Steering_Angle_Blockage 0;
BA_ "GenSigTimeoutTime_TCM" SG_ 1438 DM_Steering_Angle_Blockage 0;
BA_ "GenSigSendType" SG_ 1438 DM_Zone_Track 3;
BA_ "GenSigTimeoutTime_AGSM" SG_ 1438 DM_Zone_Track 0;
BA_ "GenSigTimeoutTime_BSM" SG_ 1438 DM_Zone_Track 0;
BA_ "GenSigTimeoutTime_DMSM" SG_ 1438 DM_Zone_Track 0;
BA_ "GenSigTimeoutTime_DTCM" SG_ 1438 DM_Zone_Track 0;
BA_ "GenSigTimeoutTime_ECM" SG_ 1438 DM_Zone_Track 0;
BA_ "GenSigTimeoutTime_EVCU2" SG_ 1438 DM_Zone_Track 0;
BA_ "GenSigTimeoutTime_GNMM" SG_ 1438 DM_Zone_Track 0;
BA_ "GenSigTimeoutTime_HCP" SG_ 1438 DM_Zone_Track 0;
BA_ "GenSigTimeoutTime_IPC" SG_ 1438 DM_Zone_Track 0;
BA_ "GenSigTimeoutTime_RFHM" SG_ 1438 DM_Zone_Track 0;
BA_ "GenSigTimeoutTime_SGW" SG_ 1438 DM_Zone_Track 0;
BA_ "GenSigTimeoutTime_TCM" SG_ 1438 DM_Zone_Track 0;
BA_ "GenSigSendType" SG_ 1438 DM_Zone_Track_Conf 3;
BA_ "GenSigTimeoutTime_AGSM" SG_ 1438 DM_Zone_Track_Conf 0;
BA_ "GenSigTimeoutTime_BCM" SG_ 1438 DM_Zone_Track_Conf 0;
BA_ "GenSigTimeoutTime_BSM" SG_ 1438 DM_Zone_Track_Conf 0;
BA_ "GenSigTimeoutTime_DMSM" SG_ 1438 DM_Zone_Track_Conf 0;
BA_ "GenSigTimeoutTime_DTCM" SG_ 1438 DM_Zone_Track_Conf 0;
BA_ "GenSigTimeoutTime_ECM" SG_ 1438 DM_Zone_Track_Conf 0;
BA_ "GenSigTimeoutTime_EVCU2" SG_ 1438 DM_Zone_Track_Conf 0;
BA_ "GenSigTimeoutTime_GNMM" SG_ 1438 DM_Zone_Track_Conf 0;
BA_ "GenSigTimeoutTime_HCP" SG_ 1438 DM_Zone_Track_Conf 0;
BA_ "GenSigTimeoutTime_IPC" SG_ 1438 DM_Zone_Track_Conf 0;
BA_ "GenSigTimeoutTime_RFHM" SG_ 1438 DM_Zone_Track_Conf 0;
BA_ "GenSigTimeoutTime_SGW" SG_ 1438 DM_Zone_Track_Conf 0;
BA_ "GenSigTimeoutTime_TCM" SG_ 1438 DM_Zone_Track_Conf 0;
BA_ "GenSigSendType" SG_ 1438 DMSM_System_Stat 3;
BA_ "GenSigTimeoutTime_AGSM" SG_ 1438 DMSM_System_Stat 0;
BA_ "GenSigTimeoutTime_BCM" SG_ 1438 DMSM_System_Stat 0;
BA_ "GenSigTimeoutTime_BSM" SG_ 1438 DMSM_System_Stat 0;
BA_ "GenSigTimeoutTime_DMSM" SG_ 1438 DMSM_System_Stat 0;
BA_ "GenSigTimeoutTime_DTCM" SG_ 1438 DMSM_System_Stat 0;
BA_ "GenSigTimeoutTime_ECM" SG_ 1438 DMSM_System_Stat 0;
BA_ "GenSigTimeoutTime_EVCU2" SG_ 1438 DMSM_System_Stat 0;
BA_ "GenSigTimeoutTime_GNMM" SG_ 1438 DMSM_System_Stat 0;
BA_ "GenSigTimeoutTime_HCP" SG_ 1438 DMSM_System_Stat 0;
BA_ "GenSigTimeoutTime_IPC" SG_ 1438 DMSM_System_Stat 0;
BA_ "GenSigTimeoutTime_RFHM" SG_ 1438 DMSM_System_Stat 0;
BA_ "GenSigTimeoutTime_SGW" SG_ 1438 DMSM_System_Stat 0;
BA_ "GenSigTimeoutTime_TCM" SG_ 1438 DMSM_System_Stat 0;
BA_ "GenSigSendType" SG_ 1438 Driver_Presence 3;
BA_ "GenSigTimeoutTime_AGSM" SG_ 1438 Driver_Presence 0;
BA_ "GenSigTimeoutTime_BCM" SG_ 1438 Driver_Presence 0;
BA_ "GenSigTimeoutTime_BSM" SG_ 1438 Driver_Presence 0;
BA_ "GenSigTimeoutTime_DMSM" SG_ 1438 Driver_Presence 0;
BA_ "GenSigTimeoutTime_DTCM" SG_ 1438 Driver_Presence 0;
BA_ "GenSigTimeoutTime_ECM" SG_ 1438 Driver_Presence 0;
BA_ "GenSigTimeoutTime_EVCU2" SG_ 1438 Driver_Presence 0;
BA_ "GenSigTimeoutTime_GNMM" SG_ 1438 Driver_Presence 0;
BA_ "GenSigTimeoutTime_HCP" SG_ 1438 Driver_Presence 0;
BA_ "GenSigTimeoutTime_IPC" SG_ 1438 Driver_Presence 0;
BA_ "GenSigTimeoutTime_RFHM" SG_ 1438 Driver_Presence 0;
BA_ "GenSigTimeoutTime_TCM" SG_ 1438 Driver_Presence 0;
BA_ "GenSigTimeoutTime_AGSM" SG_ 1438 MessageCounter_DRV_MONITOR1 0;
BA_ "GenSigTimeoutTime_BCM" SG_ 1438 MessageCounter_DRV_MONITOR1 0;
BA_ "GenSigTimeoutTime_BSM" SG_ 1438 MessageCounter_DRV_MONITOR1 0;
BA_ "GenSigTimeoutTime_DMSM" SG_ 1438 MessageCounter_DRV_MONITOR1 0;
BA_ "GenSigTimeoutTime_DTCM" SG_ 1438 MessageCounter_DRV_MONITOR1 0;
BA_ "GenSigTimeoutTime_ECM" SG_ 1438 MessageCounter_DRV_MONITOR1 0;
BA_ "GenSigTimeoutTime_EVCU2" SG_ 1438 MessageCounter_DRV_MONITOR1 0;
BA_ "GenSigTimeoutTime_GNMM" SG_ 1438 MessageCounter_DRV_MONITOR1 0;
BA_ "GenSigTimeoutTime_HCP" SG_ 1438 MessageCounter_DRV_MONITOR1 0;
BA_ "GenSigTimeoutTime_IPC" SG_ 1438 MessageCounter_DRV_MONITOR1 0;
BA_ "GenSigTimeoutTime_RFHM" SG_ 1438 MessageCounter_DRV_MONITOR1 0;
BA_ "GenSigTimeoutTime_SGW" SG_ 1438 MessageCounter_DRV_MONITOR1 0;
BA_ "GenSigTimeoutTime_TCM" SG_ 1438 MessageCounter_DRV_MONITOR1 0;
BA_ "GenSigTimeoutTime_AGSM" SG_ 2654814209 ECM_APPL1 0;
BA_ "GenSigTimeoutTime_BCM" SG_ 2654814209 ECM_APPL1 0;
BA_ "GenSigTimeoutTime_BSM" SG_ 2654814209 ECM_APPL1 0;
BA_ "GenSigTimeoutTime_CADM" SG_ 2654814209 ECM_APPL1 0;
BA_ "GenSigTimeoutTime_DMSM" SG_ 2654814209 ECM_APPL1 0;
BA_ "GenSigTimeoutTime_DTCM" SG_ 2654814209 ECM_APPL1 0;
BA_ "GenSigTimeoutTime_ECM" SG_ 2654814209 ECM_APPL1 0;
BA_ "GenSigTimeoutTime_EVCU2" SG_ 2654814209 ECM_APPL1 0;
BA_ "GenSigTimeoutTime_GNMM" SG_ 2654814209 ECM_APPL1 0;
BA_ "GenSigTimeoutTime_HCP" SG_ 2654814209 ECM_APPL1 0;
BA_ "GenSigTimeoutTime_IPC" SG_ 2654814209 ECM_APPL1 0;
BA_ "GenSigTimeoutTime_RFHM" SG_ 2654814209 ECM_APPL1 0;
BA_ "GenSigTimeoutTime_TCM" SG_ 2654814209 ECM_APPL1 0;
BA_ "GenSigTimeoutTime_AGSM" SG_ 2654817823 ECU_APPL_FD_AGSM 0;
BA_ "GenSigTimeoutTime_BCM" SG_ 2654817823 ECU_APPL_FD_AGSM 0;
BA_ "GenSigTimeoutTime_BSM" SG_ 2654817823 ECU_APPL_FD_AGSM 0;
BA_ "GenSigTimeoutTime_CADM" SG_ 2654817823 ECU_APPL_FD_AGSM 0;
BA_ "GenSigTimeoutTime_DMSM" SG_ 2654817823 ECU_APPL_FD_AGSM 0;
BA_ "GenSigTimeoutTime_DTCM" SG_ 2654817823 ECU_APPL_FD_AGSM 0;
BA_ "GenSigTimeoutTime_ECM" SG_ 2654817823 ECU_APPL_FD_AGSM 0;
BA_ "GenSigTimeoutTime_EVCU2" SG_ 2654817823 ECU_APPL_FD_AGSM 0;
BA_ "GenSigTimeoutTime_GNMM" SG_ 2654817823 ECU_APPL_FD_AGSM 0;
BA_ "GenSigTimeoutTime_HCP" SG_ 2654817823 ECU_APPL_FD_AGSM 0;
BA_ "GenSigTimeoutTime_IPC" SG_ 2654817823 ECU_APPL_FD_AGSM 0;
BA_ "GenSigTimeoutTime_RFHM" SG_ 2654817823 ECU_APPL_FD_AGSM 0;
BA_ "GenSigTimeoutTime_TCM" SG_ 2654817823 ECU_APPL_FD_AGSM 0;
BA_ "GenSigTimeoutTime_AGSM" SG_ 2654817818 ECU_APPL_FD_DTCM 0;
BA_ "GenSigTimeoutTime_BCM" SG_ 2654817818 ECU_APPL_FD_DTCM 0;
BA_ "GenSigTimeoutTime_BSM" SG_ 2654817818 ECU_APPL_FD_DTCM 0;
BA_ "GenSigTimeoutTime_CADM" SG_ 2654817818 ECU_APPL_FD_DTCM 0;
BA_ "GenSigTimeoutTime_DMSM" SG_ 2654817818 ECU_APPL_FD_DTCM 0;
BA_ "GenSigTimeoutTime_DTCM" SG_ 2654817818 ECU_APPL_FD_DTCM 0;
BA_ "GenSigTimeoutTime_ECM" SG_ 2654817818 ECU_APPL_FD_DTCM 0;
BA_ "GenSigTimeoutTime_EVCU2" SG_ 2654817818 ECU_APPL_FD_DTCM 0;
BA_ "GenSigTimeoutTime_GNMM" SG_ 2654817818 ECU_APPL_FD_DTCM 0;
BA_ "GenSigTimeoutTime_HCP" SG_ 2654817818 ECU_APPL_FD_DTCM 0;
BA_ "GenSigTimeoutTime_IPC" SG_ 2654817818 ECU_APPL_FD_DTCM 0;
BA_ "GenSigTimeoutTime_RFHM" SG_ 2654817818 ECU_APPL_FD_DTCM 0;
BA_ "GenSigTimeoutTime_TCM" SG_ 2654817818 ECU_APPL_FD_DTCM 0;
BA_ "GenSigTimeoutTime_AGSM" SG_ 2654817808 ECU_APPL_FD_ECM 0;
BA_ "GenSigTimeoutTime_BCM" SG_ 2654817808 ECU_APPL_FD_ECM 0;
BA_ "GenSigTimeoutTime_BSM" SG_ 2654817808 ECU_APPL_FD_ECM 0;
BA_ "GenSigTimeoutTime_CADM" SG_ 2654817808 ECU_APPL_FD_ECM 0;
BA_ "GenSigTimeoutTime_DMSM" SG_ 2654817808 ECU_APPL_FD_ECM 0;
BA_ "GenSigTimeoutTime_DTCM" SG_ 2654817808 ECU_APPL_FD_ECM 0;
BA_ "GenSigTimeoutTime_ECM" SG_ 2654817808 ECU_APPL_FD_ECM 0;
BA_ "GenSigTimeoutTime_EVCU2" SG_ 2654817808 ECU_APPL_FD_ECM 0;
BA_ "GenSigTimeoutTime_GNMM" SG_ 2654817808 ECU_APPL_FD_ECM 0;
BA_ "GenSigTimeoutTime_HCP" SG_ 2654817808 ECU_APPL_FD_ECM 0;
BA_ "GenSigTimeoutTime_IPC" SG_ 2654817808 ECU_APPL_FD_ECM 0;
BA_ "GenSigTimeoutTime_RFHM" SG_ 2654817808 ECU_APPL_FD_ECM 0;
BA_ "GenSigTimeoutTime_TCM" SG_ 2654817808 ECU_APPL_FD_ECM 0;
BA_ "GenSigTimeoutTime_AGSM" SG_ 2654817991 ECU_APPL_FD_RFHM 0;
BA_ "GenSigTimeoutTime_BCM" SG_ 2654817991 ECU_APPL_FD_RFHM 0;
BA_ "GenSigTimeoutTime_BSM" SG_ 2654817991 ECU_APPL_FD_RFHM 0;
BA_ "GenSigTimeoutTime_CADM" SG_ 2654817991 ECU_APPL_FD_RFHM 0;
BA_ "GenSigTimeoutTime_DMSM" SG_ 2654817991 ECU_APPL_FD_RFHM 0;
BA_ "GenSigTimeoutTime_DTCM" SG_ 2654817991 ECU_APPL_FD_RFHM 0;
BA_ "GenSigTimeoutTime_ECM" SG_ 2654817991 ECU_APPL_FD_RFHM 0;
BA_ "GenSigTimeoutTime_EVCU2" SG_ 2654817991 ECU_APPL_FD_RFHM 0;
BA_ "GenSigTimeoutTime_GNMM" SG_ 2654817991 ECU_APPL_FD_RFHM 0;
BA_ "GenSigTimeoutTime_HCP" SG_ 2654817991 ECU_APPL_FD_RFHM 0;
BA_ "GenSigTimeoutTime_IPC" SG_ 2654817991 ECU_APPL_FD_RFHM 0;
BA_ "GenSigTimeoutTime_RFHM" SG_ 2654817991 ECU_APPL_FD_RFHM 0;
BA_ "GenSigTimeoutTime_SGW" SG_ 2654817991 ECU_APPL_FD_RFHM 0;
BA_ "GenSigTimeoutTime_TCM" SG_ 2654817991 ECU_APPL_FD_RFHM 0;
BA_ "GenSigTimeoutTime_AGSM" SG_ 2654817816 ECU_APPL_FD_TCM 0;
BA_ "GenSigTimeoutTime_BCM" SG_ 2654817816 ECU_APPL_FD_TCM 0;
BA_ "GenSigTimeoutTime_BSM" SG_ 2654817816 ECU_APPL_FD_TCM 0;
BA_ "GenSigTimeoutTime_CADM" SG_ 2654817816 ECU_APPL_FD_TCM 0;
BA_ "GenSigTimeoutTime_DMSM" SG_ 2654817816 ECU_APPL_FD_TCM 0;
BA_ "GenSigTimeoutTime_DTCM" SG_ 2654817816 ECU_APPL_FD_TCM 0;
BA_ "GenSigTimeoutTime_ECM" SG_ 2654817816 ECU_APPL_FD_TCM 0;
BA_ "GenSigTimeoutTime_EVCU2" SG_ 2654817816 ECU_APPL_FD_TCM 0;
BA_ "GenSigTimeoutTime_GNMM" SG_ 2654817816 ECU_APPL_FD_TCM 0;
BA_ "GenSigTimeoutTime_HCP" SG_ 2654817816 ECU_APPL_FD_TCM 0;
BA_ "GenSigTimeoutTime_IPC" SG_ 2654817816 ECU_APPL_FD_TCM 0;
BA_ "GenSigTimeoutTime_RFHM" SG_ 2654817816 ECU_APPL_FD_TCM 0;
BA_ "GenSigTimeoutTime_SGW" SG_ 2654817816 ECU_APPL_FD_TCM 0;
BA_ "GenSigTimeoutTime_TCM" SG_ 2654817816 ECU_APPL_FD_TCM 0;
BA_ "GenSigStartValue" SG_ 1054 ACPressure 511;
BA_ "GenSigTimeoutTime_AGSM" SG_ 1054 ACPressure 0;
BA_ "GenSigTimeoutTime_BSM" SG_ 1054 ACPressure 0;
BA_ "GenSigTimeoutTime_CADM" SG_ 1054 ACPressure 0;
BA_ "GenSigTimeoutTime_DMSM" SG_ 1054 ACPressure 0;
BA_ "GenSigTimeoutTime_DTCM" SG_ 1054 ACPressure 0;
BA_ "GenSigTimeoutTime_ECM" SG_ 1054 ACPressure 0;
BA_ "GenSigTimeoutTime_EVCU2" SG_ 1054 ACPressure 0;
BA_ "GenSigTimeoutTime_GNMM" SG_ 1054 ACPressure 0;
BA_ "GenSigTimeoutTime_HCP" SG_ 1054 ACPressure 0;
BA_ "GenSigTimeoutTime_IPC" SG_ 1054 ACPressure 0;
BA_ "GenSigTimeoutTime_RFHM" SG_ 1054 ACPressure 0;
BA_ "GenSigTimeoutTime_SGW" SG_ 1054 ACPressure 0;
BA_ "GenSigTimeoutTime_TCM" SG_ 1054 ACPressure 0;
BA_ "GenSigTimeoutTime_AGSM" SG_ 1054 ACPressureFailSts 0;
BA_ "GenSigTimeoutTime_BCM" SG_ 1054 ACPressureFailSts 0;
BA_ "GenSigTimeoutTime_BSM" SG_ 1054 ACPressureFailSts 0;
BA_ "GenSigTimeoutTime_CADM" SG_ 1054 ACPressureFailSts 0;
BA_ "GenSigTimeoutTime_DMSM" SG_ 1054 ACPressureFailSts 0;
BA_ "GenSigTimeoutTime_DTCM" SG_ 1054 ACPressureFailSts 0;
BA_ "GenSigTimeoutTime_ECM" SG_ 1054 ACPressureFailSts 0;
BA_ "GenSigTimeoutTime_EVCU2" SG_ 1054 ACPressureFailSts 0;
BA_ "GenSigTimeoutTime_GNMM" SG_ 1054 ACPressureFailSts 0;
BA_ "GenSigTimeoutTime_HCP" SG_ 1054 ACPressureFailSts 0;
BA_ "GenSigTimeoutTime_IPC" SG_ 1054 ACPressureFailSts 0;
BA_ "GenSigTimeoutTime_RFHM" SG_ 1054 ACPressureFailSts 0;
BA_ "GenSigTimeoutTime_SGW" SG_ 1054 ACPressureFailSts 0;
BA_ "GenSigTimeoutTime_TCM" SG_ 1054 ACPressureFailSts 0;
BA_ "GenSigSendType" SG_ 1054 AGS2Posn 3;
BA_ "GenSigTimeoutTime_AGSM" SG_ 1054 AGS2Posn 0;
BA_ "GenSigTimeoutTime_BCM" SG_ 1054 AGS2Posn 0;
BA_ "GenSigTimeoutTime_BSM" SG_ 1054 AGS2Posn 0;
BA_ "GenSigTimeoutTime_CADM" SG_ 1054 AGS2Posn 0;
BA_ "GenSigTimeoutTime_DMSM" SG_ 1054 AGS2Posn 0;
BA_ "GenSigTimeoutTime_DTCM" SG_ 1054 AGS2Posn 0;
BA_ "GenSigTimeoutTime_ECM" SG_ 1054 AGS2Posn 0;
BA_ "GenSigTimeoutTime_EVCU2" SG_ 1054 AGS2Posn 0;
BA_ "GenSigTimeoutTime_GNMM" SG_ 1054 AGS2Posn 0;
BA_ "GenSigTimeoutTime_HCP" SG_ 1054 AGS2Posn 0;
BA_ "GenSigTimeoutTime_IPC" SG_ 1054 AGS2Posn 0;
BA_ "GenSigTimeoutTime_RFHM" SG_ 1054 AGS2Posn 0;
BA_ "GenSigTimeoutTime_SGW" SG_ 1054 AGS2Posn 0;
BA_ "GenSigTimeoutTime_TCM" SG_ 1054 AGS2Posn 0;
BA_ "GenSigStartValue" SG_ 1054 AtmosphericPressure_W 255;
BA_ "GenSigTimeoutTime_AGSM" SG_ 1054 AtmosphericPressure_W 0;
BA_ "GenSigTimeoutTime_CADM" SG_ 1054 AtmosphericPressure_W 0;
BA_ "GenSigTimeoutTime_DMSM" SG_ 1054 AtmosphericPressure_W 0;
BA_ "GenSigTimeoutTime_DTCM" SG_ 1054 AtmosphericPressure_W 0;
BA_ "GenSigTimeoutTime_ECM" SG_ 1054 AtmosphericPressure_W 0;
BA_ "GenSigTimeoutTime_EVCU2" SG_ 1054 AtmosphericPressure_W 0;
BA_ "GenSigTimeoutTime_GNMM" SG_ 1054 AtmosphericPressure_W 0;
BA_ "GenSigTimeoutTime_HCP" SG_ 1054 AtmosphericPressure_W 0;
BA_ "GenSigTimeoutTime_IPC" SG_ 1054 AtmosphericPressure_W 0;
BA_ "GenSigTimeoutTime_AGSM" SG_ 1054 AtmosphericPressureFailSts_W 0;
BA_ "GenSigTimeoutTime_BCM" SG_ 1054 AtmosphericPressureFailSts_W 0;
BA_ "GenSigTimeoutTime_BSM" SG_ 1054 AtmosphericPressureFailSts_W 0;
BA_ "GenSigTimeoutTime_CADM" SG_ 1054 AtmosphericPressureFailSts_W 0;
BA_ "GenSigTimeoutTime_DMSM" SG_ 1054 AtmosphericPressureFailSts_W 0;
BA_ "GenSigTimeoutTime_DTCM" SG_ 1054 AtmosphericPressureFailSts_W 0;
BA_ "GenSigTimeoutTime_ECM" SG_ 1054 AtmosphericPressureFailSts_W 0;
BA_ "GenSigTimeoutTime_EVCU2" SG_ 1054 AtmosphericPressureFailSts_W 0;
BA_ "GenSigTimeoutTime_GNMM" SG_ 1054 AtmosphericPressureFailSts_W 0;
BA_ "GenSigTimeoutTime_HCP" SG_ 1054 AtmosphericPressureFailSts_W 0;
BA_ "GenSigTimeoutTime_IPC" SG_ 1054 AtmosphericPressureFailSts_W 0;
BA_ "GenSigStartValue" SG_ 1054 BoostVacGauge 155;
BA_ "GenSigSendType" SG_ 1054 BoostVacGauge 4;
BA_ "GenSigTimeoutTime_AGSM" SG_ 1054 BoostVacGauge 0;
BA_ "GenSigTimeoutTime_BCM" SG_ 1054 BoostVacGauge 0;
BA_ "GenSigTimeoutTime_BSM" SG_ 1054 BoostVacGauge 0;
BA_ "GenSigTimeoutTime_CADM" SG_ 1054 BoostVacGauge 0;
BA_ "GenSigTimeoutTime_DMSM" SG_ 1054 BoostVacGauge 0;
BA_ "GenSigTimeoutTime_DTCM" SG_ 1054 BoostVacGauge 0;
BA_ "GenSigTimeoutTime_ECM" SG_ 1054 BoostVacGauge 0;
BA_ "GenSigTimeoutTime_EVCU2" SG_ 1054 BoostVacGauge 0;
BA_ "GenSigTimeoutTime_GNMM" SG_ 1054 BoostVacGauge 0;
BA_ "GenSigTimeoutTime_HCP" SG_ 1054 BoostVacGauge 0;
BA_ "GenSigTimeoutTime_RFHM" SG_ 1054 BoostVacGauge 0;
BA_ "GenSigTimeoutTime_TCM" SG_ 1054 BoostVacGauge 0;
BA_ "GenSigTimeoutTime_AGSM" SG_ 1054 BrkSw1Stat 0;
BA_ "GenSigTimeoutTime_BSM" SG_ 1054 BrkSw1Stat 0;
BA_ "GenSigTimeoutTime_CADM" SG_ 1054 BrkSw1Stat 0;
BA_ "GenSigTimeoutTime_DMSM" SG_ 1054 BrkSw1Stat 0;
BA_ "GenSigTimeoutTime_DTCM" SG_ 1054 BrkSw1Stat 0;
BA_ "GenSigTimeoutTime_ECM" SG_ 1054 BrkSw1Stat 0;
BA_ "GenSigTimeoutTime_EVCU2" SG_ 1054 BrkSw1Stat 0;
BA_ "GenSigTimeoutTime_GNMM" SG_ 1054 BrkSw1Stat 0;
BA_ "GenSigTimeoutTime_HCP" SG_ 1054 BrkSw1Stat 0;
BA_ "GenSigTimeoutTime_IPC" SG_ 1054 BrkSw1Stat 0;
BA_ "GenSigTimeoutTime_RFHM" SG_ 1054 BrkSw1Stat 0;
BA_ "GenSigTimeoutTime_TCM" SG_ 1054 BrkSw1Stat 0;
BA_ "GenSigTimeoutTime_AGSM" SG_ 1054 BrkSw2Stat 0;
BA_ "GenSigTimeoutTime_BSM" SG_ 1054 BrkSw2Stat 0;
BA_ "GenSigTimeoutTime_CADM" SG_ 1054 BrkSw2Stat 0;
BA_ "GenSigTimeoutTime_DMSM" SG_ 1054 BrkSw2Stat 0;
BA_ "GenSigTimeoutTime_DTCM" SG_ 1054 BrkSw2Stat 0;
BA_ "GenSigTimeoutTime_ECM" SG_ 1054 BrkSw2Stat 0;
BA_ "GenSigTimeoutTime_EVCU2" SG_ 1054 BrkSw2Stat 0;
BA_ "GenSigTimeoutTime_GNMM" SG_ 1054 BrkSw2Stat 0;
BA_ "GenSigTimeoutTime_HCP" SG_ 1054 BrkSw2Stat 0;
BA_ "GenSigTimeoutTime_IPC" SG_ 1054 BrkSw2Stat 0;
BA_ "GenSigTimeoutTime_RFHM" SG_ 1054 BrkSw2Stat 0;
BA_ "GenSigTimeoutTime_TCM" SG_ 1054 BrkSw2Stat 0;
BA_ "GenSigTimeoutTime_AGSM" SG_ 1054 CRC_ENGINE1 0;
BA_ "GenSigTimeoutTime_BSM" SG_ 1054 CRC_ENGINE1 0;
BA_ "GenSigTimeoutTime_CADM" SG_ 1054 CRC_ENGINE1 0;
BA_ "GenSigTimeoutTime_DMSM" SG_ 1054 CRC_ENGINE1 0;
BA_ "GenSigTimeoutTime_DTCM" SG_ 1054 CRC_ENGINE1 0;
BA_ "GenSigTimeoutTime_ECM" SG_ 1054 CRC_ENGINE1 0;
BA_ "GenSigTimeoutTime_EVCU2" SG_ 1054 CRC_ENGINE1 0;
BA_ "GenSigTimeoutTime_GNMM" SG_ 1054 CRC_ENGINE1 0;
BA_ "GenSigTimeoutTime_IPC" SG_ 1054 CRC_ENGINE1 0;
BA_ "GenSigTimeoutTime_SGW" SG_ 1054 CRC_ENGINE1 0;
BA_ "GenSigStartValue" SG_ 1054 EngMaxRPM_W 255;
BA_ "GenSigTimeoutTime_AGSM" SG_ 1054 EngMaxRPM_W 0;
BA_ "GenSigTimeoutTime_BCM" SG_ 1054 EngMaxRPM_W 0;
BA_ "GenSigTimeoutTime_BSM" SG_ 1054 EngMaxRPM_W 0;
BA_ "GenSigTimeoutTime_CADM" SG_ 1054 EngMaxRPM_W 0;
BA_ "GenSigTimeoutTime_DMSM" SG_ 1054 EngMaxRPM_W 0;
BA_ "GenSigTimeoutTime_DTCM" SG_ 1054 EngMaxRPM_W 0;
BA_ "GenSigTimeoutTime_ECM" SG_ 1054 EngMaxRPM_W 0;
BA_ "GenSigTimeoutTime_EVCU2" SG_ 1054 EngMaxRPM_W 0;
BA_ "GenSigTimeoutTime_GNMM" SG_ 1054 EngMaxRPM_W 0;
BA_ "GenSigTimeoutTime_HCP" SG_ 1054 EngMaxRPM_W 0;
BA_ "GenSigTimeoutTime_IPC" SG_ 1054 EngMaxRPM_W 0;
BA_ "GenSigTimeoutTime_RFHM" SG_ 1054 EngMaxRPM_W 0;
BA_ "GenSigTimeoutTime_SGW" SG_ 1054 EngMaxRPM_W 0;
BA_ "GenSigTimeoutTime_AGSM" SG_ 1054 ESP_TrqRqEnabl 0;
BA_ "GenSigTimeoutTime_BSM" SG_ 1054 ESP_TrqRqEnabl 0;
BA_ "GenSigTimeoutTime_CADM" SG_ 1054 ESP_TrqRqEnabl 0;
BA_ "GenSigTimeoutTime_DMSM" SG_ 1054 ESP_TrqRqEnabl 0;
BA_ "GenSigTimeoutTime_DTCM" SG_ 1054 ESP_TrqRqEnabl 0;
BA_ "GenSigTimeoutTime_ECM" SG_ 1054 ESP_TrqRqEnabl 0;
BA_ "GenSigTimeoutTime_EVCU2" SG_ 1054 ESP_TrqRqEnabl 0;
BA_ "GenSigTimeoutTime_GNMM" SG_ 1054 ESP_TrqRqEnabl 0;
BA_ "GenSigTimeoutTime_HCP" SG_ 1054 ESP_TrqRqEnabl 0;
BA_ "GenSigTimeoutTime_IPC" SG_ 1054 ESP_TrqRqEnabl 0;
BA_ "GenSigTimeoutTime_RFHM" SG_ 1054 ESP_TrqRqEnabl 0;
BA_ "GenSigTimeoutTime_TCM" SG_ 1054 ESP_TrqRqEnabl 0;
BA_ "GenSigTimeoutTime_AGSM" SG_ 1054 HighPressureFuelSystemFailure 0;
BA_ "GenSigTimeoutTime_BCM" SG_ 1054 HighPressureFuelSystemFailure 0;
BA_ "GenSigTimeoutTime_BSM" SG_ 1054 HighPressureFuelSystemFailure 0;
BA_ "GenSigTimeoutTime_CADM" SG_ 1054 HighPressureFuelSystemFailure 0;
BA_ "GenSigTimeoutTime_DMSM" SG_ 1054 HighPressureFuelSystemFailure 0;
BA_ "GenSigTimeoutTime_DTCM" SG_ 1054 HighPressureFuelSystemFailure 0;
BA_ "GenSigTimeoutTime_ECM" SG_ 1054 HighPressureFuelSystemFailure 0;
BA_ "GenSigTimeoutTime_EVCU2" SG_ 1054 HighPressureFuelSystemFailure 0;
BA_ "GenSigTimeoutTime_GNMM" SG_ 1054 HighPressureFuelSystemFailure 0;
BA_ "GenSigTimeoutTime_HCP" SG_ 1054 HighPressureFuelSystemFailure 0;
BA_ "GenSigTimeoutTime_RFHM" SG_ 1054 HighPressureFuelSystemFailure 0;
BA_ "GenSigTimeoutTime_SGW" SG_ 1054 HighPressureFuelSystemFailure 0;
BA_ "GenSigTimeoutTime_TCM" SG_ 1054 HighPressureFuelSystemFailure 0;
BA_ "GenSigTimeoutTime_AGSM" SG_ 1054 Lv1CrsCtrlOff 0;
BA_ "GenSigTimeoutTime_BSM" SG_ 1054 Lv1CrsCtrlOff 0;
BA_ "GenSigTimeoutTime_CADM" SG_ 1054 Lv1CrsCtrlOff 0;
BA_ "GenSigTimeoutTime_DMSM" SG_ 1054 Lv1CrsCtrlOff 0;
BA_ "GenSigTimeoutTime_DTCM" SG_ 1054 Lv1CrsCtrlOff 0;
BA_ "GenSigTimeoutTime_ECM" SG_ 1054 Lv1CrsCtrlOff 0;
BA_ "GenSigTimeoutTime_EVCU2" SG_ 1054 Lv1CrsCtrlOff 0;
BA_ "GenSigTimeoutTime_GNMM" SG_ 1054 Lv1CrsCtrlOff 0;
BA_ "GenSigTimeoutTime_HCP" SG_ 1054 Lv1CrsCtrlOff 0;
BA_ "GenSigTimeoutTime_IPC" SG_ 1054 Lv1CrsCtrlOff 0;
BA_ "GenSigTimeoutTime_RFHM" SG_ 1054 Lv1CrsCtrlOff 0;
BA_ "GenSigTimeoutTime_TCM" SG_ 1054 Lv1CrsCtrlOff 0;
BA_ "GenSigTimeoutTime_AGSM" SG_ 1054 MessageCounter_ENGINE1 0;
BA_ "GenSigTimeoutTime_BSM" SG_ 1054 MessageCounter_ENGINE1 0;
BA_ "GenSigTimeoutTime_CADM" SG_ 1054 MessageCounter_ENGINE1 0;
BA_ "GenSigTimeoutTime_DMSM" SG_ 1054 MessageCounter_ENGINE1 0;
BA_ "GenSigTimeoutTime_DTCM" SG_ 1054 MessageCounter_ENGINE1 0;
BA_ "GenSigTimeoutTime_ECM" SG_ 1054 MessageCounter_ENGINE1 0;
BA_ "GenSigTimeoutTime_EVCU2" SG_ 1054 MessageCounter_ENGINE1 0;
BA_ "GenSigTimeoutTime_GNMM" SG_ 1054 MessageCounter_ENGINE1 0;
BA_ "GenSigTimeoutTime_IPC" SG_ 1054 MessageCounter_ENGINE1 0;
BA_ "GenSigTimeoutTime_SGW" SG_ 1054 MessageCounter_ENGINE1 0;
BA_ "GenSigStartValue" SG_ 1054 RawPVS1 255;
BA_ "GenSigTimeoutTime_AGSM" SG_ 1054 RawPVS1 0;
BA_ "GenSigTimeoutTime_BSM" SG_ 1054 RawPVS1 0;
BA_ "GenSigTimeoutTime_CADM" SG_ 1054 RawPVS1 0;
BA_ "GenSigTimeoutTime_DMSM" SG_ 1054 RawPVS1 0;
BA_ "GenSigTimeoutTime_DTCM" SG_ 1054 RawPVS1 0;
BA_ "GenSigTimeoutTime_ECM" SG_ 1054 RawPVS1 0;
BA_ "GenSigTimeoutTime_EVCU2" SG_ 1054 RawPVS1 0;
BA_ "GenSigTimeoutTime_GNMM" SG_ 1054 RawPVS1 0;
BA_ "GenSigTimeoutTime_HCP" SG_ 1054 RawPVS1 0;
BA_ "GenSigTimeoutTime_IPC" SG_ 1054 RawPVS1 0;
BA_ "GenSigTimeoutTime_RFHM" SG_ 1054 RawPVS1 0;
BA_ "GenSigTimeoutTime_TCM" SG_ 1054 RawPVS1 0;
BA_ "GenSigStartValue" SG_ 1054 RawPVS2 255;
BA_ "GenSigTimeoutTime_AGSM" SG_ 1054 RawPVS2 0;
BA_ "GenSigTimeoutTime_BSM" SG_ 1054 RawPVS2 0;
BA_ "GenSigTimeoutTime_CADM" SG_ 1054 RawPVS2 0;
BA_ "GenSigTimeoutTime_DMSM" SG_ 1054 RawPVS2 0;
BA_ "GenSigTimeoutTime_DTCM" SG_ 1054 RawPVS2 0;
BA_ "GenSigTimeoutTime_ECM" SG_ 1054 RawPVS2 0;
BA_ "GenSigTimeoutTime_EVCU2" SG_ 1054 RawPVS2 0;
BA_ "GenSigTimeoutTime_GNMM" SG_ 1054 RawPVS2 0;
BA_ "GenSigTimeoutTime_HCP" SG_ 1054 RawPVS2 0;
BA_ "GenSigTimeoutTime_IPC" SG_ 1054 RawPVS2 0;
BA_ "GenSigTimeoutTime_RFHM" SG_ 1054 RawPVS2 0;
BA_ "GenSigTimeoutTime_TCM" SG_ 1054 RawPVS2 0;
BA_ "GenSigStartValue" SG_ 1054 RawTPS1 255;
BA_ "GenSigTimeoutTime_AGSM" SG_ 1054 RawTPS1 0;
BA_ "GenSigTimeoutTime_BSM" SG_ 1054 RawTPS1 0;
BA_ "GenSigTimeoutTime_CADM" SG_ 1054 RawTPS1 0;
BA_ "GenSigTimeoutTime_DMSM" SG_ 1054 RawTPS1 0;
BA_ "GenSigTimeoutTime_DTCM" SG_ 1054 RawTPS1 0;
BA_ "GenSigTimeoutTime_ECM" SG_ 1054 RawTPS1 0;
BA_ "GenSigTimeoutTime_EVCU2" SG_ 1054 RawTPS1 0;
BA_ "GenSigTimeoutTime_GNMM" SG_ 1054 RawTPS1 0;
BA_ "GenSigTimeoutTime_HCP" SG_ 1054 RawTPS1 0;
BA_ "GenSigTimeoutTime_IPC" SG_ 1054 RawTPS1 0;
BA_ "GenSigTimeoutTime_RFHM" SG_ 1054 RawTPS1 0;
BA_ "GenSigTimeoutTime_TCM" SG_ 1054 RawTPS1 0;
BA_ "GenSigStartValue" SG_ 1054 RawTPS2 255;
BA_ "GenSigTimeoutTime_AGSM" SG_ 1054 RawTPS2 0;
BA_ "GenSigTimeoutTime_BSM" SG_ 1054 RawTPS2 0;
BA_ "GenSigTimeoutTime_CADM" SG_ 1054 RawTPS2 0;
BA_ "GenSigTimeoutTime_DMSM" SG_ 1054 RawTPS2 0;
BA_ "GenSigTimeoutTime_DTCM" SG_ 1054 RawTPS2 0;
BA_ "GenSigTimeoutTime_ECM" SG_ 1054 RawTPS2 0;
BA_ "GenSigTimeoutTime_EVCU2" SG_ 1054 RawTPS2 0;
BA_ "GenSigTimeoutTime_GNMM" SG_ 1054 RawTPS2 0;
BA_ "GenSigTimeoutTime_HCP" SG_ 1054 RawTPS2 0;
BA_ "GenSigTimeoutTime_IPC" SG_ 1054 RawTPS2 0;
BA_ "GenSigTimeoutTime_RFHM" SG_ 1054 RawTPS2 0;
BA_ "GenSigTimeoutTime_TCM" SG_ 1054 RawTPS2 0;
BA_ "GenSigTimeoutTime_AGSM" SG_ 1054 ThermalManagementActive_W 0;
BA_ "GenSigTimeoutTime_BCM" SG_ 1054 ThermalManagementActive_W 0;
BA_ "GenSigTimeoutTime_BSM" SG_ 1054 ThermalManagementActive_W 0;
BA_ "GenSigTimeoutTime_CADM" SG_ 1054 ThermalManagementActive_W 0;
BA_ "GenSigTimeoutTime_DMSM" SG_ 1054 ThermalManagementActive_W 0;
BA_ "GenSigTimeoutTime_DTCM" SG_ 1054 ThermalManagementActive_W 0;
BA_ "GenSigTimeoutTime_ECM" SG_ 1054 ThermalManagementActive_W 0;
BA_ "GenSigTimeoutTime_EVCU2" SG_ 1054 ThermalManagementActive_W 0;
BA_ "GenSigTimeoutTime_GNMM" SG_ 1054 ThermalManagementActive_W 0;
BA_ "GenSigTimeoutTime_HCP" SG_ 1054 ThermalManagementActive_W 0;
BA_ "GenSigTimeoutTime_IPC" SG_ 1054 ThermalManagementActive_W 0;
BA_ "GenSigTimeoutTime_RFHM" SG_ 1054 ThermalManagementActive_W 0;
BA_ "GenSigTimeoutTime_SGW" SG_ 1054 ThermalManagementActive_W 0;
BA_ "GenSigTimeoutTime_AGSM" SG_ 1054 ThrottlePosition 0;
BA_ "GenSigTimeoutTime_BSM" SG_ 1054 ThrottlePosition 0;
BA_ "GenSigTimeoutTime_CADM" SG_ 1054 ThrottlePosition 0;
BA_ "GenSigTimeoutTime_DMSM" SG_ 1054 ThrottlePosition 0;
BA_ "GenSigTimeoutTime_DTCM" SG_ 1054 ThrottlePosition 0;
BA_ "GenSigTimeoutTime_ECM" SG_ 1054 ThrottlePosition 0;
BA_ "GenSigTimeoutTime_EVCU2" SG_ 1054 ThrottlePosition 0;
BA_ "GenSigTimeoutTime_GNMM" SG_ 1054 ThrottlePosition 0;
BA_ "GenSigTimeoutTime_HCP" SG_ 1054 ThrottlePosition 0;
BA_ "GenSigTimeoutTime_IPC" SG_ 1054 ThrottlePosition 0;
BA_ "GenSigTimeoutTime_RFHM" SG_ 1054 ThrottlePosition 0;
BA_ "GenSigTimeoutTime_TCM" SG_ 1054 ThrottlePosition 0;
BA_ "GenSigTimeoutTime_AGSM" SG_ 1054 TransWarmUpMin_RPM 0;
BA_ "GenSigTimeoutTime_BCM" SG_ 1054 TransWarmUpMin_RPM 0;
BA_ "GenSigTimeoutTime_BSM" SG_ 1054 TransWarmUpMin_RPM 0;
BA_ "GenSigTimeoutTime_CADM" SG_ 1054 TransWarmUpMin_RPM 0;
BA_ "GenSigTimeoutTime_DMSM" SG_ 1054 TransWarmUpMin_RPM 0;
BA_ "GenSigTimeoutTime_DTCM" SG_ 1054 TransWarmUpMin_RPM 0;
BA_ "GenSigTimeoutTime_ECM" SG_ 1054 TransWarmUpMin_RPM 0;
BA_ "GenSigTimeoutTime_EVCU2" SG_ 1054 TransWarmUpMin_RPM 0;
BA_ "GenSigTimeoutTime_GNMM" SG_ 1054 TransWarmUpMin_RPM 0;
BA_ "GenSigTimeoutTime_HCP" SG_ 1054 TransWarmUpMin_RPM 0;
BA_ "GenSigTimeoutTime_IPC" SG_ 1054 TransWarmUpMin_RPM 0;
BA_ "GenSigTimeoutTime_RFHM" SG_ 1054 TransWarmUpMin_RPM 0;
BA_ "GenSigTimeoutTime_SGW" SG_ 1054 TransWarmUpMin_RPM 0;
BA_ "GenSigTimeoutTime_AGSM" SG_ 1054 TransWarmUpReq 0;
BA_ "GenSigTimeoutTime_BCM" SG_ 1054 TransWarmUpReq 0;
BA_ "GenSigTimeoutTime_BSM" SG_ 1054 TransWarmUpReq 0;
BA_ "GenSigTimeoutTime_CADM" SG_ 1054 TransWarmUpReq 0;
BA_ "GenSigTimeoutTime_DMSM" SG_ 1054 TransWarmUpReq 0;
BA_ "GenSigTimeoutTime_DTCM" SG_ 1054 TransWarmUpReq 0;
BA_ "GenSigTimeoutTime_ECM" SG_ 1054 TransWarmUpReq 0;
BA_ "GenSigTimeoutTime_EVCU2" SG_ 1054 TransWarmUpReq 0;
BA_ "GenSigTimeoutTime_GNMM" SG_ 1054 TransWarmUpReq 0;
BA_ "GenSigTimeoutTime_HCP" SG_ 1054 TransWarmUpReq 0;
BA_ "GenSigTimeoutTime_IPC" SG_ 1054 TransWarmUpReq 0;
BA_ "GenSigTimeoutTime_RFHM" SG_ 1054 TransWarmUpReq 0;
BA_ "GenSigTimeoutTime_SGW" SG_ 1054 TransWarmUpReq 0;
BA_ "GenSigStartValue" SG_ 262 AlternatorFail_W 1;
BA_ "GenSigTimeoutTime_AGSM" SG_ 262 AlternatorFail_W 0;
BA_ "GenSigTimeoutTime_BCM" SG_ 262 AlternatorFail_W 0;
BA_ "GenSigTimeoutTime_BSM" SG_ 262 AlternatorFail_W 0;
BA_ "GenSigTimeoutTime_CADM" SG_ 262 AlternatorFail_W 0;
BA_ "GenSigTimeoutTime_DMSM" SG_ 262 AlternatorFail_W 0;
BA_ "GenSigTimeoutTime_DTCM" SG_ 262 AlternatorFail_W 0;
BA_ "GenSigTimeoutTime_ECM" SG_ 262 AlternatorFail_W 0;
BA_ "GenSigTimeoutTime_EVCU2" SG_ 262 AlternatorFail_W 0;
BA_ "GenSigTimeoutTime_GNMM" SG_ 262 AlternatorFail_W 0;
BA_ "GenSigTimeoutTime_HCP" SG_ 262 AlternatorFail_W 0;
BA_ "GenSigTimeoutTime_RFHM" SG_ 262 AlternatorFail_W 0;
BA_ "GenSigTimeoutTime_TCM" SG_ 262 AlternatorFail_W 0;
BA_ "GenSigTimeoutTime_AGSM" SG_ 262 CrankHold_W 0;
BA_ "GenSigTimeoutTime_BSM" SG_ 262 CrankHold_W 0;
BA_ "GenSigTimeoutTime_CADM" SG_ 262 CrankHold_W 0;
BA_ "GenSigTimeoutTime_DMSM" SG_ 262 CrankHold_W 0;
BA_ "GenSigTimeoutTime_DTCM" SG_ 262 CrankHold_W 0;
BA_ "GenSigTimeoutTime_ECM" SG_ 262 CrankHold_W 0;
BA_ "GenSigTimeoutTime_EVCU2" SG_ 262 CrankHold_W 0;
BA_ "GenSigTimeoutTime_GNMM" SG_ 262 CrankHold_W 0;
BA_ "GenSigTimeoutTime_HCP" SG_ 262 CrankHold_W 0;
BA_ "GenSigTimeoutTime_IPC" SG_ 262 CrankHold_W 0;
BA_ "GenSigTimeoutTime_RFHM" SG_ 262 CrankHold_W 0;
BA_ "GenSigTimeoutTime_TCM" SG_ 262 CrankHold_W 0;
BA_ "GenSigTimeoutTime_AGSM" SG_ 262 CRC_ENGINE2 0;
BA_ "GenSigTimeoutTime_ECM" SG_ 262 CRC_ENGINE2 0;
BA_ "GenSigTimeoutTime_EVCU2" SG_ 262 CRC_ENGINE2 0;
BA_ "GenSigTimeoutTime_GNMM" SG_ 262 CRC_ENGINE2 0;
BA_ "GenSigTimeoutTime_RFHM" SG_ 262 CRC_ENGINE2 0;
BA_ "GenSigTimeoutTime_SGW" SG_ 262 CRC_ENGINE2 0;
BA_ "GenSigTimeoutTime_AGSM" SG_ 262 ECM_Ack_DriveMode 0;
BA_ "GenSigTimeoutTime_BCM" SG_ 262 ECM_Ack_DriveMode 0;
BA_ "GenSigTimeoutTime_BSM" SG_ 262 ECM_Ack_DriveMode 0;
BA_ "GenSigTimeoutTime_CADM" SG_ 262 ECM_Ack_DriveMode 0;
BA_ "GenSigTimeoutTime_DMSM" SG_ 262 ECM_Ack_DriveMode 0;
BA_ "GenSigTimeoutTime_DTCM" SG_ 262 ECM_Ack_DriveMode 0;
BA_ "GenSigTimeoutTime_ECM" SG_ 262 ECM_Ack_DriveMode 0;
BA_ "GenSigTimeoutTime_EVCU2" SG_ 262 ECM_Ack_DriveMode 0;
BA_ "GenSigTimeoutTime_GNMM" SG_ 262 ECM_Ack_DriveMode 0;
BA_ "GenSigTimeoutTime_HCP" SG_ 262 ECM_Ack_DriveMode 0;
BA_ "GenSigTimeoutTime_IPC" SG_ 262 ECM_Ack_DriveMode 0;
BA_ "GenSigTimeoutTime_RFHM" SG_ 262 ECM_Ack_DriveMode 0;
BA_ "GenSigTimeoutTime_SGW" SG_ 262 ECM_Ack_DriveMode 0;
BA_ "GenSigTimeoutTime_TCM" SG_ 262 ECM_Ack_DriveMode 0;
BA_ "GenSigTimeoutTime_AGSM" SG_ 262 ECM_LHOM_Trans_W 0;
BA_ "GenSigTimeoutTime_BCM" SG_ 262 ECM_LHOM_Trans_W 0;
BA_ "GenSigTimeoutTime_BSM" SG_ 262 ECM_LHOM_Trans_W 0;
BA_ "GenSigTimeoutTime_CADM" SG_ 262 ECM_LHOM_Trans_W 0;
BA_ "GenSigTimeoutTime_DMSM" SG_ 262 ECM_LHOM_Trans_W 0;
BA_ "GenSigTimeoutTime_DTCM" SG_ 262 ECM_LHOM_Trans_W 0;
BA_ "GenSigTimeoutTime_ECM" SG_ 262 ECM_LHOM_Trans_W 0;
BA_ "GenSigTimeoutTime_EVCU2" SG_ 262 ECM_LHOM_Trans_W 0;
BA_ "GenSigTimeoutTime_GNMM" SG_ 262 ECM_LHOM_Trans_W 0;
BA_ "GenSigTimeoutTime_HCP" SG_ 262 ECM_LHOM_Trans_W 0;
BA_ "GenSigTimeoutTime_IPC" SG_ 262 ECM_LHOM_Trans_W 0;
BA_ "GenSigTimeoutTime_RFHM" SG_ 262 ECM_LHOM_Trans_W 0;
BA_ "GenSigTimeoutTime_SGW" SG_ 262 ECM_LHOM_Trans_W 0;
BA_ "GenSigTimeoutTime_AGSM" SG_ 262 ECM_LHOM_W 0;
BA_ "GenSigTimeoutTime_BCM" SG_ 262 ECM_LHOM_W 0;
BA_ "GenSigTimeoutTime_BSM" SG_ 262 ECM_LHOM_W 0;
BA_ "GenSigTimeoutTime_CADM" SG_ 262 ECM_LHOM_W 0;
BA_ "GenSigTimeoutTime_DMSM" SG_ 262 ECM_LHOM_W 0;
BA_ "GenSigTimeoutTime_DTCM" SG_ 262 ECM_LHOM_W 0;
BA_ "GenSigTimeoutTime_ECM" SG_ 262 ECM_LHOM_W 0;
BA_ "GenSigTimeoutTime_EVCU2" SG_ 262 ECM_LHOM_W 0;
BA_ "GenSigTimeoutTime_GNMM" SG_ 262 ECM_LHOM_W 0;
BA_ "GenSigTimeoutTime_HCP" SG_ 262 ECM_LHOM_W 0;
BA_ "GenSigTimeoutTime_IPC" SG_ 262 ECM_LHOM_W 0;
BA_ "GenSigTimeoutTime_RFHM" SG_ 262 ECM_LHOM_W 0;
BA_ "GenSigTimeoutTime_SGW" SG_ 262 ECM_LHOM_W 0;
BA_ "GenSigTimeoutTime_AGSM" SG_ 262 EngineFrictionTorque_W 0;
BA_ "GenSigTimeoutTime_BSM" SG_ 262 EngineFrictionTorque_W 0;
BA_ "GenSigTimeoutTime_CADM" SG_ 262 EngineFrictionTorque_W 0;
BA_ "GenSigTimeoutTime_DMSM" SG_ 262 EngineFrictionTorque_W 0;
BA_ "GenSigTimeoutTime_DTCM" SG_ 262 EngineFrictionTorque_W 0;
BA_ "GenSigTimeoutTime_ECM" SG_ 262 EngineFrictionTorque_W 0;
BA_ "GenSigTimeoutTime_EVCU2" SG_ 262 EngineFrictionTorque_W 0;
BA_ "GenSigTimeoutTime_GNMM" SG_ 262 EngineFrictionTorque_W 0;
BA_ "GenSigTimeoutTime_HCP" SG_ 262 EngineFrictionTorque_W 0;
BA_ "GenSigTimeoutTime_IPC" SG_ 262 EngineFrictionTorque_W 0;
BA_ "GenSigTimeoutTime_RFHM" SG_ 262 EngineFrictionTorque_W 0;
BA_ "GenSigTimeoutTime_TCM" SG_ 262 EngineFrictionTorque_W 0;
BA_ "GenSigTimeoutTime_AGSM" SG_ 262 EngineIdleRefSpeed 0;
BA_ "GenSigTimeoutTime_BCM" SG_ 262 EngineIdleRefSpeed 0;
BA_ "GenSigTimeoutTime_CADM" SG_ 262 EngineIdleRefSpeed 0;
BA_ "GenSigTimeoutTime_DMSM" SG_ 262 EngineIdleRefSpeed 0;
BA_ "GenSigTimeoutTime_DTCM" SG_ 262 EngineIdleRefSpeed 0;
BA_ "GenSigTimeoutTime_ECM" SG_ 262 EngineIdleRefSpeed 0;
BA_ "GenSigTimeoutTime_EVCU2" SG_ 262 EngineIdleRefSpeed 0;
BA_ "GenSigTimeoutTime_GNMM" SG_ 262 EngineIdleRefSpeed 0;
BA_ "GenSigTimeoutTime_HCP" SG_ 262 EngineIdleRefSpeed 0;
BA_ "GenSigTimeoutTime_IPC" SG_ 262 EngineIdleRefSpeed 0;
BA_ "GenSigTimeoutTime_RFHM" SG_ 262 EngineIdleRefSpeed 0;
BA_ "GenSigTimeoutTime_SGW" SG_ 262 EngineIdleRefSpeed 0;
BA_ "GenSigTimeoutTime_AGSM" SG_ 262 EngineSailingRq 0;
BA_ "GenSigTimeoutTime_BCM" SG_ 262 EngineSailingRq 0;
BA_ "GenSigTimeoutTime_BSM" SG_ 262 EngineSailingRq 0;
BA_ "GenSigTimeoutTime_CADM" SG_ 262 EngineSailingRq 0;
BA_ "GenSigTimeoutTime_DMSM" SG_ 262 EngineSailingRq 0;
BA_ "GenSigTimeoutTime_DTCM" SG_ 262 EngineSailingRq 0;
BA_ "GenSigTimeoutTime_ECM" SG_ 262 EngineSailingRq 0;
BA_ "GenSigTimeoutTime_EVCU2" SG_ 262 EngineSailingRq 0;
BA_ "GenSigTimeoutTime_GNMM" SG_ 262 EngineSailingRq 0;
BA_ "GenSigTimeoutTime_HCP" SG_ 262 EngineSailingRq 0;
BA_ "GenSigTimeoutTime_IPC" SG_ 262 EngineSailingRq 0;
BA_ "GenSigTimeoutTime_RFHM" SG_ 262 EngineSailingRq 0;
BA_ "GenSigTimeoutTime_SGW" SG_ 262 EngineSailingRq 0;
BA_ "GenSigTimeoutTime_AGSM" SG_ 262 EngineSpeedFailSts_W 0;
BA_ "GenSigTimeoutTime_BSM" SG_ 262 EngineSpeedFailSts_W 0;
BA_ "GenSigTimeoutTime_CADM" SG_ 262 EngineSpeedFailSts_W 0;
BA_ "GenSigTimeoutTime_DMSM" SG_ 262 EngineSpeedFailSts_W 0;
BA_ "GenSigTimeoutTime_ECM" SG_ 262 EngineSpeedFailSts_W 0;
BA_ "GenSigTimeoutTime_EVCU2" SG_ 262 EngineSpeedFailSts_W 0;
BA_ "GenSigTimeoutTime_GNMM" SG_ 262 EngineSpeedFailSts_W 0;
BA_ "GenSigTimeoutTime_HCP" SG_ 262 EngineSpeedFailSts_W 0;
BA_ "GenSigTimeoutTime_RFHM" SG_ 262 EngineSpeedFailSts_W 0;
BA_ "GenSigTimeoutTime_TCM" SG_ 262 EngineSpeedFailSts_W 0;
BA_ "GenSigStartValue" SG_ 262 EngineSts_W 3;
BA_ "GenSigTimeoutTime_AGSM" SG_ 262 EngineSts_W 0;
BA_ "GenSigTimeoutTime_CADM" SG_ 262 EngineSts_W 0;
BA_ "GenSigTimeoutTime_DMSM" SG_ 262 EngineSts_W 0;
BA_ "GenSigTimeoutTime_DTCM" SG_ 262 EngineSts_W 0;
BA_ "GenSigTimeoutTime_GNMM" SG_ 262 EngineSts_W 0;
BA_ "GenSigTimeoutTime_HCP" SG_ 262 EngineSts_W 0;
BA_ "GenSigTimeoutTime_RFHM" SG_ 262 EngineSts_W 0;
BA_ "GenSigStartValue" SG_ 262 EngRPM_Tach 65535;
BA_ "GenSigTimeoutTime_AGSM" SG_ 262 EngRPM_Tach 0;
BA_ "GenSigTimeoutTime_BCM" SG_ 262 EngRPM_Tach 0;
BA_ "GenSigTimeoutTime_BSM" SG_ 262 EngRPM_Tach 0;
BA_ "GenSigTimeoutTime_CADM" SG_ 262 EngRPM_Tach 0;
BA_ "GenSigTimeoutTime_DMSM" SG_ 262 EngRPM_Tach 0;
BA_ "GenSigTimeoutTime_DTCM" SG_ 262 EngRPM_Tach 0;
BA_ "GenSigTimeoutTime_ECM" SG_ 262 EngRPM_Tach 0;
BA_ "GenSigTimeoutTime_EVCU2" SG_ 262 EngRPM_Tach 0;
BA_ "GenSigTimeoutTime_GNMM" SG_ 262 EngRPM_Tach 0;
BA_ "GenSigTimeoutTime_HCP" SG_ 262 EngRPM_Tach 0;
BA_ "GenSigTimeoutTime_RFHM" SG_ 262 EngRPM_Tach 0;
BA_ "GenSigTimeoutTime_TCM" SG_ 262 EngRPM_Tach 0;
BA_ "GenSigTimeoutTime_AGSM" SG_ 262 EngTrq_Enbl_Rq_TCM_W 0;
BA_ "GenSigTimeoutTime_BSM" SG_ 262 EngTrq_Enbl_Rq_TCM_W 0;
BA_ "GenSigTimeoutTime_CADM" SG_ 262 EngTrq_Enbl_Rq_TCM_W 0;
BA_ "GenSigTimeoutTime_DMSM" SG_ 262 EngTrq_Enbl_Rq_TCM_W 0;
BA_ "GenSigTimeoutTime_DTCM" SG_ 262 EngTrq_Enbl_Rq_TCM_W 0;
BA_ "GenSigTimeoutTime_ECM" SG_ 262 EngTrq_Enbl_Rq_TCM_W 0;
BA_ "GenSigTimeoutTime_EVCU2" SG_ 262 EngTrq_Enbl_Rq_TCM_W 0;
BA_ "GenSigTimeoutTime_GNMM" SG_ 262 EngTrq_Enbl_Rq_TCM_W 0;
BA_ "GenSigTimeoutTime_HCP" SG_ 262 EngTrq_Enbl_Rq_TCM_W 0;
BA_ "GenSigTimeoutTime_IPC" SG_ 262 EngTrq_Enbl_Rq_TCM_W 0;
BA_ "GenSigTimeoutTime_RFHM" SG_ 262 EngTrq_Enbl_Rq_TCM_W 0;
BA_ "GenSigTimeoutTime_SGW" SG_ 262 EngTrq_Enbl_Rq_TCM_W 0;
BA_ "GenSigTimeoutTime_AGSM" SG_ 262 ESS_EBOOST_BRKHLD_STATUS 0;
BA_ "GenSigTimeoutTime_BCM" SG_ 262 ESS_EBOOST_BRKHLD_STATUS 0;
BA_ "GenSigTimeoutTime_CADM" SG_ 262 ESS_EBOOST_BRKHLD_STATUS 0;
BA_ "GenSigTimeoutTime_DMSM" SG_ 262 ESS_EBOOST_BRKHLD_STATUS 0;
BA_ "GenSigTimeoutTime_DTCM" SG_ 262 ESS_EBOOST_BRKHLD_STATUS 0;
BA_ "GenSigTimeoutTime_ECM" SG_ 262 ESS_EBOOST_BRKHLD_STATUS 0;
BA_ "GenSigTimeoutTime_EVCU2" SG_ 262 ESS_EBOOST_BRKHLD_STATUS 0;
BA_ "GenSigTimeoutTime_GNMM" SG_ 262 ESS_EBOOST_BRKHLD_STATUS 0;
BA_ "GenSigTimeoutTime_HCP" SG_ 262 ESS_EBOOST_BRKHLD_STATUS 0;
BA_ "GenSigTimeoutTime_IPC" SG_ 262 ESS_EBOOST_BRKHLD_STATUS 0;
BA_ "GenSigTimeoutTime_RFHM" SG_ 262 ESS_EBOOST_BRKHLD_STATUS 0;
BA_ "GenSigTimeoutTime_SGW" SG_ 262 ESS_EBOOST_BRKHLD_STATUS 0;
BA_ "GenSigTimeoutTime_TCM" SG_ 262 ESS_EBOOST_BRKHLD_STATUS 0;
BA_ "GenSigStartValue" SG_ 262 ESS_ENG_ST_W 15;
BA_ "GenSigSendType" SG_ 262 ESS_ENG_ST_W 3;
BA_ "GenSigTimeoutTime_AGSM" SG_ 262 ESS_ENG_ST_W 0;
BA_ "GenSigTimeoutTime_CADM" SG_ 262 ESS_ENG_ST_W 0;
BA_ "GenSigTimeoutTime_ECM" SG_ 262 ESS_ENG_ST_W 0;
BA_ "GenSigTimeoutTime_EVCU2" SG_ 262 ESS_ENG_ST_W 0;
BA_ "GenSigTimeoutTime_GNMM" SG_ 262 ESS_ENG_ST_W 0;
BA_ "GenSigTimeoutTime_HCP" SG_ 262 ESS_ENG_ST_W 0;
BA_ "GenSigTimeoutTime_RFHM" SG_ 262 ESS_ENG_ST_W 0;
BA_ "GenSigTimeoutTime_AGSM" SG_ 262 ESS_RqShftPark_W 0;
BA_ "GenSigTimeoutTime_CADM" SG_ 262 ESS_RqShftPark_W 0;
BA_ "GenSigTimeoutTime_DMSM" SG_ 262 ESS_RqShftPark_W 0;
BA_ "GenSigTimeoutTime_DTCM" SG_ 262 ESS_RqShftPark_W 0;
BA_ "GenSigTimeoutTime_ECM" SG_ 262 ESS_RqShftPark_W 0;
BA_ "GenSigTimeoutTime_EVCU2" SG_ 262 ESS_RqShftPark_W 0;
BA_ "GenSigTimeoutTime_GNMM" SG_ 262 ESS_RqShftPark_W 0;
BA_ "GenSigTimeoutTime_HCP" SG_ 262 ESS_RqShftPark_W 0;
BA_ "GenSigTimeoutTime_IPC" SG_ 262 ESS_RqShftPark_W 0;
BA_ "GenSigTimeoutTime_RFHM" SG_ 262 ESS_RqShftPark_W 0;
BA_ "GenSigTimeoutTime_SGW" SG_ 262 ESS_RqShftPark_W 0;
BA_ "GenSigTimeoutTime_AGSM" SG_ 262 EVRDesiredSetpoint 0;
BA_ "GenSigTimeoutTime_BCM" SG_ 262 EVRDesiredSetpoint 0;
BA_ "GenSigTimeoutTime_BSM" SG_ 262 EVRDesiredSetpoint 0;
BA_ "GenSigTimeoutTime_CADM" SG_ 262 EVRDesiredSetpoint 0;
BA_ "GenSigTimeoutTime_DMSM" SG_ 262 EVRDesiredSetpoint 0;
BA_ "GenSigTimeoutTime_DTCM" SG_ 262 EVRDesiredSetpoint 0;
BA_ "GenSigTimeoutTime_ECM" SG_ 262 EVRDesiredSetpoint 0;
BA_ "GenSigTimeoutTime_EVCU2" SG_ 262 EVRDesiredSetpoint 0;
BA_ "GenSigTimeoutTime_GNMM" SG_ 262 EVRDesiredSetpoint 0;
BA_ "GenSigTimeoutTime_IPC" SG_ 262 EVRDesiredSetpoint 0;
BA_ "GenSigTimeoutTime_RFHM" SG_ 262 EVRDesiredSetpoint 0;
BA_ "GenSigTimeoutTime_SGW" SG_ 262 EVRDesiredSetpoint 0;
BA_ "GenSigTimeoutTime_TCM" SG_ 262 EVRDesiredSetpoint 0;
BA_ "GenSigTimeoutTime_AGSM" SG_ 262 FuelConsumption_GAG_3 0;
BA_ "GenSigTimeoutTime_BCM" SG_ 262 FuelConsumption_GAG_3 0;
BA_ "GenSigTimeoutTime_BSM" SG_ 262 FuelConsumption_GAG_3 0;
BA_ "GenSigTimeoutTime_CADM" SG_ 262 FuelConsumption_GAG_3 0;
BA_ "GenSigTimeoutTime_DMSM" SG_ 262 FuelConsumption_GAG_3 0;
BA_ "GenSigTimeoutTime_DTCM" SG_ 262 FuelConsumption_GAG_3 0;
BA_ "GenSigTimeoutTime_ECM" SG_ 262 FuelConsumption_GAG_3 0;
BA_ "GenSigTimeoutTime_GNMM" SG_ 262 FuelConsumption_GAG_3 0;
BA_ "GenSigTimeoutTime_HCP" SG_ 262 FuelConsumption_GAG_3 0;
BA_ "GenSigTimeoutTime_RFHM" SG_ 262 FuelConsumption_GAG_3 0;
BA_ "GenSigTimeoutTime_TCM" SG_ 262 FuelConsumption_GAG_3 0;
BA_ "GenSigTimeoutTime_AGSM" SG_ 262 FullOFC_Actv 0;
BA_ "GenSigTimeoutTime_BCM" SG_ 262 FullOFC_Actv 0;
BA_ "GenSigTimeoutTime_BSM" SG_ 262 FullOFC_Actv 0;
BA_ "GenSigTimeoutTime_CADM" SG_ 262 FullOFC_Actv 0;
BA_ "GenSigTimeoutTime_DMSM" SG_ 262 FullOFC_Actv 0;
BA_ "GenSigTimeoutTime_DTCM" SG_ 262 FullOFC_Actv 0;
BA_ "GenSigTimeoutTime_ECM" SG_ 262 FullOFC_Actv 0;
BA_ "GenSigTimeoutTime_EVCU2" SG_ 262 FullOFC_Actv 0;
BA_ "GenSigTimeoutTime_GNMM" SG_ 262 FullOFC_Actv 0;
BA_ "GenSigTimeoutTime_HCP" SG_ 262 FullOFC_Actv 0;
BA_ "GenSigTimeoutTime_IPC" SG_ 262 FullOFC_Actv 0;
BA_ "GenSigTimeoutTime_RFHM" SG_ 262 FullOFC_Actv 0;
BA_ "GenSigTimeoutTime_SGW" SG_ 262 FullOFC_Actv 0;
BA_ "GenSigTimeoutTime_TCM" SG_ 262 FullOFC_Actv 0;
BA_ "GenSigTimeoutTime_AGSM" SG_ 262 GasPedalGradient_W 0;
BA_ "GenSigTimeoutTime_BSM" SG_ 262 GasPedalGradient_W 0;
BA_ "GenSigTimeoutTime_CADM" SG_ 262 GasPedalGradient_W 0;
BA_ "GenSigTimeoutTime_DMSM" SG_ 262 GasPedalGradient_W 0;
BA_ "GenSigTimeoutTime_DTCM" SG_ 262 GasPedalGradient_W 0;
BA_ "GenSigTimeoutTime_ECM" SG_ 262 GasPedalGradient_W 0;
BA_ "GenSigTimeoutTime_EVCU2" SG_ 262 GasPedalGradient_W 0;
BA_ "GenSigTimeoutTime_GNMM" SG_ 262 GasPedalGradient_W 0;
BA_ "GenSigTimeoutTime_HCP" SG_ 262 GasPedalGradient_W 0;
BA_ "GenSigTimeoutTime_IPC" SG_ 262 GasPedalGradient_W 0;
BA_ "GenSigTimeoutTime_RFHM" SG_ 262 GasPedalGradient_W 0;
BA_ "GenSigTimeoutTime_SGW" SG_ 262 GasPedalGradient_W 0;
BA_ "GenSigTimeoutTime_TCM" SG_ 262 GasPedalGradient_W 0;
BA_ "GenSigTimeoutTime_AGSM" SG_ 262 GasPedalPosition_W 0;
BA_ "GenSigTimeoutTime_CADM" SG_ 262 GasPedalPosition_W 0;
BA_ "GenSigTimeoutTime_DMSM" SG_ 262 GasPedalPosition_W 0;
BA_ "GenSigTimeoutTime_EVCU2" SG_ 262 GasPedalPosition_W 0;
BA_ "GenSigTimeoutTime_GNMM" SG_ 262 GasPedalPosition_W 0;
BA_ "GenSigTimeoutTime_IPC" SG_ 262 GasPedalPosition_W 0;
BA_ "GenSigTimeoutTime_RFHM" SG_ 262 GasPedalPosition_W 0;
BA_ "GenSigTimeoutTime_AGSM" SG_ 262 GasPedalPositionFailSts_W 0;
BA_ "GenSigTimeoutTime_CADM" SG_ 262 GasPedalPositionFailSts_W 0;
BA_ "GenSigTimeoutTime_DMSM" SG_ 262 GasPedalPositionFailSts_W 0;
BA_ "GenSigTimeoutTime_ECM" SG_ 262 GasPedalPositionFailSts_W 0;
BA_ "GenSigTimeoutTime_EVCU2" SG_ 262 GasPedalPositionFailSts_W 0;
BA_ "GenSigTimeoutTime_GNMM" SG_ 262 GasPedalPositionFailSts_W 0;
BA_ "GenSigTimeoutTime_HCP" SG_ 262 GasPedalPositionFailSts_W 0;
BA_ "GenSigTimeoutTime_IPC" SG_ 262 GasPedalPositionFailSts_W 0;
BA_ "GenSigTimeoutTime_RFHM" SG_ 262 GasPedalPositionFailSts_W 0;
BA_ "GenSigStartValue" SG_ 262 IntakeAirTemperature_W 65;
BA_ "GenSigTimeoutTime_AGSM" SG_ 262 IntakeAirTemperature_W 0;
BA_ "GenSigTimeoutTime_BCM" SG_ 262 IntakeAirTemperature_W 0;
BA_ "GenSigTimeoutTime_BSM" SG_ 262 IntakeAirTemperature_W 0;
BA_ "GenSigTimeoutTime_CADM" SG_ 262 IntakeAirTemperature_W 0;
BA_ "GenSigTimeoutTime_DMSM" SG_ 262 IntakeAirTemperature_W 0;
BA_ "GenSigTimeoutTime_DTCM" SG_ 262 IntakeAirTemperature_W 0;
BA_ "GenSigTimeoutTime_EVCU2" SG_ 262 IntakeAirTemperature_W 0;
BA_ "GenSigTimeoutTime_GNMM" SG_ 262 IntakeAirTemperature_W 0;
BA_ "GenSigTimeoutTime_HCP" SG_ 262 IntakeAirTemperature_W 0;
BA_ "GenSigTimeoutTime_RFHM" SG_ 262 IntakeAirTemperature_W 0;
BA_ "GenSigTimeoutTime_AGSM" SG_ 262 KickDownRequest_W 0;
BA_ "GenSigTimeoutTime_BCM" SG_ 262 KickDownRequest_W 0;
BA_ "GenSigTimeoutTime_BSM" SG_ 262 KickDownRequest_W 0;
BA_ "GenSigTimeoutTime_CADM" SG_ 262 KickDownRequest_W 0;
BA_ "GenSigTimeoutTime_DMSM" SG_ 262 KickDownRequest_W 0;
BA_ "GenSigTimeoutTime_DTCM" SG_ 262 KickDownRequest_W 0;
BA_ "GenSigTimeoutTime_ECM" SG_ 262 KickDownRequest_W 0;
BA_ "GenSigTimeoutTime_EVCU2" SG_ 262 KickDownRequest_W 0;
BA_ "GenSigTimeoutTime_GNMM" SG_ 262 KickDownRequest_W 0;
BA_ "GenSigTimeoutTime_HCP" SG_ 262 KickDownRequest_W 0;
BA_ "GenSigTimeoutTime_IPC" SG_ 262 KickDownRequest_W 0;
BA_ "GenSigTimeoutTime_RFHM" SG_ 262 KickDownRequest_W 0;
BA_ "GenSigTimeoutTime_SGW" SG_ 262 KickDownRequest_W 0;
BA_ "GenSigTimeoutTime_AGSM" SG_ 262 LV12PwrFreeRq_W 0;
BA_ "GenSigTimeoutTime_BCM" SG_ 262 LV12PwrFreeRq_W 0;
BA_ "GenSigTimeoutTime_BSM" SG_ 262 LV12PwrFreeRq_W 0;
BA_ "GenSigTimeoutTime_CADM" SG_ 262 LV12PwrFreeRq_W 0;
BA_ "GenSigTimeoutTime_DMSM" SG_ 262 LV12PwrFreeRq_W 0;
BA_ "GenSigTimeoutTime_DTCM" SG_ 262 LV12PwrFreeRq_W 0;
BA_ "GenSigTimeoutTime_ECM" SG_ 262 LV12PwrFreeRq_W 0;
BA_ "GenSigTimeoutTime_EVCU2" SG_ 262 LV12PwrFreeRq_W 0;
BA_ "GenSigTimeoutTime_GNMM" SG_ 262 LV12PwrFreeRq_W 0;
BA_ "GenSigTimeoutTime_HCP" SG_ 262 LV12PwrFreeRq_W 0;
BA_ "GenSigTimeoutTime_IPC" SG_ 262 LV12PwrFreeRq_W 0;
BA_ "GenSigTimeoutTime_RFHM" SG_ 262 LV12PwrFreeRq_W 0;
BA_ "GenSigTimeoutTime_SGW" SG_ 262 LV12PwrFreeRq_W 0;
BA_ "GenSigTimeoutTime_AGSM" SG_ 262 MessageCounter_ENGINE2 0;
BA_ "GenSigTimeoutTime_ECM" SG_ 262 MessageCounter_ENGINE2 0;
BA_ "GenSigTimeoutTime_EVCU2" SG_ 262 MessageCounter_ENGINE2 0;
BA_ "GenSigTimeoutTime_GNMM" SG_ 262 MessageCounter_ENGINE2 0;
BA_ "GenSigTimeoutTime_RFHM" SG_ 262 MessageCounter_ENGINE2 0;
BA_ "GenSigTimeoutTime_SGW" SG_ 262 MessageCounter_ENGINE2 0;
BA_ "GenSigTimeoutTime_AGSM" SG_ 262 PowertrainPrplsnActv 0;
BA_ "GenSigTimeoutTime_DMSM" SG_ 262 PowertrainPrplsnActv 0;
BA_ "GenSigTimeoutTime_DTCM" SG_ 262 PowertrainPrplsnActv 0;
BA_ "GenSigTimeoutTime_ECM" SG_ 262 PowertrainPrplsnActv 0;
BA_ "GenSigTimeoutTime_GNMM" SG_ 262 PowertrainPrplsnActv 0;
BA_ "GenSigTimeoutTime_HCP" SG_ 262 PowertrainPrplsnActv 0;
BA_ "GenSigTimeoutTime_AGSM" SG_ 262 StartRelayBCMCmd_W 0;
BA_ "GenSigTimeoutTime_BSM" SG_ 262 StartRelayBCMCmd_W 0;
BA_ "GenSigTimeoutTime_CADM" SG_ 262 StartRelayBCMCmd_W 0;
BA_ "GenSigTimeoutTime_DMSM" SG_ 262 StartRelayBCMCmd_W 0;
BA_ "GenSigTimeoutTime_DTCM" SG_ 262 StartRelayBCMCmd_W 0;
BA_ "GenSigTimeoutTime_ECM" SG_ 262 StartRelayBCMCmd_W 0;
BA_ "GenSigTimeoutTime_EVCU2" SG_ 262 StartRelayBCMCmd_W 0;
BA_ "GenSigTimeoutTime_GNMM" SG_ 262 StartRelayBCMCmd_W 0;
BA_ "GenSigTimeoutTime_HCP" SG_ 262 StartRelayBCMCmd_W 0;
BA_ "GenSigTimeoutTime_IPC" SG_ 262 StartRelayBCMCmd_W 0;
BA_ "GenSigTimeoutTime_RFHM" SG_ 262 StartRelayBCMCmd_W 0;
BA_ "GenSigTimeoutTime_SGW" SG_ 262 StartRelayBCMCmd_W 0;
BA_ "GenSigTimeoutTime_TCM" SG_ 262 StartRelayBCMCmd_W 0;
BA_ "GenSigTimeoutTime_AGSM" SG_ 262 TRANS_CLU_SLIP_MODE_W 0;
BA_ "GenSigTimeoutTime_BCM" SG_ 262 TRANS_CLU_SLIP_MODE_W 0;
BA_ "GenSigTimeoutTime_BSM" SG_ 262 TRANS_CLU_SLIP_MODE_W 0;
BA_ "GenSigTimeoutTime_CADM" SG_ 262 TRANS_CLU_SLIP_MODE_W 0;
BA_ "GenSigTimeoutTime_DMSM" SG_ 262 TRANS_CLU_SLIP_MODE_W 0;
BA_ "GenSigTimeoutTime_DTCM" SG_ 262 TRANS_CLU_SLIP_MODE_W 0;
BA_ "GenSigTimeoutTime_ECM" SG_ 262 TRANS_CLU_SLIP_MODE_W 0;
BA_ "GenSigTimeoutTime_EVCU2" SG_ 262 TRANS_CLU_SLIP_MODE_W 0;
BA_ "GenSigTimeoutTime_GNMM" SG_ 262 TRANS_CLU_SLIP_MODE_W 0;
BA_ "GenSigTimeoutTime_HCP" SG_ 262 TRANS_CLU_SLIP_MODE_W 0;
BA_ "GenSigTimeoutTime_IPC" SG_ 262 TRANS_CLU_SLIP_MODE_W 0;
BA_ "GenSigTimeoutTime_RFHM" SG_ 262 TRANS_CLU_SLIP_MODE_W 0;
BA_ "GenSigTimeoutTime_SGW" SG_ 262 TRANS_CLU_SLIP_MODE_W 0;
BA_ "GenSigTimeoutTime_AGSM" SG_ 262 TxAC_EMCC_rq_W 0;
BA_ "GenSigTimeoutTime_BCM" SG_ 262 TxAC_EMCC_rq_W 0;
BA_ "GenSigTimeoutTime_BSM" SG_ 262 TxAC_EMCC_rq_W 0;
BA_ "GenSigTimeoutTime_CADM" SG_ 262 TxAC_EMCC_rq_W 0;
BA_ "GenSigTimeoutTime_DMSM" SG_ 262 TxAC_EMCC_rq_W 0;
BA_ "GenSigTimeoutTime_DTCM" SG_ 262 TxAC_EMCC_rq_W 0;
BA_ "GenSigTimeoutTime_ECM" SG_ 262 TxAC_EMCC_rq_W 0;
BA_ "GenSigTimeoutTime_EVCU2" SG_ 262 TxAC_EMCC_rq_W 0;
BA_ "GenSigTimeoutTime_GNMM" SG_ 262 TxAC_EMCC_rq_W 0;
BA_ "GenSigTimeoutTime_HCP" SG_ 262 TxAC_EMCC_rq_W 0;
BA_ "GenSigTimeoutTime_IPC" SG_ 262 TxAC_EMCC_rq_W 0;
BA_ "GenSigTimeoutTime_RFHM" SG_ 262 TxAC_EMCC_rq_W 0;
BA_ "GenSigTimeoutTime_SGW" SG_ 262 TxAC_EMCC_rq_W 0;
BA_ "GenSigSendType" SG_ 1036 AfterRunCoolantPumpFailSts 3;
BA_ "GenSigTimeoutTime_AGSM" SG_ 1036 AfterRunCoolantPumpFailSts 0;
BA_ "GenSigTimeoutTime_BCM" SG_ 1036 AfterRunCoolantPumpFailSts 0;
BA_ "GenSigTimeoutTime_BSM" SG_ 1036 AfterRunCoolantPumpFailSts 0;
BA_ "GenSigTimeoutTime_CADM" SG_ 1036 AfterRunCoolantPumpFailSts 0;
BA_ "GenSigTimeoutTime_DMSM" SG_ 1036 AfterRunCoolantPumpFailSts 0;
BA_ "GenSigTimeoutTime_DTCM" SG_ 1036 AfterRunCoolantPumpFailSts 0;
BA_ "GenSigTimeoutTime_ECM" SG_ 1036 AfterRunCoolantPumpFailSts 0;
BA_ "GenSigTimeoutTime_EVCU2" SG_ 1036 AfterRunCoolantPumpFailSts 0;
BA_ "GenSigTimeoutTime_GNMM" SG_ 1036 AfterRunCoolantPumpFailSts 0;
BA_ "GenSigTimeoutTime_HCP" SG_ 1036 AfterRunCoolantPumpFailSts 0;
BA_ "GenSigTimeoutTime_RFHM" SG_ 1036 AfterRunCoolantPumpFailSts 0;
BA_ "GenSigTimeoutTime_SGW" SG_ 1036 AfterRunCoolantPumpFailSts 0;
BA_ "GenSigTimeoutTime_TCM" SG_ 1036 AfterRunCoolantPumpFailSts 0;
BA_ "GenSigSendType" SG_ 1036 AxleInAir_Stat 3;
BA_ "GenSigTimeoutTime_AGSM" SG_ 1036 AxleInAir_Stat 0;
BA_ "GenSigTimeoutTime_CADM" SG_ 1036 AxleInAir_Stat 0;
BA_ "GenSigTimeoutTime_DMSM" SG_ 1036 AxleInAir_Stat 0;
BA_ "GenSigTimeoutTime_ECM" SG_ 1036 AxleInAir_Stat 0;
BA_ "GenSigTimeoutTime_EVCU2" SG_ 1036 AxleInAir_Stat 0;
BA_ "GenSigTimeoutTime_GNMM" SG_ 1036 AxleInAir_Stat 0;
BA_ "GenSigTimeoutTime_HCP" SG_ 1036 AxleInAir_Stat 0;
BA_ "GenSigTimeoutTime_IPC" SG_ 1036 AxleInAir_Stat 0;
BA_ "GenSigTimeoutTime_RFHM" SG_ 1036 AxleInAir_Stat 0;
BA_ "GenSigTimeoutTime_SGW" SG_ 1036 AxleInAir_Stat 0;
BA_ "GenSigStartValue" SG_ 1036 CoolVlvPos 255;
BA_ "GenSigTimeoutTime_AGSM" SG_ 1036 CoolVlvPos 0;
BA_ "GenSigTimeoutTime_BSM" SG_ 1036 CoolVlvPos 0;
BA_ "GenSigTimeoutTime_CADM" SG_ 1036 CoolVlvPos 0;
BA_ "GenSigTimeoutTime_DMSM" SG_ 1036 CoolVlvPos 0;
BA_ "GenSigTimeoutTime_DTCM" SG_ 1036 CoolVlvPos 0;
BA_ "GenSigTimeoutTime_ECM" SG_ 1036 CoolVlvPos 0;
BA_ "GenSigTimeoutTime_EVCU2" SG_ 1036 CoolVlvPos 0;
BA_ "GenSigTimeoutTime_GNMM" SG_ 1036 CoolVlvPos 0;
BA_ "GenSigTimeoutTime_HCP" SG_ 1036 CoolVlvPos 0;
BA_ "GenSigTimeoutTime_IPC" SG_ 1036 CoolVlvPos 0;
BA_ "GenSigTimeoutTime_RFHM" SG_ 1036 CoolVlvPos 0;
BA_ "GenSigTimeoutTime_SGW" SG_ 1036 CoolVlvPos 0;
BA_ "GenSigTimeoutTime_TCM" SG_ 1036 CoolVlvPos 0;
BA_ "GenSigTimeoutTime_AGSM" SG_ 1036 CRC_ENGINE3 0;
BA_ "GenSigTimeoutTime_BCM" SG_ 1036 CRC_ENGINE3 0;
BA_ "GenSigTimeoutTime_CADM" SG_ 1036 CRC_ENGINE3 0;
BA_ "GenSigTimeoutTime_DMSM" SG_ 1036 CRC_ENGINE3 0;
BA_ "GenSigTimeoutTime_DTCM" SG_ 1036 CRC_ENGINE3 0;
BA_ "GenSigTimeoutTime_ECM" SG_ 1036 CRC_ENGINE3 0;
BA_ "GenSigTimeoutTime_EVCU2" SG_ 1036 CRC_ENGINE3 0;
BA_ "GenSigTimeoutTime_GNMM" SG_ 1036 CRC_ENGINE3 0;
BA_ "GenSigTimeoutTime_HCP" SG_ 1036 CRC_ENGINE3 0;
BA_ "GenSigTimeoutTime_IPC" SG_ 1036 CRC_ENGINE3 0;
BA_ "GenSigTimeoutTime_RFHM" SG_ 1036 CRC_ENGINE3 0;
BA_ "GenSigTimeoutTime_SGW" SG_ 1036 CRC_ENGINE3 0;
BA_ "GenSigStartValue" SG_ 1036 DefFuelEcon 255;
BA_ "GenSigTimeoutTime_AGSM" SG_ 1036 DefFuelEcon 0;
BA_ "GenSigTimeoutTime_BCM" SG_ 1036 DefFuelEcon 0;
BA_ "GenSigTimeoutTime_BSM" SG_ 1036 DefFuelEcon 0;
BA_ "GenSigTimeoutTime_CADM" SG_ 1036 DefFuelEcon 0;
BA_ "GenSigTimeoutTime_DMSM" SG_ 1036 DefFuelEcon 0;
BA_ "GenSigTimeoutTime_DTCM" SG_ 1036 DefFuelEcon 0;
BA_ "GenSigTimeoutTime_ECM" SG_ 1036 DefFuelEcon 0;
BA_ "GenSigTimeoutTime_EVCU2" SG_ 1036 DefFuelEcon 0;
BA_ "GenSigTimeoutTime_GNMM" SG_ 1036 DefFuelEcon 0;
BA_ "GenSigTimeoutTime_HCP" SG_ 1036 DefFuelEcon 0;
BA_ "GenSigTimeoutTime_RFHM" SG_ 1036 DefFuelEcon 0;
BA_ "GenSigTimeoutTime_TCM" SG_ 1036 DefFuelEcon 0;
BA_ "GenSigStartValue" SG_ 1036 DistOilLifeRst 65535;
BA_ "GenSigSendType" SG_ 1036 DistOilLifeRst 3;
BA_ "GenSigTimeoutTime_AGSM" SG_ 1036 DistOilLifeRst 0;
BA_ "GenSigTimeoutTime_BSM" SG_ 1036 DistOilLifeRst 0;
BA_ "GenSigTimeoutTime_CADM" SG_ 1036 DistOilLifeRst 0;
BA_ "GenSigTimeoutTime_DMSM" SG_ 1036 DistOilLifeRst 0;
BA_ "GenSigTimeoutTime_DTCM" SG_ 1036 DistOilLifeRst 0;
BA_ "GenSigTimeoutTime_ECM" SG_ 1036 DistOilLifeRst 0;
BA_ "GenSigTimeoutTime_EVCU2" SG_ 1036 DistOilLifeRst 0;
BA_ "GenSigTimeoutTime_GNMM" SG_ 1036 DistOilLifeRst 0;
BA_ "GenSigTimeoutTime_HCP" SG_ 1036 DistOilLifeRst 0;
BA_ "GenSigTimeoutTime_RFHM" SG_ 1036 DistOilLifeRst 0;
BA_ "GenSigTimeoutTime_SGW" SG_ 1036 DistOilLifeRst 0;
BA_ "GenSigTimeoutTime_TCM" SG_ 1036 DistOilLifeRst 0;
BA_ "GenSigSendType" SG_ 1036 ECM_Thermal_AAD_Request 3;
BA_ "GenSigTimeoutTime_AGSM" SG_ 1036 ECM_Thermal_AAD_Request 0;
BA_ "GenSigTimeoutTime_BCM" SG_ 1036 ECM_Thermal_AAD_Request 0;
BA_ "GenSigTimeoutTime_BSM" SG_ 1036 ECM_Thermal_AAD_Request 0;
BA_ "GenSigTimeoutTime_CADM" SG_ 1036 ECM_Thermal_AAD_Request 0;
BA_ "GenSigTimeoutTime_DMSM" SG_ 1036 ECM_Thermal_AAD_Request 0;
BA_ "GenSigTimeoutTime_DTCM" SG_ 1036 ECM_Thermal_AAD_Request 0;
BA_ "GenSigTimeoutTime_ECM" SG_ 1036 ECM_Thermal_AAD_Request 0;
BA_ "GenSigTimeoutTime_GNMM" SG_ 1036 ECM_Thermal_AAD_Request 0;
BA_ "GenSigTimeoutTime_HCP" SG_ 1036 ECM_Thermal_AAD_Request 0;
BA_ "GenSigTimeoutTime_IPC" SG_ 1036 ECM_Thermal_AAD_Request 0;
BA_ "GenSigTimeoutTime_RFHM" SG_ 1036 ECM_Thermal_AAD_Request 0;
BA_ "GenSigTimeoutTime_SGW" SG_ 1036 ECM_Thermal_AAD_Request 0;
BA_ "GenSigTimeoutTime_TCM" SG_ 1036 ECM_Thermal_AAD_Request 0;
BA_ "GenSigSendType" SG_ 1036 EngineOilCritical 3;
BA_ "GenSigTimeoutTime_AGSM" SG_ 1036 EngineOilCritical 0;
BA_ "GenSigTimeoutTime_BCM" SG_ 1036 EngineOilCritical 0;
BA_ "GenSigTimeoutTime_BSM" SG_ 1036 EngineOilCritical 0;
BA_ "GenSigTimeoutTime_CADM" SG_ 1036 EngineOilCritical 0;
BA_ "GenSigTimeoutTime_DMSM" SG_ 1036 EngineOilCritical 0;
BA_ "GenSigTimeoutTime_DTCM" SG_ 1036 EngineOilCritical 0;
BA_ "GenSigTimeoutTime_ECM" SG_ 1036 EngineOilCritical 0;
BA_ "GenSigTimeoutTime_EVCU2" SG_ 1036 EngineOilCritical 0;
BA_ "GenSigTimeoutTime_GNMM" SG_ 1036 EngineOilCritical 0;
BA_ "GenSigTimeoutTime_HCP" SG_ 1036 EngineOilCritical 0;
BA_ "GenSigTimeoutTime_RFHM" SG_ 1036 EngineOilCritical 0;
BA_ "GenSigTimeoutTime_SGW" SG_ 1036 EngineOilCritical 0;
BA_ "GenSigTimeoutTime_TCM" SG_ 1036 EngineOilCritical 0;
BA_ "GenSigTimeoutTime_AGSM" SG_ 1036 EngineOilLevel 0;
BA_ "GenSigTimeoutTime_BCM" SG_ 1036 EngineOilLevel 0;
BA_ "GenSigTimeoutTime_BSM" SG_ 1036 EngineOilLevel 0;
BA_ "GenSigTimeoutTime_CADM" SG_ 1036 EngineOilLevel 0;
BA_ "GenSigTimeoutTime_DMSM" SG_ 1036 EngineOilLevel 0;
BA_ "GenSigTimeoutTime_DTCM" SG_ 1036 EngineOilLevel 0;
BA_ "GenSigTimeoutTime_ECM" SG_ 1036 EngineOilLevel 0;
BA_ "GenSigTimeoutTime_EVCU2" SG_ 1036 EngineOilLevel 0;
BA_ "GenSigTimeoutTime_GNMM" SG_ 1036 EngineOilLevel 0;
BA_ "GenSigTimeoutTime_HCP" SG_ 1036 EngineOilLevel 0;
BA_ "GenSigTimeoutTime_RFHM" SG_ 1036 EngineOilLevel 0;
BA_ "GenSigTimeoutTime_SGW" SG_ 1036 EngineOilLevel 0;
BA_ "GenSigTimeoutTime_TCM" SG_ 1036 EngineOilLevel 0;
BA_ "GenSigSendType" SG_ 1036 EngineOilMin 3;
BA_ "GenSigTimeoutTime_AGSM" SG_ 1036 EngineOilMin 0;
BA_ "GenSigTimeoutTime_BCM" SG_ 1036 EngineOilMin 0;
BA_ "GenSigTimeoutTime_BSM" SG_ 1036 EngineOilMin 0;
BA_ "GenSigTimeoutTime_CADM" SG_ 1036 EngineOilMin 0;
BA_ "GenSigTimeoutTime_DMSM" SG_ 1036 EngineOilMin 0;
BA_ "GenSigTimeoutTime_DTCM" SG_ 1036 EngineOilMin 0;
BA_ "GenSigTimeoutTime_ECM" SG_ 1036 EngineOilMin 0;
BA_ "GenSigTimeoutTime_EVCU2" SG_ 1036 EngineOilMin 0;
BA_ "GenSigTimeoutTime_GNMM" SG_ 1036 EngineOilMin 0;
BA_ "GenSigTimeoutTime_HCP" SG_ 1036 EngineOilMin 0;
BA_ "GenSigTimeoutTime_RFHM" SG_ 1036 EngineOilMin 0;
BA_ "GenSigTimeoutTime_SGW" SG_ 1036 EngineOilMin 0;
BA_ "GenSigTimeoutTime_TCM" SG_ 1036 EngineOilMin 0;
BA_ "GenSigSendType" SG_ 1036 EngineOilOverfill 3;
BA_ "GenSigTimeoutTime_AGSM" SG_ 1036 EngineOilOverfill 0;
BA_ "GenSigTimeoutTime_BCM" SG_ 1036 EngineOilOverfill 0;
BA_ "GenSigTimeoutTime_BSM" SG_ 1036 EngineOilOverfill 0;
BA_ "GenSigTimeoutTime_CADM" SG_ 1036 EngineOilOverfill 0;
BA_ "GenSigTimeoutTime_DMSM" SG_ 1036 EngineOilOverfill 0;
BA_ "GenSigTimeoutTime_DTCM" SG_ 1036 EngineOilOverfill 0;
BA_ "GenSigTimeoutTime_ECM" SG_ 1036 EngineOilOverfill 0;
BA_ "GenSigTimeoutTime_EVCU2" SG_ 1036 EngineOilOverfill 0;
BA_ "GenSigTimeoutTime_GNMM" SG_ 1036 EngineOilOverfill 0;
BA_ "GenSigTimeoutTime_HCP" SG_ 1036 EngineOilOverfill 0;
BA_ "GenSigTimeoutTime_RFHM" SG_ 1036 EngineOilOverfill 0;
BA_ "GenSigTimeoutTime_SGW" SG_ 1036 EngineOilOverfill 0;
BA_ "GenSigTimeoutTime_TCM" SG_ 1036 EngineOilOverfill 0;
BA_ "GenSigStartValue" SG_ 1036 EngineOilTemperature 255;
BA_ "GenSigTimeoutTime_AGSM" SG_ 1036 EngineOilTemperature 0;
BA_ "GenSigTimeoutTime_BCM" SG_ 1036 EngineOilTemperature 0;
BA_ "GenSigTimeoutTime_BSM" SG_ 1036 EngineOilTemperature 0;
BA_ "GenSigTimeoutTime_CADM" SG_ 1036 EngineOilTemperature 0;
BA_ "GenSigTimeoutTime_DMSM" SG_ 1036 EngineOilTemperature 0;
BA_ "GenSigTimeoutTime_DTCM" SG_ 1036 EngineOilTemperature 0;
BA_ "GenSigTimeoutTime_ECM" SG_ 1036 EngineOilTemperature 0;
BA_ "GenSigTimeoutTime_GNMM" SG_ 1036 EngineOilTemperature 0;
BA_ "GenSigTimeoutTime_HCP" SG_ 1036 EngineOilTemperature 0;
BA_ "GenSigTimeoutTime_RFHM" SG_ 1036 EngineOilTemperature 0;
BA_ "GenSigTimeoutTime_AGSM" SG_ 1036 FANStatus 0;
BA_ "GenSigTimeoutTime_BCM" SG_ 1036 FANStatus 0;
BA_ "GenSigTimeoutTime_BSM" SG_ 1036 FANStatus 0;
BA_ "GenSigTimeoutTime_CADM" SG_ 1036 FANStatus 0;
BA_ "GenSigTimeoutTime_DMSM" SG_ 1036 FANStatus 0;
BA_ "GenSigTimeoutTime_DTCM" SG_ 1036 FANStatus 0;
BA_ "GenSigTimeoutTime_ECM" SG_ 1036 FANStatus 0;
BA_ "GenSigTimeoutTime_EVCU2" SG_ 1036 FANStatus 0;
BA_ "GenSigTimeoutTime_GNMM" SG_ 1036 FANStatus 0;
BA_ "GenSigTimeoutTime_HCP" SG_ 1036 FANStatus 0;
BA_ "GenSigTimeoutTime_IPC" SG_ 1036 FANStatus 0;
BA_ "GenSigTimeoutTime_RFHM" SG_ 1036 FANStatus 0;
BA_ "GenSigTimeoutTime_SGW" SG_ 1036 FANStatus 0;
BA_ "GenSigTimeoutTime_TCM" SG_ 1036 FANStatus 0;
BA_ "GenSigTimeoutTime_AGSM" SG_ 1036 MessageCounter_ENGINE3 0;
BA_ "GenSigTimeoutTime_BCM" SG_ 1036 MessageCounter_ENGINE3 0;
BA_ "GenSigTimeoutTime_CADM" SG_ 1036 MessageCounter_ENGINE3 0;
BA_ "GenSigTimeoutTime_DMSM" SG_ 1036 MessageCounter_ENGINE3 0;
BA_ "GenSigTimeoutTime_DTCM" SG_ 1036 MessageCounter_ENGINE3 0;
BA_ "GenSigTimeoutTime_ECM" SG_ 1036 MessageCounter_ENGINE3 0;
BA_ "GenSigTimeoutTime_EVCU2" SG_ 1036 MessageCounter_ENGINE3 0;
BA_ "GenSigTimeoutTime_GNMM" SG_ 1036 MessageCounter_ENGINE3 0;
BA_ "GenSigTimeoutTime_HCP" SG_ 1036 MessageCounter_ENGINE3 0;
BA_ "GenSigTimeoutTime_IPC" SG_ 1036 MessageCounter_ENGINE3 0;
BA_ "GenSigTimeoutTime_RFHM" SG_ 1036 MessageCounter_ENGINE3 0;
BA_ "GenSigTimeoutTime_SGW" SG_ 1036 MessageCounter_ENGINE3 0;
BA_ "GenSigSendType" SG_ 1036 OIL_IND_LMP_FLSH 3;
BA_ "GenSigTimeoutTime_AGSM" SG_ 1036 OIL_IND_LMP_FLSH 0;
BA_ "GenSigTimeoutTime_BCM" SG_ 1036 OIL_IND_LMP_FLSH 0;
BA_ "GenSigTimeoutTime_BSM" SG_ 1036 OIL_IND_LMP_FLSH 0;
BA_ "GenSigTimeoutTime_CADM" SG_ 1036 OIL_IND_LMP_FLSH 0;
BA_ "GenSigTimeoutTime_DMSM" SG_ 1036 OIL_IND_LMP_FLSH 0;
BA_ "GenSigTimeoutTime_DTCM" SG_ 1036 OIL_IND_LMP_FLSH 0;
BA_ "GenSigTimeoutTime_ECM" SG_ 1036 OIL_IND_LMP_FLSH 0;
BA_ "GenSigTimeoutTime_EVCU2" SG_ 1036 OIL_IND_LMP_FLSH 0;
BA_ "GenSigTimeoutTime_GNMM" SG_ 1036 OIL_IND_LMP_FLSH 0;
BA_ "GenSigTimeoutTime_HCP" SG_ 1036 OIL_IND_LMP_FLSH 0;
BA_ "GenSigTimeoutTime_RFHM" SG_ 1036 OIL_IND_LMP_FLSH 0;
BA_ "GenSigTimeoutTime_TCM" SG_ 1036 OIL_IND_LMP_FLSH 0;
BA_ "GenSigSendType" SG_ 1036 OIL_TEMP_CHM_RQ 3;
BA_ "GenSigTimeoutTime_AGSM" SG_ 1036 OIL_TEMP_CHM_RQ 0;
BA_ "GenSigTimeoutTime_BCM" SG_ 1036 OIL_TEMP_CHM_RQ 0;
BA_ "GenSigTimeoutTime_BSM" SG_ 1036 OIL_TEMP_CHM_RQ 0;
BA_ "GenSigTimeoutTime_CADM" SG_ 1036 OIL_TEMP_CHM_RQ 0;
BA_ "GenSigTimeoutTime_DMSM" SG_ 1036 OIL_TEMP_CHM_RQ 0;
BA_ "GenSigTimeoutTime_DTCM" SG_ 1036 OIL_TEMP_CHM_RQ 0;
BA_ "GenSigTimeoutTime_ECM" SG_ 1036 OIL_TEMP_CHM_RQ 0;
BA_ "GenSigTimeoutTime_EVCU2" SG_ 1036 OIL_TEMP_CHM_RQ 0;
BA_ "GenSigTimeoutTime_GNMM" SG_ 1036 OIL_TEMP_CHM_RQ 0;
BA_ "GenSigTimeoutTime_HCP" SG_ 1036 OIL_TEMP_CHM_RQ 0;
BA_ "GenSigTimeoutTime_IPC" SG_ 1036 OIL_TEMP_CHM_RQ 0;
BA_ "GenSigTimeoutTime_RFHM" SG_ 1036 OIL_TEMP_CHM_RQ 0;
BA_ "GenSigTimeoutTime_TCM" SG_ 1036 OIL_TEMP_CHM_RQ 0;
BA_ "GenSigSendType" SG_ 1036 OIL_TEMP_IND_RQ 3;
BA_ "GenSigTimeoutTime_AGSM" SG_ 1036 OIL_TEMP_IND_RQ 0;
BA_ "GenSigTimeoutTime_BCM" SG_ 1036 OIL_TEMP_IND_RQ 0;
BA_ "GenSigTimeoutTime_BSM" SG_ 1036 OIL_TEMP_IND_RQ 0;
BA_ "GenSigTimeoutTime_CADM" SG_ 1036 OIL_TEMP_IND_RQ 0;
BA_ "GenSigTimeoutTime_DMSM" SG_ 1036 OIL_TEMP_IND_RQ 0;
BA_ "GenSigTimeoutTime_DTCM" SG_ 1036 OIL_TEMP_IND_RQ 0;
BA_ "GenSigTimeoutTime_ECM" SG_ 1036 OIL_TEMP_IND_RQ 0;
BA_ "GenSigTimeoutTime_EVCU2" SG_ 1036 OIL_TEMP_IND_RQ 0;
BA_ "GenSigTimeoutTime_GNMM" SG_ 1036 OIL_TEMP_IND_RQ 0;
BA_ "GenSigTimeoutTime_HCP" SG_ 1036 OIL_TEMP_IND_RQ 0;
BA_ "GenSigTimeoutTime_RFHM" SG_ 1036 OIL_TEMP_IND_RQ 0;
BA_ "GenSigTimeoutTime_TCM" SG_ 1036 OIL_TEMP_IND_RQ 0;
BA_ "GenSigStartValue" SG_ 1036 OilLifeLeft 255;
BA_ "GenSigSendType" SG_ 1036 OilLifeLeft 3;
BA_ "GenSigTimeoutTime_AGSM" SG_ 1036 OilLifeLeft 0;
BA_ "GenSigTimeoutTime_BCM" SG_ 1036 OilLifeLeft 0;
BA_ "GenSigTimeoutTime_BSM" SG_ 1036 OilLifeLeft 0;
BA_ "GenSigTimeoutTime_CADM" SG_ 1036 OilLifeLeft 0;
BA_ "GenSigTimeoutTime_DMSM" SG_ 1036 OilLifeLeft 0;
BA_ "GenSigTimeoutTime_DTCM" SG_ 1036 OilLifeLeft 0;
BA_ "GenSigTimeoutTime_ECM" SG_ 1036 OilLifeLeft 0;
BA_ "GenSigTimeoutTime_EVCU2" SG_ 1036 OilLifeLeft 0;
BA_ "GenSigTimeoutTime_GNMM" SG_ 1036 OilLifeLeft 0;
BA_ "GenSigTimeoutTime_HCP" SG_ 1036 OilLifeLeft 0;
BA_ "GenSigTimeoutTime_RFHM" SG_ 1036 OilLifeLeft 0;
BA_ "GenSigTimeoutTime_TCM" SG_ 1036 OilLifeLeft 0;
BA_ "GenSigSendType" SG_ 1036 OilLifeLeftRst 3;
BA_ "GenSigTimeoutTime_AGSM" SG_ 1036 OilLifeLeftRst 0;
BA_ "GenSigTimeoutTime_BCM" SG_ 1036 OilLifeLeftRst 0;
BA_ "GenSigTimeoutTime_BSM" SG_ 1036 OilLifeLeftRst 0;
BA_ "GenSigTimeoutTime_CADM" SG_ 1036 OilLifeLeftRst 0;
BA_ "GenSigTimeoutTime_DMSM" SG_ 1036 OilLifeLeftRst 0;
BA_ "GenSigTimeoutTime_DTCM" SG_ 1036 OilLifeLeftRst 0;
BA_ "GenSigTimeoutTime_ECM" SG_ 1036 OilLifeLeftRst 0;
BA_ "GenSigTimeoutTime_EVCU2" SG_ 1036 OilLifeLeftRst 0;
BA_ "GenSigTimeoutTime_GNMM" SG_ 1036 OilLifeLeftRst 0;
BA_ "GenSigTimeoutTime_HCP" SG_ 1036 OilLifeLeftRst 0;
BA_ "GenSigTimeoutTime_RFHM" SG_ 1036 OilLifeLeftRst 0;
BA_ "GenSigTimeoutTime_SGW" SG_ 1036 OilLifeLeftRst 0;
BA_ "GenSigTimeoutTime_TCM" SG_ 1036 OilLifeLeftRst 0;
BA_ "GenSigTimeoutTime_AGSM" SG_ 1036 PT_WorkSite_Invtr_Capacity_ECM 0;
BA_ "GenSigTimeoutTime_BSM" SG_ 1036 PT_WorkSite_Invtr_Capacity_ECM 0;
BA_ "GenSigTimeoutTime_CADM" SG_ 1036 PT_WorkSite_Invtr_Capacity_ECM 0;
BA_ "GenSigTimeoutTime_DMSM" SG_ 1036 PT_WorkSite_Invtr_Capacity_ECM 0;
BA_ "GenSigTimeoutTime_DTCM" SG_ 1036 PT_WorkSite_Invtr_Capacity_ECM 0;
BA_ "GenSigTimeoutTime_ECM" SG_ 1036 PT_WorkSite_Invtr_Capacity_ECM 0;
BA_ "GenSigTimeoutTime_EVCU2" SG_ 1036 PT_WorkSite_Invtr_Capacity_ECM 0;
BA_ "GenSigTimeoutTime_GNMM" SG_ 1036 PT_WorkSite_Invtr_Capacity_ECM 0;
BA_ "GenSigTimeoutTime_HCP" SG_ 1036 PT_WorkSite_Invtr_Capacity_ECM 0;
BA_ "GenSigTimeoutTime_IPC" SG_ 1036 PT_WorkSite_Invtr_Capacity_ECM 0;
BA_ "GenSigTimeoutTime_RFHM" SG_ 1036 PT_WorkSite_Invtr_Capacity_ECM 0;
BA_ "GenSigTimeoutTime_SGW" SG_ 1036 PT_WorkSite_Invtr_Capacity_ECM 0;
BA_ "GenSigTimeoutTime_TCM" SG_ 1036 PT_WorkSite_Invtr_Capacity_ECM 0;
BA_ "GenSigTimeoutTime_AGSM" SG_ 1036 PT_WorkSite_Invtr_Sts_ECM 0;
BA_ "GenSigTimeoutTime_BSM" SG_ 1036 PT_WorkSite_Invtr_Sts_ECM 0;
BA_ "GenSigTimeoutTime_CADM" SG_ 1036 PT_WorkSite_Invtr_Sts_ECM 0;
BA_ "GenSigTimeoutTime_DMSM" SG_ 1036 PT_WorkSite_Invtr_Sts_ECM 0;
BA_ "GenSigTimeoutTime_DTCM" SG_ 1036 PT_WorkSite_Invtr_Sts_ECM 0;
BA_ "GenSigTimeoutTime_ECM" SG_ 1036 PT_WorkSite_Invtr_Sts_ECM 0;
BA_ "GenSigTimeoutTime_EVCU2" SG_ 1036 PT_WorkSite_Invtr_Sts_ECM 0;
BA_ "GenSigTimeoutTime_GNMM" SG_ 1036 PT_WorkSite_Invtr_Sts_ECM 0;
BA_ "GenSigTimeoutTime_HCP" SG_ 1036 PT_WorkSite_Invtr_Sts_ECM 0;
BA_ "GenSigTimeoutTime_IPC" SG_ 1036 PT_WorkSite_Invtr_Sts_ECM 0;
BA_ "GenSigTimeoutTime_RFHM" SG_ 1036 PT_WorkSite_Invtr_Sts_ECM 0;
BA_ "GenSigTimeoutTime_SGW" SG_ 1036 PT_WorkSite_Invtr_Sts_ECM 0;
BA_ "GenSigTimeoutTime_TCM" SG_ 1036 PT_WorkSite_Invtr_Sts_ECM 0;
BA_ "GenSigStartValue" SG_ 518 AirFuelRatio 255;
BA_ "GenSigTimeoutTime_AGSM" SG_ 518 AirFuelRatio 0;
BA_ "GenSigTimeoutTime_BCM" SG_ 518 AirFuelRatio 0;
BA_ "GenSigTimeoutTime_BSM" SG_ 518 AirFuelRatio 0;
BA_ "GenSigTimeoutTime_CADM" SG_ 518 AirFuelRatio 0;
BA_ "GenSigTimeoutTime_DMSM" SG_ 518 AirFuelRatio 0;
BA_ "GenSigTimeoutTime_DTCM" SG_ 518 AirFuelRatio 0;
BA_ "GenSigTimeoutTime_ECM" SG_ 518 AirFuelRatio 0;
BA_ "GenSigTimeoutTime_EVCU2" SG_ 518 AirFuelRatio 0;
BA_ "GenSigTimeoutTime_GNMM" SG_ 518 AirFuelRatio 0;
BA_ "GenSigTimeoutTime_HCP" SG_ 518 AirFuelRatio 0;
BA_ "GenSigTimeoutTime_RFHM" SG_ 518 AirFuelRatio 0;
BA_ "GenSigTimeoutTime_TCM" SG_ 518 AirFuelRatio 0;
BA_ "GenSigTimeoutTime_AGSM" SG_ 518 CRC_ENGINE5 0;
BA_ "GenSigTimeoutTime_DMSM" SG_ 518 CRC_ENGINE5 0;
BA_ "GenSigTimeoutTime_DTCM" SG_ 518 CRC_ENGINE5 0;
BA_ "GenSigTimeoutTime_ECM" SG_ 518 CRC_ENGINE5 0;
BA_ "GenSigTimeoutTime_EVCU2" SG_ 518 CRC_ENGINE5 0;
BA_ "GenSigTimeoutTime_GNMM" SG_ 518 CRC_ENGINE5 0;
BA_ "GenSigTimeoutTime_IPC" SG_ 518 CRC_ENGINE5 0;
BA_ "GenSigTimeoutTime_RFHM" SG_ 518 CRC_ENGINE5 0;
BA_ "GenSigTimeoutTime_SGW" SG_ 518 CRC_ENGINE5 0;
BA_ "GenSigTimeoutTime_AGSM" SG_ 518 ECM_CODE_CLR_W 0;
BA_ "GenSigTimeoutTime_BCM" SG_ 518 ECM_CODE_CLR_W 0;
BA_ "GenSigTimeoutTime_BSM" SG_ 518 ECM_CODE_CLR_W 0;
BA_ "GenSigTimeoutTime_CADM" SG_ 518 ECM_CODE_CLR_W 0;
BA_ "GenSigTimeoutTime_DMSM" SG_ 518 ECM_CODE_CLR_W 0;
BA_ "GenSigTimeoutTime_DTCM" SG_ 518 ECM_CODE_CLR_W 0;
BA_ "GenSigTimeoutTime_ECM" SG_ 518 ECM_CODE_CLR_W 0;
BA_ "GenSigTimeoutTime_EVCU2" SG_ 518 ECM_CODE_CLR_W 0;
BA_ "GenSigTimeoutTime_GNMM" SG_ 518 ECM_CODE_CLR_W 0;
BA_ "GenSigTimeoutTime_IPC" SG_ 518 ECM_CODE_CLR_W 0;
BA_ "GenSigTimeoutTime_RFHM" SG_ 518 ECM_CODE_CLR_W 0;
BA_ "GenSigTimeoutTime_SGW" SG_ 518 ECM_CODE_CLR_W 0;
BA_ "GenSigTimeoutTime_AGSM" SG_ 518 ECM_READINESS_RESET_W 0;
BA_ "GenSigTimeoutTime_BCM" SG_ 518 ECM_READINESS_RESET_W 0;
BA_ "GenSigTimeoutTime_BSM" SG_ 518 ECM_READINESS_RESET_W 0;
BA_ "GenSigTimeoutTime_CADM" SG_ 518 ECM_READINESS_RESET_W 0;
BA_ "GenSigTimeoutTime_DMSM" SG_ 518 ECM_READINESS_RESET_W 0;
BA_ "GenSigTimeoutTime_DTCM" SG_ 518 ECM_READINESS_RESET_W 0;
BA_ "GenSigTimeoutTime_ECM" SG_ 518 ECM_READINESS_RESET_W 0;
BA_ "GenSigTimeoutTime_EVCU2" SG_ 518 ECM_READINESS_RESET_W 0;
BA_ "GenSigTimeoutTime_GNMM" SG_ 518 ECM_READINESS_RESET_W 0;
BA_ "GenSigTimeoutTime_IPC" SG_ 518 ECM_READINESS_RESET_W 0;
BA_ "GenSigTimeoutTime_RFHM" SG_ 518 ECM_READINESS_RESET_W 0;
BA_ "GenSigTimeoutTime_SGW" SG_ 518 ECM_READINESS_RESET_W 0;
BA_ "GenSigTimeoutTime_AGSM" SG_ 518 EngineReadyForESS_W 0;
BA_ "GenSigTimeoutTime_BCM" SG_ 518 EngineReadyForESS_W 0;
BA_ "GenSigTimeoutTime_BSM" SG_ 518 EngineReadyForESS_W 0;
BA_ "GenSigTimeoutTime_CADM" SG_ 518 EngineReadyForESS_W 0;
BA_ "GenSigTimeoutTime_DMSM" SG_ 518 EngineReadyForESS_W 0;
BA_ "GenSigTimeoutTime_DTCM" SG_ 518 EngineReadyForESS_W 0;
BA_ "GenSigTimeoutTime_ECM" SG_ 518 EngineReadyForESS_W 0;
BA_ "GenSigTimeoutTime_EVCU2" SG_ 518 EngineReadyForESS_W 0;
BA_ "GenSigTimeoutTime_GNMM" SG_ 518 EngineReadyForESS_W 0;
BA_ "GenSigTimeoutTime_HCP" SG_ 518 EngineReadyForESS_W 0;
BA_ "GenSigTimeoutTime_IPC" SG_ 518 EngineReadyForESS_W 0;
BA_ "GenSigTimeoutTime_RFHM" SG_ 518 EngineReadyForESS_W 0;
BA_ "GenSigTimeoutTime_SGW" SG_ 518 EngineReadyForESS_W 0;
BA_ "GenSigStartValue" SG_ 518 EngTrqMaxCorrFctr_W 255;
BA_ "GenSigTimeoutTime_AGSM" SG_ 518 EngTrqMaxCorrFctr_W 0;
BA_ "GenSigTimeoutTime_BCM" SG_ 518 EngTrqMaxCorrFctr_W 0;
BA_ "GenSigTimeoutTime_BSM" SG_ 518 EngTrqMaxCorrFctr_W 0;
BA_ "GenSigTimeoutTime_CADM" SG_ 518 EngTrqMaxCorrFctr_W 0;
BA_ "GenSigTimeoutTime_DMSM" SG_ 518 EngTrqMaxCorrFctr_W 0;
BA_ "GenSigTimeoutTime_DTCM" SG_ 518 EngTrqMaxCorrFctr_W 0;
BA_ "GenSigTimeoutTime_ECM" SG_ 518 EngTrqMaxCorrFctr_W 0;
BA_ "GenSigTimeoutTime_EVCU2" SG_ 518 EngTrqMaxCorrFctr_W 0;
BA_ "GenSigTimeoutTime_GNMM" SG_ 518 EngTrqMaxCorrFctr_W 0;
BA_ "GenSigTimeoutTime_HCP" SG_ 518 EngTrqMaxCorrFctr_W 0;
BA_ "GenSigTimeoutTime_IPC" SG_ 518 EngTrqMaxCorrFctr_W 0;
BA_ "GenSigTimeoutTime_RFHM" SG_ 518 EngTrqMaxCorrFctr_W 0;
BA_ "GenSigTimeoutTime_SGW" SG_ 518 EngTrqMaxCorrFctr_W 0;
BA_ "GenSigTimeoutTime_AGSM" SG_ 518 GrMin_Rq_ECM_W 0;
BA_ "GenSigTimeoutTime_BCM" SG_ 518 GrMin_Rq_ECM_W 0;
BA_ "GenSigTimeoutTime_BSM" SG_ 518 GrMin_Rq_ECM_W 0;
BA_ "GenSigTimeoutTime_CADM" SG_ 518 GrMin_Rq_ECM_W 0;
BA_ "GenSigTimeoutTime_DMSM" SG_ 518 GrMin_Rq_ECM_W 0;
BA_ "GenSigTimeoutTime_DTCM" SG_ 518 GrMin_Rq_ECM_W 0;
BA_ "GenSigTimeoutTime_ECM" SG_ 518 GrMin_Rq_ECM_W 0;
BA_ "GenSigTimeoutTime_EVCU2" SG_ 518 GrMin_Rq_ECM_W 0;
BA_ "GenSigTimeoutTime_GNMM" SG_ 518 GrMin_Rq_ECM_W 0;
BA_ "GenSigTimeoutTime_HCP" SG_ 518 GrMin_Rq_ECM_W 0;
BA_ "GenSigTimeoutTime_IPC" SG_ 518 GrMin_Rq_ECM_W 0;
BA_ "GenSigTimeoutTime_RFHM" SG_ 518 GrMin_Rq_ECM_W 0;
BA_ "GenSigTimeoutTime_SGW" SG_ 518 GrMin_Rq_ECM_W 0;
BA_ "GenSigStartValue" SG_ 518 IntkAirTempIntrClr 255;
BA_ "GenSigTimeoutTime_AGSM" SG_ 518 IntkAirTempIntrClr 0;
BA_ "GenSigTimeoutTime_BCM" SG_ 518 IntkAirTempIntrClr 0;
BA_ "GenSigTimeoutTime_BSM" SG_ 518 IntkAirTempIntrClr 0;
BA_ "GenSigTimeoutTime_CADM" SG_ 518 IntkAirTempIntrClr 0;
BA_ "GenSigTimeoutTime_DMSM" SG_ 518 IntkAirTempIntrClr 0;
BA_ "GenSigTimeoutTime_DTCM" SG_ 518 IntkAirTempIntrClr 0;
BA_ "GenSigTimeoutTime_ECM" SG_ 518 IntkAirTempIntrClr 0;
BA_ "GenSigTimeoutTime_EVCU2" SG_ 518 IntkAirTempIntrClr 0;
BA_ "GenSigTimeoutTime_GNMM" SG_ 518 IntkAirTempIntrClr 0;
BA_ "GenSigTimeoutTime_HCP" SG_ 518 IntkAirTempIntrClr 0;
BA_ "GenSigTimeoutTime_RFHM" SG_ 518 IntkAirTempIntrClr 0;
BA_ "GenSigTimeoutTime_TCM" SG_ 518 IntkAirTempIntrClr 0;
BA_ "GenSigStartValue" SG_ 518 LTR_CoolantTemp 255;
BA_ "GenSigTimeoutTime_AGSM" SG_ 518 LTR_CoolantTemp 0;
BA_ "GenSigTimeoutTime_BCM" SG_ 518 LTR_CoolantTemp 0;
BA_ "GenSigTimeoutTime_BSM" SG_ 518 LTR_CoolantTemp 0;
BA_ "GenSigTimeoutTime_CADM" SG_ 518 LTR_CoolantTemp 0;
BA_ "GenSigTimeoutTime_DMSM" SG_ 518 LTR_CoolantTemp 0;
BA_ "GenSigTimeoutTime_DTCM" SG_ 518 LTR_CoolantTemp 0;
BA_ "GenSigTimeoutTime_ECM" SG_ 518 LTR_CoolantTemp 0;
BA_ "GenSigTimeoutTime_EVCU2" SG_ 518 LTR_CoolantTemp 0;
BA_ "GenSigTimeoutTime_GNMM" SG_ 518 LTR_CoolantTemp 0;
BA_ "GenSigTimeoutTime_HCP" SG_ 518 LTR_CoolantTemp 0;
BA_ "GenSigTimeoutTime_RFHM" SG_ 518 LTR_CoolantTemp 0;
BA_ "GenSigTimeoutTime_TCM" SG_ 518 LTR_CoolantTemp 0;
BA_ "GenSigTimeoutTime_AGSM" SG_ 518 MessageCounter_ENGINE5 0;
BA_ "GenSigTimeoutTime_DMSM" SG_ 518 MessageCounter_ENGINE5 0;
BA_ "GenSigTimeoutTime_DTCM" SG_ 518 MessageCounter_ENGINE5 0;
BA_ "GenSigTimeoutTime_ECM" SG_ 518 MessageCounter_ENGINE5 0;
BA_ "GenSigTimeoutTime_EVCU2" SG_ 518 MessageCounter_ENGINE5 0;
BA_ "GenSigTimeoutTime_GNMM" SG_ 518 MessageCounter_ENGINE5 0;
BA_ "GenSigTimeoutTime_IPC" SG_ 518 MessageCounter_ENGINE5 0;
BA_ "GenSigTimeoutTime_RFHM" SG_ 518 MessageCounter_ENGINE5 0;
BA_ "GenSigTimeoutTime_SGW" SG_ 518 MessageCounter_ENGINE5 0;
BA_ "GenSigStartValue" SG_ 518 PdlPosActual 1;
BA_ "GenSigTimeoutTime_AGSM" SG_ 518 PdlPosActual 0;
BA_ "GenSigTimeoutTime_DMSM" SG_ 518 PdlPosActual 0;
BA_ "GenSigTimeoutTime_DTCM" SG_ 518 PdlPosActual 0;
BA_ "GenSigTimeoutTime_ECM" SG_ 518 PdlPosActual 0;
BA_ "GenSigTimeoutTime_EVCU2" SG_ 518 PdlPosActual 0;
BA_ "GenSigTimeoutTime_GNMM" SG_ 518 PdlPosActual 0;
BA_ "GenSigTimeoutTime_HCP" SG_ 518 PdlPosActual 0;
BA_ "GenSigTimeoutTime_IPC" SG_ 518 PdlPosActual 0;
BA_ "GenSigTimeoutTime_RFHM" SG_ 518 PdlPosActual 0;
BA_ "GenSigTimeoutTime_TCM" SG_ 518 PdlPosActual 0;
BA_ "GenSigTimeoutTime_AGSM" SG_ 518 RPMOverRev_W 0;
BA_ "GenSigTimeoutTime_BCM" SG_ 518 RPMOverRev_W 0;
BA_ "GenSigTimeoutTime_BSM" SG_ 518 RPMOverRev_W 0;
BA_ "GenSigTimeoutTime_CADM" SG_ 518 RPMOverRev_W 0;
BA_ "GenSigTimeoutTime_DMSM" SG_ 518 RPMOverRev_W 0;
BA_ "GenSigTimeoutTime_DTCM" SG_ 518 RPMOverRev_W 0;
BA_ "GenSigTimeoutTime_ECM" SG_ 518 RPMOverRev_W 0;
BA_ "GenSigTimeoutTime_EVCU2" SG_ 518 RPMOverRev_W 0;
BA_ "GenSigTimeoutTime_GNMM" SG_ 518 RPMOverRev_W 0;
BA_ "GenSigTimeoutTime_HCP" SG_ 518 RPMOverRev_W 0;
BA_ "GenSigTimeoutTime_IPC" SG_ 518 RPMOverRev_W 0;
BA_ "GenSigTimeoutTime_RFHM" SG_ 518 RPMOverRev_W 0;
BA_ "GenSigTimeoutTime_SGW" SG_ 518 RPMOverRev_W 0;
BA_ "GenSigTimeoutTime_TCM" SG_ 518 RPMOverRev_W 0;
BA_ "GenSigTimeoutTime_AGSM" SG_ 751 CRC_ENGINE6 0;
BA_ "GenSigTimeoutTime_DMSM" SG_ 751 CRC_ENGINE6 0;
BA_ "GenSigTimeoutTime_ECM" SG_ 751 CRC_ENGINE6 0;
BA_ "GenSigTimeoutTime_EVCU2" SG_ 751 CRC_ENGINE6 0;
BA_ "GenSigTimeoutTime_GNMM" SG_ 751 CRC_ENGINE6 0;
BA_ "GenSigTimeoutTime_HCP" SG_ 751 CRC_ENGINE6 0;
BA_ "GenSigTimeoutTime_RFHM" SG_ 751 CRC_ENGINE6 0;
BA_ "GenSigTimeoutTime_SGW" SG_ 751 CRC_ENGINE6 0;
BA_ "GenSigTimeoutTime_AGSM" SG_ 751 DrvAway_Alert 0;
BA_ "GenSigTimeoutTime_BCM" SG_ 751 DrvAway_Alert 0;
BA_ "GenSigTimeoutTime_BSM" SG_ 751 DrvAway_Alert 0;
BA_ "GenSigTimeoutTime_CADM" SG_ 751 DrvAway_Alert 0;
BA_ "GenSigTimeoutTime_DMSM" SG_ 751 DrvAway_Alert 0;
BA_ "GenSigTimeoutTime_DTCM" SG_ 751 DrvAway_Alert 0;
BA_ "GenSigTimeoutTime_ECM" SG_ 751 DrvAway_Alert 0;
BA_ "GenSigTimeoutTime_EVCU2" SG_ 751 DrvAway_Alert 0;
BA_ "GenSigTimeoutTime_GNMM" SG_ 751 DrvAway_Alert 0;
BA_ "GenSigTimeoutTime_HCP" SG_ 751 DrvAway_Alert 0;
BA_ "GenSigTimeoutTime_RFHM" SG_ 751 DrvAway_Alert 0;
BA_ "GenSigTimeoutTime_SGW" SG_ 751 DrvAway_Alert 0;
BA_ "GenSigTimeoutTime_TCM" SG_ 751 DrvAway_Alert 0;
BA_ "GenSigSendType" SG_ 751 DrvAway_Indications 3;
BA_ "GenSigTimeoutTime_AGSM" SG_ 751 DrvAway_Indications 0;
BA_ "GenSigTimeoutTime_BCM" SG_ 751 DrvAway_Indications 0;
BA_ "GenSigTimeoutTime_BSM" SG_ 751 DrvAway_Indications 0;
BA_ "GenSigTimeoutTime_CADM" SG_ 751 DrvAway_Indications 0;
BA_ "GenSigTimeoutTime_DMSM" SG_ 751 DrvAway_Indications 0;
BA_ "GenSigTimeoutTime_DTCM" SG_ 751 DrvAway_Indications 0;
BA_ "GenSigTimeoutTime_ECM" SG_ 751 DrvAway_Indications 0;
BA_ "GenSigTimeoutTime_EVCU2" SG_ 751 DrvAway_Indications 0;
BA_ "GenSigTimeoutTime_GNMM" SG_ 751 DrvAway_Indications 0;
BA_ "GenSigTimeoutTime_HCP" SG_ 751 DrvAway_Indications 0;
BA_ "GenSigTimeoutTime_RFHM" SG_ 751 DrvAway_Indications 0;
BA_ "GenSigTimeoutTime_SGW" SG_ 751 DrvAway_Indications 0;
BA_ "GenSigTimeoutTime_TCM" SG_ 751 DrvAway_Indications 0;
BA_ "GenSigTimeoutTime_AGSM" SG_ 751 DrvAway_Inhibit 0;
BA_ "GenSigTimeoutTime_BCM" SG_ 751 DrvAway_Inhibit 0;
BA_ "GenSigTimeoutTime_BSM" SG_ 751 DrvAway_Inhibit 0;
BA_ "GenSigTimeoutTime_CADM" SG_ 751 DrvAway_Inhibit 0;
BA_ "GenSigTimeoutTime_DMSM" SG_ 751 DrvAway_Inhibit 0;
BA_ "GenSigTimeoutTime_DTCM" SG_ 751 DrvAway_Inhibit 0;
BA_ "GenSigTimeoutTime_ECM" SG_ 751 DrvAway_Inhibit 0;
BA_ "GenSigTimeoutTime_EVCU2" SG_ 751 DrvAway_Inhibit 0;
BA_ "GenSigTimeoutTime_GNMM" SG_ 751 DrvAway_Inhibit 0;
BA_ "GenSigTimeoutTime_HCP" SG_ 751 DrvAway_Inhibit 0;
BA_ "GenSigTimeoutTime_RFHM" SG_ 751 DrvAway_Inhibit 0;
BA_ "GenSigTimeoutTime_SGW" SG_ 751 DrvAway_Inhibit 0;
BA_ "GenSigTimeoutTime_TCM" SG_ 751 DrvAway_Inhibit 0;
BA_ "GenSigTimeoutTime_AGSM" SG_ 751 ECM_FOTA_Conflict 0;
BA_ "GenSigTimeoutTime_BCM" SG_ 751 ECM_FOTA_Conflict 0;
BA_ "GenSigTimeoutTime_BSM" SG_ 751 ECM_FOTA_Conflict 0;
BA_ "GenSigTimeoutTime_CADM" SG_ 751 ECM_FOTA_Conflict 0;
BA_ "GenSigTimeoutTime_DMSM" SG_ 751 ECM_FOTA_Conflict 0;
BA_ "GenSigTimeoutTime_DTCM" SG_ 751 ECM_FOTA_Conflict 0;
BA_ "GenSigTimeoutTime_ECM" SG_ 751 ECM_FOTA_Conflict 0;
BA_ "GenSigTimeoutTime_EVCU2" SG_ 751 ECM_FOTA_Conflict 0;
BA_ "GenSigTimeoutTime_GNMM" SG_ 751 ECM_FOTA_Conflict 0;
BA_ "GenSigTimeoutTime_HCP" SG_ 751 ECM_FOTA_Conflict 0;
BA_ "GenSigTimeoutTime_IPC" SG_ 751 ECM_FOTA_Conflict 0;
BA_ "GenSigTimeoutTime_RFHM" SG_ 751 ECM_FOTA_Conflict 0;
BA_ "GenSigTimeoutTime_TCM" SG_ 751 ECM_FOTA_Conflict 0;
BA_ "GenSigTimeoutTime_AGSM" SG_ 751 ECM_MSG_RQ 0;
BA_ "GenSigTimeoutTime_BCM" SG_ 751 ECM_MSG_RQ 0;
BA_ "GenSigTimeoutTime_BSM" SG_ 751 ECM_MSG_RQ 0;
BA_ "GenSigTimeoutTime_CADM" SG_ 751 ECM_MSG_RQ 0;
BA_ "GenSigTimeoutTime_DMSM" SG_ 751 ECM_MSG_RQ 0;
BA_ "GenSigTimeoutTime_DTCM" SG_ 751 ECM_MSG_RQ 0;
BA_ "GenSigTimeoutTime_ECM" SG_ 751 ECM_MSG_RQ 0;
BA_ "GenSigTimeoutTime_EVCU2" SG_ 751 ECM_MSG_RQ 0;
BA_ "GenSigTimeoutTime_GNMM" SG_ 751 ECM_MSG_RQ 0;
BA_ "GenSigTimeoutTime_HCP" SG_ 751 ECM_MSG_RQ 0;
BA_ "GenSigTimeoutTime_IPC" SG_ 751 ECM_MSG_RQ 0;
BA_ "GenSigTimeoutTime_RFHM" SG_ 751 ECM_MSG_RQ 0;
BA_ "GenSigTimeoutTime_TCM" SG_ 751 ECM_MSG_RQ 0;
BA_ "GenSigTimeoutTime_AGSM" SG_ 751 EngineWaterTemp 0;
BA_ "GenSigTimeoutTime_BSM" SG_ 751 EngineWaterTemp 0;
BA_ "GenSigTimeoutTime_CADM" SG_ 751 EngineWaterTemp 0;
BA_ "GenSigTimeoutTime_DMSM" SG_ 751 EngineWaterTemp 0;
BA_ "GenSigTimeoutTime_DTCM" SG_ 751 EngineWaterTemp 0;
BA_ "GenSigTimeoutTime_ECM" SG_ 751 EngineWaterTemp 0;
BA_ "GenSigTimeoutTime_EVCU2" SG_ 751 EngineWaterTemp 0;
BA_ "GenSigTimeoutTime_GNMM" SG_ 751 EngineWaterTemp 0;
BA_ "GenSigTimeoutTime_HCP" SG_ 751 EngineWaterTemp 0;
BA_ "GenSigTimeoutTime_RFHM" SG_ 751 EngineWaterTemp 0;
BA_ "GenSigTimeoutTime_AGSM" SG_ 751 FuelConsumption_GAG 0;
BA_ "GenSigTimeoutTime_BCM" SG_ 751 FuelConsumption_GAG 0;
BA_ "GenSigTimeoutTime_BSM" SG_ 751 FuelConsumption_GAG 0;
BA_ "GenSigTimeoutTime_CADM" SG_ 751 FuelConsumption_GAG 0;
BA_ "GenSigTimeoutTime_DMSM" SG_ 751 FuelConsumption_GAG 0;
BA_ "GenSigTimeoutTime_DTCM" SG_ 751 FuelConsumption_GAG 0;
BA_ "GenSigTimeoutTime_ECM" SG_ 751 FuelConsumption_GAG 0;
BA_ "GenSigTimeoutTime_EVCU2" SG_ 751 FuelConsumption_GAG 0;
BA_ "GenSigTimeoutTime_GNMM" SG_ 751 FuelConsumption_GAG 0;
BA_ "GenSigTimeoutTime_HCP" SG_ 751 FuelConsumption_GAG 0;
BA_ "GenSigTimeoutTime_IPC" SG_ 751 FuelConsumption_GAG 0;
BA_ "GenSigTimeoutTime_RFHM" SG_ 751 FuelConsumption_GAG 0;
BA_ "GenSigTimeoutTime_TCM" SG_ 751 FuelConsumption_GAG 0;
BA_ "GenSigTimeoutTime_AGSM" SG_ 751 GearShiftIndication 0;
BA_ "GenSigTimeoutTime_BCM" SG_ 751 GearShiftIndication 0;
BA_ "GenSigTimeoutTime_BSM" SG_ 751 GearShiftIndication 0;
BA_ "GenSigTimeoutTime_CADM" SG_ 751 GearShiftIndication 0;
BA_ "GenSigTimeoutTime_DMSM" SG_ 751 GearShiftIndication 0;
BA_ "GenSigTimeoutTime_DTCM" SG_ 751 GearShiftIndication 0;
BA_ "GenSigTimeoutTime_ECM" SG_ 751 GearShiftIndication 0;
BA_ "GenSigTimeoutTime_EVCU2" SG_ 751 GearShiftIndication 0;
BA_ "GenSigTimeoutTime_GNMM" SG_ 751 GearShiftIndication 0;
BA_ "GenSigTimeoutTime_HCP" SG_ 751 GearShiftIndication 0;
BA_ "GenSigTimeoutTime_IPC" SG_ 751 GearShiftIndication 0;
BA_ "GenSigTimeoutTime_RFHM" SG_ 751 GearShiftIndication 0;
BA_ "GenSigTimeoutTime_TCM" SG_ 751 GearShiftIndication 0;
BA_ "GenSigTimeoutTime_AGSM" SG_ 751 HP_MODE_STS 0;
BA_ "GenSigTimeoutTime_BCM" SG_ 751 HP_MODE_STS 0;
BA_ "GenSigTimeoutTime_BSM" SG_ 751 HP_MODE_STS 0;
BA_ "GenSigTimeoutTime_CADM" SG_ 751 HP_MODE_STS 0;
BA_ "GenSigTimeoutTime_DMSM" SG_ 751 HP_MODE_STS 0;
BA_ "GenSigTimeoutTime_DTCM" SG_ 751 HP_MODE_STS 0;
BA_ "GenSigTimeoutTime_ECM" SG_ 751 HP_MODE_STS 0;
BA_ "GenSigTimeoutTime_EVCU2" SG_ 751 HP_MODE_STS 0;
BA_ "GenSigTimeoutTime_GNMM" SG_ 751 HP_MODE_STS 0;
BA_ "GenSigTimeoutTime_HCP" SG_ 751 HP_MODE_STS 0;
BA_ "GenSigTimeoutTime_IPC" SG_ 751 HP_MODE_STS 0;
BA_ "GenSigTimeoutTime_RFHM" SG_ 751 HP_MODE_STS 0;
BA_ "GenSigTimeoutTime_SGW" SG_ 751 HP_MODE_STS 0;
BA_ "GenSigTimeoutTime_TCM" SG_ 751 HP_MODE_STS 0;
BA_ "GenSigTimeoutTime_AGSM" SG_ 751 LeakCheckTimerValue 0;
BA_ "GenSigTimeoutTime_BSM" SG_ 751 LeakCheckTimerValue 0;
BA_ "GenSigTimeoutTime_CADM" SG_ 751 LeakCheckTimerValue 0;
BA_ "GenSigTimeoutTime_DMSM" SG_ 751 LeakCheckTimerValue 0;
BA_ "GenSigTimeoutTime_DTCM" SG_ 751 LeakCheckTimerValue 0;
BA_ "GenSigTimeoutTime_ECM" SG_ 751 LeakCheckTimerValue 0;
BA_ "GenSigTimeoutTime_EVCU2" SG_ 751 LeakCheckTimerValue 0;
BA_ "GenSigTimeoutTime_GNMM" SG_ 751 LeakCheckTimerValue 0;
BA_ "GenSigTimeoutTime_HCP" SG_ 751 LeakCheckTimerValue 0;
BA_ "GenSigTimeoutTime_IPC" SG_ 751 LeakCheckTimerValue 0;
BA_ "GenSigTimeoutTime_RFHM" SG_ 751 LeakCheckTimerValue 0;
BA_ "GenSigTimeoutTime_SGW" SG_ 751 LeakCheckTimerValue 0;
BA_ "GenSigTimeoutTime_TCM" SG_ 751 LeakCheckTimerValue 0;
BA_ "GenSigTimeoutTime_AGSM" SG_ 751 LeakTestRequest 0;
BA_ "GenSigTimeoutTime_BSM" SG_ 751 LeakTestRequest 0;
BA_ "GenSigTimeoutTime_CADM" SG_ 751 LeakTestRequest 0;
BA_ "GenSigTimeoutTime_DMSM" SG_ 751 LeakTestRequest 0;
BA_ "GenSigTimeoutTime_DTCM" SG_ 751 LeakTestRequest 0;
BA_ "GenSigTimeoutTime_ECM" SG_ 751 LeakTestRequest 0;
BA_ "GenSigTimeoutTime_EVCU2" SG_ 751 LeakTestRequest 0;
BA_ "GenSigTimeoutTime_GNMM" SG_ 751 LeakTestRequest 0;
BA_ "GenSigTimeoutTime_HCP" SG_ 751 LeakTestRequest 0;
BA_ "GenSigTimeoutTime_IPC" SG_ 751 LeakTestRequest 0;
BA_ "GenSigTimeoutTime_RFHM" SG_ 751 LeakTestRequest 0;
BA_ "GenSigTimeoutTime_SGW" SG_ 751 LeakTestRequest 0;
BA_ "GenSigTimeoutTime_TCM" SG_ 751 LeakTestRequest 0;
BA_ "GenSigTimeoutTime_AGSM" SG_ 751 LeakTestSts 0;
BA_ "GenSigTimeoutTime_BSM" SG_ 751 LeakTestSts 0;
BA_ "GenSigTimeoutTime_CADM" SG_ 751 LeakTestSts 0;
BA_ "GenSigTimeoutTime_DMSM" SG_ 751 LeakTestSts 0;
BA_ "GenSigTimeoutTime_DTCM" SG_ 751 LeakTestSts 0;
BA_ "GenSigTimeoutTime_ECM" SG_ 751 LeakTestSts 0;
BA_ "GenSigTimeoutTime_EVCU2" SG_ 751 LeakTestSts 0;
BA_ "GenSigTimeoutTime_GNMM" SG_ 751 LeakTestSts 0;
BA_ "GenSigTimeoutTime_HCP" SG_ 751 LeakTestSts 0;
BA_ "GenSigTimeoutTime_IPC" SG_ 751 LeakTestSts 0;
BA_ "GenSigTimeoutTime_RFHM" SG_ 751 LeakTestSts 0;
BA_ "GenSigTimeoutTime_SGW" SG_ 751 LeakTestSts 0;
BA_ "GenSigTimeoutTime_TCM" SG_ 751 LeakTestSts 0;
BA_ "GenSigTimeoutTime_AGSM" SG_ 751 MessageCounter_ENGINE6 0;
BA_ "GenSigTimeoutTime_DMSM" SG_ 751 MessageCounter_ENGINE6 0;
BA_ "GenSigTimeoutTime_ECM" SG_ 751 MessageCounter_ENGINE6 0;
BA_ "GenSigTimeoutTime_EVCU2" SG_ 751 MessageCounter_ENGINE6 0;
BA_ "GenSigTimeoutTime_GNMM" SG_ 751 MessageCounter_ENGINE6 0;
BA_ "GenSigTimeoutTime_HCP" SG_ 751 MessageCounter_ENGINE6 0;
BA_ "GenSigTimeoutTime_RFHM" SG_ 751 MessageCounter_ENGINE6 0;
BA_ "GenSigTimeoutTime_SGW" SG_ 751 MessageCounter_ENGINE6 0;
BA_ "GenSigStartValue" SG_ 751 SAMInfo 15;
BA_ "GenSigTimeoutTime_AGSM" SG_ 751 SAMInfo 0;
BA_ "GenSigTimeoutTime_BSM" SG_ 751 SAMInfo 0;
BA_ "GenSigTimeoutTime_CADM" SG_ 751 SAMInfo 0;
BA_ "GenSigTimeoutTime_DMSM" SG_ 751 SAMInfo 0;
BA_ "GenSigTimeoutTime_DTCM" SG_ 751 SAMInfo 0;
BA_ "GenSigTimeoutTime_ECM" SG_ 751 SAMInfo 0;
BA_ "GenSigTimeoutTime_EVCU2" SG_ 751 SAMInfo 0;
BA_ "GenSigTimeoutTime_GNMM" SG_ 751 SAMInfo 0;
BA_ "GenSigTimeoutTime_HCP" SG_ 751 SAMInfo 0;
BA_ "GenSigTimeoutTime_IPC" SG_ 751 SAMInfo 0;
BA_ "GenSigTimeoutTime_RFHM" SG_ 751 SAMInfo 0;
BA_ "GenSigTimeoutTime_SGW" SG_ 751 SAMInfo 0;
BA_ "GenSigTimeoutTime_TCM" SG_ 751 SAMInfo 0;
BA_ "GenSigTimeoutTime_AGSM" SG_ 751 Selector_SystemFailSts 0;
BA_ "GenSigTimeoutTime_BCM" SG_ 751 Selector_SystemFailSts 0;
BA_ "GenSigTimeoutTime_BSM" SG_ 751 Selector_SystemFailSts 0;
BA_ "GenSigTimeoutTime_CADM" SG_ 751 Selector_SystemFailSts 0;
BA_ "GenSigTimeoutTime_DMSM" SG_ 751 Selector_SystemFailSts 0;
BA_ "GenSigTimeoutTime_DTCM" SG_ 751 Selector_SystemFailSts 0;
BA_ "GenSigTimeoutTime_ECM" SG_ 751 Selector_SystemFailSts 0;
BA_ "GenSigTimeoutTime_EVCU2" SG_ 751 Selector_SystemFailSts 0;
BA_ "GenSigTimeoutTime_GNMM" SG_ 751 Selector_SystemFailSts 0;
BA_ "GenSigTimeoutTime_HCP" SG_ 751 Selector_SystemFailSts 0;
BA_ "GenSigTimeoutTime_RFHM" SG_ 751 Selector_SystemFailSts 0;
BA_ "GenSigTimeoutTime_SGW" SG_ 751 Selector_SystemFailSts 0;
BA_ "GenSigTimeoutTime_TCM" SG_ 751 Selector_SystemFailSts 0;
BA_ "GenSigTimeoutTime_AGSM" SG_ 751 StarterProtectionTime 0;
BA_ "GenSigTimeoutTime_BCM" SG_ 751 StarterProtectionTime 0;
BA_ "GenSigTimeoutTime_BSM" SG_ 751 StarterProtectionTime 0;
BA_ "GenSigTimeoutTime_CADM" SG_ 751 StarterProtectionTime 0;
BA_ "GenSigTimeoutTime_DMSM" SG_ 751 StarterProtectionTime 0;
BA_ "GenSigTimeoutTime_DTCM" SG_ 751 StarterProtectionTime 0;
BA_ "GenSigTimeoutTime_ECM" SG_ 751 StarterProtectionTime 0;
BA_ "GenSigTimeoutTime_EVCU2" SG_ 751 StarterProtectionTime 0;
BA_ "GenSigTimeoutTime_GNMM" SG_ 751 StarterProtectionTime 0;
BA_ "GenSigTimeoutTime_HCP" SG_ 751 StarterProtectionTime 0;
BA_ "GenSigTimeoutTime_RFHM" SG_ 751 StarterProtectionTime 0;
BA_ "GenSigTimeoutTime_SGW" SG_ 751 StarterProtectionTime 0;
BA_ "GenSigTimeoutTime_TCM" SG_ 751 StarterProtectionTime 0;
BA_ "GenSigTimeoutTime_AGSM" SG_ 751 StartProtectionInhibit 0;
BA_ "GenSigTimeoutTime_BCM" SG_ 751 StartProtectionInhibit 0;
BA_ "GenSigTimeoutTime_BSM" SG_ 751 StartProtectionInhibit 0;
BA_ "GenSigTimeoutTime_CADM" SG_ 751 StartProtectionInhibit 0;
BA_ "GenSigTimeoutTime_DMSM" SG_ 751 StartProtectionInhibit 0;
BA_ "GenSigTimeoutTime_DTCM" SG_ 751 StartProtectionInhibit 0;
BA_ "GenSigTimeoutTime_ECM" SG_ 751 StartProtectionInhibit 0;
BA_ "GenSigTimeoutTime_EVCU2" SG_ 751 StartProtectionInhibit 0;
BA_ "GenSigTimeoutTime_GNMM" SG_ 751 StartProtectionInhibit 0;
BA_ "GenSigTimeoutTime_HCP" SG_ 751 StartProtectionInhibit 0;
BA_ "GenSigTimeoutTime_RFHM" SG_ 751 StartProtectionInhibit 0;
BA_ "GenSigTimeoutTime_SGW" SG_ 751 StartProtectionInhibit 0;
BA_ "GenSigTimeoutTime_TCM" SG_ 751 StartProtectionInhibit 0;
BA_ "GenSigTimeoutTime_AGSM" SG_ 751 StartRelayBCMFeedbackFault 0;
BA_ "GenSigTimeoutTime_BSM" SG_ 751 StartRelayBCMFeedbackFault 0;
BA_ "GenSigTimeoutTime_CADM" SG_ 751 StartRelayBCMFeedbackFault 0;
BA_ "GenSigTimeoutTime_DMSM" SG_ 751 StartRelayBCMFeedbackFault 0;
BA_ "GenSigTimeoutTime_DTCM" SG_ 751 StartRelayBCMFeedbackFault 0;
BA_ "GenSigTimeoutTime_ECM" SG_ 751 StartRelayBCMFeedbackFault 0;
BA_ "GenSigTimeoutTime_EVCU2" SG_ 751 StartRelayBCMFeedbackFault 0;
BA_ "GenSigTimeoutTime_GNMM" SG_ 751 StartRelayBCMFeedbackFault 0;
BA_ "GenSigTimeoutTime_HCP" SG_ 751 StartRelayBCMFeedbackFault 0;
BA_ "GenSigTimeoutTime_IPC" SG_ 751 StartRelayBCMFeedbackFault 0;
BA_ "GenSigTimeoutTime_RFHM" SG_ 751 StartRelayBCMFeedbackFault 0;
BA_ "GenSigTimeoutTime_SGW" SG_ 751 StartRelayBCMFeedbackFault 0;
BA_ "GenSigTimeoutTime_TCM" SG_ 751 StartRelayBCMFeedbackFault 0;
BA_ "GenSigTimeoutTime_AGSM" SG_ 751 StartRelayECMFeedbackFault 0;
BA_ "GenSigTimeoutTime_BSM" SG_ 751 StartRelayECMFeedbackFault 0;
BA_ "GenSigTimeoutTime_CADM" SG_ 751 StartRelayECMFeedbackFault 0;
BA_ "GenSigTimeoutTime_DMSM" SG_ 751 StartRelayECMFeedbackFault 0;
BA_ "GenSigTimeoutTime_DTCM" SG_ 751 StartRelayECMFeedbackFault 0;
BA_ "GenSigTimeoutTime_ECM" SG_ 751 StartRelayECMFeedbackFault 0;
BA_ "GenSigTimeoutTime_EVCU2" SG_ 751 StartRelayECMFeedbackFault 0;
BA_ "GenSigTimeoutTime_GNMM" SG_ 751 StartRelayECMFeedbackFault 0;
BA_ "GenSigTimeoutTime_HCP" SG_ 751 StartRelayECMFeedbackFault 0;
BA_ "GenSigTimeoutTime_IPC" SG_ 751 StartRelayECMFeedbackFault 0;
BA_ "GenSigTimeoutTime_RFHM" SG_ 751 StartRelayECMFeedbackFault 0;
BA_ "GenSigTimeoutTime_TCM" SG_ 751 StartRelayECMFeedbackFault 0;
BA_ "GenSigSendType" SG_ 751 Terrain_HMI_Rq_ECM 3;
BA_ "GenSigTimeoutTime_AGSM" SG_ 751 Terrain_HMI_Rq_ECM 0;
BA_ "GenSigTimeoutTime_BCM" SG_ 751 Terrain_HMI_Rq_ECM 0;
BA_ "GenSigTimeoutTime_BSM" SG_ 751 Terrain_HMI_Rq_ECM 0;
BA_ "GenSigTimeoutTime_CADM" SG_ 751 Terrain_HMI_Rq_ECM 0;
BA_ "GenSigTimeoutTime_DMSM" SG_ 751 Terrain_HMI_Rq_ECM 0;
BA_ "GenSigTimeoutTime_DTCM" SG_ 751 Terrain_HMI_Rq_ECM 0;
BA_ "GenSigTimeoutTime_ECM" SG_ 751 Terrain_HMI_Rq_ECM 0;
BA_ "GenSigTimeoutTime_EVCU2" SG_ 751 Terrain_HMI_Rq_ECM 0;
BA_ "GenSigTimeoutTime_GNMM" SG_ 751 Terrain_HMI_Rq_ECM 0;
BA_ "GenSigTimeoutTime_HCP" SG_ 751 Terrain_HMI_Rq_ECM 0;
BA_ "GenSigTimeoutTime_RFHM" SG_ 751 Terrain_HMI_Rq_ECM 0;
BA_ "GenSigTimeoutTime_SGW" SG_ 751 Terrain_HMI_Rq_ECM 0;
BA_ "GenSigTimeoutTime_TCM" SG_ 751 Terrain_HMI_Rq_ECM 0;
BA_ "GenSigSendType" SG_ 751 TerrainModeDesiredStat 3;
BA_ "GenSigTimeoutTime_AGSM" SG_ 751 TerrainModeDesiredStat 0;
BA_ "GenSigTimeoutTime_BSM" SG_ 751 TerrainModeDesiredStat 0;
BA_ "GenSigTimeoutTime_CADM" SG_ 751 TerrainModeDesiredStat 0;
BA_ "GenSigTimeoutTime_DMSM" SG_ 751 TerrainModeDesiredStat 0;
BA_ "GenSigTimeoutTime_DTCM" SG_ 751 TerrainModeDesiredStat 0;
BA_ "GenSigTimeoutTime_ECM" SG_ 751 TerrainModeDesiredStat 0;
BA_ "GenSigTimeoutTime_EVCU2" SG_ 751 TerrainModeDesiredStat 0;
BA_ "GenSigTimeoutTime_GNMM" SG_ 751 TerrainModeDesiredStat 0;
BA_ "GenSigTimeoutTime_HCP" SG_ 751 TerrainModeDesiredStat 0;
BA_ "GenSigTimeoutTime_RFHM" SG_ 751 TerrainModeDesiredStat 0;
BA_ "GenSigTimeoutTime_TCM" SG_ 751 TerrainModeDesiredStat 0;
BA_ "GenSigTimeoutTime_AGSM" SG_ 751 TerrainModeInterfaceButton_ECM 0;
BA_ "GenSigTimeoutTime_BCM" SG_ 751 TerrainModeInterfaceButton_ECM 0;
BA_ "GenSigTimeoutTime_BSM" SG_ 751 TerrainModeInterfaceButton_ECM 0;
BA_ "GenSigTimeoutTime_CADM" SG_ 751 TerrainModeInterfaceButton_ECM 0;
BA_ "GenSigTimeoutTime_DMSM" SG_ 751 TerrainModeInterfaceButton_ECM 0;
BA_ "GenSigTimeoutTime_DTCM" SG_ 751 TerrainModeInterfaceButton_ECM 0;
BA_ "GenSigTimeoutTime_ECM" SG_ 751 TerrainModeInterfaceButton_ECM 0;
BA_ "GenSigTimeoutTime_EVCU2" SG_ 751 TerrainModeInterfaceButton_ECM 0;
BA_ "GenSigTimeoutTime_GNMM" SG_ 751 TerrainModeInterfaceButton_ECM 0;
BA_ "GenSigTimeoutTime_HCP" SG_ 751 TerrainModeInterfaceButton_ECM 0;
BA_ "GenSigTimeoutTime_IPC" SG_ 751 TerrainModeInterfaceButton_ECM 0;
BA_ "GenSigTimeoutTime_RFHM" SG_ 751 TerrainModeInterfaceButton_ECM 0;
BA_ "GenSigTimeoutTime_TCM" SG_ 751 TerrainModeInterfaceButton_ECM 0;
BA_ "GenSigStartValue" SG_ 751 TerrainModeStat_ECM 31;
BA_ "GenSigTimeoutTime_AGSM" SG_ 751 TerrainModeStat_ECM 0;
BA_ "GenSigTimeoutTime_DMSM" SG_ 751 TerrainModeStat_ECM 0;
BA_ "GenSigTimeoutTime_EVCU2" SG_ 751 TerrainModeStat_ECM 0;
BA_ "GenSigTimeoutTime_GNMM" SG_ 751 TerrainModeStat_ECM 0;
BA_ "GenSigTimeoutTime_HCP" SG_ 751 TerrainModeStat_ECM 0;
BA_ "GenSigTimeoutTime_RFHM" SG_ 751 TerrainModeStat_ECM 0;
BA_ "GenSigTimeoutTime_AGSM" SG_ 751 Trns_DrvMd_CfgSts_ECM 0;
BA_ "GenSigTimeoutTime_BCM" SG_ 751 Trns_DrvMd_CfgSts_ECM 0;
BA_ "GenSigTimeoutTime_BSM" SG_ 751 Trns_DrvMd_CfgSts_ECM 0;
BA_ "GenSigTimeoutTime_CADM" SG_ 751 Trns_DrvMd_CfgSts_ECM 0;
BA_ "GenSigTimeoutTime_DMSM" SG_ 751 Trns_DrvMd_CfgSts_ECM 0;
BA_ "GenSigTimeoutTime_DTCM" SG_ 751 Trns_DrvMd_CfgSts_ECM 0;
BA_ "GenSigTimeoutTime_ECM" SG_ 751 Trns_DrvMd_CfgSts_ECM 0;
BA_ "GenSigTimeoutTime_EVCU2" SG_ 751 Trns_DrvMd_CfgSts_ECM 0;
BA_ "GenSigTimeoutTime_GNMM" SG_ 751 Trns_DrvMd_CfgSts_ECM 0;
BA_ "GenSigTimeoutTime_HCP" SG_ 751 Trns_DrvMd_CfgSts_ECM 0;
BA_ "GenSigTimeoutTime_IPC" SG_ 751 Trns_DrvMd_CfgSts_ECM 0;
BA_ "GenSigTimeoutTime_RFHM" SG_ 751 Trns_DrvMd_CfgSts_ECM 0;
BA_ "GenSigTimeoutTime_TCM" SG_ 751 Trns_DrvMd_CfgSts_ECM 0;
BA_ "GenSigTimeoutTime_AGSM" SG_ 751 Trns_DrvMdReq_ECM 0;
BA_ "GenSigTimeoutTime_BCM" SG_ 751 Trns_DrvMdReq_ECM 0;
BA_ "GenSigTimeoutTime_BSM" SG_ 751 Trns_DrvMdReq_ECM 0;
BA_ "GenSigTimeoutTime_CADM" SG_ 751 Trns_DrvMdReq_ECM 0;
BA_ "GenSigTimeoutTime_DMSM" SG_ 751 Trns_DrvMdReq_ECM 0;
BA_ "GenSigTimeoutTime_DTCM" SG_ 751 Trns_DrvMdReq_ECM 0;
BA_ "GenSigTimeoutTime_ECM" SG_ 751 Trns_DrvMdReq_ECM 0;
BA_ "GenSigTimeoutTime_EVCU2" SG_ 751 Trns_DrvMdReq_ECM 0;
BA_ "GenSigTimeoutTime_GNMM" SG_ 751 Trns_DrvMdReq_ECM 0;
BA_ "GenSigTimeoutTime_HCP" SG_ 751 Trns_DrvMdReq_ECM 0;
BA_ "GenSigTimeoutTime_IPC" SG_ 751 Trns_DrvMdReq_ECM 0;
BA_ "GenSigTimeoutTime_RFHM" SG_ 751 Trns_DrvMdReq_ECM 0;
BA_ "GenSigTimeoutTime_SGW" SG_ 751 Trns_DrvMdReq_ECM 0;
BA_ "GenSigStartValue" SG_ 1448 CompressorSts 2;
BA_ "GenSigSendType" SG_ 1448 CompressorSts 3;
BA_ "GenSigTimeoutTime_AGSM" SG_ 1448 CompressorSts 0;
BA_ "GenSigTimeoutTime_BSM" SG_ 1448 CompressorSts 0;
BA_ "GenSigTimeoutTime_CADM" SG_ 1448 CompressorSts 0;
BA_ "GenSigTimeoutTime_DMSM" SG_ 1448 CompressorSts 0;
BA_ "GenSigTimeoutTime_DTCM" SG_ 1448 CompressorSts 0;
BA_ "GenSigTimeoutTime_ECM" SG_ 1448 CompressorSts 0;
BA_ "GenSigTimeoutTime_EVCU2" SG_ 1448 CompressorSts 0;
BA_ "GenSigTimeoutTime_GNMM" SG_ 1448 CompressorSts 0;
BA_ "GenSigTimeoutTime_HCP" SG_ 1448 CompressorSts 0;
BA_ "GenSigTimeoutTime_IPC" SG_ 1448 CompressorSts 0;
BA_ "GenSigTimeoutTime_RFHM" SG_ 1448 CompressorSts 0;
BA_ "GenSigTimeoutTime_AGSM" SG_ 1448 CRC_ENGINE7 0;
BA_ "GenSigTimeoutTime_BSM" SG_ 1448 CRC_ENGINE7 0;
BA_ "GenSigTimeoutTime_DMSM" SG_ 1448 CRC_ENGINE7 0;
BA_ "GenSigTimeoutTime_DTCM" SG_ 1448 CRC_ENGINE7 0;
BA_ "GenSigTimeoutTime_ECM" SG_ 1448 CRC_ENGINE7 0;
BA_ "GenSigTimeoutTime_EVCU2" SG_ 1448 CRC_ENGINE7 0;
BA_ "GenSigTimeoutTime_GNMM" SG_ 1448 CRC_ENGINE7 0;
BA_ "GenSigTimeoutTime_HCP" SG_ 1448 CRC_ENGINE7 0;
BA_ "GenSigTimeoutTime_RFHM" SG_ 1448 CRC_ENGINE7 0;
BA_ "GenSigTimeoutTime_SGW" SG_ 1448 CRC_ENGINE7 0;
BA_ "GenSigSendType" SG_ 1448 ECM_THA_Resp 4;
BA_ "GenSigTimeoutTime_AGSM" SG_ 1448 ECM_THA_Resp 0;
BA_ "GenSigTimeoutTime_BSM" SG_ 1448 ECM_THA_Resp 0;
BA_ "GenSigTimeoutTime_CADM" SG_ 1448 ECM_THA_Resp 0;
BA_ "GenSigTimeoutTime_DMSM" SG_ 1448 ECM_THA_Resp 0;
BA_ "GenSigTimeoutTime_DTCM" SG_ 1448 ECM_THA_Resp 0;
BA_ "GenSigTimeoutTime_ECM" SG_ 1448 ECM_THA_Resp 0;
BA_ "GenSigTimeoutTime_EVCU2" SG_ 1448 ECM_THA_Resp 0;
BA_ "GenSigTimeoutTime_GNMM" SG_ 1448 ECM_THA_Resp 0;
BA_ "GenSigTimeoutTime_HCP" SG_ 1448 ECM_THA_Resp 0;
BA_ "GenSigTimeoutTime_IPC" SG_ 1448 ECM_THA_Resp 0;
BA_ "GenSigTimeoutTime_RFHM" SG_ 1448 ECM_THA_Resp 0;
BA_ "GenSigTimeoutTime_SGW" SG_ 1448 ECM_THA_Resp 0;
BA_ "GenSigTimeoutTime_TCM" SG_ 1448 ECM_THA_Resp 0;
BA_ "GenSigSendType" SG_ 1448 ECM_TRSC_Resp 3;
BA_ "GenSigTimeoutTime_AGSM" SG_ 1448 ECM_TRSC_Resp 0;
BA_ "GenSigTimeoutTime_BSM" SG_ 1448 ECM_TRSC_Resp 0;
BA_ "GenSigTimeoutTime_CADM" SG_ 1448 ECM_TRSC_Resp 0;
BA_ "GenSigTimeoutTime_DMSM" SG_ 1448 ECM_TRSC_Resp 0;
BA_ "GenSigTimeoutTime_DTCM" SG_ 1448 ECM_TRSC_Resp 0;
BA_ "GenSigTimeoutTime_ECM" SG_ 1448 ECM_TRSC_Resp 0;
BA_ "GenSigTimeoutTime_EVCU2" SG_ 1448 ECM_TRSC_Resp 0;
BA_ "GenSigTimeoutTime_GNMM" SG_ 1448 ECM_TRSC_Resp 0;
BA_ "GenSigTimeoutTime_HCP" SG_ 1448 ECM_TRSC_Resp 0;
BA_ "GenSigTimeoutTime_IPC" SG_ 1448 ECM_TRSC_Resp 0;
BA_ "GenSigTimeoutTime_RFHM" SG_ 1448 ECM_TRSC_Resp 0;
BA_ "GenSigTimeoutTime_SGW" SG_ 1448 ECM_TRSC_Resp 0;
BA_ "GenSigTimeoutTime_TCM" SG_ 1448 ECM_TRSC_Resp 0;
BA_ "GenSigSendType" SG_ 1448 ECM_WARN_BTO 3;
BA_ "GenSigTimeoutTime_AGSM" SG_ 1448 ECM_WARN_BTO 0;
BA_ "GenSigTimeoutTime_BCM" SG_ 1448 ECM_WARN_BTO 0;
BA_ "GenSigTimeoutTime_BSM" SG_ 1448 ECM_WARN_BTO 0;
BA_ "GenSigTimeoutTime_CADM" SG_ 1448 ECM_WARN_BTO 0;
BA_ "GenSigTimeoutTime_DMSM" SG_ 1448 ECM_WARN_BTO 0;
BA_ "GenSigTimeoutTime_DTCM" SG_ 1448 ECM_WARN_BTO 0;
BA_ "GenSigTimeoutTime_ECM" SG_ 1448 ECM_WARN_BTO 0;
BA_ "GenSigTimeoutTime_EVCU2" SG_ 1448 ECM_WARN_BTO 0;
BA_ "GenSigTimeoutTime_GNMM" SG_ 1448 ECM_WARN_BTO 0;
BA_ "GenSigTimeoutTime_HCP" SG_ 1448 ECM_WARN_BTO 0;
BA_ "GenSigTimeoutTime_RFHM" SG_ 1448 ECM_WARN_BTO 0;
BA_ "GenSigTimeoutTime_SGW" SG_ 1448 ECM_WARN_BTO 0;
BA_ "GenSigTimeoutTime_TCM" SG_ 1448 ECM_WARN_BTO 0;
BA_ "GenSigSendType" SG_ 1448 ECM_WARN_BTO_1 3;
BA_ "GenSigTimeoutTime_AGSM" SG_ 1448 ECM_WARN_BTO_1 0;
BA_ "GenSigTimeoutTime_BCM" SG_ 1448 ECM_WARN_BTO_1 0;
BA_ "GenSigTimeoutTime_BSM" SG_ 1448 ECM_WARN_BTO_1 0;
BA_ "GenSigTimeoutTime_CADM" SG_ 1448 ECM_WARN_BTO_1 0;
BA_ "GenSigTimeoutTime_DMSM" SG_ 1448 ECM_WARN_BTO_1 0;
BA_ "GenSigTimeoutTime_DTCM" SG_ 1448 ECM_WARN_BTO_1 0;
BA_ "GenSigTimeoutTime_ECM" SG_ 1448 ECM_WARN_BTO_1 0;
BA_ "GenSigTimeoutTime_EVCU2" SG_ 1448 ECM_WARN_BTO_1 0;
BA_ "GenSigTimeoutTime_GNMM" SG_ 1448 ECM_WARN_BTO_1 0;
BA_ "GenSigTimeoutTime_HCP" SG_ 1448 ECM_WARN_BTO_1 0;
BA_ "GenSigTimeoutTime_RFHM" SG_ 1448 ECM_WARN_BTO_1 0;
BA_ "GenSigTimeoutTime_SGW" SG_ 1448 ECM_WARN_BTO_1 0;
BA_ "GenSigTimeoutTime_TCM" SG_ 1448 ECM_WARN_BTO_1 0;
BA_ "GenSigStartValue" SG_ 1448 EMSFailSts 2;
BA_ "GenSigSendType" SG_ 1448 EMSFailSts 3;
BA_ "GenSigTimeoutTime_AGSM" SG_ 1448 EMSFailSts 0;
BA_ "GenSigTimeoutTime_BSM" SG_ 1448 EMSFailSts 0;
BA_ "GenSigTimeoutTime_DMSM" SG_ 1448 EMSFailSts 0;
BA_ "GenSigTimeoutTime_DTCM" SG_ 1448 EMSFailSts 0;
BA_ "GenSigTimeoutTime_ECM" SG_ 1448 EMSFailSts 0;
BA_ "GenSigTimeoutTime_EVCU2" SG_ 1448 EMSFailSts 0;
BA_ "GenSigTimeoutTime_GNMM" SG_ 1448 EMSFailSts 0;
BA_ "GenSigTimeoutTime_HCP" SG_ 1448 EMSFailSts 0;
BA_ "GenSigTimeoutTime_RFHM" SG_ 1448 EMSFailSts 0;
BA_ "GenSigTimeoutTime_TCM" SG_ 1448 EMSFailSts 0;
BA_ "GenSigSendType" SG_ 1448 EngineOperatingMode 3;
BA_ "GenSigTimeoutTime_AGSM" SG_ 1448 EngineOperatingMode 0;
BA_ "GenSigTimeoutTime_BCM" SG_ 1448 EngineOperatingMode 0;
BA_ "GenSigTimeoutTime_BSM" SG_ 1448 EngineOperatingMode 0;
BA_ "GenSigTimeoutTime_CADM" SG_ 1448 EngineOperatingMode 0;
BA_ "GenSigTimeoutTime_DMSM" SG_ 1448 EngineOperatingMode 0;
BA_ "GenSigTimeoutTime_DTCM" SG_ 1448 EngineOperatingMode 0;
BA_ "GenSigTimeoutTime_ECM" SG_ 1448 EngineOperatingMode 0;
BA_ "GenSigTimeoutTime_EVCU2" SG_ 1448 EngineOperatingMode 0;
BA_ "GenSigTimeoutTime_GNMM" SG_ 1448 EngineOperatingMode 0;
BA_ "GenSigTimeoutTime_HCP" SG_ 1448 EngineOperatingMode 0;
BA_ "GenSigTimeoutTime_IPC" SG_ 1448 EngineOperatingMode 0;
BA_ "GenSigTimeoutTime_RFHM" SG_ 1448 EngineOperatingMode 0;
BA_ "GenSigTimeoutTime_TCM" SG_ 1448 EngineOperatingMode 0;
BA_ "GenSigSendType" SG_ 1448 ETCFailSts 3;
BA_ "GenSigTimeoutTime_AGSM" SG_ 1448 ETCFailSts 0;
BA_ "GenSigTimeoutTime_BSM" SG_ 1448 ETCFailSts 0;
BA_ "GenSigTimeoutTime_CADM" SG_ 1448 ETCFailSts 0;
BA_ "GenSigTimeoutTime_DMSM" SG_ 1448 ETCFailSts 0;
BA_ "GenSigTimeoutTime_DTCM" SG_ 1448 ETCFailSts 0;
BA_ "GenSigTimeoutTime_ECM" SG_ 1448 ETCFailSts 0;
BA_ "GenSigTimeoutTime_EVCU2" SG_ 1448 ETCFailSts 0;
BA_ "GenSigTimeoutTime_GNMM" SG_ 1448 ETCFailSts 0;
BA_ "GenSigTimeoutTime_HCP" SG_ 1448 ETCFailSts 0;
BA_ "GenSigTimeoutTime_RFHM" SG_ 1448 ETCFailSts 0;
BA_ "GenSigTimeoutTime_TCM" SG_ 1448 ETCFailSts 0;
BA_ "GenSigSendType" SG_ 1448 ExhaustTemperature 3;
BA_ "GenSigTimeoutTime_AGSM" SG_ 1448 ExhaustTemperature 0;
BA_ "GenSigTimeoutTime_BCM" SG_ 1448 ExhaustTemperature 0;
BA_ "GenSigTimeoutTime_BSM" SG_ 1448 ExhaustTemperature 0;
BA_ "GenSigTimeoutTime_CADM" SG_ 1448 ExhaustTemperature 0;
BA_ "GenSigTimeoutTime_DMSM" SG_ 1448 ExhaustTemperature 0;
BA_ "GenSigTimeoutTime_DTCM" SG_ 1448 ExhaustTemperature 0;
BA_ "GenSigTimeoutTime_ECM" SG_ 1448 ExhaustTemperature 0;
BA_ "GenSigTimeoutTime_GNMM" SG_ 1448 ExhaustTemperature 0;
BA_ "GenSigTimeoutTime_HCP" SG_ 1448 ExhaustTemperature 0;
BA_ "GenSigTimeoutTime_IPC" SG_ 1448 ExhaustTemperature 0;
BA_ "GenSigTimeoutTime_RFHM" SG_ 1448 ExhaustTemperature 0;
BA_ "GenSigTimeoutTime_TCM" SG_ 1448 ExhaustTemperature 0;
BA_ "GenSigTimeoutTime_AGSM" SG_ 1448 FuelMM_Sts 0;
BA_ "GenSigTimeoutTime_BCM" SG_ 1448 FuelMM_Sts 0;
BA_ "GenSigTimeoutTime_BSM" SG_ 1448 FuelMM_Sts 0;
BA_ "GenSigTimeoutTime_CADM" SG_ 1448 FuelMM_Sts 0;
BA_ "GenSigTimeoutTime_DMSM" SG_ 1448 FuelMM_Sts 0;
BA_ "GenSigTimeoutTime_DTCM" SG_ 1448 FuelMM_Sts 0;
BA_ "GenSigTimeoutTime_ECM" SG_ 1448 FuelMM_Sts 0;
BA_ "GenSigTimeoutTime_EVCU2" SG_ 1448 FuelMM_Sts 0;
BA_ "GenSigTimeoutTime_GNMM" SG_ 1448 FuelMM_Sts 0;
BA_ "GenSigTimeoutTime_HCP" SG_ 1448 FuelMM_Sts 0;
BA_ "GenSigTimeoutTime_RFHM" SG_ 1448 FuelMM_Sts 0;
BA_ "GenSigTimeoutTime_SGW" SG_ 1448 FuelMM_Sts 0;
BA_ "GenSigTimeoutTime_TCM" SG_ 1448 FuelMM_Sts 0;
BA_ "GenSigStartValue" SG_ 1448 HoursOilLifeRst 4095;
BA_ "GenSigTimeoutTime_AGSM" SG_ 1448 HoursOilLifeRst 0;
BA_ "GenSigTimeoutTime_BSM" SG_ 1448 HoursOilLifeRst 0;
BA_ "GenSigTimeoutTime_CADM" SG_ 1448 HoursOilLifeRst 0;
BA_ "GenSigTimeoutTime_DMSM" SG_ 1448 HoursOilLifeRst 0;
BA_ "GenSigTimeoutTime_DTCM" SG_ 1448 HoursOilLifeRst 0;
BA_ "GenSigTimeoutTime_ECM" SG_ 1448 HoursOilLifeRst 0;
BA_ "GenSigTimeoutTime_EVCU2" SG_ 1448 HoursOilLifeRst 0;
BA_ "GenSigTimeoutTime_GNMM" SG_ 1448 HoursOilLifeRst 0;
BA_ "GenSigTimeoutTime_HCP" SG_ 1448 HoursOilLifeRst 0;
BA_ "GenSigTimeoutTime_IPC" SG_ 1448 HoursOilLifeRst 0;
BA_ "GenSigTimeoutTime_RFHM" SG_ 1448 HoursOilLifeRst 0;
BA_ "GenSigTimeoutTime_SGW" SG_ 1448 HoursOilLifeRst 0;
BA_ "GenSigTimeoutTime_TCM" SG_ 1448 HoursOilLifeRst 0;
BA_ "GenSigSendType" SG_ 1448 KNK_MG_TRIGGER 3;
BA_ "GenSigTimeoutTime_AGSM" SG_ 1448 KNK_MG_TRIGGER 0;
BA_ "GenSigTimeoutTime_BCM" SG_ 1448 KNK_MG_TRIGGER 0;
BA_ "GenSigTimeoutTime_BSM" SG_ 1448 KNK_MG_TRIGGER 0;
BA_ "GenSigTimeoutTime_CADM" SG_ 1448 KNK_MG_TRIGGER 0;
BA_ "GenSigTimeoutTime_DMSM" SG_ 1448 KNK_MG_TRIGGER 0;
BA_ "GenSigTimeoutTime_DTCM" SG_ 1448 KNK_MG_TRIGGER 0;
BA_ "GenSigTimeoutTime_ECM" SG_ 1448 KNK_MG_TRIGGER 0;
BA_ "GenSigTimeoutTime_EVCU2" SG_ 1448 KNK_MG_TRIGGER 0;
BA_ "GenSigTimeoutTime_GNMM" SG_ 1448 KNK_MG_TRIGGER 0;
BA_ "GenSigTimeoutTime_HCP" SG_ 1448 KNK_MG_TRIGGER 0;
BA_ "GenSigTimeoutTime_RFHM" SG_ 1448 KNK_MG_TRIGGER 0;
BA_ "GenSigTimeoutTime_SGW" SG_ 1448 KNK_MG_TRIGGER 0;
BA_ "GenSigTimeoutTime_TCM" SG_ 1448 KNK_MG_TRIGGER 0;
BA_ "GenSigTimeoutTime_AGSM" SG_ 1448 MessageCounter_ENGINE7 0;
BA_ "GenSigTimeoutTime_BSM" SG_ 1448 MessageCounter_ENGINE7 0;
BA_ "GenSigTimeoutTime_DMSM" SG_ 1448 MessageCounter_ENGINE7 0;
BA_ "GenSigTimeoutTime_DTCM" SG_ 1448 MessageCounter_ENGINE7 0;
BA_ "GenSigTimeoutTime_ECM" SG_ 1448 MessageCounter_ENGINE7 0;
BA_ "GenSigTimeoutTime_EVCU2" SG_ 1448 MessageCounter_ENGINE7 0;
BA_ "GenSigTimeoutTime_GNMM" SG_ 1448 MessageCounter_ENGINE7 0;
BA_ "GenSigTimeoutTime_HCP" SG_ 1448 MessageCounter_ENGINE7 0;
BA_ "GenSigTimeoutTime_RFHM" SG_ 1448 MessageCounter_ENGINE7 0;
BA_ "GenSigTimeoutTime_SGW" SG_ 1448 MessageCounter_ENGINE7 0;
BA_ "GenSigTimeoutTime_AGSM" SG_ 1448 MntncSts 0;
BA_ "GenSigTimeoutTime_BCM" SG_ 1448 MntncSts 0;
BA_ "GenSigTimeoutTime_BSM" SG_ 1448 MntncSts 0;
BA_ "GenSigTimeoutTime_CADM" SG_ 1448 MntncSts 0;
BA_ "GenSigTimeoutTime_DMSM" SG_ 1448 MntncSts 0;
BA_ "GenSigTimeoutTime_DTCM" SG_ 1448 MntncSts 0;
BA_ "GenSigTimeoutTime_ECM" SG_ 1448 MntncSts 0;
BA_ "GenSigTimeoutTime_EVCU2" SG_ 1448 MntncSts 0;
BA_ "GenSigTimeoutTime_GNMM" SG_ 1448 MntncSts 0;
BA_ "GenSigTimeoutTime_HCP" SG_ 1448 MntncSts 0;
BA_ "GenSigTimeoutTime_RFHM" SG_ 1448 MntncSts 0;
BA_ "GenSigTimeoutTime_TCM" SG_ 1448 MntncSts 0;
BA_ "GenSigSendType" SG_ 1448 OilLifeSts 3;
BA_ "GenSigTimeoutTime_AGSM" SG_ 1448 OilLifeSts 0;
BA_ "GenSigTimeoutTime_BCM" SG_ 1448 OilLifeSts 0;
BA_ "GenSigTimeoutTime_BSM" SG_ 1448 OilLifeSts 0;
BA_ "GenSigTimeoutTime_CADM" SG_ 1448 OilLifeSts 0;
BA_ "GenSigTimeoutTime_DMSM" SG_ 1448 OilLifeSts 0;
BA_ "GenSigTimeoutTime_DTCM" SG_ 1448 OilLifeSts 0;
BA_ "GenSigTimeoutTime_ECM" SG_ 1448 OilLifeSts 0;
BA_ "GenSigTimeoutTime_EVCU2" SG_ 1448 OilLifeSts 0;
BA_ "GenSigTimeoutTime_GNMM" SG_ 1448 OilLifeSts 0;
BA_ "GenSigTimeoutTime_HCP" SG_ 1448 OilLifeSts 0;
BA_ "GenSigTimeoutTime_IPC" SG_ 1448 OilLifeSts 0;
BA_ "GenSigTimeoutTime_RFHM" SG_ 1448 OilLifeSts 0;
BA_ "GenSigTimeoutTime_TCM" SG_ 1448 OilLifeSts 0;
BA_ "GenSigStartValue" SG_ 1448 OilPressureSts 1;
BA_ "GenSigSendType" SG_ 1448 OilPressureSts 3;
BA_ "GenSigTimeoutTime_AGSM" SG_ 1448 OilPressureSts 0;
BA_ "GenSigTimeoutTime_BSM" SG_ 1448 OilPressureSts 0;
BA_ "GenSigTimeoutTime_CADM" SG_ 1448 OilPressureSts 0;
BA_ "GenSigTimeoutTime_DMSM" SG_ 1448 OilPressureSts 0;
BA_ "GenSigTimeoutTime_DTCM" SG_ 1448 OilPressureSts 0;
BA_ "GenSigTimeoutTime_ECM" SG_ 1448 OilPressureSts 0;
BA_ "GenSigTimeoutTime_EVCU2" SG_ 1448 OilPressureSts 0;
BA_ "GenSigTimeoutTime_GNMM" SG_ 1448 OilPressureSts 0;
BA_ "GenSigTimeoutTime_HCP" SG_ 1448 OilPressureSts 0;
BA_ "GenSigTimeoutTime_RFHM" SG_ 1448 OilPressureSts 0;
BA_ "GenSigTimeoutTime_TCM" SG_ 1448 OilPressureSts 0;
BA_ "GenSigSendType" SG_ 1448 PerfShftRq_HUD 3;
BA_ "GenSigTimeoutTime_AGSM" SG_ 1448 PerfShftRq_HUD 0;
BA_ "GenSigTimeoutTime_BCM" SG_ 1448 PerfShftRq_HUD 0;
BA_ "GenSigTimeoutTime_BSM" SG_ 1448 PerfShftRq_HUD 0;
BA_ "GenSigTimeoutTime_CADM" SG_ 1448 PerfShftRq_HUD 0;
BA_ "GenSigTimeoutTime_DMSM" SG_ 1448 PerfShftRq_HUD 0;
BA_ "GenSigTimeoutTime_DTCM" SG_ 1448 PerfShftRq_HUD 0;
BA_ "GenSigTimeoutTime_ECM" SG_ 1448 PerfShftRq_HUD 0;
BA_ "GenSigTimeoutTime_EVCU2" SG_ 1448 PerfShftRq_HUD 0;
BA_ "GenSigTimeoutTime_GNMM" SG_ 1448 PerfShftRq_HUD 0;
BA_ "GenSigTimeoutTime_HCP" SG_ 1448 PerfShftRq_HUD 0;
BA_ "GenSigTimeoutTime_RFHM" SG_ 1448 PerfShftRq_HUD 0;
BA_ "GenSigTimeoutTime_SGW" SG_ 1448 PerfShftRq_HUD 0;
BA_ "GenSigTimeoutTime_TCM" SG_ 1448 PerfShftRq_HUD 0;
BA_ "GenSigSendType" SG_ 1448 SpStDispstat 3;
BA_ "GenSigTimeoutTime_AGSM" SG_ 1448 SpStDispstat 0;
BA_ "GenSigTimeoutTime_BSM" SG_ 1448 SpStDispstat 0;
BA_ "GenSigTimeoutTime_CADM" SG_ 1448 SpStDispstat 0;
BA_ "GenSigTimeoutTime_DMSM" SG_ 1448 SpStDispstat 0;
BA_ "GenSigTimeoutTime_DTCM" SG_ 1448 SpStDispstat 0;
BA_ "GenSigTimeoutTime_ECM" SG_ 1448 SpStDispstat 0;
BA_ "GenSigTimeoutTime_EVCU2" SG_ 1448 SpStDispstat 0;
BA_ "GenSigTimeoutTime_GNMM" SG_ 1448 SpStDispstat 0;
BA_ "GenSigTimeoutTime_HCP" SG_ 1448 SpStDispstat 0;
BA_ "GenSigTimeoutTime_RFHM" SG_ 1448 SpStDispstat 0;
BA_ "GenSigSendType" SG_ 1448 SpStIndRq 3;
BA_ "GenSigTimeoutTime_AGSM" SG_ 1448 SpStIndRq 0;
BA_ "GenSigTimeoutTime_BCM" SG_ 1448 SpStIndRq 0;
BA_ "GenSigTimeoutTime_BSM" SG_ 1448 SpStIndRq 0;
BA_ "GenSigTimeoutTime_CADM" SG_ 1448 SpStIndRq 0;
BA_ "GenSigTimeoutTime_DMSM" SG_ 1448 SpStIndRq 0;
BA_ "GenSigTimeoutTime_DTCM" SG_ 1448 SpStIndRq 0;
BA_ "GenSigTimeoutTime_ECM" SG_ 1448 SpStIndRq 0;
BA_ "GenSigTimeoutTime_EVCU2" SG_ 1448 SpStIndRq 0;
BA_ "GenSigTimeoutTime_GNMM" SG_ 1448 SpStIndRq 0;
BA_ "GenSigTimeoutTime_HCP" SG_ 1448 SpStIndRq 0;
BA_ "GenSigTimeoutTime_RFHM" SG_ 1448 SpStIndRq 0;
BA_ "GenSigTimeoutTime_SGW" SG_ 1448 SpStIndRq 0;
BA_ "GenSigTimeoutTime_TCM" SG_ 1448 SpStIndRq 0;
BA_ "GenSigSendType" SG_ 1448 SpStSwStat 3;
BA_ "GenSigTimeoutTime_AGSM" SG_ 1448 SpStSwStat 0;
BA_ "GenSigTimeoutTime_BSM" SG_ 1448 SpStSwStat 0;
BA_ "GenSigTimeoutTime_CADM" SG_ 1448 SpStSwStat 0;
BA_ "GenSigTimeoutTime_DMSM" SG_ 1448 SpStSwStat 0;
BA_ "GenSigTimeoutTime_DTCM" SG_ 1448 SpStSwStat 0;
BA_ "GenSigTimeoutTime_ECM" SG_ 1448 SpStSwStat 0;
BA_ "GenSigTimeoutTime_EVCU2" SG_ 1448 SpStSwStat 0;
BA_ "GenSigTimeoutTime_GNMM" SG_ 1448 SpStSwStat 0;
BA_ "GenSigTimeoutTime_HCP" SG_ 1448 SpStSwStat 0;
BA_ "GenSigTimeoutTime_RFHM" SG_ 1448 SpStSwStat 0;
BA_ "GenSigTimeoutTime_TCM" SG_ 1448 SpStSwStat 0;
BA_ "GenSigTimeoutTime_AGSM" SG_ 1055 AFTER_RUN_STATUS 0;
BA_ "GenSigTimeoutTime_BCM" SG_ 1055 AFTER_RUN_STATUS 0;
BA_ "GenSigTimeoutTime_BSM" SG_ 1055 AFTER_RUN_STATUS 0;
BA_ "GenSigTimeoutTime_CADM" SG_ 1055 AFTER_RUN_STATUS 0;
BA_ "GenSigTimeoutTime_DMSM" SG_ 1055 AFTER_RUN_STATUS 0;
BA_ "GenSigTimeoutTime_DTCM" SG_ 1055 AFTER_RUN_STATUS 0;
BA_ "GenSigTimeoutTime_ECM" SG_ 1055 AFTER_RUN_STATUS 0;
BA_ "GenSigTimeoutTime_EVCU2" SG_ 1055 AFTER_RUN_STATUS 0;
BA_ "GenSigTimeoutTime_GNMM" SG_ 1055 AFTER_RUN_STATUS 0;
BA_ "GenSigTimeoutTime_HCP" SG_ 1055 AFTER_RUN_STATUS 0;
BA_ "GenSigTimeoutTime_IPC" SG_ 1055 AFTER_RUN_STATUS 0;
BA_ "GenSigTimeoutTime_RFHM" SG_ 1055 AFTER_RUN_STATUS 0;
BA_ "GenSigTimeoutTime_TCM" SG_ 1055 AFTER_RUN_STATUS 0;
BA_ "GenSigTimeoutTime_AGSM" SG_ 1055 AM_ECM_Prsnt 0;
BA_ "GenSigTimeoutTime_BSM" SG_ 1055 AM_ECM_Prsnt 0;
BA_ "GenSigTimeoutTime_CADM" SG_ 1055 AM_ECM_Prsnt 0;
BA_ "GenSigTimeoutTime_DMSM" SG_ 1055 AM_ECM_Prsnt 0;
BA_ "GenSigTimeoutTime_DTCM" SG_ 1055 AM_ECM_Prsnt 0;
BA_ "GenSigTimeoutTime_ECM" SG_ 1055 AM_ECM_Prsnt 0;
BA_ "GenSigTimeoutTime_EVCU2" SG_ 1055 AM_ECM_Prsnt 0;
BA_ "GenSigTimeoutTime_GNMM" SG_ 1055 AM_ECM_Prsnt 0;
BA_ "GenSigTimeoutTime_HCP" SG_ 1055 AM_ECM_Prsnt 0;
BA_ "GenSigTimeoutTime_IPC" SG_ 1055 AM_ECM_Prsnt 0;
BA_ "GenSigTimeoutTime_RFHM" SG_ 1055 AM_ECM_Prsnt 0;
BA_ "GenSigTimeoutTime_SGW" SG_ 1055 AM_ECM_Prsnt 0;
BA_ "GenSigTimeoutTime_TCM" SG_ 1055 AM_ECM_Prsnt 0;
BA_ "GenSigTimeoutTime_AGSM" SG_ 1055 COOLING_REQUIRED_STATUS 0;
BA_ "GenSigTimeoutTime_BCM" SG_ 1055 COOLING_REQUIRED_STATUS 0;
BA_ "GenSigTimeoutTime_BSM" SG_ 1055 COOLING_REQUIRED_STATUS 0;
BA_ "GenSigTimeoutTime_CADM" SG_ 1055 COOLING_REQUIRED_STATUS 0;
BA_ "GenSigTimeoutTime_DMSM" SG_ 1055 COOLING_REQUIRED_STATUS 0;
BA_ "GenSigTimeoutTime_DTCM" SG_ 1055 COOLING_REQUIRED_STATUS 0;
BA_ "GenSigTimeoutTime_ECM" SG_ 1055 COOLING_REQUIRED_STATUS 0;
BA_ "GenSigTimeoutTime_EVCU2" SG_ 1055 COOLING_REQUIRED_STATUS 0;
BA_ "GenSigTimeoutTime_GNMM" SG_ 1055 COOLING_REQUIRED_STATUS 0;
BA_ "GenSigTimeoutTime_HCP" SG_ 1055 COOLING_REQUIRED_STATUS 0;
BA_ "GenSigTimeoutTime_IPC" SG_ 1055 COOLING_REQUIRED_STATUS 0;
BA_ "GenSigTimeoutTime_RFHM" SG_ 1055 COOLING_REQUIRED_STATUS 0;
BA_ "GenSigTimeoutTime_TCM" SG_ 1055 COOLING_REQUIRED_STATUS 0;
BA_ "GenSigTimeoutTime_AGSM" SG_ 1055 CRC_ENGINE8 0;
BA_ "GenSigTimeoutTime_BCM" SG_ 1055 CRC_ENGINE8 0;
BA_ "GenSigTimeoutTime_BSM" SG_ 1055 CRC_ENGINE8 0;
BA_ "GenSigTimeoutTime_CADM" SG_ 1055 CRC_ENGINE8 0;
BA_ "GenSigTimeoutTime_DMSM" SG_ 1055 CRC_ENGINE8 0;
BA_ "GenSigTimeoutTime_DTCM" SG_ 1055 CRC_ENGINE8 0;
BA_ "GenSigTimeoutTime_ECM" SG_ 1055 CRC_ENGINE8 0;
BA_ "GenSigTimeoutTime_GNMM" SG_ 1055 CRC_ENGINE8 0;
BA_ "GenSigTimeoutTime_IPC" SG_ 1055 CRC_ENGINE8 0;
BA_ "GenSigTimeoutTime_RFHM" SG_ 1055 CRC_ENGINE8 0;
BA_ "GenSigTimeoutTime_SGW" SG_ 1055 CRC_ENGINE8 0;
BA_ "GenSigTimeoutTime_AGSM" SG_ 1055 GF_Charge 0;
BA_ "GenSigTimeoutTime_BSM" SG_ 1055 GF_Charge 0;
BA_ "GenSigTimeoutTime_CADM" SG_ 1055 GF_Charge 0;
BA_ "GenSigTimeoutTime_DMSM" SG_ 1055 GF_Charge 0;
BA_ "GenSigTimeoutTime_DTCM" SG_ 1055 GF_Charge 0;
BA_ "GenSigTimeoutTime_ECM" SG_ 1055 GF_Charge 0;
BA_ "GenSigTimeoutTime_EVCU2" SG_ 1055 GF_Charge 0;
BA_ "GenSigTimeoutTime_GNMM" SG_ 1055 GF_Charge 0;
BA_ "GenSigTimeoutTime_HCP" SG_ 1055 GF_Charge 0;
BA_ "GenSigTimeoutTime_IPC" SG_ 1055 GF_Charge 0;
BA_ "GenSigTimeoutTime_RFHM" SG_ 1055 GF_Charge 0;
BA_ "GenSigTimeoutTime_TCM" SG_ 1055 GF_Charge 0;
BA_ "GenSigTimeoutTime_AGSM" SG_ 1055 HOOD_AJAR_STATUS 0;
BA_ "GenSigTimeoutTime_BCM" SG_ 1055 HOOD_AJAR_STATUS 0;
BA_ "GenSigTimeoutTime_BSM" SG_ 1055 HOOD_AJAR_STATUS 0;
BA_ "GenSigTimeoutTime_CADM" SG_ 1055 HOOD_AJAR_STATUS 0;
BA_ "GenSigTimeoutTime_DMSM" SG_ 1055 HOOD_AJAR_STATUS 0;
BA_ "GenSigTimeoutTime_DTCM" SG_ 1055 HOOD_AJAR_STATUS 0;
BA_ "GenSigTimeoutTime_ECM" SG_ 1055 HOOD_AJAR_STATUS 0;
BA_ "GenSigTimeoutTime_EVCU2" SG_ 1055 HOOD_AJAR_STATUS 0;
BA_ "GenSigTimeoutTime_GNMM" SG_ 1055 HOOD_AJAR_STATUS 0;
BA_ "GenSigTimeoutTime_HCP" SG_ 1055 HOOD_AJAR_STATUS 0;
BA_ "GenSigTimeoutTime_IPC" SG_ 1055 HOOD_AJAR_STATUS 0;
BA_ "GenSigTimeoutTime_RFHM" SG_ 1055 HOOD_AJAR_STATUS 0;
BA_ "GenSigTimeoutTime_TCM" SG_ 1055 HOOD_AJAR_STATUS 0;
BA_ "GenSigTimeoutTime_AGSM" SG_ 1055 LTR_TARGET_TEMP 0;
BA_ "GenSigTimeoutTime_BCM" SG_ 1055 LTR_TARGET_TEMP 0;
BA_ "GenSigTimeoutTime_BSM" SG_ 1055 LTR_TARGET_TEMP 0;
BA_ "GenSigTimeoutTime_CADM" SG_ 1055 LTR_TARGET_TEMP 0;
BA_ "GenSigTimeoutTime_DMSM" SG_ 1055 LTR_TARGET_TEMP 0;
BA_ "GenSigTimeoutTime_DTCM" SG_ 1055 LTR_TARGET_TEMP 0;
BA_ "GenSigTimeoutTime_ECM" SG_ 1055 LTR_TARGET_TEMP 0;
BA_ "GenSigTimeoutTime_EVCU2" SG_ 1055 LTR_TARGET_TEMP 0;
BA_ "GenSigTimeoutTime_GNMM" SG_ 1055 LTR_TARGET_TEMP 0;
BA_ "GenSigTimeoutTime_HCP" SG_ 1055 LTR_TARGET_TEMP 0;
BA_ "GenSigTimeoutTime_IPC" SG_ 1055 LTR_TARGET_TEMP 0;
BA_ "GenSigTimeoutTime_RFHM" SG_ 1055 LTR_TARGET_TEMP 0;
BA_ "GenSigTimeoutTime_TCM" SG_ 1055 LTR_TARGET_TEMP 0;
BA_ "GenSigStartValue" SG_ 1055 MAP_4_BAR 511;
BA_ "GenSigTimeoutTime_AGSM" SG_ 1055 MAP_4_BAR 0;
BA_ "GenSigTimeoutTime_CADM" SG_ 1055 MAP_4_BAR 0;
BA_ "GenSigTimeoutTime_DMSM" SG_ 1055 MAP_4_BAR 0;
BA_ "GenSigTimeoutTime_DTCM" SG_ 1055 MAP_4_BAR 0;
BA_ "GenSigTimeoutTime_ECM" SG_ 1055 MAP_4_BAR 0;
BA_ "GenSigTimeoutTime_EVCU2" SG_ 1055 MAP_4_BAR 0;
BA_ "GenSigTimeoutTime_GNMM" SG_ 1055 MAP_4_BAR 0;
BA_ "GenSigTimeoutTime_IPC" SG_ 1055 MAP_4_BAR 0;
BA_ "GenSigTimeoutTime_RFHM" SG_ 1055 MAP_4_BAR 0;
BA_ "GenSigTimeoutTime_TCM" SG_ 1055 MAP_4_BAR 0;
BA_ "GenSigTimeoutTime_AGSM" SG_ 1055 MdsAct 0;
BA_ "GenSigTimeoutTime_BCM" SG_ 1055 MdsAct 0;
BA_ "GenSigTimeoutTime_BSM" SG_ 1055 MdsAct 0;
BA_ "GenSigTimeoutTime_CADM" SG_ 1055 MdsAct 0;
BA_ "GenSigTimeoutTime_DMSM" SG_ 1055 MdsAct 0;
BA_ "GenSigTimeoutTime_DTCM" SG_ 1055 MdsAct 0;
BA_ "GenSigTimeoutTime_ECM" SG_ 1055 MdsAct 0;
BA_ "GenSigTimeoutTime_EVCU2" SG_ 1055 MdsAct 0;
BA_ "GenSigTimeoutTime_GNMM" SG_ 1055 MdsAct 0;
BA_ "GenSigTimeoutTime_HCP" SG_ 1055 MdsAct 0;
BA_ "GenSigTimeoutTime_RFHM" SG_ 1055 MdsAct 0;
BA_ "GenSigTimeoutTime_AGSM" SG_ 1055 MdsActforANC 0;
BA_ "GenSigTimeoutTime_BSM" SG_ 1055 MdsActforANC 0;
BA_ "GenSigTimeoutTime_CADM" SG_ 1055 MdsActforANC 0;
BA_ "GenSigTimeoutTime_DMSM" SG_ 1055 MdsActforANC 0;
BA_ "GenSigTimeoutTime_DTCM" SG_ 1055 MdsActforANC 0;
BA_ "GenSigTimeoutTime_ECM" SG_ 1055 MdsActforANC 0;
BA_ "GenSigTimeoutTime_EVCU2" SG_ 1055 MdsActforANC 0;
BA_ "GenSigTimeoutTime_GNMM" SG_ 1055 MdsActforANC 0;
BA_ "GenSigTimeoutTime_HCP" SG_ 1055 MdsActforANC 0;
BA_ "GenSigTimeoutTime_IPC" SG_ 1055 MdsActforANC 0;
BA_ "GenSigTimeoutTime_RFHM" SG_ 1055 MdsActforANC 0;
BA_ "GenSigTimeoutTime_SGW" SG_ 1055 MdsActforANC 0;
BA_ "GenSigTimeoutTime_TCM" SG_ 1055 MdsActforANC 0;
BA_ "GenSigTimeoutTime_AGSM" SG_ 1055 MessageCounter_ENGINE8 0;
BA_ "GenSigTimeoutTime_BCM" SG_ 1055 MessageCounter_ENGINE8 0;
BA_ "GenSigTimeoutTime_BSM" SG_ 1055 MessageCounter_ENGINE8 0;
BA_ "GenSigTimeoutTime_CADM" SG_ 1055 MessageCounter_ENGINE8 0;
BA_ "GenSigTimeoutTime_DMSM" SG_ 1055 MessageCounter_ENGINE8 0;
BA_ "GenSigTimeoutTime_DTCM" SG_ 1055 MessageCounter_ENGINE8 0;
BA_ "GenSigTimeoutTime_ECM" SG_ 1055 MessageCounter_ENGINE8 0;
BA_ "GenSigTimeoutTime_GNMM" SG_ 1055 MessageCounter_ENGINE8 0;
BA_ "GenSigTimeoutTime_IPC" SG_ 1055 MessageCounter_ENGINE8 0;
BA_ "GenSigTimeoutTime_RFHM" SG_ 1055 MessageCounter_ENGINE8 0;
BA_ "GenSigTimeoutTime_SGW" SG_ 1055 MessageCounter_ENGINE8 0;
BA_ "GenSigStartValue" SG_ 1055 OIL_PRESS 255;
BA_ "GenSigTimeoutTime_AGSM" SG_ 1055 OIL_PRESS 0;
BA_ "GenSigTimeoutTime_BCM" SG_ 1055 OIL_PRESS 0;
BA_ "GenSigTimeoutTime_BSM" SG_ 1055 OIL_PRESS 0;
BA_ "GenSigTimeoutTime_CADM" SG_ 1055 OIL_PRESS 0;
BA_ "GenSigTimeoutTime_DMSM" SG_ 1055 OIL_PRESS 0;
BA_ "GenSigTimeoutTime_DTCM" SG_ 1055 OIL_PRESS 0;
BA_ "GenSigTimeoutTime_ECM" SG_ 1055 OIL_PRESS 0;
BA_ "GenSigTimeoutTime_EVCU2" SG_ 1055 OIL_PRESS 0;
BA_ "GenSigTimeoutTime_GNMM" SG_ 1055 OIL_PRESS 0;
BA_ "GenSigTimeoutTime_HCP" SG_ 1055 OIL_PRESS 0;
BA_ "GenSigTimeoutTime_RFHM" SG_ 1055 OIL_PRESS 0;
BA_ "GenSigTimeoutTime_TCM" SG_ 1055 OIL_PRESS 0;
BA_ "GenSigTimeoutTime_AGSM" SG_ 1055 PSI_EnableSts 0;
BA_ "GenSigTimeoutTime_BCM" SG_ 1055 PSI_EnableSts 0;
BA_ "GenSigTimeoutTime_BSM" SG_ 1055 PSI_EnableSts 0;
BA_ "GenSigTimeoutTime_CADM" SG_ 1055 PSI_EnableSts 0;
BA_ "GenSigTimeoutTime_DMSM" SG_ 1055 PSI_EnableSts 0;
BA_ "GenSigTimeoutTime_DTCM" SG_ 1055 PSI_EnableSts 0;
BA_ "GenSigTimeoutTime_ECM" SG_ 1055 PSI_EnableSts 0;
BA_ "GenSigTimeoutTime_EVCU2" SG_ 1055 PSI_EnableSts 0;
BA_ "GenSigTimeoutTime_GNMM" SG_ 1055 PSI_EnableSts 0;
BA_ "GenSigTimeoutTime_HCP" SG_ 1055 PSI_EnableSts 0;
BA_ "GenSigTimeoutTime_IPC" SG_ 1055 PSI_EnableSts 0;
BA_ "GenSigTimeoutTime_RFHM" SG_ 1055 PSI_EnableSts 0;
BA_ "GenSigTimeoutTime_TCM" SG_ 1055 PSI_EnableSts 0;
BA_ "GenSigTimeoutTime_AGSM" SG_ 1055 PSI_Gr1_RPM 0;
BA_ "GenSigTimeoutTime_BCM" SG_ 1055 PSI_Gr1_RPM 0;
BA_ "GenSigTimeoutTime_BSM" SG_ 1055 PSI_Gr1_RPM 0;
BA_ "GenSigTimeoutTime_CADM" SG_ 1055 PSI_Gr1_RPM 0;
BA_ "GenSigTimeoutTime_DMSM" SG_ 1055 PSI_Gr1_RPM 0;
BA_ "GenSigTimeoutTime_DTCM" SG_ 1055 PSI_Gr1_RPM 0;
BA_ "GenSigTimeoutTime_ECM" SG_ 1055 PSI_Gr1_RPM 0;
BA_ "GenSigTimeoutTime_EVCU2" SG_ 1055 PSI_Gr1_RPM 0;
BA_ "GenSigTimeoutTime_GNMM" SG_ 1055 PSI_Gr1_RPM 0;
BA_ "GenSigTimeoutTime_HCP" SG_ 1055 PSI_Gr1_RPM 0;
BA_ "GenSigTimeoutTime_IPC" SG_ 1055 PSI_Gr1_RPM 0;
BA_ "GenSigTimeoutTime_RFHM" SG_ 1055 PSI_Gr1_RPM 0;
BA_ "GenSigTimeoutTime_TCM" SG_ 1055 PSI_Gr1_RPM 0;
BA_ "GenSigTimeoutTime_AGSM" SG_ 1055 PSI_Gr2_RPM 0;
BA_ "GenSigTimeoutTime_BCM" SG_ 1055 PSI_Gr2_RPM 0;
BA_ "GenSigTimeoutTime_BSM" SG_ 1055 PSI_Gr2_RPM 0;
BA_ "GenSigTimeoutTime_CADM" SG_ 1055 PSI_Gr2_RPM 0;
BA_ "GenSigTimeoutTime_DMSM" SG_ 1055 PSI_Gr2_RPM 0;
BA_ "GenSigTimeoutTime_DTCM" SG_ 1055 PSI_Gr2_RPM 0;
BA_ "GenSigTimeoutTime_ECM" SG_ 1055 PSI_Gr2_RPM 0;
BA_ "GenSigTimeoutTime_EVCU2" SG_ 1055 PSI_Gr2_RPM 0;
BA_ "GenSigTimeoutTime_GNMM" SG_ 1055 PSI_Gr2_RPM 0;
BA_ "GenSigTimeoutTime_HCP" SG_ 1055 PSI_Gr2_RPM 0;
BA_ "GenSigTimeoutTime_IPC" SG_ 1055 PSI_Gr2_RPM 0;
BA_ "GenSigTimeoutTime_RFHM" SG_ 1055 PSI_Gr2_RPM 0;
BA_ "GenSigTimeoutTime_TCM" SG_ 1055 PSI_Gr2_RPM 0;
BA_ "GenSigTimeoutTime_AGSM" SG_ 1055 PSI_Gr3_RPM 0;
BA_ "GenSigTimeoutTime_BCM" SG_ 1055 PSI_Gr3_RPM 0;
BA_ "GenSigTimeoutTime_BSM" SG_ 1055 PSI_Gr3_RPM 0;
BA_ "GenSigTimeoutTime_CADM" SG_ 1055 PSI_Gr3_RPM 0;
BA_ "GenSigTimeoutTime_DMSM" SG_ 1055 PSI_Gr3_RPM 0;
BA_ "GenSigTimeoutTime_DTCM" SG_ 1055 PSI_Gr3_RPM 0;
BA_ "GenSigTimeoutTime_ECM" SG_ 1055 PSI_Gr3_RPM 0;
BA_ "GenSigTimeoutTime_EVCU2" SG_ 1055 PSI_Gr3_RPM 0;
BA_ "GenSigTimeoutTime_GNMM" SG_ 1055 PSI_Gr3_RPM 0;
BA_ "GenSigTimeoutTime_HCP" SG_ 1055 PSI_Gr3_RPM 0;
BA_ "GenSigTimeoutTime_IPC" SG_ 1055 PSI_Gr3_RPM 0;
BA_ "GenSigTimeoutTime_RFHM" SG_ 1055 PSI_Gr3_RPM 0;
BA_ "GenSigTimeoutTime_TCM" SG_ 1055 PSI_Gr3_RPM 0;
BA_ "GenSigTimeoutTime_AGSM" SG_ 1055 PSI_Gr4_RPM 0;
BA_ "GenSigTimeoutTime_BCM" SG_ 1055 PSI_Gr4_RPM 0;
BA_ "GenSigTimeoutTime_BSM" SG_ 1055 PSI_Gr4_RPM 0;
BA_ "GenSigTimeoutTime_CADM" SG_ 1055 PSI_Gr4_RPM 0;
BA_ "GenSigTimeoutTime_DMSM" SG_ 1055 PSI_Gr4_RPM 0;
BA_ "GenSigTimeoutTime_DTCM" SG_ 1055 PSI_Gr4_RPM 0;
BA_ "GenSigTimeoutTime_ECM" SG_ 1055 PSI_Gr4_RPM 0;
BA_ "GenSigTimeoutTime_EVCU2" SG_ 1055 PSI_Gr4_RPM 0;
BA_ "GenSigTimeoutTime_GNMM" SG_ 1055 PSI_Gr4_RPM 0;
BA_ "GenSigTimeoutTime_HCP" SG_ 1055 PSI_Gr4_RPM 0;
BA_ "GenSigTimeoutTime_IPC" SG_ 1055 PSI_Gr4_RPM 0;
BA_ "GenSigTimeoutTime_RFHM" SG_ 1055 PSI_Gr4_RPM 0;
BA_ "GenSigTimeoutTime_TCM" SG_ 1055 PSI_Gr4_RPM 0;
BA_ "GenSigTimeoutTime_AGSM" SG_ 1055 PSI_Gr5_RPM 0;
BA_ "GenSigTimeoutTime_BCM" SG_ 1055 PSI_Gr5_RPM 0;
BA_ "GenSigTimeoutTime_BSM" SG_ 1055 PSI_Gr5_RPM 0;
BA_ "GenSigTimeoutTime_CADM" SG_ 1055 PSI_Gr5_RPM 0;
BA_ "GenSigTimeoutTime_DMSM" SG_ 1055 PSI_Gr5_RPM 0;
BA_ "GenSigTimeoutTime_DTCM" SG_ 1055 PSI_Gr5_RPM 0;
BA_ "GenSigTimeoutTime_ECM" SG_ 1055 PSI_Gr5_RPM 0;
BA_ "GenSigTimeoutTime_EVCU2" SG_ 1055 PSI_Gr5_RPM 0;
BA_ "GenSigTimeoutTime_GNMM" SG_ 1055 PSI_Gr5_RPM 0;
BA_ "GenSigTimeoutTime_HCP" SG_ 1055 PSI_Gr5_RPM 0;
BA_ "GenSigTimeoutTime_IPC" SG_ 1055 PSI_Gr5_RPM 0;
BA_ "GenSigTimeoutTime_RFHM" SG_ 1055 PSI_Gr5_RPM 0;
BA_ "GenSigTimeoutTime_TCM" SG_ 1055 PSI_Gr5_RPM 0;
BA_ "GenSigTimeoutTime_AGSM" SG_ 1055 PSI_Max_RPM 0;
BA_ "GenSigTimeoutTime_BCM" SG_ 1055 PSI_Max_RPM 0;
BA_ "GenSigTimeoutTime_BSM" SG_ 1055 PSI_Max_RPM 0;
BA_ "GenSigTimeoutTime_CADM" SG_ 1055 PSI_Max_RPM 0;
BA_ "GenSigTimeoutTime_DMSM" SG_ 1055 PSI_Max_RPM 0;
BA_ "GenSigTimeoutTime_DTCM" SG_ 1055 PSI_Max_RPM 0;
BA_ "GenSigTimeoutTime_ECM" SG_ 1055 PSI_Max_RPM 0;
BA_ "GenSigTimeoutTime_EVCU2" SG_ 1055 PSI_Max_RPM 0;
BA_ "GenSigTimeoutTime_GNMM" SG_ 1055 PSI_Max_RPM 0;
BA_ "GenSigTimeoutTime_HCP" SG_ 1055 PSI_Max_RPM 0;
BA_ "GenSigTimeoutTime_IPC" SG_ 1055 PSI_Max_RPM 0;
BA_ "GenSigTimeoutTime_RFHM" SG_ 1055 PSI_Max_RPM 0;
BA_ "GenSigTimeoutTime_TCM" SG_ 1055 PSI_Max_RPM 0;
BA_ "GenSigTimeoutTime_AGSM" SG_ 1055 RACE_CLDWN_BATT_STAT 0;
BA_ "GenSigTimeoutTime_BCM" SG_ 1055 RACE_CLDWN_BATT_STAT 0;
BA_ "GenSigTimeoutTime_BSM" SG_ 1055 RACE_CLDWN_BATT_STAT 0;
BA_ "GenSigTimeoutTime_CADM" SG_ 1055 RACE_CLDWN_BATT_STAT 0;
BA_ "GenSigTimeoutTime_DMSM" SG_ 1055 RACE_CLDWN_BATT_STAT 0;
BA_ "GenSigTimeoutTime_DTCM" SG_ 1055 RACE_CLDWN_BATT_STAT 0;
BA_ "GenSigTimeoutTime_ECM" SG_ 1055 RACE_CLDWN_BATT_STAT 0;
BA_ "GenSigTimeoutTime_EVCU2" SG_ 1055 RACE_CLDWN_BATT_STAT 0;
BA_ "GenSigTimeoutTime_GNMM" SG_ 1055 RACE_CLDWN_BATT_STAT 0;
BA_ "GenSigTimeoutTime_HCP" SG_ 1055 RACE_CLDWN_BATT_STAT 0;
BA_ "GenSigTimeoutTime_IPC" SG_ 1055 RACE_CLDWN_BATT_STAT 0;
BA_ "GenSigTimeoutTime_RFHM" SG_ 1055 RACE_CLDWN_BATT_STAT 0;
BA_ "GenSigTimeoutTime_TCM" SG_ 1055 RACE_CLDWN_BATT_STAT 0;
BA_ "GenSigTimeoutTime_AGSM" SG_ 1055 RACE_CLDWN_DEAC_TIME 0;
BA_ "GenSigTimeoutTime_BCM" SG_ 1055 RACE_CLDWN_DEAC_TIME 0;
BA_ "GenSigTimeoutTime_BSM" SG_ 1055 RACE_CLDWN_DEAC_TIME 0;
BA_ "GenSigTimeoutTime_CADM" SG_ 1055 RACE_CLDWN_DEAC_TIME 0;
BA_ "GenSigTimeoutTime_DMSM" SG_ 1055 RACE_CLDWN_DEAC_TIME 0;
BA_ "GenSigTimeoutTime_DTCM" SG_ 1055 RACE_CLDWN_DEAC_TIME 0;
BA_ "GenSigTimeoutTime_ECM" SG_ 1055 RACE_CLDWN_DEAC_TIME 0;
BA_ "GenSigTimeoutTime_EVCU2" SG_ 1055 RACE_CLDWN_DEAC_TIME 0;
BA_ "GenSigTimeoutTime_GNMM" SG_ 1055 RACE_CLDWN_DEAC_TIME 0;
BA_ "GenSigTimeoutTime_HCP" SG_ 1055 RACE_CLDWN_DEAC_TIME 0;
BA_ "GenSigTimeoutTime_IPC" SG_ 1055 RACE_CLDWN_DEAC_TIME 0;
BA_ "GenSigTimeoutTime_RFHM" SG_ 1055 RACE_CLDWN_DEAC_TIME 0;
BA_ "GenSigTimeoutTime_TCM" SG_ 1055 RACE_CLDWN_DEAC_TIME 0;
BA_ "GenSigTimeoutTime_AGSM" SG_ 1055 RACE_CLDWN_SEL 0;
BA_ "GenSigTimeoutTime_BCM" SG_ 1055 RACE_CLDWN_SEL 0;
BA_ "GenSigTimeoutTime_BSM" SG_ 1055 RACE_CLDWN_SEL 0;
BA_ "GenSigTimeoutTime_CADM" SG_ 1055 RACE_CLDWN_SEL 0;
BA_ "GenSigTimeoutTime_DMSM" SG_ 1055 RACE_CLDWN_SEL 0;
BA_ "GenSigTimeoutTime_DTCM" SG_ 1055 RACE_CLDWN_SEL 0;
BA_ "GenSigTimeoutTime_ECM" SG_ 1055 RACE_CLDWN_SEL 0;
BA_ "GenSigTimeoutTime_EVCU2" SG_ 1055 RACE_CLDWN_SEL 0;
BA_ "GenSigTimeoutTime_GNMM" SG_ 1055 RACE_CLDWN_SEL 0;
BA_ "GenSigTimeoutTime_HCP" SG_ 1055 RACE_CLDWN_SEL 0;
BA_ "GenSigTimeoutTime_IPC" SG_ 1055 RACE_CLDWN_SEL 0;
BA_ "GenSigTimeoutTime_RFHM" SG_ 1055 RACE_CLDWN_SEL 0;
BA_ "GenSigTimeoutTime_TCM" SG_ 1055 RACE_CLDWN_SEL 0;
BA_ "GenSigTimeoutTime_AGSM" SG_ 1055 RefuelEvent 0;
BA_ "GenSigTimeoutTime_BSM" SG_ 1055 RefuelEvent 0;
BA_ "GenSigTimeoutTime_CADM" SG_ 1055 RefuelEvent 0;
BA_ "GenSigTimeoutTime_DMSM" SG_ 1055 RefuelEvent 0;
BA_ "GenSigTimeoutTime_DTCM" SG_ 1055 RefuelEvent 0;
BA_ "GenSigTimeoutTime_ECM" SG_ 1055 RefuelEvent 0;
BA_ "GenSigTimeoutTime_EVCU2" SG_ 1055 RefuelEvent 0;
BA_ "GenSigTimeoutTime_GNMM" SG_ 1055 RefuelEvent 0;
BA_ "GenSigTimeoutTime_HCP" SG_ 1055 RefuelEvent 0;
BA_ "GenSigTimeoutTime_IPC" SG_ 1055 RefuelEvent 0;
BA_ "GenSigTimeoutTime_RFHM" SG_ 1055 RefuelEvent 0;
BA_ "GenSigTimeoutTime_SGW" SG_ 1055 RefuelEvent 0;
BA_ "GenSigTimeoutTime_TCM" SG_ 1055 RefuelEvent 0;
BA_ "GenSigTimeoutTime_AGSM" SG_ 1055 RefuelIndication 0;
BA_ "GenSigTimeoutTime_BCM" SG_ 1055 RefuelIndication 0;
BA_ "GenSigTimeoutTime_BSM" SG_ 1055 RefuelIndication 0;
BA_ "GenSigTimeoutTime_CADM" SG_ 1055 RefuelIndication 0;
BA_ "GenSigTimeoutTime_DMSM" SG_ 1055 RefuelIndication 0;
BA_ "GenSigTimeoutTime_DTCM" SG_ 1055 RefuelIndication 0;
BA_ "GenSigTimeoutTime_ECM" SG_ 1055 RefuelIndication 0;
BA_ "GenSigTimeoutTime_EVCU2" SG_ 1055 RefuelIndication 0;
BA_ "GenSigTimeoutTime_GNMM" SG_ 1055 RefuelIndication 0;
BA_ "GenSigTimeoutTime_HCP" SG_ 1055 RefuelIndication 0;
BA_ "GenSigTimeoutTime_RFHM" SG_ 1055 RefuelIndication 0;
BA_ "GenSigTimeoutTime_SGW" SG_ 1055 RefuelIndication 0;
BA_ "GenSigTimeoutTime_TCM" SG_ 1055 RefuelIndication 0;
BA_ "GenSigStartValue" SG_ 1055 RevOilLifeRst 65535;
BA_ "GenSigTimeoutTime_AGSM" SG_ 1055 RevOilLifeRst 0;
BA_ "GenSigTimeoutTime_BSM" SG_ 1055 RevOilLifeRst 0;
BA_ "GenSigTimeoutTime_CADM" SG_ 1055 RevOilLifeRst 0;
BA_ "GenSigTimeoutTime_DMSM" SG_ 1055 RevOilLifeRst 0;
BA_ "GenSigTimeoutTime_DTCM" SG_ 1055 RevOilLifeRst 0;
BA_ "GenSigTimeoutTime_ECM" SG_ 1055 RevOilLifeRst 0;
BA_ "GenSigTimeoutTime_EVCU2" SG_ 1055 RevOilLifeRst 0;
BA_ "GenSigTimeoutTime_GNMM" SG_ 1055 RevOilLifeRst 0;
BA_ "GenSigTimeoutTime_HCP" SG_ 1055 RevOilLifeRst 0;
BA_ "GenSigTimeoutTime_IPC" SG_ 1055 RevOilLifeRst 0;
BA_ "GenSigTimeoutTime_RFHM" SG_ 1055 RevOilLifeRst 0;
BA_ "GenSigTimeoutTime_SGW" SG_ 1055 RevOilLifeRst 0;
BA_ "GenSigTimeoutTime_TCM" SG_ 1055 RevOilLifeRst 0;
BA_ "GenSigTimeoutTime_AGSM" SG_ 1055 SYSTEM_STATUS 0;
BA_ "GenSigTimeoutTime_BCM" SG_ 1055 SYSTEM_STATUS 0;
BA_ "GenSigTimeoutTime_BSM" SG_ 1055 SYSTEM_STATUS 0;
BA_ "GenSigTimeoutTime_CADM" SG_ 1055 SYSTEM_STATUS 0;
BA_ "GenSigTimeoutTime_DMSM" SG_ 1055 SYSTEM_STATUS 0;
BA_ "GenSigTimeoutTime_DTCM" SG_ 1055 SYSTEM_STATUS 0;
BA_ "GenSigTimeoutTime_ECM" SG_ 1055 SYSTEM_STATUS 0;
BA_ "GenSigTimeoutTime_EVCU2" SG_ 1055 SYSTEM_STATUS 0;
BA_ "GenSigTimeoutTime_GNMM" SG_ 1055 SYSTEM_STATUS 0;
BA_ "GenSigTimeoutTime_HCP" SG_ 1055 SYSTEM_STATUS 0;
BA_ "GenSigTimeoutTime_IPC" SG_ 1055 SYSTEM_STATUS 0;
BA_ "GenSigTimeoutTime_RFHM" SG_ 1055 SYSTEM_STATUS 0;
BA_ "GenSigTimeoutTime_TCM" SG_ 1055 SYSTEM_STATUS 0;
VAL_ 517 AWDSysStat 0 "SH_IPG" 1 "4LO" 2 "4HI" 3 "2WD" 4 "NEUTRAL" 5 "SYNC_IPG" 6 "4WDLock" 7 "SNA";
VAL_ 517 CCMFailSts 0 "FailNotPresent" 1 "FailPresent";
VAL_ 517 DrvLnMinTrqMd 0 "False" 1 "True";
VAL_ 517 DrvLnTrqRq 511 "SNA";
VAL_ 517 Ft_RrCouplingTrq_Actual 255 "SNA";
VAL_ 517 Ft_RrCouplingTrq_Desired 255 "SNA";
VAL_ 1447 CNT_DIFF_MOD 0 "FREE" 1 " ESP_OPEN" 2 " ESP_HOLD" 3 " CMD_FLT" 4 " Currently Not used" 5 " Currently Not used" 6 " Currently Not used" 7 " SNA";
VAL_ 1447 DTCM_HMI_Rq 0 "No_request" 1 "SCREEN_1" 2 "SCREEN_2" 3 "SCREEN_3" 4 "SCREEN_4" 5 "SCREEN_5" 6 "SCREEN_6" 7 "SCREEN_7" 8 "SCREEN_8" 9 "SCREEN_9" 10 "SCREEN_10" 11 "SCREEN_11" 12 "SCREEN_12" 13 "SCREEN_13" 14 "SCREEN_14" 15 "SCREEN_15" 16 "SCREEN_16" 17 "SCREEN_17" 18 "SCREEN_18" 19 "SCREEN_19" 20 "SCREEN_20" 21 "SCREEN_21" 22 "SCREEN_22" 23 "SCREEN_23" 24 "SCREEN_24" 25 "SCREEN_25" 26 "SCREEN_26" 27 "SCREEN_27" 28 "SCREEN_28" 29 "SCREEN_29" 30 "SCREEN_30" 31 "SNA";
VAL_ 1447 TerSt_SWITCH1 0 "Off" 1 "Continuous" 2 "Blink" 3 "SNA";
VAL_ 1447 TerSt_SWITCH2 0 "Off" 1 "Continuous" 2 "Blink" 3 "SNA";
VAL_ 1068 AxleLckr_SRV_RQ 0 "OFF" 1 "ON" 2 "BLINK" 3 "SNA";
VAL_ 1068 AxleLckr_Stat 0 "Unlocked" 1 "Rear_Locked" 2 "Front_Rear_Locked" 3 "SNA";
VAL_ 1068 AxleLckrEvicDisp 0 "None" 1 "SCREEN_1" 2 "SCREEN_2" 3 "SCREEN_3" 4 "SCREEN_4" 5 "SCREEN_5" 6 "SCREEN_6" 7 "SCREEN_7" 8 "SCREEN_8" 9 "SCREEN_9" 10 "SCREEN_10" 11 "SCREEN_11" 12 "SCREEN_12" 13 "SCREEN_13" 14 "SCREEN_14" 15 "SCREEN_15" 16 "SCREEN_16" 17 "SCREEN_17" 18 "SCREEN_18" 19 "SCREEN_19" 20 "SCREEN_20" 21 "SCREEN_21" 22 "SCREEN_22" 23 "SCREEN_23" 24 "SCREEN_24" 25 "SCREEN_25" 26 "SCREEN_26" 27 "SCREEN_27" 28 "SCREEN_28" 29 "SCREEN_29" 30 "SCREEN_30" 31 "SNA";
VAL_ 1068 DTCM_Vehicle_Hold_Rq 0 "NotActive" 1 "Active";
VAL_ 1068 RrAxleLockerIndRq 0 "OFF" 1 "ON" 2 "BLINK" 3 "SNA";
VAL_ 1068 Tcase2WD_Stat 0 "OFF" 1 "ON" 2 "BLINK" 3 "SNA";
VAL_ 1068 Tcase4Lock 0 "OFF" 1 "ON" 2 "BLINK" 3 "SNA";
VAL_ 1068 TcaseAWD 0 "OFF" 1 "ON" 2 "BLINK" 3 "SNA";
VAL_ 1068 TCASERANGESTATUS 0 "HIGH" 1 "NTRL" 2 "LOW" 3 "SNA";
VAL_ 1438 DM_Camera_Blind 0 "Unknown" 1 "Not_Occluded" 2 "Partial_Occluded" 3 "Feature_Not_Aval";
VAL_ 1438 DM_Distract_State 0 "Unknown" 1 "Not_Distracted" 2 "Partially_Distracted" 3 "Fully_Distracted";
VAL_ 1438 DM_Drowsy_Micro 0 "False" 1 "True";
VAL_ 1438 DM_Drowsy_State 0 "Unknown" 1 "Not_Drowsy" 2 "Partially_Drowsy" 3 "Fully_Drowsy";
VAL_ 1438 DM_Eyes_Tracked 0 "False" 1 "True";
VAL_ 1438 DM_Steering_Angle_Blockage 0 "False" 1 "True";
VAL_ 1438 DM_Zone_Track 0 "Unknown" 1 "On_Road" 2 "Cluster" 3 "Left_Mirror" 4 "Right_Mirror" 5 "Radio" 6 "Rear_View_Mirror" 7 "Off_Road";
VAL_ 1438 DMSM_System_Stat 0 "Standby" 1 "Temp_NA" 2 "Internal_Error" 3 "Functional";
VAL_ 1438 Driver_Presence 0 "Not_Present" 1 "Present";
VAL_ 1054 ACPressure 511 "SNA";
VAL_ 1054 ACPressureFailSts 0 "Fail_Not_Present" 1 "Fail_Present";
VAL_ 1054 AGS2Posn 127 "SNA";
VAL_ 1054 AtmosphericPressure_W 255 "SNA";
VAL_ 1054 AtmosphericPressureFailSts_W 0 "Fail_Not_Present" 1 "Fail_Present";
VAL_ 1054 BoostVacGauge 255 "SNA";
VAL_ 1054 EngMaxRPM_W 255 "SNA";
VAL_ 1054 HighPressureFuelSystemFailure 0 "No_Fault" 1 "Fault";
VAL_ 1054 ThermalManagementActive_W 0 "Not_active" 1 "Active";
VAL_ 1054 TransWarmUpMin_RPM 255 "SNA";
VAL_ 1054 TransWarmUpReq 0 "WarmUp_Not_Enabled" 1 "WarmUp_Enabled";
VAL_ 262 AlternatorFail_W 0 "Alternator_Fail" 1 "Alternator_Not_In_Fail";
VAL_ 262 CrankHold_W 0 "Not_Active" 1 "Active";
VAL_ 262 ECM_Ack_DriveMode 0 "No_programs_available_selected" 1 "Eco" 2 "Sport" 3 "Valet" 4 "Ice_Winter" 5 "Tow_Haul" 6 "Track" 7 "4LowMode" 8 "HDC_SSC" 9 "Rock" 10 "Sand" 11 "Mud" 12 "Normal" 13 "Mud_Sand";
VAL_ 262 ECM_LHOM_Trans_W 0 "Limp Home not Active" 1 "No Redundant Torque Req" 2 "Precise Torque +/-15%" 3 "Imprecise Torque";
VAL_ 262 ECM_LHOM_W 0 "Not_In_Limp_Home" 1 "In_Limp_Home";
VAL_ 262 EngineFrictionTorque_W 511 "SNA";
VAL_ 262 EngineIdleRefSpeed 4095 "SNA";
VAL_ 262 EngineSailingRq 0 "Not_Request" 1 "Request";
VAL_ 262 EngineSpeed_W 16383 "SNA";
VAL_ 262 EngineSpeedFailSts_W 0 "Fail_not_present" 1 "Fail_present";
VAL_ 262 EngineSts_W 0 "Engine_Off" 1 "Engine_Cranking" 2 "Engine_On" 3 "SNA";
VAL_ 262 EngRPM_Tach 65535 "SNA";
VAL_ 262 EngTrq_Enbl_Rq_TCM_W 0 "Not_Active" 1 "Active";
VAL_ 262 ESS_EBOOST_BRKHLD_STATUS 0 "Default_Hold_BSM" 1 "ImmediateRelease" 2 "PositiveGradeTorqueBlending" 3 "NegativeGradeTorqueBlending" 7 "SNA";
VAL_ 262 ESS_ENG_ST_W 1 "ENS Stopped / ENS_STOPPED" 2 "ENS Request Start / ENS_RQ_ST" 3 "ENS Running / ENS_RUN" 4 "ENS Stop Pending / ENS_STOP_PEND" 5 "ENS Start protection / ENS_ST_PRTCT" 6 "ENS Start inhibit / ENS_ST_INH" 7 "ENS disabled / ENS_DSBL" 8 "ENS_IHB_LATCH" 9 "ENS Starting / ENS_Starting" 15 "SNA";
VAL_ 262 EVRDesiredSetpoint 255 "SNA";
VAL_ 262 FullOFC_Actv 0 "Not_Active" 1 "Active";
VAL_ 262 GasPedalGradient_W 255 "SNA";
VAL_ 262 GasPedalPosition_W 255 "SNA";
VAL_ 262 GasPedalPositionFailSts_W 0 "Fail_not_present" 1 "Fail_present";
VAL_ 262 IntakeAirTemperature_W 255 "SNA";
VAL_ 262 KickDownRequest_W 0 "No_kd_request" 1 "Kd_request";
VAL_ 262 LV12PwrFreeRq_W 0 "Level 1 or 2 Power free Mode NOT active" 1 "Level 1 or 2 Power free Mode Active";
VAL_ 262 PowertrainPrplsnActv 0 "Off" 1 "Active";
VAL_ 262 StartRelayBCMCmd_W 0 "Not_Action" 1 "Action";
VAL_ 262 TRANS_CLU_SLIP_MODE_W 0 "NORMAL" 1 "MDS_RQ" 2 "IDFSO_RQ" 3 "AC_EN_DIS_RQ" 4 "IDFSO_ACTIVE" 5 "MDS_IDFSO_ACT" 7 "SNA";
VAL_ 262 TxAC_EMCC_rq_W 0 "False" 1 "True";
VAL_ 1036 AfterRunCoolantPumpFailSts 0 "Fault_Not_Present" 1 "Fault_Present";
VAL_ 1036 AxleInAir_Stat 0 "None" 1 "Rough_terrain" 2 "Front_in_air" 3 "Rear_in_air" 4 "Both_in_air" 7 "SNA";
VAL_ 1036 CoolVlvPos 255 "SNA";
VAL_ 1036 DefFuelEcon 255 "SNA";
VAL_ 1036 DistOilLifeRst 65535 "SNA";
VAL_ 1036 ECM_Thermal_AAD_Request 0 "Normal_Level" 1 "Low_Level";
VAL_ 1036 EngineOilCritical 0 "False" 1 "True";
VAL_ 1036 EngineOilLevel 0 "Level1" 1 "Level2" 2 "Level3" 3 "Level4" 4 "Level5" 5 "Level6" 6 "Level7" 7 "Level8" 8 "Level9" 9 "Level10" 10 "Level11" 11 "Level12" 12 "Level13" 13 "Level14" 31 "SNA";
VAL_ 1036 EngineOilMin 0 "False" 1 "True";
VAL_ 1036 EngineOilOverfill 0 "False" 1 "True";
VAL_ 1036 EngineOilTemperature 255 "SNA";
VAL_ 1036 FANStatus 127 "SNA";
VAL_ 1036 OIL_IND_LMP_FLSH 0 "Not_active" 1 "Active";
VAL_ 1036 OIL_TEMP_CHM_RQ 0 "NONE" 1 "SINGLE" 2 "SLOW" 3 "FAST";
VAL_ 1036 OIL_TEMP_IND_RQ 0 "OFF" 1 "ON" 2 "FLASH" 3 "SNA";
VAL_ 1036 OilLifeLeft 255 "SNA";
VAL_ 1036 OilLifeLeftRst 0 "Not_Active" 1 "Active";
VAL_ 1036 PT_WorkSite_Invtr_Sts_ECM 0 "NOT_ACTIVE" 1 "ACTIVE" 3 "SNA";
VAL_ 518 AirFuelRatio 255 "SNA";
VAL_ 518 ECM_CODE_CLR_W 0 "Not Cleared" 1 "Cleared";
VAL_ 518 ECM_READINESS_RESET_W 0 "Not Set" 1 "Set";
VAL_ 518 EngineReadyForESS_W 0 "Not_Active" 1 "Active";
VAL_ 518 EngTrqMaxCorrFctr_W 255 "SNA";
VAL_ 518 GrMin_Rq_ECM_W 0 "Passive" 1 "G1" 2 "G2" 3 "G3" 4 "G4" 5 "G5" 6 "G6" 7 "G7" 8 "G8" 9 "G9";
VAL_ 518 IntkAirTempIntrClr 255 "SNA";
VAL_ 518 LTR_CoolantTemp 255 "SNA";
VAL_ 518 PdlPosActual 255 "SNA";
VAL_ 518 RPMOverRev_W 0 "FALSE" 1 "TRUE";
VAL_ 751 DrvAway_Alert 0 "FALSE" 1 "TRUE";
VAL_ 751 DrvAway_Indications 0 "No_Indication" 1 "DrvAway_Shft_Corr" 2 "DrvAway_Auto_Stop";
VAL_ 751 DrvAway_Inhibit 0 "FALSE" 1 "TRUE";
VAL_ 751 ECM_FOTA_Conflict 0 "False" 1 "True";
VAL_ 751 ECM_MSG_RQ 0 "NONE" 1 "SCREEN_1" 2 "SCREEN_2" 3 "SCREEN_3" 4 "SCREEN_4" 5 "SCREEN_5" 6 "SCREEN_6" 7 "SCREEN_7" 8 "SCREEN_8" 9 "SCREEN_9" 10 "SCREEN_10" 11 "SCREEN_11" 12 "SCREEN_12" 13 "SCREEN_13" 14 "SCREEN_14" 15 "SCREEN_15" 16 "SCREEN_16" 17 "SCREEN_17" 18 "SCREEN_18" 19 "SCREEN_19" 20 "SCREEN_20" 21 "SCREEN_21" 22 "SCREEN_22" 23 "SCREEN_23" 24 "SCREEN_24" 25 "SCREEN_25" 26 "SCREEN_26" 27 "SCREEN_27" 28 "SCREEN_28" 29 "SCREEN_29" 30 "SCREEN_30" 31 "SNA";
VAL_ 751 EngineWaterTemp 255 "SNA";
VAL_ 751 FuelConsumption_GAG 65535 "SNA";
VAL_ 751 GearShiftIndication 0 "No_Gearshift_Suggestion_by_ECM" 1 "Downshift_Suggestion_by_ECM" 2 "Upshift_Suggestion_by_ECM" 3 "Strategy_Not_Available_ECM_Fail";
VAL_ 751 HP_MODE_STS 0 "NONE" 1 "VALET" 2 "BLACK" 3 "RED" 7 "SNA";
VAL_ 751 LeakCheckTimerValue 511 "SNA";
VAL_ 751 LeakTestRequest 0 "No_Request" 1 "Leak_Test_Requested";
VAL_ 751 LeakTestSts 0 "NONE" 1 "PEND" 2 "COMPLETE" 3 "DELAY";
VAL_ 751 SAMInfo 0 "OFF" 1 "Engine_OFF" 2 "Cranking_management" 3 "ColdEngineManagement" 4 "Eassist_Ready" 5 "Steady_State" 6 "Regenerative_Braking_BSG" 7 "Quick_Charge" 8 "Auto_Shut_OFF" 9 "Shut_OFF" 10 "SAM_recovery" 11 "Battery_Regeneration" 12 "STOP_START" 13 "E_Assist" 14 "NEUTRAL" 15 "SNA";
VAL_ 751 Selector_SystemFailSts 0 "Fail_Not_Present" 1 "Fail_Present";
VAL_ 751 StarterProtectionTime 255 "SNA";
VAL_ 751 StartProtectionInhibit 0 "Default" 2 "Crank_Inhibit" 3 "SNA";
VAL_ 751 StartRelayBCMFeedbackFault 0 "False" 1 "True";
VAL_ 751 StartRelayECMFeedbackFault 0 "False" 1 "True";
VAL_ 751 Terrain_HMI_Rq_ECM 0 "No_Request" 1 "SCREEN_1" 2 "SCREEN_2" 3 "SCREEN_3" 4 "SCREEN_4" 5 "SCREEN_5" 6 "SCREEN_6" 7 "SCREEN_7" 8 "SCREEN_8" 9 "SCREEN_9" 10 "SCREEN_10" 11 "SCREEN_11" 12 "SCREEN_12" 13 "SCREEN_13" 14 "SCREEN_14" 15 "SCREEN_15" 16 "SCREEN_16" 17 "SCREEN_17" 18 "SCREEN_18" 19 "SCREEN_19" 20 "SCREEN_20" 21 "SCREEN_21" 22 "SCREEN_22" 23 "SCREEN_23" 24 "SCREEN_24" 25 "SCREEN_25" 26 "SCREEN_26" 27 "SCREEN_27" 28 "SCREEN_28" 29 "SCREEN_29" 30 "SCREEN_30" 31 "SNA";
VAL_ 751 TerrainModeDesiredStat 0 "Auto" 1 "Auto_Fault" 2 "Rock" 3 "Track" 4 "Snow" 5 "Offroad" 6 "Eco" 7 "Corsa" 8 "Sport" 9 "Mud_Sand" 10 "Mud" 11 "Sand" 12 "Valet" 13 "Custom" 14 "Tow" 15 "DRAG" 16 "BAJA" 31 "SNA";
VAL_ 751 TerrainModeInterfaceButton_ECM 0 "Not_Activated" 1 "Activated" 5 "Short_to_Ground_Fault" 6 "Open_Short_to_Power_Fault" 7 "SNA";
VAL_ 751 TerrainModeStat_ECM 0 "Auto" 1 "Auto_Fault" 2 "Rock" 3 "Track" 4 "Snow" 5 "Offroad" 6 "Eco" 7 "Corsa" 8 "Sport" 9 "Mud_Sand" 10 "Mud" 11 "Sand" 12 "Valet" 13 "Custom" 14 "Tow" 15 "DRAG" 16 "BAJA" 31 "SNA";
VAL_ 751 Trns_DrvMd_CfgSts_ECM 0 "NP" 1 "STREET" 2 "VALET" 3 "SPORT" 4 "S_PLUS" 5 "TRACK" 6 "ECO" 7 "SNOW" 8 "ROCK " 9 "TOW" 10 "DRAG" 11 "MUD" 12 "SAND" 13 "BAJA" 14 "OFFROAD" 31 "SNA";
VAL_ 751 Trns_DrvMdReq_ECM 0 "NP" 1 "STREET" 2 "VALET" 3 "SPORT" 4 "S_PLUS" 5 "TRACK" 6 "ECO" 7 "SNOW" 8 "ROCK " 9 "TOW" 10 "DRAG" 11 "MUD" 12 "SAND" 13 "BAJA" 14 "OFFROAD" 31 "SNA";
VAL_ 1448 CompressorSts 0 "Not_Used" 1 "Not_inserted_by_NCM" 2 "Not_insrtd_by_driver_or_security" 3 "Inserted";
VAL_ 1448 ECM_THA_Resp 0 "Off" 1 "Active" 3 "SNA";
VAL_ 1448 ECM_TRSC_Resp 0 "OFF" 1 "Active" 3 "SNA";
VAL_ 1448 ECM_WARN_BTO 0 "Not_Active" 1 "Active";
VAL_ 1448 ECM_WARN_BTO_1 0 "Not_Active" 1 "Active";
VAL_ 1448 EMSFailSts 0 "Fail_Not_Present" 1 "Fail_Flash_Light_Indication" 2 "Fail_Fix_Light_Indication" 3 "Flash_For_Service";
VAL_ 1448 EngineOperatingMode 0 "Normal" 1 "DPF Regeneration LO" 2 "DPF Regeneration HI" 3 "NSC DeNOx Regeneration" 4 "NSC DeSOx Regeneration" 5 "SCR Heat-up strategy";
VAL_ 1448 ETCFailSts 0 "Fail_Not_Present" 1 "Fail_Flash_Light_Indication" 2 "Fail_Fix_Light_Indication" 3 "Flash_For_Service";
VAL_ 1448 ExhaustTemperature 255 "SNA";
VAL_ 1448 FuelMM_Sts 0 "INACTIVE" 1 "ACTIVE" 2 "DISABLED";
VAL_ 1448 HoursOilLifeRst 4095 "SNA";
VAL_ 1448 KNK_MG_TRIGGER 0 "LSPI_NO_MESSAGE" 1 "LSPI_LEVEL_1" 2 "LSPI_LEVEL_2" 3 "LSPI_LEVEL_3";
VAL_ 1448 MntncSts 0 "NONE" 1 "SOON" 2 "NOW" 3 "SNA";
VAL_ 1448 OilLifeSts 0 "Normal_Oil_Properties" 1 "Oil_Life_Reset" 2 "Change_Oil_Required" 3 "Not_used";
VAL_ 1448 OilPressureSts 0 "Normal_Pressure" 1 "Low_Pressure";
VAL_ 1448 PerfShftRq_HUD 0 "DISABLE_MUTE" 1 "PRE_SHIFT 1" 2 "PRE_SHIFT 2" 3 "SHIFT NOW";
VAL_ 1448 SpStDispstat 0 "NONE" 3 "ACTIVE" 1 "PCR_OPENS" 4 "D_OR_SB" 5 "NR_DRV_NOT_DET" 6 "DR_INHIB" 7 "TX_INHIB" 8 "KEY" 9 "BATT" 10 "SYSFLT" 11 "NR" 12 "READY" 13 "OFF" 14 "HOOD" 15 "PEDAL" 16 "BATT_CHG" 17 "TM" 18 "T4WD_L" 20 "INCLINE" 21 "AMB_TEMP" 23 "SB" 24 "DR_AJAR" 25 "CABIN" 26 "MAX_HVAC" 27 "FT_DEFROST" 29 "ST_WHEEL" 30 "Eng_Temp_Hi" 31 "Eng_Temp_Lo" 32 "Prk_Brk_Inhib" 33 "Park_Inhib" 34 "Hood_Inhib" 35 "DPF_Regen" 38 "BATT_HIGH" 63 "SNA";
VAL_ 1448 SpStIndRq 0 "Not_Active" 1 "Active";
VAL_ 1448 SpStSwStat 0 "OFF" 1 "CONT" 2 "BLINK" 3 "SNA";
VAL_ 1055 AM_ECM_Prsnt 0 "DEFAULT" 2 "AM_ECM_PRESENT" 3 "SNA";
VAL_ 1055 GF_Charge 65535 "SNA";
VAL_ 1055 LTR_TARGET_TEMP 254 "Failure" 255 "SNA";
VAL_ 1055 MAP_4_BAR 511 "SNA";
VAL_ 1055 MdsAct 0 "Not Active" 1 "Active";
VAL_ 1055 MdsActforANC 0 "Not Active" 1 "Active";
VAL_ 1055 OIL_PRESS 255 "SNA";
VAL_ 1055 PSI_EnableSts 0 "Not_Enabled" 1 "Enabled";
VAL_ 1055 PSI_Gr1_RPM 31 "SNA";
VAL_ 1055 PSI_Gr2_RPM 31 "SNA";
VAL_ 1055 PSI_Gr3_RPM 31 "SNA";
VAL_ 1055 PSI_Gr4_RPM 31 "SNA";
VAL_ 1055 PSI_Gr5_RPM 31 "SNA";
VAL_ 1055 RACE_CLDWN_DEAC_TIME 1023 "SNA";
VAL_ 1055 RefuelEvent 0 "NONE" 1 "PEND" 2 "TRUE" 3 "COMP" 4 "FAULT";
VAL_ 1055 RefuelIndication 0 "NONE" 1 "WAIT" 2 "PARK" 3 "OK" 4 "DOOR" 5 "BLOCKAGE" 6 "SERVICE";
VAL_ 1055 RevOilLifeRst 65535 "SNA";
