VERSION ""

NS_ :

BS_:

BU_: External_Tool CADM LRRF MRRRL MRRRR

BO_ 91 LRRF1_Detection_120_126: 64 LRRF
 SG_ LRRF1_CAN_DET_Near_TARGET_126 : 454|1@0+ (1,0) [0|1] ""  CADM
 SG_ LRRF1_CAN_DET_Near_TARGET_125 : 453|1@0+ (1,0) [0|1] ""  CADM
 SG_ LRRF1_CAN_DET_Near_TARGET_124 : 452|1@0+ (1,0) [0|1] ""  CADM
 SG_ LRRF1_CAN_DET_Near_TARGET_123 : 451|1@0+ (1,0) [0|1] ""  CADM
 SG_ LRRF1_CAN_DET_Near_TARGET_122 : 450|1@0+ (1,0) [0|1] ""  CADM
 SG_ LRRF1_CAN_DET_Near_TARGET_121 : 449|1@0+ (1,0) [0|1] ""  CADM
 SG_ LRRF1_CAN_DET_Near_TARGET_120 : 448|1@0+ (1,0) [0|1] ""  CADM
 SG_ LRRF1_CAN_DET_ELEVATION_120 : 63|7@0+ (0.002748,-0.1745) [-0.1745|0.174496] "rad"  CADM
 SG_ LRRF1_CAN_DET_CONFID_AZIMUTH_120 : 33|2@0+ (1,0) [0|3] ""  CADM
 SG_ LRRF1_CAN_DET_SUPER_RES_TAR_0007 : 56|1@0+ (1,0) [0|1] ""  CADM
 SG_ LRRF1_CAN_DET_CONFID_ELEVAT_0007 : 48|1@0+ (1,0) [0|1] ""  CADM
 SG_ LRRF1_CAN_DET_HOST_VEH_CLUT_0007 : 49|1@0+ (1,0) [0|1] ""  CADM
 SG_ LRRF1_CAN_DET_VALID_LEVEL_120 : 0|1@0+ (1,0) [0|1] ""  CADM
 SG_ LRRF1_CAN_DET_AZIMUTH_120 : 47|14@0+ (0.0003834,-3.1416) [-3.1416|3.1396422] "rad"  CADM
 SG_ LRRF1_CAN_DET_RANGE_120 : 31|14@0+ (0.015625,0) [0|255.984375] "m"  CADM
 SG_ LRRF1_CAN_DET_RANGE_RATE_120 : 15|14@0+ (0.015625,-128) [-128|127.984375] "m/s"  CADM
 SG_ LRRF1_CAN_DET_AMPLITUDE_120 : 7|7@0+ (1,-64) [-64|63] "dBsm"  CADM
 SG_ LRRF1_CAN_SCAN_INDEX_2LSB_120 : 17|2@0+ (1,0) [0|3] ""  CADM
 SG_ LRRF1_Det_CRC_18 : 503|16@0+ (1,0) [0|65535] ""  CADM
 SG_ LRRF1_Det_MC_18 : 491|4@0+ (1,0) [0|15] ""  CADM
 SG_ LRRF1_CAN_SCAN_INDEX_2LSB_126 : 401|2@0+ (1,0) [0|3] ""  CADM
 SG_ LRRF1_CAN_SCAN_INDEX_2LSB_125 : 337|2@0+ (1,0) [0|3] ""  CADM
 SG_ LRRF1_CAN_SCAN_INDEX_2LSB_124 : 273|2@0+ (1,0) [0|3] ""  CADM
 SG_ LRRF1_CAN_SCAN_INDEX_2LSB_123 : 209|2@0+ (1,0) [0|3] ""  CADM
 SG_ LRRF1_CAN_SCAN_INDEX_2LSB_122 : 145|2@0+ (1,0) [0|3] ""  CADM
 SG_ LRRF1_CAN_SCAN_INDEX_2LSB_121 : 81|2@0+ (1,0) [0|3] ""  CADM
 SG_ LRRF1_CAN_DET_RANGE_RATE_126 : 399|14@0+ (0.015625,-128) [-128|127.984375] "m/s"  CADM
 SG_ LRRF1_CAN_DET_RANGE_RATE_125 : 335|14@0+ (0.015625,-128) [-128|127.984375] "m/s"  CADM
 SG_ LRRF1_CAN_DET_RANGE_RATE_124 : 271|14@0+ (0.015625,-128) [-128|127.984375] "m/s"  CADM
 SG_ LRRF1_CAN_DET_RANGE_RATE_123 : 207|14@0+ (0.015625,-128) [-128|127.984375] "m/s"  CADM
 SG_ LRRF1_CAN_DET_RANGE_RATE_122 : 143|14@0+ (0.015625,-128) [-128|127.984375] "m/s"  CADM
 SG_ LRRF1_CAN_DET_RANGE_RATE_121 : 79|14@0+ (0.015625,-128) [-128|127.984375] "m/s"  CADM
 SG_ LRRF1_CAN_DET_RANGE_126 : 415|14@0+ (0.015625,0) [0|255.984375] "m"  CADM
 SG_ LRRF1_CAN_DET_RANGE_125 : 351|14@0+ (0.015625,0) [0|255.984375] "m"  CADM
 SG_ LRRF1_CAN_DET_RANGE_124 : 287|14@0+ (0.015625,0) [0|255.984375] "m"  CADM
 SG_ LRRF1_CAN_DET_RANGE_123 : 223|14@0+ (0.015625,0) [0|255.984375] "m"  CADM
 SG_ LRRF1_CAN_DET_RANGE_122 : 159|14@0+ (0.015625,0) [0|255.984375] "m"  CADM
 SG_ LRRF1_CAN_DET_RANGE_121 : 95|14@0+ (0.015625,0) [0|255.984375] "m"  CADM
 SG_ LRRF1_CAN_DET_SUPER_RES_TAR_0008 : 432|1@0+ (1,0) [0|1] ""  CADM
 SG_ LRRF1_CAN_DET_SUPER_RES_TAR_0009 : 368|1@0+ (1,0) [0|1] ""  CADM
 SG_ LRRF1_CAN_DET_SUPER_RES_TAR_0010 : 304|1@0+ (1,0) [0|1] ""  CADM
 SG_ LRRF1_CAN_DET_SUPER_RES_TAR_0011 : 240|1@0+ (1,0) [0|1] ""  CADM
 SG_ LRRF1_CAN_DET_SUPER_RES_TAR_0012 : 176|1@0+ (1,0) [0|1] ""  CADM
 SG_ LRRF1_CAN_DET_SUPER_RES_TAR_0013 : 112|1@0+ (1,0) [0|1] ""  CADM
 SG_ LRRF1_CAN_DET_HOST_VEH_CLUT_0008 : 433|1@0+ (1,0) [0|1] ""  CADM
 SG_ LRRF1_CAN_DET_HOST_VEH_CLUT_0009 : 369|1@0+ (1,0) [0|1] ""  CADM
 SG_ LRRF1_CAN_DET_HOST_VEH_CLUT_0010 : 305|1@0+ (1,0) [0|1] ""  CADM
 SG_ LRRF1_CAN_DET_HOST_VEH_CLUT_0011 : 241|1@0+ (1,0) [0|1] ""  CADM
 SG_ LRRF1_CAN_DET_HOST_VEH_CLUT_0012 : 177|1@0+ (1,0) [0|1] ""  CADM
 SG_ LRRF1_CAN_DET_HOST_VEH_CLUT_0013 : 113|1@0+ (1,0) [0|1] ""  CADM
 SG_ LRRF1_CAN_DET_ELEVATION_126 : 447|7@0+ (0.002748,-0.1745) [-0.1745|0.174496] "rad"  CADM
 SG_ LRRF1_CAN_DET_ELEVATION_125 : 383|7@0+ (0.002748,-0.1745) [-0.1745|0.174496] "rad"  CADM
 SG_ LRRF1_CAN_DET_ELEVATION_124 : 319|7@0+ (0.002748,-0.1745) [-0.1745|0.174496] "rad"  CADM
 SG_ LRRF1_CAN_DET_ELEVATION_123 : 255|7@0+ (0.002748,-0.1745) [-0.1745|0.174496] "rad"  CADM
 SG_ LRRF1_CAN_DET_ELEVATION_122 : 191|7@0+ (0.002748,-0.1745) [-0.1745|0.174496] "rad"  CADM
 SG_ LRRF1_CAN_DET_ELEVATION_121 : 127|7@0+ (0.002748,-0.1745) [-0.1745|0.174496] "rad"  CADM
 SG_ LRRF1_CAN_DET_CONFID_ELEVAT_0008 : 440|1@0+ (1,0) [0|1] ""  CADM
 SG_ LRRF1_CAN_DET_CONFID_ELEVAT_0009 : 376|1@0+ (1,0) [0|1] ""  CADM
 SG_ LRRF1_CAN_DET_CONFID_ELEVAT_0010 : 312|1@0+ (1,0) [0|1] ""  CADM
 SG_ LRRF1_CAN_DET_CONFID_ELEVAT_0011 : 248|1@0+ (1,0) [0|1] ""  CADM
 SG_ LRRF1_CAN_DET_CONFID_ELEVAT_0012 : 184|1@0+ (1,0) [0|1] ""  CADM
 SG_ LRRF1_CAN_DET_CONFID_ELEVAT_0013 : 120|1@0+ (1,0) [0|1] ""  CADM
 SG_ LRRF1_CAN_DET_CONFID_AZIMUTH_126 : 417|2@0+ (1,0) [0|3] ""  CADM
 SG_ LRRF1_CAN_DET_CONFID_AZIMUTH_125 : 353|2@0+ (1,0) [0|3] ""  CADM
 SG_ LRRF1_CAN_DET_CONFID_AZIMUTH_124 : 289|2@0+ (1,0) [0|3] ""  CADM
 SG_ LRRF1_CAN_DET_CONFID_AZIMUTH_123 : 225|2@0+ (1,0) [0|3] ""  CADM
 SG_ LRRF1_CAN_DET_CONFID_AZIMUTH_122 : 161|2@0+ (1,0) [0|3] ""  CADM
 SG_ LRRF1_CAN_DET_CONFID_AZIMUTH_121 : 97|2@0+ (1,0) [0|3] ""  CADM
 SG_ LRRF1_CAN_DET_AZIMUTH_126 : 431|14@0+ (0.0003834,-3.1416) [-3.1416|3.1396422] "rad"  CADM
 SG_ LRRF1_CAN_DET_AZIMUTH_125 : 367|14@0+ (0.0003834,-3.1416) [-3.1416|3.1396422] "rad"  CADM
 SG_ LRRF1_CAN_DET_AZIMUTH_124 : 303|14@0+ (0.0003834,-3.1416) [-3.1416|3.1396422] "rad"  CADM
 SG_ LRRF1_CAN_DET_AZIMUTH_123 : 239|14@0+ (0.0003834,-3.1416) [-3.1416|3.1396422] "rad"  CADM
 SG_ LRRF1_CAN_DET_AZIMUTH_122 : 175|14@0+ (0.0003834,-3.1416) [-3.1416|3.1396422] "rad"  CADM
 SG_ LRRF1_CAN_DET_AZIMUTH_121 : 111|14@0+ (0.0003834,-3.1416) [-3.1416|3.1396422] "rad"  CADM
 SG_ LRRF1_CAN_DET_AMPLITUDE_126 : 391|7@0+ (1,-64) [-64|63] "dBsm"  CADM
 SG_ LRRF1_CAN_DET_AMPLITUDE_125 : 327|7@0+ (1,-64) [-64|63] "dBsm"  CADM
 SG_ LRRF1_CAN_DET_AMPLITUDE_124 : 263|7@0+ (1,-64) [-64|63] "dBsm"  CADM
 SG_ LRRF1_CAN_DET_AMPLITUDE_123 : 199|7@0+ (1,-64) [-64|63] "dBsm"  CADM
 SG_ LRRF1_CAN_DET_AMPLITUDE_122 : 135|7@0+ (1,-64) [-64|63] "dBsm"  CADM
 SG_ LRRF1_CAN_DET_AMPLITUDE_121 : 71|7@0+ (1,-64) [-64|63] "dBsm"  CADM
 SG_ LRRF1_CAN_DET_VALID_LEVEL_126 : 384|1@0+ (1,0) [0|1] ""  CADM
 SG_ LRRF1_CAN_DET_VALID_LEVEL_125 : 320|1@0+ (1,0) [0|1] ""  CADM
 SG_ LRRF1_CAN_DET_VALID_LEVEL_124 : 256|1@0+ (1,0) [0|1] ""  CADM
 SG_ LRRF1_CAN_DET_VALID_LEVEL_123 : 192|1@0+ (1,0) [0|1] ""  CADM
 SG_ LRRF1_CAN_DET_VALID_LEVEL_122 : 128|1@0+ (1,0) [0|1] ""  CADM
 SG_ LRRF1_CAN_DET_VALID_LEVEL_121 : 64|1@0+ (1,0) [0|1] ""  CADM

BO_ 90 LRRF1_Detection_113_119: 64 LRRF
 SG_ LRRF1_CAN_DET_Near_TARGET_119 : 454|1@0+ (1,0) [0|1] ""  CADM
 SG_ LRRF1_CAN_DET_Near_TARGET_118 : 453|1@0+ (1,0) [0|1] ""  CADM
 SG_ LRRF1_CAN_DET_Near_TARGET_117 : 452|1@0+ (1,0) [0|1] ""  CADM
 SG_ LRRF1_CAN_DET_Near_TARGET_116 : 451|1@0+ (1,0) [0|1] ""  CADM
 SG_ LRRF1_CAN_DET_Near_TARGET_115 : 450|1@0+ (1,0) [0|1] ""  CADM
 SG_ LRRF1_CAN_DET_Near_TARGET_114 : 449|1@0+ (1,0) [0|1] ""  CADM
 SG_ LRRF1_CAN_DET_Near_TARGET_113 : 448|1@0+ (1,0) [0|1] ""  CADM
 SG_ LRRF1_CAN_DET_ELEVATION_113 : 63|7@0+ (0.002748,-0.1745) [-0.1745|0.174496] "rad"  CADM
 SG_ LRRF1_CAN_DET_CONFID_AZIMUTH_113 : 33|2@0+ (1,0) [0|3] ""  CADM
 SG_ LRRF1_CAN_DET_SUPER_RES_TAR_0014 : 56|1@0+ (1,0) [0|1] ""  CADM
 SG_ LRRF1_CAN_DET_CONFID_ELEVAT_0014 : 48|1@0+ (1,0) [0|1] ""  CADM
 SG_ LRRF1_CAN_DET_HOST_VEH_CLUT_0014 : 49|1@0+ (1,0) [0|1] ""  CADM
 SG_ LRRF1_CAN_DET_VALID_LEVEL_113 : 0|1@0+ (1,0) [0|1] ""  CADM
 SG_ LRRF1_CAN_DET_AZIMUTH_113 : 47|14@0+ (0.0003834,-3.1416) [-3.1416|3.1396422] "rad"  CADM
 SG_ LRRF1_CAN_DET_RANGE_113 : 31|14@0+ (0.015625,0) [0|255.984375] "m"  CADM
 SG_ LRRF1_CAN_DET_RANGE_RATE_113 : 15|14@0+ (0.015625,-128) [-128|127.984375] "m/s"  CADM
 SG_ LRRF1_CAN_DET_AMPLITUDE_113 : 7|7@0+ (1,-64) [-64|63] "dBsm"  CADM
 SG_ LRRF1_CAN_SCAN_INDEX_2LSB_113 : 17|2@0+ (1,0) [0|3] ""  CADM
 SG_ LRRF1_Det_CRC_17 : 503|16@0+ (1,0) [0|65535] ""  CADM
 SG_ LRRF1_Det_MC_17 : 491|4@0+ (1,0) [0|15] ""  CADM
 SG_ LRRF1_CAN_SCAN_INDEX_2LSB_119 : 401|2@0+ (1,0) [0|3] ""  CADM
 SG_ LRRF1_CAN_SCAN_INDEX_2LSB_118 : 337|2@0+ (1,0) [0|3] ""  CADM
 SG_ LRRF1_CAN_SCAN_INDEX_2LSB_117 : 273|2@0+ (1,0) [0|3] ""  CADM
 SG_ LRRF1_CAN_SCAN_INDEX_2LSB_116 : 209|2@0+ (1,0) [0|3] ""  CADM
 SG_ LRRF1_CAN_SCAN_INDEX_2LSB_115 : 145|2@0+ (1,0) [0|3] ""  CADM
 SG_ LRRF1_CAN_SCAN_INDEX_2LSB_114 : 81|2@0+ (1,0) [0|3] ""  CADM
 SG_ LRRF1_CAN_DET_RANGE_RATE_119 : 399|14@0+ (0.015625,-128) [-128|127.984375] "m/s"  CADM
 SG_ LRRF1_CAN_DET_RANGE_RATE_118 : 335|14@0+ (0.015625,-128) [-128|127.984375] "m/s"  CADM
 SG_ LRRF1_CAN_DET_RANGE_RATE_117 : 271|14@0+ (0.015625,-128) [-128|127.984375] "m/s"  CADM
 SG_ LRRF1_CAN_DET_RANGE_RATE_116 : 207|14@0+ (0.015625,-128) [-128|127.984375] "m/s"  CADM
 SG_ LRRF1_CAN_DET_RANGE_RATE_115 : 143|14@0+ (0.015625,-128) [-128|127.984375] "m/s"  CADM
 SG_ LRRF1_CAN_DET_RANGE_RATE_114 : 79|14@0+ (0.015625,-128) [-128|127.984375] "m/s"  CADM
 SG_ LRRF1_CAN_DET_RANGE_119 : 415|14@0+ (0.015625,0) [0|255.984375] "m"  CADM
 SG_ LRRF1_CAN_DET_RANGE_118 : 351|14@0+ (0.015625,0) [0|255.984375] "m"  CADM
 SG_ LRRF1_CAN_DET_RANGE_117 : 287|14@0+ (0.015625,0) [0|255.984375] "m"  CADM
 SG_ LRRF1_CAN_DET_RANGE_116 : 223|14@0+ (0.015625,0) [0|255.984375] "m"  CADM
 SG_ LRRF1_CAN_DET_RANGE_115 : 159|14@0+ (0.015625,0) [0|255.984375] "m"  CADM
 SG_ LRRF1_CAN_DET_RANGE_114 : 95|14@0+ (0.015625,0) [0|255.984375] "m"  CADM
 SG_ LRRF1_CAN_DET_SUPER_RES_TAR_0015 : 432|1@0+ (1,0) [0|1] ""  CADM
 SG_ LRRF1_CAN_DET_SUPER_RES_TAR_0016 : 368|1@0+ (1,0) [0|1] ""  CADM
 SG_ LRRF1_CAN_DET_SUPER_RES_TAR_0017 : 304|1@0+ (1,0) [0|1] ""  CADM
 SG_ LRRF1_CAN_DET_SUPER_RES_TAR_0018 : 240|1@0+ (1,0) [0|1] ""  CADM
 SG_ LRRF1_CAN_DET_SUPER_RES_TAR_0019 : 176|1@0+ (1,0) [0|1] ""  CADM
 SG_ LRRF1_CAN_DET_SUPER_RES_TAR_0020 : 112|1@0+ (1,0) [0|1] ""  CADM
 SG_ LRRF1_CAN_DET_HOST_VEH_CLUT_0015 : 433|1@0+ (1,0) [0|1] ""  CADM
 SG_ LRRF1_CAN_DET_HOST_VEH_CLUT_0016 : 369|1@0+ (1,0) [0|1] ""  CADM
 SG_ LRRF1_CAN_DET_HOST_VEH_CLUT_0017 : 305|1@0+ (1,0) [0|1] ""  CADM
 SG_ LRRF1_CAN_DET_HOST_VEH_CLUT_0018 : 241|1@0+ (1,0) [0|1] ""  CADM
 SG_ LRRF1_CAN_DET_HOST_VEH_CLUT_0019 : 177|1@0+ (1,0) [0|1] ""  CADM
 SG_ LRRF1_CAN_DET_HOST_VEH_CLUT_0020 : 113|1@0+ (1,0) [0|1] ""  CADM
 SG_ LRRF1_CAN_DET_ELEVATION_119 : 447|7@0+ (0.002748,-0.1745) [-0.1745|0.174496] "rad"  CADM
 SG_ LRRF1_CAN_DET_ELEVATION_118 : 383|7@0+ (0.002748,-0.1745) [-0.1745|0.174496] "rad"  CADM
 SG_ LRRF1_CAN_DET_ELEVATION_117 : 319|7@0+ (0.002748,-0.1745) [-0.1745|0.174496] "rad"  CADM
 SG_ LRRF1_CAN_DET_ELEVATION_116 : 255|7@0+ (0.002748,-0.1745) [-0.1745|0.174496] "rad"  CADM
 SG_ LRRF1_CAN_DET_ELEVATION_115 : 191|7@0+ (0.002748,-0.1745) [-0.1745|0.174496] "rad"  CADM
 SG_ LRRF1_CAN_DET_ELEVATION_114 : 127|7@0+ (0.002748,-0.1745) [-0.1745|0.174496] "rad"  CADM
 SG_ LRRF1_CAN_DET_CONFID_ELEVAT_0015 : 440|1@0+ (1,0) [0|1] ""  CADM
 SG_ LRRF1_CAN_DET_CONFID_ELEVAT_0016 : 376|1@0+ (1,0) [0|1] ""  CADM
 SG_ LRRF1_CAN_DET_CONFID_ELEVAT_0017 : 312|1@0+ (1,0) [0|1] ""  CADM
 SG_ LRRF1_CAN_DET_CONFID_ELEVAT_0018 : 248|1@0+ (1,0) [0|1] ""  CADM
 SG_ LRRF1_CAN_DET_CONFID_ELEVAT_0019 : 184|1@0+ (1,0) [0|1] ""  CADM
 SG_ LRRF1_CAN_DET_CONFID_ELEVAT_0020 : 120|1@0+ (1,0) [0|1] ""  CADM
 SG_ LRRF1_CAN_DET_CONFID_AZIMUTH_119 : 417|2@0+ (1,0) [0|3] ""  CADM
 SG_ LRRF1_CAN_DET_CONFID_AZIMUTH_118 : 353|2@0+ (1,0) [0|3] ""  CADM
 SG_ LRRF1_CAN_DET_CONFID_AZIMUTH_117 : 289|2@0+ (1,0) [0|3] ""  CADM
 SG_ LRRF1_CAN_DET_CONFID_AZIMUTH_116 : 225|2@0+ (1,0) [0|3] ""  CADM
 SG_ LRRF1_CAN_DET_CONFID_AZIMUTH_115 : 161|2@0+ (1,0) [0|3] ""  CADM
 SG_ LRRF1_CAN_DET_CONFID_AZIMUTH_114 : 97|2@0+ (1,0) [0|3] ""  CADM
 SG_ LRRF1_CAN_DET_AZIMUTH_119 : 431|14@0+ (0.0003834,-3.1416) [-3.1416|3.1396422] "rad"  CADM
 SG_ LRRF1_CAN_DET_AZIMUTH_118 : 367|14@0+ (0.0003834,-3.1416) [-3.1416|3.1396422] "rad"  CADM
 SG_ LRRF1_CAN_DET_AZIMUTH_117 : 303|14@0+ (0.0003834,-3.1416) [-3.1416|3.1396422] "rad"  CADM
 SG_ LRRF1_CAN_DET_AZIMUTH_116 : 239|14@0+ (0.0003834,-3.1416) [-3.1416|3.1396422] "rad"  CADM
 SG_ LRRF1_CAN_DET_AZIMUTH_115 : 175|14@0+ (0.0003834,-3.1416) [-3.1416|3.1396422] "rad"  CADM
 SG_ LRRF1_CAN_DET_AZIMUTH_114 : 111|14@0+ (0.0003834,-3.1416) [-3.1416|3.1396422] "rad"  CADM
 SG_ LRRF1_CAN_DET_AMPLITUDE_119 : 391|7@0+ (1,-64) [-64|63] "dBsm"  CADM
 SG_ LRRF1_CAN_DET_AMPLITUDE_118 : 327|7@0+ (1,-64) [-64|63] "dBsm"  CADM
 SG_ LRRF1_CAN_DET_AMPLITUDE_117 : 263|7@0+ (1,-64) [-64|63] "dBsm"  CADM
 SG_ LRRF1_CAN_DET_AMPLITUDE_116 : 199|7@0+ (1,-64) [-64|63] "dBsm"  CADM
 SG_ LRRF1_CAN_DET_AMPLITUDE_115 : 135|7@0+ (1,-64) [-64|63] "dBsm"  CADM
 SG_ LRRF1_CAN_DET_AMPLITUDE_114 : 71|7@0+ (1,-64) [-64|63] "dBsm"  CADM
 SG_ LRRF1_CAN_DET_VALID_LEVEL_119 : 384|1@0+ (1,0) [0|1] ""  CADM
 SG_ LRRF1_CAN_DET_VALID_LEVEL_118 : 320|1@0+ (1,0) [0|1] ""  CADM
 SG_ LRRF1_CAN_DET_VALID_LEVEL_117 : 256|1@0+ (1,0) [0|1] ""  CADM
 SG_ LRRF1_CAN_DET_VALID_LEVEL_116 : 192|1@0+ (1,0) [0|1] ""  CADM
 SG_ LRRF1_CAN_DET_VALID_LEVEL_115 : 128|1@0+ (1,0) [0|1] ""  CADM
 SG_ LRRF1_CAN_DET_VALID_LEVEL_114 : 64|1@0+ (1,0) [0|1] ""  CADM

BO_ 89 LRRF1_Detection_106_112: 64 LRRF
 SG_ LRRF1_CAN_DET_Near_TARGET_112 : 454|1@0+ (1,0) [0|1] ""  CADM
 SG_ LRRF1_CAN_DET_Near_TARGET_111 : 453|1@0+ (1,0) [0|1] ""  CADM
 SG_ LRRF1_CAN_DET_Near_TARGET_110 : 452|1@0+ (1,0) [0|1] ""  CADM
 SG_ LRRF1_CAN_DET_Near_TARGET_109 : 451|1@0+ (1,0) [0|1] ""  CADM
 SG_ LRRF1_CAN_DET_Near_TARGET_108 : 450|1@0+ (1,0) [0|1] ""  CADM
 SG_ LRRF1_CAN_DET_Near_TARGET_107 : 449|1@0+ (1,0) [0|1] ""  CADM
 SG_ LRRF1_CAN_DET_Near_TARGET_106 : 448|1@0+ (1,0) [0|1] ""  CADM
 SG_ LRRF1_CAN_DET_ELEVATION_106 : 63|7@0+ (0.002748,-0.1745) [-0.1745|0.174496] "rad"  CADM
 SG_ LRRF1_CAN_DET_CONFID_AZIMUTH_106 : 33|2@0+ (1,0) [0|3] ""  CADM
 SG_ LRRF1_CAN_DET_SUPER_RES_TAR_0021 : 56|1@0+ (1,0) [0|1] ""  CADM
 SG_ LRRF1_CAN_DET_CONFID_ELEVAT_0021 : 48|1@0+ (1,0) [0|1] ""  CADM
 SG_ LRRF1_CAN_DET_HOST_VEH_CLUT_0021 : 49|1@0+ (1,0) [0|1] ""  CADM
 SG_ LRRF1_CAN_DET_VALID_LEVEL_106 : 0|1@0+ (1,0) [0|1] ""  CADM
 SG_ LRRF1_CAN_DET_AZIMUTH_106 : 47|14@0+ (0.0003834,-3.1416) [-3.1416|3.1396422] "rad"  CADM
 SG_ LRRF1_CAN_DET_RANGE_106 : 31|14@0+ (0.015625,0) [0|255.984375] "m"  CADM
 SG_ LRRF1_CAN_DET_RANGE_RATE_106 : 15|14@0+ (0.015625,-128) [-128|127.984375] "m/s"  CADM
 SG_ LRRF1_CAN_DET_AMPLITUDE_106 : 7|7@0+ (1,-64) [-64|63] "dBsm"  CADM
 SG_ LRRF1_CAN_SCAN_INDEX_2LSB_106 : 17|2@0+ (1,0) [0|3] ""  CADM
 SG_ LRRF1_Det_CRC_16 : 503|16@0+ (1,0) [0|65535] ""  CADM
 SG_ LRRF1_Det_MC_16 : 491|4@0+ (1,0) [0|15] ""  CADM
 SG_ LRRF1_CAN_SCAN_INDEX_2LSB_112 : 401|2@0+ (1,0) [0|3] ""  CADM
 SG_ LRRF1_CAN_SCAN_INDEX_2LSB_111 : 337|2@0+ (1,0) [0|3] ""  CADM
 SG_ LRRF1_CAN_SCAN_INDEX_2LSB_110 : 273|2@0+ (1,0) [0|3] ""  CADM
 SG_ LRRF1_CAN_SCAN_INDEX_2LSB_109 : 209|2@0+ (1,0) [0|3] ""  CADM
 SG_ LRRF1_CAN_SCAN_INDEX_2LSB_108 : 145|2@0+ (1,0) [0|3] ""  CADM
 SG_ LRRF1_CAN_SCAN_INDEX_2LSB_107 : 81|2@0+ (1,0) [0|3] ""  CADM
 SG_ LRRF1_CAN_DET_RANGE_RATE_112 : 399|14@0+ (0.015625,-128) [-128|127.984375] "m/s"  CADM
 SG_ LRRF1_CAN_DET_RANGE_RATE_111 : 335|14@0+ (0.015625,-128) [-128|127.984375] "m/s"  CADM
 SG_ LRRF1_CAN_DET_RANGE_RATE_110 : 271|14@0+ (0.015625,-128) [-128|127.984375] "m/s"  CADM
 SG_ LRRF1_CAN_DET_RANGE_RATE_109 : 207|14@0+ (0.015625,-128) [-128|127.984375] "m/s"  CADM
 SG_ LRRF1_CAN_DET_RANGE_RATE_108 : 143|14@0+ (0.015625,-128) [-128|127.984375] "m/s"  CADM
 SG_ LRRF1_CAN_DET_RANGE_RATE_107 : 79|14@0+ (0.015625,-128) [-128|127.984375] "m/s"  CADM
 SG_ LRRF1_CAN_DET_RANGE_112 : 415|14@0+ (0.015625,0) [0|255.984375] "m"  CADM
 SG_ LRRF1_CAN_DET_RANGE_111 : 351|14@0+ (0.015625,0) [0|255.984375] "m"  CADM
 SG_ LRRF1_CAN_DET_RANGE_110 : 287|14@0+ (0.015625,0) [0|255.984375] "m"  CADM
 SG_ LRRF1_CAN_DET_RANGE_109 : 223|14@0+ (0.015625,0) [0|255.984375] "m"  CADM
 SG_ LRRF1_CAN_DET_RANGE_108 : 159|14@0+ (0.015625,0) [0|255.984375] "m"  CADM
 SG_ LRRF1_CAN_DET_RANGE_107 : 95|14@0+ (0.015625,0) [0|255.984375] "m"  CADM
 SG_ LRRF1_CAN_DET_SUPER_RES_TAR_0022 : 432|1@0+ (1,0) [0|1] ""  CADM
 SG_ LRRF1_CAN_DET_SUPER_RES_TAR_0023 : 368|1@0+ (1,0) [0|1] ""  CADM
 SG_ LRRF1_CAN_DET_SUPER_RES_TAR_0024 : 304|1@0+ (1,0) [0|1] ""  CADM
 SG_ LRRF1_CAN_DET_SUPER_RES_TAR_0025 : 240|1@0+ (1,0) [0|1] ""  CADM
 SG_ LRRF1_CAN_DET_SUPER_RES_TAR_0026 : 176|1@0+ (1,0) [0|1] ""  CADM
 SG_ LRRF1_CAN_DET_SUPER_RES_TAR_0027 : 112|1@0+ (1,0) [0|1] ""  CADM
 SG_ LRRF1_CAN_DET_HOST_VEH_CLUT_0022 : 433|1@0+ (1,0) [0|1] ""  CADM
 SG_ LRRF1_CAN_DET_HOST_VEH_CLUT_0023 : 369|1@0+ (1,0) [0|1] ""  CADM
 SG_ LRRF1_CAN_DET_HOST_VEH_CLUT_0024 : 305|1@0+ (1,0) [0|1] ""  CADM
 SG_ LRRF1_CAN_DET_HOST_VEH_CLUT_0025 : 241|1@0+ (1,0) [0|1] ""  CADM
 SG_ LRRF1_CAN_DET_HOST_VEH_CLUT_0026 : 177|1@0+ (1,0) [0|1] ""  CADM
 SG_ LRRF1_CAN_DET_HOST_VEH_CLUT_0027 : 113|1@0+ (1,0) [0|1] ""  CADM
 SG_ LRRF1_CAN_DET_ELEVATION_112 : 447|7@0+ (0.002748,-0.1745) [-0.1745|0.174496] "rad"  CADM
 SG_ LRRF1_CAN_DET_ELEVATION_111 : 383|7@0+ (0.002748,-0.1745) [-0.1745|0.174496] "rad"  CADM
 SG_ LRRF1_CAN_DET_ELEVATION_110 : 319|7@0+ (0.002748,-0.1745) [-0.1745|0.174496] "rad"  CADM
 SG_ LRRF1_CAN_DET_ELEVATION_109 : 255|7@0+ (0.002748,-0.1745) [-0.1745|0.174496] "rad"  CADM
 SG_ LRRF1_CAN_DET_ELEVATION_108 : 191|7@0+ (0.002748,-0.1745) [-0.1745|0.174496] "rad"  CADM
 SG_ LRRF1_CAN_DET_ELEVATION_107 : 127|7@0+ (0.002748,-0.1745) [-0.1745|0.174496] "rad"  CADM
 SG_ LRRF1_CAN_DET_CONFID_ELEVAT_0022 : 440|1@0+ (1,0) [0|1] ""  CADM
 SG_ LRRF1_CAN_DET_CONFID_ELEVAT_0023 : 376|1@0+ (1,0) [0|1] ""  CADM
 SG_ LRRF1_CAN_DET_CONFID_ELEVAT_0024 : 312|1@0+ (1,0) [0|1] ""  CADM
 SG_ LRRF1_CAN_DET_CONFID_ELEVAT_0025 : 248|1@0+ (1,0) [0|1] ""  CADM
 SG_ LRRF1_CAN_DET_CONFID_ELEVAT_0026 : 184|1@0+ (1,0) [0|1] ""  CADM
 SG_ LRRF1_CAN_DET_CONFID_ELEVAT_0027 : 120|1@0+ (1,0) [0|1] ""  CADM
 SG_ LRRF1_CAN_DET_CONFID_AZIMUTH_112 : 417|2@0+ (1,0) [0|3] ""  CADM
 SG_ LRRF1_CAN_DET_CONFID_AZIMUTH_111 : 353|2@0+ (1,0) [0|3] ""  CADM
 SG_ LRRF1_CAN_DET_CONFID_AZIMUTH_110 : 289|2@0+ (1,0) [0|3] ""  CADM
 SG_ LRRF1_CAN_DET_CONFID_AZIMUTH_109 : 225|2@0+ (1,0) [0|3] ""  CADM
 SG_ LRRF1_CAN_DET_CONFID_AZIMUTH_108 : 161|2@0+ (1,0) [0|3] ""  CADM
 SG_ LRRF1_CAN_DET_CONFID_AZIMUTH_107 : 97|2@0+ (1,0) [0|3] ""  CADM
 SG_ LRRF1_CAN_DET_AZIMUTH_112 : 431|14@0+ (0.0003834,-3.1416) [-3.1416|3.1396422] "rad"  CADM
 SG_ LRRF1_CAN_DET_AZIMUTH_111 : 367|14@0+ (0.0003834,-3.1416) [-3.1416|3.1396422] "rad"  CADM
 SG_ LRRF1_CAN_DET_AZIMUTH_110 : 303|14@0+ (0.0003834,-3.1416) [-3.1416|3.1396422] "rad"  CADM
 SG_ LRRF1_CAN_DET_AZIMUTH_109 : 239|14@0+ (0.0003834,-3.1416) [-3.1416|3.1396422] "rad"  CADM
 SG_ LRRF1_CAN_DET_AZIMUTH_108 : 175|14@0+ (0.0003834,-3.1416) [-3.1416|3.1396422] "rad"  CADM
 SG_ LRRF1_CAN_DET_AZIMUTH_107 : 111|14@0+ (0.0003834,-3.1416) [-3.1416|3.1396422] "rad"  CADM
 SG_ LRRF1_CAN_DET_AMPLITUDE_112 : 391|7@0+ (1,-64) [-64|63] "dBsm"  CADM
 SG_ LRRF1_CAN_DET_AMPLITUDE_111 : 327|7@0+ (1,-64) [-64|63] "dBsm"  CADM
 SG_ LRRF1_CAN_DET_AMPLITUDE_110 : 263|7@0+ (1,-64) [-64|63] "dBsm"  CADM
 SG_ LRRF1_CAN_DET_AMPLITUDE_109 : 199|7@0+ (1,-64) [-64|63] "dBsm"  CADM
 SG_ LRRF1_CAN_DET_AMPLITUDE_108 : 135|7@0+ (1,-64) [-64|63] "dBsm"  CADM
 SG_ LRRF1_CAN_DET_AMPLITUDE_107 : 71|7@0+ (1,-64) [-64|63] "dBsm"  CADM
 SG_ LRRF1_CAN_DET_VALID_LEVEL_112 : 384|1@0+ (1,0) [0|1] ""  CADM
 SG_ LRRF1_CAN_DET_VALID_LEVEL_111 : 320|1@0+ (1,0) [0|1] ""  CADM
 SG_ LRRF1_CAN_DET_VALID_LEVEL_110 : 256|1@0+ (1,0) [0|1] ""  CADM
 SG_ LRRF1_CAN_DET_VALID_LEVEL_109 : 192|1@0+ (1,0) [0|1] ""  CADM
 SG_ LRRF1_CAN_DET_VALID_LEVEL_108 : 128|1@0+ (1,0) [0|1] ""  CADM
 SG_ LRRF1_CAN_DET_VALID_LEVEL_107 : 64|1@0+ (1,0) [0|1] ""  CADM

BO_ 88 LRRF1_Detection_099_105: 64 LRRF
 SG_ LRRF1_CAN_DET_Near_TARGET_105 : 454|1@0+ (1,0) [0|1] ""  CADM
 SG_ LRRF1_CAN_DET_Near_TARGET_104 : 453|1@0+ (1,0) [0|1] ""  CADM
 SG_ LRRF1_CAN_DET_Near_TARGET_103 : 452|1@0+ (1,0) [0|1] ""  CADM
 SG_ LRRF1_CAN_DET_Near_TARGET_102 : 451|1@0+ (1,0) [0|1] ""  CADM
 SG_ LRRF1_CAN_DET_Near_TARGET_101 : 450|1@0+ (1,0) [0|1] ""  CADM
 SG_ LRRF1_CAN_DET_Near_TARGET_100 : 449|1@0+ (1,0) [0|1] ""  CADM
 SG_ LRRF1_CAN_DET_Near_TARGET_99 : 448|1@0+ (1,0) [0|1] ""  CADM
 SG_ LRRF1_CAN_DET_ELEVATION_99 : 63|7@0+ (0.002748,-0.1745) [-0.1745|0.174496] "rad"  CADM
 SG_ LRRF1_CAN_DET_CONFID_AZIMUTH_99 : 33|2@0+ (1,0) [0|3] ""  CADM
 SG_ LRRF1_CAN_DET_SUPER_RES_TARGET_9 : 56|1@0+ (1,0) [0|1] ""  CADM
 SG_ LRRF1_CAN_DET_CONFID_ELEVATION_9 : 48|1@0+ (1,0) [0|1] ""  CADM
 SG_ LRRF1_CAN_DET_HOST_VEH_CLUTTER_9 : 49|1@0+ (1,0) [0|1] ""  CADM
 SG_ LRRF1_CAN_DET_VALID_LEVEL_99 : 0|1@0+ (1,0) [0|1] ""  CADM
 SG_ LRRF1_CAN_DET_AZIMUTH_99 : 47|14@0+ (0.0003834,-3.1416) [-3.1416|3.1396422] "rad"  CADM
 SG_ LRRF1_CAN_DET_RANGE_99 : 31|14@0+ (0.015625,0) [0|255.984375] "m"  CADM
 SG_ LRRF1_CAN_DET_RANGE_RATE_99 : 15|14@0+ (0.015625,-128) [-128|127.984375] "m/s"  CADM
 SG_ LRRF1_CAN_DET_AMPLITUDE_99 : 7|7@0+ (1,-64) [-64|63] "dBsm"  CADM
 SG_ LRRF1_CAN_SCAN_INDEX_2LSB_99 : 17|2@0+ (1,0) [0|3] ""  CADM
 SG_ LRRF1_Det_CRC_15 : 503|16@0+ (1,0) [0|65535] ""  CADM
 SG_ LRRF1_Det_MC_15 : 491|4@0+ (1,0) [0|15] ""  CADM
 SG_ LRRF1_CAN_SCAN_INDEX_2LSB_105 : 401|2@0+ (1,0) [0|3] ""  CADM
 SG_ LRRF1_CAN_SCAN_INDEX_2LSB_104 : 337|2@0+ (1,0) [0|3] ""  CADM
 SG_ LRRF1_CAN_SCAN_INDEX_2LSB_103 : 273|2@0+ (1,0) [0|3] ""  CADM
 SG_ LRRF1_CAN_SCAN_INDEX_2LSB_102 : 209|2@0+ (1,0) [0|3] ""  CADM
 SG_ LRRF1_CAN_SCAN_INDEX_2LSB_101 : 145|2@0+ (1,0) [0|3] ""  CADM
 SG_ LRRF1_CAN_SCAN_INDEX_2LSB_100 : 81|2@0+ (1,0) [0|3] ""  CADM
 SG_ LRRF1_CAN_DET_RANGE_RATE_105 : 399|14@0+ (0.015625,-128) [-128|127.984375] "m/s"  CADM
 SG_ LRRF1_CAN_DET_RANGE_RATE_104 : 335|14@0+ (0.015625,-128) [-128|127.984375] "m/s"  CADM
 SG_ LRRF1_CAN_DET_RANGE_RATE_103 : 271|14@0+ (0.015625,-128) [-128|127.984375] "m/s"  CADM
 SG_ LRRF1_CAN_DET_RANGE_RATE_102 : 207|14@0+ (0.015625,-128) [-128|127.984375] "m/s"  CADM
 SG_ LRRF1_CAN_DET_RANGE_RATE_101 : 143|14@0+ (0.015625,-128) [-128|127.984375] "m/s"  CADM
 SG_ LRRF1_CAN_DET_RANGE_RATE_100 : 79|14@0+ (0.015625,-128) [-128|127.984375] "m/s"  CADM
 SG_ LRRF1_CAN_DET_RANGE_105 : 415|14@0+ (0.015625,0) [0|255.984375] "m"  CADM
 SG_ LRRF1_CAN_DET_RANGE_104 : 351|14@0+ (0.015625,0) [0|255.984375] "m"  CADM
 SG_ LRRF1_CAN_DET_RANGE_103 : 287|14@0+ (0.015625,0) [0|255.984375] "m"  CADM
 SG_ LRRF1_CAN_DET_RANGE_102 : 223|14@0+ (0.015625,0) [0|255.984375] "m"  CADM
 SG_ LRRF1_CAN_DET_RANGE_101 : 159|14@0+ (0.015625,0) [0|255.984375] "m"  CADM
 SG_ LRRF1_CAN_DET_RANGE_100 : 95|14@0+ (0.015625,0) [0|255.984375] "m"  CADM
 SG_ LRRF1_CAN_DET_SUPER_RES_TAR_0028 : 432|1@0+ (1,0) [0|1] ""  CADM
 SG_ LRRF1_CAN_DET_SUPER_RES_TAR_0029 : 368|1@0+ (1,0) [0|1] ""  CADM
 SG_ LRRF1_CAN_DET_SUPER_RES_TAR_0030 : 304|1@0+ (1,0) [0|1] ""  CADM
 SG_ LRRF1_CAN_DET_SUPER_RES_TAR_0031 : 240|1@0+ (1,0) [0|1] ""  CADM
 SG_ LRRF1_CAN_DET_SUPER_RES_TAR_0032 : 176|1@0+ (1,0) [0|1] ""  CADM
 SG_ LRRF1_CAN_DET_SUPER_RES_TAR_0033 : 112|1@0+ (1,0) [0|1] ""  CADM
 SG_ LRRF1_CAN_DET_HOST_VEH_CLUT_0028 : 433|1@0+ (1,0) [0|1] ""  CADM
 SG_ LRRF1_CAN_DET_HOST_VEH_CLUT_0029 : 369|1@0+ (1,0) [0|1] ""  CADM
 SG_ LRRF1_CAN_DET_HOST_VEH_CLUT_0030 : 305|1@0+ (1,0) [0|1] ""  CADM
 SG_ LRRF1_CAN_DET_HOST_VEH_CLUT_0031 : 241|1@0+ (1,0) [0|1] ""  CADM
 SG_ LRRF1_CAN_DET_HOST_VEH_CLUT_0032 : 177|1@0+ (1,0) [0|1] ""  CADM
 SG_ LRRF1_CAN_DET_HOST_VEH_CLUT_0033 : 113|1@0+ (1,0) [0|1] ""  CADM
 SG_ LRRF1_CAN_DET_ELEVATION_105 : 447|7@0+ (0.002748,-0.1745) [-0.1745|0.174496] "rad"  CADM
 SG_ LRRF1_CAN_DET_ELEVATION_104 : 383|7@0+ (0.002748,-0.1745) [-0.1745|0.174496] "rad"  CADM
 SG_ LRRF1_CAN_DET_ELEVATION_103 : 319|7@0+ (0.002748,-0.1745) [-0.1745|0.174496] "rad"  CADM
 SG_ LRRF1_CAN_DET_ELEVATION_102 : 255|7@0+ (0.002748,-0.1745) [-0.1745|0.174496] "rad"  CADM
 SG_ LRRF1_CAN_DET_ELEVATION_101 : 191|7@0+ (0.002748,-0.1745) [-0.1745|0.174496] "rad"  CADM
 SG_ LRRF1_CAN_DET_ELEVATION_100 : 127|7@0+ (0.002748,-0.1745) [-0.1745|0.174496] "rad"  CADM
 SG_ LRRF1_CAN_DET_CONFID_ELEVAT_0028 : 440|1@0+ (1,0) [0|1] ""  CADM
 SG_ LRRF1_CAN_DET_CONFID_ELEVAT_0029 : 376|1@0+ (1,0) [0|1] ""  CADM
 SG_ LRRF1_CAN_DET_CONFID_ELEVAT_0030 : 312|1@0+ (1,0) [0|1] ""  CADM
 SG_ LRRF1_CAN_DET_CONFID_ELEVAT_0031 : 248|1@0+ (1,0) [0|1] ""  CADM
 SG_ LRRF1_CAN_DET_CONFID_ELEVAT_0032 : 184|1@0+ (1,0) [0|1] ""  CADM
 SG_ LRRF1_CAN_DET_CONFID_ELEVAT_0033 : 120|1@0+ (1,0) [0|1] ""  CADM
 SG_ LRRF1_CAN_DET_CONFID_AZIMUTH_105 : 417|2@0+ (1,0) [0|3] ""  CADM
 SG_ LRRF1_CAN_DET_CONFID_AZIMUTH_104 : 353|2@0+ (1,0) [0|3] ""  CADM
 SG_ LRRF1_CAN_DET_CONFID_AZIMUTH_103 : 289|2@0+ (1,0) [0|3] ""  CADM
 SG_ LRRF1_CAN_DET_CONFID_AZIMUTH_102 : 225|2@0+ (1,0) [0|3] ""  CADM
 SG_ LRRF1_CAN_DET_CONFID_AZIMUTH_101 : 161|2@0+ (1,0) [0|3] ""  CADM
 SG_ LRRF1_CAN_DET_CONFID_AZIMUTH_100 : 97|2@0+ (1,0) [0|3] ""  CADM
 SG_ LRRF1_CAN_DET_AZIMUTH_105 : 431|14@0+ (0.0003834,-3.1416) [-3.1416|3.1396422] "rad"  CADM
 SG_ LRRF1_CAN_DET_AZIMUTH_104 : 367|14@0+ (0.0003834,-3.1416) [-3.1416|3.1396422] "rad"  CADM
 SG_ LRRF1_CAN_DET_AZIMUTH_103 : 303|14@0+ (0.0003834,-3.1416) [-3.1416|3.1396422] "rad"  CADM
 SG_ LRRF1_CAN_DET_AZIMUTH_102 : 239|14@0+ (0.0003834,-3.1416) [-3.1416|3.1396422] "rad"  CADM
 SG_ LRRF1_CAN_DET_AZIMUTH_101 : 175|14@0+ (0.0003834,-3.1416) [-3.1416|3.1396422] "rad"  CADM
 SG_ LRRF1_CAN_DET_AZIMUTH_100 : 111|14@0+ (0.0003834,-3.1416) [-3.1416|3.1396422] "rad"  CADM
 SG_ LRRF1_CAN_DET_AMPLITUDE_105 : 391|7@0+ (1,-64) [-64|63] "dBsm"  CADM
 SG_ LRRF1_CAN_DET_AMPLITUDE_104 : 327|7@0+ (1,-64) [-64|63] "dBsm"  CADM
 SG_ LRRF1_CAN_DET_AMPLITUDE_103 : 263|7@0+ (1,-64) [-64|63] "dBsm"  CADM
 SG_ LRRF1_CAN_DET_AMPLITUDE_102 : 199|7@0+ (1,-64) [-64|63] "dBsm"  CADM
 SG_ LRRF1_CAN_DET_AMPLITUDE_101 : 135|7@0+ (1,-64) [-64|63] "dBsm"  CADM
 SG_ LRRF1_CAN_DET_AMPLITUDE_100 : 71|7@0+ (1,-64) [-64|63] "dBsm"  CADM
 SG_ LRRF1_CAN_DET_VALID_LEVEL_105 : 384|1@0+ (1,0) [0|1] ""  CADM
 SG_ LRRF1_CAN_DET_VALID_LEVEL_104 : 320|1@0+ (1,0) [0|1] ""  CADM
 SG_ LRRF1_CAN_DET_VALID_LEVEL_103 : 256|1@0+ (1,0) [0|1] ""  CADM
 SG_ LRRF1_CAN_DET_VALID_LEVEL_102 : 192|1@0+ (1,0) [0|1] ""  CADM
 SG_ LRRF1_CAN_DET_VALID_LEVEL_101 : 128|1@0+ (1,0) [0|1] ""  CADM
 SG_ LRRF1_CAN_DET_VALID_LEVEL_100 : 64|1@0+ (1,0) [0|1] ""  CADM

BO_ 87 LRRF1_Detection_092_098: 64 LRRF
 SG_ LRRF1_CAN_DET_Near_TARGET_98 : 454|1@0+ (1,0) [0|1] ""  CADM
 SG_ LRRF1_CAN_DET_Near_TARGET_97 : 453|1@0+ (1,0) [0|1] ""  CADM
 SG_ LRRF1_CAN_DET_Near_TARGET_96 : 452|1@0+ (1,0) [0|1] ""  CADM
 SG_ LRRF1_CAN_DET_Near_TARGET_95 : 451|1@0+ (1,0) [0|1] ""  CADM
 SG_ LRRF1_CAN_DET_Near_TARGET_94 : 450|1@0+ (1,0) [0|1] ""  CADM
 SG_ LRRF1_CAN_DET_Near_TARGET_93 : 449|1@0+ (1,0) [0|1] ""  CADM
 SG_ LRRF1_CAN_DET_Near_TARGET_92 : 448|1@0+ (1,0) [0|1] ""  CADM
 SG_ LRRF1_CAN_DET_ELEVATION_92 : 63|7@0+ (0.002748,-0.1745) [-0.1745|0.174496] "rad"  CADM
 SG_ LRRF1_CAN_DET_CONFID_AZIMUTH_92 : 33|2@0+ (1,0) [0|3] ""  CADM
 SG_ LRRF1_CAN_DET_SUPER_RES_TAR_0034 : 56|1@0+ (1,0) [0|1] ""  CADM
 SG_ LRRF1_CAN_DET_CONFID_ELEVAT_0034 : 48|1@0+ (1,0) [0|1] ""  CADM
 SG_ LRRF1_CAN_DET_HOST_VEH_CLUT_0034 : 49|1@0+ (1,0) [0|1] ""  CADM
 SG_ LRRF1_CAN_DET_VALID_LEVEL_92 : 0|1@0+ (1,0) [0|1] ""  CADM
 SG_ LRRF1_CAN_DET_AZIMUTH_92 : 47|14@0+ (0.0003834,-3.1416) [-3.1416|3.1396422] "rad"  CADM
 SG_ LRRF1_CAN_DET_RANGE_92 : 31|14@0+ (0.015625,0) [0|255.984375] "m"  CADM
 SG_ LRRF1_CAN_DET_RANGE_RATE_92 : 15|14@0+ (0.015625,-128) [-128|127.984375] "m/s"  CADM
 SG_ LRRF1_CAN_DET_AMPLITUDE_92 : 7|7@0+ (1,-64) [-64|63] "dBsm"  CADM
 SG_ LRRF1_CAN_SCAN_INDEX_2LSB_92 : 17|2@0+ (1,0) [0|3] ""  CADM
 SG_ LRRF1_Det_CRC_14 : 503|16@0+ (1,0) [0|65535] ""  CADM
 SG_ LRRF1_Det_MC_14 : 491|4@0+ (1,0) [0|15] ""  CADM
 SG_ LRRF1_CAN_SCAN_INDEX_2LSB_98 : 401|2@0+ (1,0) [0|3] ""  CADM
 SG_ LRRF1_CAN_SCAN_INDEX_2LSB_97 : 337|2@0+ (1,0) [0|3] ""  CADM
 SG_ LRRF1_CAN_SCAN_INDEX_2LSB_96 : 273|2@0+ (1,0) [0|3] ""  CADM
 SG_ LRRF1_CAN_SCAN_INDEX_2LSB_95 : 209|2@0+ (1,0) [0|3] ""  CADM
 SG_ LRRF1_CAN_SCAN_INDEX_2LSB_94 : 145|2@0+ (1,0) [0|3] ""  CADM
 SG_ LRRF1_CAN_SCAN_INDEX_2LSB_93 : 81|2@0+ (1,0) [0|3] ""  CADM
 SG_ LRRF1_CAN_DET_RANGE_RATE_98 : 399|14@0+ (0.015625,-128) [-128|127.984375] "m/s"  CADM
 SG_ LRRF1_CAN_DET_RANGE_RATE_97 : 335|14@0+ (0.015625,-128) [-128|127.984375] "m/s"  CADM
 SG_ LRRF1_CAN_DET_RANGE_RATE_96 : 271|14@0+ (0.015625,-128) [-128|127.984375] "m/s"  CADM
 SG_ LRRF1_CAN_DET_RANGE_RATE_95 : 207|14@0+ (0.015625,-128) [-128|127.984375] "m/s"  CADM
 SG_ LRRF1_CAN_DET_RANGE_RATE_94 : 143|14@0+ (0.015625,-128) [-128|127.984375] "m/s"  CADM
 SG_ LRRF1_CAN_DET_RANGE_RATE_93 : 79|14@0+ (0.015625,-128) [-128|127.984375] "m/s"  CADM
 SG_ LRRF1_CAN_DET_RANGE_98 : 415|14@0+ (0.015625,0) [0|255.984375] "m"  CADM
 SG_ LRRF1_CAN_DET_RANGE_97 : 351|14@0+ (0.015625,0) [0|255.984375] "m"  CADM
 SG_ LRRF1_CAN_DET_RANGE_96 : 287|14@0+ (0.015625,0) [0|255.984375] "m"  CADM
 SG_ LRRF1_CAN_DET_RANGE_95 : 223|14@0+ (0.015625,0) [0|255.984375] "m"  CADM
 SG_ LRRF1_CAN_DET_RANGE_94 : 159|14@0+ (0.015625,0) [0|255.984375] "m"  CADM
 SG_ LRRF1_CAN_DET_RANGE_93 : 95|14@0+ (0.015625,0) [0|255.984375] "m"  CADM
 SG_ LRRF1_CAN_DET_SUPER_RES_TAR_0035 : 432|1@0+ (1,0) [0|1] ""  CADM
 SG_ LRRF1_CAN_DET_SUPER_RES_TAR_0036 : 368|1@0+ (1,0) [0|1] ""  CADM
 SG_ LRRF1_CAN_DET_SUPER_RES_TAR_0037 : 304|1@0+ (1,0) [0|1] ""  CADM
 SG_ LRRF1_CAN_DET_SUPER_RES_TAR_0038 : 240|1@0+ (1,0) [0|1] ""  CADM
 SG_ LRRF1_CAN_DET_SUPER_RES_TAR_0039 : 176|1@0+ (1,0) [0|1] ""  CADM
 SG_ LRRF1_CAN_DET_SUPER_RES_TAR_0040 : 112|1@0+ (1,0) [0|1] ""  CADM
 SG_ LRRF1_CAN_DET_HOST_VEH_CLUT_0035 : 433|1@0+ (1,0) [0|1] ""  CADM
 SG_ LRRF1_CAN_DET_HOST_VEH_CLUT_0036 : 369|1@0+ (1,0) [0|1] ""  CADM
 SG_ LRRF1_CAN_DET_HOST_VEH_CLUT_0037 : 305|1@0+ (1,0) [0|1] ""  CADM
 SG_ LRRF1_CAN_DET_HOST_VEH_CLUT_0038 : 241|1@0+ (1,0) [0|1] ""  CADM
 SG_ LRRF1_CAN_DET_HOST_VEH_CLUT_0039 : 177|1@0+ (1,0) [0|1] ""  CADM
 SG_ LRRF1_CAN_DET_HOST_VEH_CLUT_0040 : 113|1@0+ (1,0) [0|1] ""  CADM
 SG_ LRRF1_CAN_DET_ELEVATION_98 : 447|7@0+ (0.002748,-0.1745) [-0.1745|0.174496] "rad"  CADM
 SG_ LRRF1_CAN_DET_ELEVATION_97 : 383|7@0+ (0.002748,-0.1745) [-0.1745|0.174496] "rad"  CADM
 SG_ LRRF1_CAN_DET_ELEVATION_96 : 319|7@0+ (0.002748,-0.1745) [-0.1745|0.174496] "rad"  CADM
 SG_ LRRF1_CAN_DET_ELEVATION_95 : 255|7@0+ (0.002748,-0.1745) [-0.1745|0.174496] "rad"  CADM
 SG_ LRRF1_CAN_DET_ELEVATION_94 : 191|7@0+ (0.002748,-0.1745) [-0.1745|0.174496] "rad"  CADM
 SG_ LRRF1_CAN_DET_ELEVATION_93 : 127|7@0+ (0.002748,-0.1745) [-0.1745|0.174496] "rad"  CADM
 SG_ LRRF1_CAN_DET_CONFID_ELEVAT_0035 : 440|1@0+ (1,0) [0|1] ""  CADM
 SG_ LRRF1_CAN_DET_CONFID_ELEVAT_0036 : 376|1@0+ (1,0) [0|1] ""  CADM
 SG_ LRRF1_CAN_DET_CONFID_ELEVAT_0037 : 312|1@0+ (1,0) [0|1] ""  CADM
 SG_ LRRF1_CAN_DET_CONFID_ELEVAT_0038 : 248|1@0+ (1,0) [0|1] ""  CADM
 SG_ LRRF1_CAN_DET_CONFID_ELEVAT_0039 : 184|1@0+ (1,0) [0|1] ""  CADM
 SG_ LRRF1_CAN_DET_CONFID_ELEVAT_0040 : 120|1@0+ (1,0) [0|1] ""  CADM
 SG_ LRRF1_CAN_DET_CONFID_AZIMUTH_98 : 417|2@0+ (1,0) [0|3] ""  CADM
 SG_ LRRF1_CAN_DET_CONFID_AZIMUTH_97 : 353|2@0+ (1,0) [0|3] ""  CADM
 SG_ LRRF1_CAN_DET_CONFID_AZIMUTH_96 : 289|2@0+ (1,0) [0|3] ""  CADM
 SG_ LRRF1_CAN_DET_CONFID_AZIMUTH_95 : 225|2@0+ (1,0) [0|3] ""  CADM
 SG_ LRRF1_CAN_DET_CONFID_AZIMUTH_94 : 161|2@0+ (1,0) [0|3] ""  CADM
 SG_ LRRF1_CAN_DET_CONFID_AZIMUTH_93 : 97|2@0+ (1,0) [0|3] ""  CADM
 SG_ LRRF1_CAN_DET_AZIMUTH_98 : 431|14@0+ (0.0003834,-3.1416) [-3.1416|3.1396422] "rad"  CADM
 SG_ LRRF1_CAN_DET_AZIMUTH_97 : 367|14@0+ (0.0003834,-3.1416) [-3.1416|3.1396422] "rad"  CADM
 SG_ LRRF1_CAN_DET_AZIMUTH_96 : 303|14@0+ (0.0003834,-3.1416) [-3.1416|3.1396422] "rad"  CADM
 SG_ LRRF1_CAN_DET_AZIMUTH_95 : 239|14@0+ (0.0003834,-3.1416) [-3.1416|3.1396422] "rad"  CADM
 SG_ LRRF1_CAN_DET_AZIMUTH_94 : 175|14@0+ (0.0003834,-3.1416) [-3.1416|3.1396422] "rad"  CADM
 SG_ LRRF1_CAN_DET_AZIMUTH_93 : 111|14@0+ (0.0003834,-3.1416) [-3.1416|3.1396422] "rad"  CADM
 SG_ LRRF1_CAN_DET_AMPLITUDE_98 : 391|7@0+ (1,-64) [-64|63] "dBsm"  CADM
 SG_ LRRF1_CAN_DET_AMPLITUDE_97 : 327|7@0+ (1,-64) [-64|63] "dBsm"  CADM
 SG_ LRRF1_CAN_DET_AMPLITUDE_96 : 263|7@0+ (1,-64) [-64|63] "dBsm"  CADM
 SG_ LRRF1_CAN_DET_AMPLITUDE_95 : 199|7@0+ (1,-64) [-64|63] "dBsm"  CADM
 SG_ LRRF1_CAN_DET_AMPLITUDE_94 : 135|7@0+ (1,-64) [-64|63] "dBsm"  CADM
 SG_ LRRF1_CAN_DET_AMPLITUDE_93 : 71|7@0+ (1,-64) [-64|63] "dBsm"  CADM
 SG_ LRRF1_CAN_DET_VALID_LEVEL_98 : 384|1@0+ (1,0) [0|1] ""  CADM
 SG_ LRRF1_CAN_DET_VALID_LEVEL_97 : 320|1@0+ (1,0) [0|1] ""  CADM
 SG_ LRRF1_CAN_DET_VALID_LEVEL_96 : 256|1@0+ (1,0) [0|1] ""  CADM
 SG_ LRRF1_CAN_DET_VALID_LEVEL_95 : 192|1@0+ (1,0) [0|1] ""  CADM
 SG_ LRRF1_CAN_DET_VALID_LEVEL_94 : 128|1@0+ (1,0) [0|1] ""  CADM
 SG_ LRRF1_CAN_DET_VALID_LEVEL_93 : 64|1@0+ (1,0) [0|1] ""  CADM

BO_ 86 LRRF1_Detection_085_091: 64 LRRF
 SG_ LRRF1_CAN_DET_Near_TARGET_91 : 454|1@0+ (1,0) [0|1] ""  CADM
 SG_ LRRF1_CAN_DET_Near_TARGET_90 : 453|1@0+ (1,0) [0|1] ""  CADM
 SG_ LRRF1_CAN_DET_Near_TARGET_89 : 452|1@0+ (1,0) [0|1] ""  CADM
 SG_ LRRF1_CAN_DET_Near_TARGET_88 : 451|1@0+ (1,0) [0|1] ""  CADM
 SG_ LRRF1_CAN_DET_Near_TARGET_87 : 450|1@0+ (1,0) [0|1] ""  CADM
 SG_ LRRF1_CAN_DET_Near_TARGET_86 : 449|1@0+ (1,0) [0|1] ""  CADM
 SG_ LRRF1_CAN_DET_Near_TARGET_85 : 448|1@0+ (1,0) [0|1] ""  CADM
 SG_ LRRF1_CAN_DET_ELEVATION_85 : 63|7@0+ (0.002748,-0.1745) [-0.1745|0.174496] "rad"  CADM
 SG_ LRRF1_CAN_DET_CONFID_AZIMUTH_85 : 33|2@0+ (1,0) [0|3] ""  CADM
 SG_ LRRF1_CAN_DET_SUPER_RES_TARGET_8 : 56|1@0+ (1,0) [0|1] ""  CADM
 SG_ LRRF1_CAN_DET_CONFID_ELEVATION_8 : 48|1@0+ (1,0) [0|1] ""  CADM
 SG_ LRRF1_CAN_DET_HOST_VEH_CLUTTER_8 : 49|1@0+ (1,0) [0|1] ""  CADM
 SG_ LRRF1_CAN_DET_VALID_LEVEL_85 : 0|1@0+ (1,0) [0|1] ""  CADM
 SG_ LRRF1_CAN_DET_AZIMUTH_85 : 47|14@0+ (0.0003834,-3.1416) [-3.1416|3.1396422] "rad"  CADM
 SG_ LRRF1_CAN_DET_RANGE_85 : 31|14@0+ (0.015625,0) [0|255.984375] "m"  CADM
 SG_ LRRF1_CAN_DET_RANGE_RATE_85 : 15|14@0+ (0.015625,-128) [-128|127.984375] "m/s"  CADM
 SG_ LRRF1_CAN_DET_AMPLITUDE_85 : 7|7@0+ (1,-64) [-64|63] "dBsm"  CADM
 SG_ LRRF1_CAN_SCAN_INDEX_2LSB_85 : 17|2@0+ (1,0) [0|3] ""  CADM
 SG_ LRRF1_Det_CRC_13 : 503|16@0+ (1,0) [0|65535] ""  CADM
 SG_ LRRF1_Det_MC_13 : 491|4@0+ (1,0) [0|15] ""  CADM
 SG_ LRRF1_CAN_SCAN_INDEX_2LSB_91 : 401|2@0+ (1,0) [0|3] ""  CADM
 SG_ LRRF1_CAN_SCAN_INDEX_2LSB_90 : 337|2@0+ (1,0) [0|3] ""  CADM
 SG_ LRRF1_CAN_SCAN_INDEX_2LSB_89 : 273|2@0+ (1,0) [0|3] ""  CADM
 SG_ LRRF1_CAN_SCAN_INDEX_2LSB_88 : 209|2@0+ (1,0) [0|3] ""  CADM
 SG_ LRRF1_CAN_SCAN_INDEX_2LSB_87 : 145|2@0+ (1,0) [0|3] ""  CADM
 SG_ LRRF1_CAN_SCAN_INDEX_2LSB_86 : 81|2@0+ (1,0) [0|3] ""  CADM
 SG_ LRRF1_CAN_DET_RANGE_RATE_91 : 399|14@0+ (0.015625,-128) [-128|127.984375] "m/s"  CADM
 SG_ LRRF1_CAN_DET_RANGE_RATE_90 : 335|14@0+ (0.015625,-128) [-128|127.984375] "m/s"  CADM
 SG_ LRRF1_CAN_DET_RANGE_RATE_89 : 271|14@0+ (0.015625,-128) [-128|127.984375] "m/s"  CADM
 SG_ LRRF1_CAN_DET_RANGE_RATE_88 : 207|14@0+ (0.015625,-128) [-128|127.984375] "m/s"  CADM
 SG_ LRRF1_CAN_DET_RANGE_RATE_87 : 143|14@0+ (0.015625,-128) [-128|127.984375] "m/s"  CADM
 SG_ LRRF1_CAN_DET_RANGE_RATE_86 : 79|14@0+ (0.015625,-128) [-128|127.984375] "m/s"  CADM
 SG_ LRRF1_CAN_DET_RANGE_91 : 415|14@0+ (0.015625,0) [0|255.984375] "m"  CADM
 SG_ LRRF1_CAN_DET_RANGE_90 : 351|14@0+ (0.015625,0) [0|255.984375] "m"  CADM
 SG_ LRRF1_CAN_DET_RANGE_89 : 287|14@0+ (0.015625,0) [0|255.984375] "m"  CADM
 SG_ LRRF1_CAN_DET_RANGE_88 : 223|14@0+ (0.015625,0) [0|255.984375] "m"  CADM
 SG_ LRRF1_CAN_DET_RANGE_87 : 159|14@0+ (0.015625,0) [0|255.984375] "m"  CADM
 SG_ LRRF1_CAN_DET_RANGE_86 : 95|14@0+ (0.015625,0) [0|255.984375] "m"  CADM
 SG_ LRRF1_CAN_DET_SUPER_RES_TAR_0041 : 432|1@0+ (1,0) [0|1] ""  CADM
 SG_ LRRF1_CAN_DET_SUPER_RES_TAR_0042 : 368|1@0+ (1,0) [0|1] ""  CADM
 SG_ LRRF1_CAN_DET_SUPER_RES_TAR_0043 : 304|1@0+ (1,0) [0|1] ""  CADM
 SG_ LRRF1_CAN_DET_SUPER_RES_TAR_0044 : 240|1@0+ (1,0) [0|1] ""  CADM
 SG_ LRRF1_CAN_DET_SUPER_RES_TAR_0045 : 176|1@0+ (1,0) [0|1] ""  CADM
 SG_ LRRF1_CAN_DET_SUPER_RES_TAR_0046 : 112|1@0+ (1,0) [0|1] ""  CADM
 SG_ LRRF1_CAN_DET_HOST_VEH_CLUT_0041 : 433|1@0+ (1,0) [0|1] ""  CADM
 SG_ LRRF1_CAN_DET_HOST_VEH_CLUT_0042 : 369|1@0+ (1,0) [0|1] ""  CADM
 SG_ LRRF1_CAN_DET_HOST_VEH_CLUT_0043 : 305|1@0+ (1,0) [0|1] ""  CADM
 SG_ LRRF1_CAN_DET_HOST_VEH_CLUT_0044 : 241|1@0+ (1,0) [0|1] ""  CADM
 SG_ LRRF1_CAN_DET_HOST_VEH_CLUT_0045 : 177|1@0+ (1,0) [0|1] ""  CADM
 SG_ LRRF1_CAN_DET_HOST_VEH_CLUT_0046 : 113|1@0+ (1,0) [0|1] ""  CADM
 SG_ LRRF1_CAN_DET_ELEVATION_91 : 447|7@0+ (0.002748,-0.1745) [-0.1745|0.174496] "rad"  CADM
 SG_ LRRF1_CAN_DET_ELEVATION_90 : 383|7@0+ (0.002748,-0.1745) [-0.1745|0.174496] "rad"  CADM
 SG_ LRRF1_CAN_DET_ELEVATION_89 : 319|7@0+ (0.002748,-0.1745) [-0.1745|0.174496] "rad"  CADM
 SG_ LRRF1_CAN_DET_ELEVATION_88 : 255|7@0+ (0.002748,-0.1745) [-0.1745|0.174496] "rad"  CADM
 SG_ LRRF1_CAN_DET_ELEVATION_87 : 191|7@0+ (0.002748,-0.1745) [-0.1745|0.174496] "rad"  CADM
 SG_ LRRF1_CAN_DET_ELEVATION_86 : 127|7@0+ (0.002748,-0.1745) [-0.1745|0.174496] "rad"  CADM
 SG_ LRRF1_CAN_DET_CONFID_ELEVAT_0041 : 440|1@0+ (1,0) [0|1] ""  CADM
 SG_ LRRF1_CAN_DET_CONFID_ELEVAT_0042 : 376|1@0+ (1,0) [0|1] ""  CADM
 SG_ LRRF1_CAN_DET_CONFID_ELEVAT_0043 : 312|1@0+ (1,0) [0|1] ""  CADM
 SG_ LRRF1_CAN_DET_CONFID_ELEVAT_0044 : 248|1@0+ (1,0) [0|1] ""  CADM
 SG_ LRRF1_CAN_DET_CONFID_ELEVAT_0045 : 184|1@0+ (1,0) [0|1] ""  CADM
 SG_ LRRF1_CAN_DET_CONFID_ELEVAT_0046 : 120|1@0+ (1,0) [0|1] ""  CADM
 SG_ LRRF1_CAN_DET_CONFID_AZIMUTH_91 : 417|2@0+ (1,0) [0|3] ""  CADM
 SG_ LRRF1_CAN_DET_CONFID_AZIMUTH_90 : 353|2@0+ (1,0) [0|3] ""  CADM
 SG_ LRRF1_CAN_DET_CONFID_AZIMUTH_89 : 289|2@0+ (1,0) [0|3] ""  CADM
 SG_ LRRF1_CAN_DET_CONFID_AZIMUTH_88 : 225|2@0+ (1,0) [0|3] ""  CADM
 SG_ LRRF1_CAN_DET_CONFID_AZIMUTH_87 : 161|2@0+ (1,0) [0|3] ""  CADM
 SG_ LRRF1_CAN_DET_CONFID_AZIMUTH_86 : 97|2@0+ (1,0) [0|3] ""  CADM
 SG_ LRRF1_CAN_DET_AZIMUTH_91 : 431|14@0+ (0.0003834,-3.1416) [-3.1416|3.1396422] "rad"  CADM
 SG_ LRRF1_CAN_DET_AZIMUTH_90 : 367|14@0+ (0.0003834,-3.1416) [-3.1416|3.1396422] "rad"  CADM
 SG_ LRRF1_CAN_DET_AZIMUTH_89 : 303|14@0+ (0.0003834,-3.1416) [-3.1416|3.1396422] "rad"  CADM
 SG_ LRRF1_CAN_DET_AZIMUTH_88 : 239|14@0+ (0.0003834,-3.1416) [-3.1416|3.1396422] "rad"  CADM
 SG_ LRRF1_CAN_DET_AZIMUTH_87 : 175|14@0+ (0.0003834,-3.1416) [-3.1416|3.1396422] "rad"  CADM
 SG_ LRRF1_CAN_DET_AZIMUTH_86 : 111|14@0+ (0.0003834,-3.1416) [-3.1416|3.1396422] "rad"  CADM
 SG_ LRRF1_CAN_DET_AMPLITUDE_91 : 391|7@0+ (1,-64) [-64|63] "dBsm"  CADM
 SG_ LRRF1_CAN_DET_AMPLITUDE_90 : 327|7@0+ (1,-64) [-64|63] "dBsm"  CADM
 SG_ LRRF1_CAN_DET_AMPLITUDE_89 : 263|7@0+ (1,-64) [-64|63] "dBsm"  CADM
 SG_ LRRF1_CAN_DET_AMPLITUDE_88 : 199|7@0+ (1,-64) [-64|63] "dBsm"  CADM
 SG_ LRRF1_CAN_DET_AMPLITUDE_87 : 135|7@0+ (1,-64) [-64|63] "dBsm"  CADM
 SG_ LRRF1_CAN_DET_AMPLITUDE_86 : 71|7@0+ (1,-64) [-64|63] "dBsm"  CADM
 SG_ LRRF1_CAN_DET_VALID_LEVEL_91 : 384|1@0+ (1,0) [0|1] ""  CADM
 SG_ LRRF1_CAN_DET_VALID_LEVEL_90 : 320|1@0+ (1,0) [0|1] ""  CADM
 SG_ LRRF1_CAN_DET_VALID_LEVEL_89 : 256|1@0+ (1,0) [0|1] ""  CADM
 SG_ LRRF1_CAN_DET_VALID_LEVEL_88 : 192|1@0+ (1,0) [0|1] ""  CADM
 SG_ LRRF1_CAN_DET_VALID_LEVEL_87 : 128|1@0+ (1,0) [0|1] ""  CADM
 SG_ LRRF1_CAN_DET_VALID_LEVEL_86 : 64|1@0+ (1,0) [0|1] ""  CADM

BO_ 85 LRRF1_Detection_078_084: 64 LRRF
 SG_ LRRF1_CAN_DET_Near_TARGET_84 : 454|1@0+ (1,0) [0|1] ""  CADM
 SG_ LRRF1_CAN_DET_Near_TARGET_83 : 453|1@0+ (1,0) [0|1] ""  CADM
 SG_ LRRF1_CAN_DET_Near_TARGET_82 : 452|1@0+ (1,0) [0|1] ""  CADM
 SG_ LRRF1_CAN_DET_Near_TARGET_81 : 451|1@0+ (1,0) [0|1] ""  CADM
 SG_ LRRF1_CAN_DET_Near_TARGET_80 : 450|1@0+ (1,0) [0|1] ""  CADM
 SG_ LRRF1_CAN_DET_Near_TARGET_79 : 449|1@0+ (1,0) [0|1] ""  CADM
 SG_ LRRF1_CAN_DET_Near_TARGET_78 : 448|1@0+ (1,0) [0|1] ""  CADM
 SG_ LRRF1_CAN_DET_ELEVATION_78 : 63|7@0+ (0.002748,-0.1745) [-0.1745|0.174496] "rad"  CADM
 SG_ LRRF1_CAN_DET_CONFID_AZIMUTH_78 : 33|2@0+ (1,0) [0|3] ""  CADM
 SG_ LRRF1_CAN_DET_SUPER_RES_TARGET_7 : 56|1@0+ (1,0) [0|1] ""  CADM
 SG_ LRRF1_CAN_DET_CONFID_ELEVATION_7 : 48|1@0+ (1,0) [0|1] ""  CADM
 SG_ LRRF1_CAN_DET_HOST_VEH_CLUTTER_7 : 49|1@0+ (1,0) [0|1] ""  CADM
 SG_ LRRF1_CAN_DET_VALID_LEVEL_78 : 0|1@0+ (1,0) [0|1] ""  CADM
 SG_ LRRF1_CAN_DET_AZIMUTH_78 : 47|14@0+ (0.0003834,-3.1416) [-3.1416|3.1396422] "rad"  CADM
 SG_ LRRF1_CAN_DET_RANGE_78 : 31|14@0+ (0.015625,0) [0|255.984375] "m"  CADM
 SG_ LRRF1_CAN_DET_RANGE_RATE_78 : 15|14@0+ (0.015625,-128) [-128|127.984375] "m/s"  CADM
 SG_ LRRF1_CAN_DET_AMPLITUDE_78 : 7|7@0+ (1,-64) [-64|63] "dBsm"  CADM
 SG_ LRRF1_CAN_SCAN_INDEX_2LSB_78 : 17|2@0+ (1,0) [0|3] ""  CADM
 SG_ LRRF1_Det_CRC_12 : 503|16@0+ (1,0) [0|65535] ""  CADM
 SG_ LRRF1_Det_MC_12 : 491|4@0+ (1,0) [0|15] ""  CADM
 SG_ LRRF1_CAN_SCAN_INDEX_2LSB_84 : 401|2@0+ (1,0) [0|3] ""  CADM
 SG_ LRRF1_CAN_SCAN_INDEX_2LSB_83 : 337|2@0+ (1,0) [0|3] ""  CADM
 SG_ LRRF1_CAN_SCAN_INDEX_2LSB_82 : 273|2@0+ (1,0) [0|3] ""  CADM
 SG_ LRRF1_CAN_SCAN_INDEX_2LSB_81 : 209|2@0+ (1,0) [0|3] ""  CADM
 SG_ LRRF1_CAN_SCAN_INDEX_2LSB_80 : 145|2@0+ (1,0) [0|3] ""  CADM
 SG_ LRRF1_CAN_SCAN_INDEX_2LSB_79 : 81|2@0+ (1,0) [0|3] ""  CADM
 SG_ LRRF1_CAN_DET_RANGE_RATE_84 : 399|14@0+ (0.015625,-128) [-128|127.984375] "m/s"  CADM
 SG_ LRRF1_CAN_DET_RANGE_RATE_83 : 335|14@0+ (0.015625,-128) [-128|127.984375] "m/s"  CADM
 SG_ LRRF1_CAN_DET_RANGE_RATE_82 : 271|14@0+ (0.015625,-128) [-128|127.984375] "m/s"  CADM
 SG_ LRRF1_CAN_DET_RANGE_RATE_81 : 207|14@0+ (0.015625,-128) [-128|127.984375] "m/s"  CADM
 SG_ LRRF1_CAN_DET_RANGE_RATE_80 : 143|14@0+ (0.015625,-128) [-128|127.984375] "m/s"  CADM
 SG_ LRRF1_CAN_DET_RANGE_RATE_79 : 79|14@0+ (0.015625,-128) [-128|127.984375] "m/s"  CADM
 SG_ LRRF1_CAN_DET_RANGE_84 : 415|14@0+ (0.015625,0) [0|255.984375] "m"  CADM
 SG_ LRRF1_CAN_DET_RANGE_83 : 351|14@0+ (0.015625,0) [0|255.984375] "m"  CADM
 SG_ LRRF1_CAN_DET_RANGE_82 : 287|14@0+ (0.015625,0) [0|255.984375] "m"  CADM
 SG_ LRRF1_CAN_DET_RANGE_81 : 223|14@0+ (0.015625,0) [0|255.984375] "m"  CADM
 SG_ LRRF1_CAN_DET_RANGE_80 : 159|14@0+ (0.015625,0) [0|255.984375] "m"  CADM
 SG_ LRRF1_CAN_DET_RANGE_79 : 95|14@0+ (0.015625,0) [0|255.984375] "m"  CADM
 SG_ LRRF1_CAN_DET_SUPER_RES_TAR_0047 : 432|1@0+ (1,0) [0|1] ""  CADM
 SG_ LRRF1_CAN_DET_SUPER_RES_TAR_0048 : 368|1@0+ (1,0) [0|1] ""  CADM
 SG_ LRRF1_CAN_DET_SUPER_RES_TAR_0049 : 304|1@0+ (1,0) [0|1] ""  CADM
 SG_ LRRF1_CAN_DET_SUPER_RES_TAR_0050 : 240|1@0+ (1,0) [0|1] ""  CADM
 SG_ LRRF1_CAN_DET_SUPER_RES_TAR_0051 : 176|1@0+ (1,0) [0|1] ""  CADM
 SG_ LRRF1_CAN_DET_SUPER_RES_TAR_0052 : 112|1@0+ (1,0) [0|1] ""  CADM
 SG_ LRRF1_CAN_DET_HOST_VEH_CLUT_0047 : 433|1@0+ (1,0) [0|1] ""  CADM
 SG_ LRRF1_CAN_DET_HOST_VEH_CLUT_0048 : 369|1@0+ (1,0) [0|1] ""  CADM
 SG_ LRRF1_CAN_DET_HOST_VEH_CLUT_0049 : 305|1@0+ (1,0) [0|1] ""  CADM
 SG_ LRRF1_CAN_DET_HOST_VEH_CLUT_0050 : 241|1@0+ (1,0) [0|1] ""  CADM
 SG_ LRRF1_CAN_DET_HOST_VEH_CLUT_0051 : 177|1@0+ (1,0) [0|1] ""  CADM
 SG_ LRRF1_CAN_DET_HOST_VEH_CLUT_0052 : 113|1@0+ (1,0) [0|1] ""  CADM
 SG_ LRRF1_CAN_DET_ELEVATION_84 : 447|7@0+ (0.002748,-0.1745) [-0.1745|0.174496] "rad"  CADM
 SG_ LRRF1_CAN_DET_ELEVATION_83 : 383|7@0+ (0.002748,-0.1745) [-0.1745|0.174496] "rad"  CADM
 SG_ LRRF1_CAN_DET_ELEVATION_82 : 319|7@0+ (0.002748,-0.1745) [-0.1745|0.174496] "rad"  CADM
 SG_ LRRF1_CAN_DET_ELEVATION_81 : 255|7@0+ (0.002748,-0.1745) [-0.1745|0.174496] "rad"  CADM
 SG_ LRRF1_CAN_DET_ELEVATION_80 : 191|7@0+ (0.002748,-0.1745) [-0.1745|0.174496] "rad"  CADM
 SG_ LRRF1_CAN_DET_ELEVATION_79 : 127|7@0+ (0.002748,-0.1745) [-0.1745|0.174496] "rad"  CADM
 SG_ LRRF1_CAN_DET_CONFID_ELEVAT_0047 : 440|1@0+ (1,0) [0|1] ""  CADM
 SG_ LRRF1_CAN_DET_CONFID_ELEVAT_0048 : 376|1@0+ (1,0) [0|1] ""  CADM
 SG_ LRRF1_CAN_DET_CONFID_ELEVAT_0049 : 312|1@0+ (1,0) [0|1] ""  CADM
 SG_ LRRF1_CAN_DET_CONFID_ELEVAT_0050 : 248|1@0+ (1,0) [0|1] ""  CADM
 SG_ LRRF1_CAN_DET_CONFID_ELEVAT_0051 : 184|1@0+ (1,0) [0|1] ""  CADM
 SG_ LRRF1_CAN_DET_CONFID_ELEVAT_0052 : 120|1@0+ (1,0) [0|1] ""  CADM
 SG_ LRRF1_CAN_DET_CONFID_AZIMUTH_84 : 417|2@0+ (1,0) [0|3] ""  CADM
 SG_ LRRF1_CAN_DET_CONFID_AZIMUTH_83 : 353|2@0+ (1,0) [0|3] ""  CADM
 SG_ LRRF1_CAN_DET_CONFID_AZIMUTH_82 : 289|2@0+ (1,0) [0|3] ""  CADM
 SG_ LRRF1_CAN_DET_CONFID_AZIMUTH_81 : 225|2@0+ (1,0) [0|3] ""  CADM
 SG_ LRRF1_CAN_DET_CONFID_AZIMUTH_80 : 161|2@0+ (1,0) [0|3] ""  CADM
 SG_ LRRF1_CAN_DET_CONFID_AZIMUTH_79 : 97|2@0+ (1,0) [0|3] ""  CADM
 SG_ LRRF1_CAN_DET_AZIMUTH_84 : 431|14@0+ (0.0003834,-3.1416) [-3.1416|3.1396422] "rad"  CADM
 SG_ LRRF1_CAN_DET_AZIMUTH_83 : 367|14@0+ (0.0003834,-3.1416) [-3.1416|3.1396422] "rad"  CADM
 SG_ LRRF1_CAN_DET_AZIMUTH_82 : 303|14@0+ (0.0003834,-3.1416) [-3.1416|3.1396422] "rad"  CADM
 SG_ LRRF1_CAN_DET_AZIMUTH_81 : 239|14@0+ (0.0003834,-3.1416) [-3.1416|3.1396422] "rad"  CADM
 SG_ LRRF1_CAN_DET_AZIMUTH_80 : 175|14@0+ (0.0003834,-3.1416) [-3.1416|3.1396422] "rad"  CADM
 SG_ LRRF1_CAN_DET_AZIMUTH_79 : 111|14@0+ (0.0003834,-3.1416) [-3.1416|3.1396422] "rad"  CADM
 SG_ LRRF1_CAN_DET_AMPLITUDE_84 : 391|7@0+ (1,-64) [-64|63] "dBsm"  CADM
 SG_ LRRF1_CAN_DET_AMPLITUDE_83 : 327|7@0+ (1,-64) [-64|63] "dBsm"  CADM
 SG_ LRRF1_CAN_DET_AMPLITUDE_82 : 263|7@0+ (1,-64) [-64|63] "dBsm"  CADM
 SG_ LRRF1_CAN_DET_AMPLITUDE_81 : 199|7@0+ (1,-64) [-64|63] "dBsm"  CADM
 SG_ LRRF1_CAN_DET_AMPLITUDE_80 : 135|7@0+ (1,-64) [-64|63] "dBsm"  CADM
 SG_ LRRF1_CAN_DET_AMPLITUDE_79 : 71|7@0+ (1,-64) [-64|63] "dBsm"  CADM
 SG_ LRRF1_CAN_DET_VALID_LEVEL_84 : 384|1@0+ (1,0) [0|1] ""  CADM
 SG_ LRRF1_CAN_DET_VALID_LEVEL_83 : 320|1@0+ (1,0) [0|1] ""  CADM
 SG_ LRRF1_CAN_DET_VALID_LEVEL_82 : 256|1@0+ (1,0) [0|1] ""  CADM
 SG_ LRRF1_CAN_DET_VALID_LEVEL_81 : 192|1@0+ (1,0) [0|1] ""  CADM
 SG_ LRRF1_CAN_DET_VALID_LEVEL_80 : 128|1@0+ (1,0) [0|1] ""  CADM
 SG_ LRRF1_CAN_DET_VALID_LEVEL_79 : 64|1@0+ (1,0) [0|1] ""  CADM

BA_DEF_ SG_  "NWM_WakeupAllowed" ENUM  "0 No","1 Yes";
BA_DEF_ BO_  "GenMsgTimeoutTime" INT 0 2500;
BA_DEF_ BO_  "WakeupMessage" ENUM  "0 No","1 Yes";
BA_DEF_ SG_  "SignalDescription" STRING ;
BA_DEF_ SG_  "GenSigTimeoutTime_ABS_ESC" INT 0 100000;
BA_DEF_ SG_  "UsedOnPgmDBC" ENUM  "No","Yes";
BA_DEF_ BO_  "VFrameFormat" ENUM  "StandardCAN","ExtendedCAN","reserved","reserved","reserved","reserved","reserved","reserved","reserved","reserved","reserved","reserved","reserved","reserved","StandardCAN_FD","ExtendedCAN_FD";
BA_DEF_ BO_  "DiagConnection" INT 0 65535;
BA_DEF_ BO_  "CanTpBs" INT 0 255;
BA_DEF_ BO_  "EventRateOfChange" INT 10 10000;
BA_DEF_ BO_  "DiagState" ENUM  "No","Yes";
BA_DEF_ BO_  "DiagRequest" ENUM  "No","Yes";
BA_DEF_ BO_  "DiagResponse" ENUM  "No","Yes";
BA_DEF_ SG_  "GenSigCycleTime" INT 0 0;
BA_DEF_ SG_  "GenSigMarked" STRING ;
BA_DEF_ SG_  "GenSigVtName" STRING ;
BA_DEF_ SG_  "GenSigVtEn" STRING ;
BA_DEF_ SG_  "GenSigCmt" STRING ;
BA_DEF_ SG_  "GenSigSendType" ENUM  "Cyclic","OnWrite","vector_leerstring","OnChange","vector_leerstring","IfActive","vector_leerstring","NoSigSendType";
BA_DEF_ SG_  "GenSigInactiveValue" INT 0 100000;
BA_DEF_ SG_  "GenSigMissingSourceValue" INT 0 1000000000;
BA_DEF_ SG_  "GenSigStartValue" INT 0 1000000000;
BA_DEF_ BO_  "GenMsgILSupport" ENUM  "No","Yes";
BA_DEF_ BO_  "GenMsgSendType" ENUM  "FixedPeriodic","Event","EnabledPeriodic","NotUsed","NotUsed","EventPeriodic","NotUsed","NotUsed","NoMsgSendType";
BA_DEF_ BO_  "GenMsgCycleTime" INT 0 100000;
BA_DEF_ BO_  "GenMsgDelayTime" INT 0 10000;
BA_DEF_ BO_  "GenMsgNrOfRepetition" INT 0 100;
BA_DEF_ BO_  "GenMsgStartDelayTime" INT 0 10000;
BA_DEF_ BO_  "NetworkInitialization" ENUM  "No","Yes";
BA_DEF_ SG_  "SystemSignalLongSymbol" STRING ;
BA_DEF_DEF_  "NWM_WakeupAllowed" "0 No";
BA_DEF_DEF_  "GenMsgTimeoutTime" 2500;
BA_DEF_DEF_  "WakeupMessage" "0 No";
BA_DEF_DEF_  "SignalDescription" "";
BA_DEF_DEF_  "GenSigTimeoutTime_ABS_ESC" 0;
BA_DEF_DEF_  "UsedOnPgmDBC" "Yes";
BA_DEF_DEF_  "VFrameFormat" "StandardCAN_FD";
BA_DEF_DEF_  "DiagConnection" 0;
BA_DEF_DEF_  "CanTpBs" 255;
BA_DEF_DEF_  "EventRateOfChange" 10000;
BA_DEF_DEF_  "DiagState" "No";
BA_DEF_DEF_  "DiagRequest" "No";
BA_DEF_DEF_  "DiagResponse" "No";
BA_DEF_DEF_  "GenSigCycleTime" 0;
BA_DEF_DEF_  "GenSigMarked" "";
BA_DEF_DEF_  "GenSigVtName" "";
BA_DEF_DEF_  "GenSigVtEn" "";
BA_DEF_DEF_  "GenSigCmt" "";
BA_DEF_DEF_  "GenSigSendType" "NoSigSendType";
BA_DEF_DEF_  "GenSigInactiveValue" 0;
BA_DEF_DEF_  "GenSigMissingSourceValue" 0;
BA_DEF_DEF_  "GenSigStartValue" 0;
BA_DEF_DEF_  "GenMsgILSupport" "Yes";
BA_DEF_DEF_  "GenMsgSendType" "NoMsgSendType";
BA_DEF_DEF_  "GenMsgCycleTime" 0;
BA_DEF_DEF_  "GenMsgDelayTime" 0;
BA_DEF_DEF_  "GenMsgNrOfRepetition" 0;
BA_DEF_DEF_  "GenMsgStartDelayTime" 0;
BA_DEF_DEF_  "NetworkInitialization" "No";
BA_DEF_DEF_  "SystemSignalLongSymbol" "";
BA_ "GenMsgTimeoutTime" BO_ 91 0;
BA_ "GenMsgSendType" BO_ 91 1;
BA_ "GenMsgTimeoutTime" BO_ 90 0;
BA_ "GenMsgSendType" BO_ 90 1;
BA_ "GenMsgTimeoutTime" BO_ 89 0;
BA_ "GenMsgSendType" BO_ 89 1;
BA_ "GenMsgTimeoutTime" BO_ 88 0;
BA_ "GenMsgSendType" BO_ 88 1;
BA_ "GenMsgTimeoutTime" BO_ 87 0;
BA_ "GenMsgSendType" BO_ 87 1;
BA_ "GenMsgTimeoutTime" BO_ 86 0;
BA_ "GenMsgSendType" BO_ 86 1;
BA_ "GenMsgTimeoutTime" BO_ 85 0;
BA_ "GenMsgSendType" BO_ 85 1;
BA_ "GenSigSendType" SG_ 91 LRRF1_CAN_DET_Near_TARGET_126 1;
BA_ "SignalDescription" SG_ 91 LRRF1_CAN_DET_Near_TARGET_126 "Near_Target_Discrimination";
BA_ "SignalDescription" SG_ 91 LRRF1_CAN_DET_Near_TARGET_125 "Near_Target_Discrimination";
BA_ "SignalDescription" SG_ 91 LRRF1_CAN_DET_Near_TARGET_124 "Near_Target_Discrimination";
BA_ "SignalDescription" SG_ 91 LRRF1_CAN_DET_Near_TARGET_123 "Near_Target_Discrimination";
BA_ "SignalDescription" SG_ 91 LRRF1_CAN_DET_Near_TARGET_122 "Near_Target_Discrimination";
BA_ "SignalDescription" SG_ 91 LRRF1_CAN_DET_Near_TARGET_121 "Near_Target_Discrimination";
BA_ "SignalDescription" SG_ 91 LRRF1_CAN_DET_Near_TARGET_120 "Near_Target_Discrimination";
BA_ "GenSigStartValue" SG_ 91 LRRF1_CAN_DET_ELEVATION_120 63.8646288209607;
BA_ "SignalDescription" SG_ 91 LRRF1_CAN_DET_ELEVATION_120 "Detected object elevation position 120";
BA_ "GenSigVtEn" SG_ 91 LRRF1_CAN_DET_CONFID_AZIMUTH_120 "TRUE";
BA_ "SignalDescription" SG_ 91 LRRF1_CAN_DET_CONFID_AZIMUTH_120 "Signal to noise level 120";
BA_ "SignalDescription" SG_ 91 LRRF1_CAN_DET_SUPER_RES_TAR_0007 "Super resolution target 120";
BA_ "SystemSignalLongSymbol" SG_ 91 LRRF1_CAN_DET_SUPER_RES_TAR_0007 "LRRF1_CAN_DET_SUPER_RES_TARGET_120";
BA_ "SignalDescription" SG_ 91 LRRF1_CAN_DET_CONFID_ELEVAT_0007 "Elevation Angle Confidence 120";
BA_ "SystemSignalLongSymbol" SG_ 91 LRRF1_CAN_DET_CONFID_ELEVAT_0007 "LRRF1_CAN_DET_CONFID_ELEVATION_120";
BA_ "SignalDescription" SG_ 91 LRRF1_CAN_DET_HOST_VEH_CLUT_0007 "Host vehicle clutter 120";
BA_ "SystemSignalLongSymbol" SG_ 91 LRRF1_CAN_DET_HOST_VEH_CLUT_0007 "LRRF1_CAN_DET_HOST_VEH_CLUTTER_120";
BA_ "SignalDescription" SG_ 91 LRRF1_CAN_DET_VALID_LEVEL_120 "Detected object valid level 120";
BA_ "GenSigStartValue" SG_ 91 LRRF1_CAN_DET_AZIMUTH_120 8194.05320813772;
BA_ "SignalDescription" SG_ 91 LRRF1_CAN_DET_AZIMUTH_120 "Detected object azimuth position 120";
BA_ "SignalDescription" SG_ 91 LRRF1_CAN_DET_RANGE_120 "Detected object range 120";
BA_ "GenSigStartValue" SG_ 91 LRRF1_CAN_DET_RANGE_RATE_120 8192;
BA_ "SignalDescription" SG_ 91 LRRF1_CAN_DET_RANGE_RATE_120 "Detected object range rate 120";
BA_ "SignalDescription" SG_ 91 LRRF1_CAN_DET_AMPLITUDE_120 "Detected object amplitude 120";
BA_ "SignalDescription" SG_ 91 LRRF1_CAN_SCAN_INDEX_2LSB_120 "The two LSB of scan index 120";
BA_ "SignalDescription" SG_ 91 LRRF1_Det_CRC_18 "Cyclic Redundancy Check for Detection Message Number 18";
BA_ "SignalDescription" SG_ 91 LRRF1_Det_MC_18 "Message Count for Detection Message Number 18";
BA_ "SignalDescription" SG_ 91 LRRF1_CAN_SCAN_INDEX_2LSB_126 "The two LSB of scan index 126";
BA_ "SignalDescription" SG_ 91 LRRF1_CAN_SCAN_INDEX_2LSB_125 "The two LSB of scan index 125";
BA_ "SignalDescription" SG_ 91 LRRF1_CAN_SCAN_INDEX_2LSB_124 "The two LSB of scan index 124";
BA_ "SignalDescription" SG_ 91 LRRF1_CAN_SCAN_INDEX_2LSB_123 "The two LSB of scan index 123";
BA_ "SignalDescription" SG_ 91 LRRF1_CAN_SCAN_INDEX_2LSB_122 "The two LSB of scan index 122";
BA_ "SignalDescription" SG_ 91 LRRF1_CAN_SCAN_INDEX_2LSB_121 "The two LSB of scan index 121";
BA_ "GenSigStartValue" SG_ 91 LRRF1_CAN_DET_RANGE_RATE_126 8192;
BA_ "SignalDescription" SG_ 91 LRRF1_CAN_DET_RANGE_RATE_126 "Detected object range rate 126";
BA_ "GenSigStartValue" SG_ 91 LRRF1_CAN_DET_RANGE_RATE_125 8192;
BA_ "SignalDescription" SG_ 91 LRRF1_CAN_DET_RANGE_RATE_125 "Detected object range rate 125";
BA_ "GenSigStartValue" SG_ 91 LRRF1_CAN_DET_RANGE_RATE_124 8192;
BA_ "SignalDescription" SG_ 91 LRRF1_CAN_DET_RANGE_RATE_124 "Detected object range rate 124";
BA_ "GenSigStartValue" SG_ 91 LRRF1_CAN_DET_RANGE_RATE_123 8192;
BA_ "SignalDescription" SG_ 91 LRRF1_CAN_DET_RANGE_RATE_123 "Detected object range rate 123";
BA_ "GenSigStartValue" SG_ 91 LRRF1_CAN_DET_RANGE_RATE_122 8192;
BA_ "SignalDescription" SG_ 91 LRRF1_CAN_DET_RANGE_RATE_122 "Detected object range rate 122";
BA_ "GenSigStartValue" SG_ 91 LRRF1_CAN_DET_RANGE_RATE_121 8192;
BA_ "SignalDescription" SG_ 91 LRRF1_CAN_DET_RANGE_RATE_121 "Detected object range rate 121";
BA_ "SignalDescription" SG_ 91 LRRF1_CAN_DET_RANGE_126 "Detected object range 126";
BA_ "SignalDescription" SG_ 91 LRRF1_CAN_DET_RANGE_125 "Detected object range 125";
BA_ "SignalDescription" SG_ 91 LRRF1_CAN_DET_RANGE_124 "Detected object range 124";
BA_ "SignalDescription" SG_ 91 LRRF1_CAN_DET_RANGE_123 "Detected object range 123";
BA_ "SignalDescription" SG_ 91 LRRF1_CAN_DET_RANGE_122 "Detected object range 122";
BA_ "SignalDescription" SG_ 91 LRRF1_CAN_DET_RANGE_121 "Detected object range 121";
BA_ "SignalDescription" SG_ 91 LRRF1_CAN_DET_SUPER_RES_TAR_0008 "Super resolution target 126";
BA_ "SystemSignalLongSymbol" SG_ 91 LRRF1_CAN_DET_SUPER_RES_TAR_0008 "LRRF1_CAN_DET_SUPER_RES_TARGET_126";
BA_ "SignalDescription" SG_ 91 LRRF1_CAN_DET_SUPER_RES_TAR_0009 "Super resolution target 125";
BA_ "SystemSignalLongSymbol" SG_ 91 LRRF1_CAN_DET_SUPER_RES_TAR_0009 "LRRF1_CAN_DET_SUPER_RES_TARGET_125";
BA_ "SignalDescription" SG_ 91 LRRF1_CAN_DET_SUPER_RES_TAR_0010 "Super resolution target 124";
BA_ "SystemSignalLongSymbol" SG_ 91 LRRF1_CAN_DET_SUPER_RES_TAR_0010 "LRRF1_CAN_DET_SUPER_RES_TARGET_124";
BA_ "SignalDescription" SG_ 91 LRRF1_CAN_DET_SUPER_RES_TAR_0011 "Super resolution target 123";
BA_ "SystemSignalLongSymbol" SG_ 91 LRRF1_CAN_DET_SUPER_RES_TAR_0011 "LRRF1_CAN_DET_SUPER_RES_TARGET_123";
BA_ "SignalDescription" SG_ 91 LRRF1_CAN_DET_SUPER_RES_TAR_0012 "Super resolution target 122";
BA_ "SystemSignalLongSymbol" SG_ 91 LRRF1_CAN_DET_SUPER_RES_TAR_0012 "LRRF1_CAN_DET_SUPER_RES_TARGET_122";
BA_ "SignalDescription" SG_ 91 LRRF1_CAN_DET_SUPER_RES_TAR_0013 "Super resolution target 121";
BA_ "SystemSignalLongSymbol" SG_ 91 LRRF1_CAN_DET_SUPER_RES_TAR_0013 "LRRF1_CAN_DET_SUPER_RES_TARGET_121";
BA_ "SignalDescription" SG_ 91 LRRF1_CAN_DET_HOST_VEH_CLUT_0008 "Host vehicle clutter 126";
BA_ "SystemSignalLongSymbol" SG_ 91 LRRF1_CAN_DET_HOST_VEH_CLUT_0008 "LRRF1_CAN_DET_HOST_VEH_CLUTTER_126";
BA_ "SignalDescription" SG_ 91 LRRF1_CAN_DET_HOST_VEH_CLUT_0009 "Host vehicle clutter 125";
BA_ "SystemSignalLongSymbol" SG_ 91 LRRF1_CAN_DET_HOST_VEH_CLUT_0009 "LRRF1_CAN_DET_HOST_VEH_CLUTTER_125";
BA_ "SignalDescription" SG_ 91 LRRF1_CAN_DET_HOST_VEH_CLUT_0010 "Host vehicle clutter 124";
BA_ "SystemSignalLongSymbol" SG_ 91 LRRF1_CAN_DET_HOST_VEH_CLUT_0010 "LRRF1_CAN_DET_HOST_VEH_CLUTTER_124";
BA_ "SignalDescription" SG_ 91 LRRF1_CAN_DET_HOST_VEH_CLUT_0011 "Host vehicle clutter 123";
BA_ "SystemSignalLongSymbol" SG_ 91 LRRF1_CAN_DET_HOST_VEH_CLUT_0011 "LRRF1_CAN_DET_HOST_VEH_CLUTTER_123";
BA_ "SignalDescription" SG_ 91 LRRF1_CAN_DET_HOST_VEH_CLUT_0012 "Host vehicle clutter 122";
BA_ "SystemSignalLongSymbol" SG_ 91 LRRF1_CAN_DET_HOST_VEH_CLUT_0012 "LRRF1_CAN_DET_HOST_VEH_CLUTTER_122";
BA_ "SignalDescription" SG_ 91 LRRF1_CAN_DET_HOST_VEH_CLUT_0013 "Host vehicle clutter 121";
BA_ "SystemSignalLongSymbol" SG_ 91 LRRF1_CAN_DET_HOST_VEH_CLUT_0013 "LRRF1_CAN_DET_HOST_VEH_CLUTTER_121";
BA_ "GenSigStartValue" SG_ 91 LRRF1_CAN_DET_ELEVATION_126 63.8646288209607;
BA_ "SignalDescription" SG_ 91 LRRF1_CAN_DET_ELEVATION_126 "Detected object elevation position 126";
BA_ "GenSigStartValue" SG_ 91 LRRF1_CAN_DET_ELEVATION_125 63.8646288209607;
BA_ "SignalDescription" SG_ 91 LRRF1_CAN_DET_ELEVATION_125 "Detected object elevation position 125";
BA_ "GenSigStartValue" SG_ 91 LRRF1_CAN_DET_ELEVATION_124 63.8646288209607;
BA_ "SignalDescription" SG_ 91 LRRF1_CAN_DET_ELEVATION_124 "Detected object elevation position 124";
BA_ "GenSigStartValue" SG_ 91 LRRF1_CAN_DET_ELEVATION_123 63.8646288209607;
BA_ "SignalDescription" SG_ 91 LRRF1_CAN_DET_ELEVATION_123 "Detected object elevation position 123";
BA_ "GenSigStartValue" SG_ 91 LRRF1_CAN_DET_ELEVATION_122 63.8646288209607;
BA_ "SignalDescription" SG_ 91 LRRF1_CAN_DET_ELEVATION_122 "Detected object elevation position 122";
BA_ "GenSigStartValue" SG_ 91 LRRF1_CAN_DET_ELEVATION_121 63.8646288209607;
BA_ "SignalDescription" SG_ 91 LRRF1_CAN_DET_ELEVATION_121 "Detected object elevation position 121";
BA_ "SignalDescription" SG_ 91 LRRF1_CAN_DET_CONFID_ELEVAT_0008 "Elevation Angle Confidence 126";
BA_ "SystemSignalLongSymbol" SG_ 91 LRRF1_CAN_DET_CONFID_ELEVAT_0008 "LRRF1_CAN_DET_CONFID_ELEVATION_126";
BA_ "SignalDescription" SG_ 91 LRRF1_CAN_DET_CONFID_ELEVAT_0009 "Elevation Angle Confidence 125";
BA_ "SystemSignalLongSymbol" SG_ 91 LRRF1_CAN_DET_CONFID_ELEVAT_0009 "LRRF1_CAN_DET_CONFID_ELEVATION_125";
BA_ "SignalDescription" SG_ 91 LRRF1_CAN_DET_CONFID_ELEVAT_0010 "Elevation Angle Confidence 124";
BA_ "SystemSignalLongSymbol" SG_ 91 LRRF1_CAN_DET_CONFID_ELEVAT_0010 "LRRF1_CAN_DET_CONFID_ELEVATION_124";
BA_ "SignalDescription" SG_ 91 LRRF1_CAN_DET_CONFID_ELEVAT_0011 "Elevation Angle Confidence 123";
BA_ "SystemSignalLongSymbol" SG_ 91 LRRF1_CAN_DET_CONFID_ELEVAT_0011 "LRRF1_CAN_DET_CONFID_ELEVATION_123";
BA_ "SignalDescription" SG_ 91 LRRF1_CAN_DET_CONFID_ELEVAT_0012 "Elevation Angle Confidence 122";
BA_ "SystemSignalLongSymbol" SG_ 91 LRRF1_CAN_DET_CONFID_ELEVAT_0012 "LRRF1_CAN_DET_CONFID_ELEVATION_122";
BA_ "SignalDescription" SG_ 91 LRRF1_CAN_DET_CONFID_ELEVAT_0013 "Elevation Angle Confidence 121";
BA_ "SystemSignalLongSymbol" SG_ 91 LRRF1_CAN_DET_CONFID_ELEVAT_0013 "LRRF1_CAN_DET_CONFID_ELEVATION_121";
BA_ "GenSigVtEn" SG_ 91 LRRF1_CAN_DET_CONFID_AZIMUTH_126 "TRUE";
BA_ "SignalDescription" SG_ 91 LRRF1_CAN_DET_CONFID_AZIMUTH_126 "Signal to noise level 126";
BA_ "GenSigVtEn" SG_ 91 LRRF1_CAN_DET_CONFID_AZIMUTH_125 "TRUE";
BA_ "SignalDescription" SG_ 91 LRRF1_CAN_DET_CONFID_AZIMUTH_125 "Signal to noise level 125";
BA_ "GenSigVtEn" SG_ 91 LRRF1_CAN_DET_CONFID_AZIMUTH_124 "TRUE";
BA_ "SignalDescription" SG_ 91 LRRF1_CAN_DET_CONFID_AZIMUTH_124 "Signal to noise level 124";
BA_ "GenSigVtEn" SG_ 91 LRRF1_CAN_DET_CONFID_AZIMUTH_123 "TRUE";
BA_ "SignalDescription" SG_ 91 LRRF1_CAN_DET_CONFID_AZIMUTH_123 "Signal to noise level 123";
BA_ "GenSigVtEn" SG_ 91 LRRF1_CAN_DET_CONFID_AZIMUTH_122 "TRUE";
BA_ "SignalDescription" SG_ 91 LRRF1_CAN_DET_CONFID_AZIMUTH_122 "Signal to noise level 122";
BA_ "GenSigVtEn" SG_ 91 LRRF1_CAN_DET_CONFID_AZIMUTH_121 "TRUE";
BA_ "SignalDescription" SG_ 91 LRRF1_CAN_DET_CONFID_AZIMUTH_121 "Signal to noise level 121";
BA_ "GenSigStartValue" SG_ 91 LRRF1_CAN_DET_AZIMUTH_126 8194.05320813772;
BA_ "SignalDescription" SG_ 91 LRRF1_CAN_DET_AZIMUTH_126 "Detected object azimuth position 126";
BA_ "GenSigStartValue" SG_ 91 LRRF1_CAN_DET_AZIMUTH_125 8194.05320813772;
BA_ "SignalDescription" SG_ 91 LRRF1_CAN_DET_AZIMUTH_125 "Detected object azimuth position 125";
BA_ "GenSigStartValue" SG_ 91 LRRF1_CAN_DET_AZIMUTH_124 8194.05320813772;
BA_ "SignalDescription" SG_ 91 LRRF1_CAN_DET_AZIMUTH_124 "Detected object azimuth position 124";
BA_ "GenSigStartValue" SG_ 91 LRRF1_CAN_DET_AZIMUTH_123 8194.05320813772;
BA_ "SignalDescription" SG_ 91 LRRF1_CAN_DET_AZIMUTH_123 "Detected object azimuth position 123";
BA_ "GenSigStartValue" SG_ 91 LRRF1_CAN_DET_AZIMUTH_122 8194.05320813772;
BA_ "SignalDescription" SG_ 91 LRRF1_CAN_DET_AZIMUTH_122 "Detected object azimuth position 122";
BA_ "GenSigStartValue" SG_ 91 LRRF1_CAN_DET_AZIMUTH_121 8194.05320813772;
BA_ "SignalDescription" SG_ 91 LRRF1_CAN_DET_AZIMUTH_121 "Detected object azimuth position 121";
BA_ "SignalDescription" SG_ 91 LRRF1_CAN_DET_AMPLITUDE_126 "Detected object amplitude 126";
BA_ "SignalDescription" SG_ 91 LRRF1_CAN_DET_AMPLITUDE_125 "Detected object amplitude 125";
BA_ "SignalDescription" SG_ 91 LRRF1_CAN_DET_AMPLITUDE_124 "Detected object amplitude 124";
BA_ "SignalDescription" SG_ 91 LRRF1_CAN_DET_AMPLITUDE_123 "Detected object amplitude 123";
BA_ "SignalDescription" SG_ 91 LRRF1_CAN_DET_AMPLITUDE_122 "Detected object amplitude 122";
BA_ "SignalDescription" SG_ 91 LRRF1_CAN_DET_AMPLITUDE_121 "Detected object amplitude 121";
BA_ "SignalDescription" SG_ 91 LRRF1_CAN_DET_VALID_LEVEL_126 "Detected object valid level 126";
BA_ "SignalDescription" SG_ 91 LRRF1_CAN_DET_VALID_LEVEL_125 "Detected object valid level 125";
BA_ "SignalDescription" SG_ 91 LRRF1_CAN_DET_VALID_LEVEL_124 "Detected object valid level 124";
BA_ "SignalDescription" SG_ 91 LRRF1_CAN_DET_VALID_LEVEL_123 "Detected object valid level 123";
BA_ "SignalDescription" SG_ 91 LRRF1_CAN_DET_VALID_LEVEL_122 "Detected object valid level 122";
BA_ "SignalDescription" SG_ 91 LRRF1_CAN_DET_VALID_LEVEL_121 "Detected object valid level 121";
BA_ "GenSigSendType" SG_ 90 LRRF1_CAN_DET_Near_TARGET_119 1;
BA_ "SignalDescription" SG_ 90 LRRF1_CAN_DET_Near_TARGET_119 "Near_Target_Discrimination";
BA_ "SignalDescription" SG_ 90 LRRF1_CAN_DET_Near_TARGET_118 "Near_Target_Discrimination";
BA_ "SignalDescription" SG_ 90 LRRF1_CAN_DET_Near_TARGET_117 "Near_Target_Discrimination";
BA_ "SignalDescription" SG_ 90 LRRF1_CAN_DET_Near_TARGET_116 "Near_Target_Discrimination";
BA_ "SignalDescription" SG_ 90 LRRF1_CAN_DET_Near_TARGET_115 "Near_Target_Discrimination";
BA_ "SignalDescription" SG_ 90 LRRF1_CAN_DET_Near_TARGET_114 "Near_Target_Discrimination";
BA_ "SignalDescription" SG_ 90 LRRF1_CAN_DET_Near_TARGET_113 "Near_Target_Discrimination";
BA_ "GenSigStartValue" SG_ 90 LRRF1_CAN_DET_ELEVATION_113 63.8646288209607;
BA_ "SignalDescription" SG_ 90 LRRF1_CAN_DET_ELEVATION_113 "Detected object elevation position 113";
BA_ "GenSigVtEn" SG_ 90 LRRF1_CAN_DET_CONFID_AZIMUTH_113 "TRUE";
BA_ "SignalDescription" SG_ 90 LRRF1_CAN_DET_CONFID_AZIMUTH_113 "Signal to noise level 113";
BA_ "SignalDescription" SG_ 90 LRRF1_CAN_DET_SUPER_RES_TAR_0014 "Super resolution target 113";
BA_ "SystemSignalLongSymbol" SG_ 90 LRRF1_CAN_DET_SUPER_RES_TAR_0014 "LRRF1_CAN_DET_SUPER_RES_TARGET_113";
BA_ "SignalDescription" SG_ 90 LRRF1_CAN_DET_CONFID_ELEVAT_0014 "Elevation Angle Confidence 113";
BA_ "SystemSignalLongSymbol" SG_ 90 LRRF1_CAN_DET_CONFID_ELEVAT_0014 "LRRF1_CAN_DET_CONFID_ELEVATION_113";
BA_ "SignalDescription" SG_ 90 LRRF1_CAN_DET_HOST_VEH_CLUT_0014 "Host vehicle clutter 113";
BA_ "SystemSignalLongSymbol" SG_ 90 LRRF1_CAN_DET_HOST_VEH_CLUT_0014 "LRRF1_CAN_DET_HOST_VEH_CLUTTER_113";
BA_ "SignalDescription" SG_ 90 LRRF1_CAN_DET_VALID_LEVEL_113 "Detected object valid level 113";
BA_ "GenSigStartValue" SG_ 90 LRRF1_CAN_DET_AZIMUTH_113 8194.05320813772;
BA_ "SignalDescription" SG_ 90 LRRF1_CAN_DET_AZIMUTH_113 "Detected object azimuth position 113";
BA_ "SignalDescription" SG_ 90 LRRF1_CAN_DET_RANGE_113 "Detected object range 113";
BA_ "GenSigStartValue" SG_ 90 LRRF1_CAN_DET_RANGE_RATE_113 8192;
BA_ "SignalDescription" SG_ 90 LRRF1_CAN_DET_RANGE_RATE_113 "Detected object range rate 113";
BA_ "SignalDescription" SG_ 90 LRRF1_CAN_DET_AMPLITUDE_113 "Detected object amplitude 113";
BA_ "SignalDescription" SG_ 90 LRRF1_CAN_SCAN_INDEX_2LSB_113 "The two LSB of scan index 113";
BA_ "SignalDescription" SG_ 90 LRRF1_Det_CRC_17 "Cyclic Redundancy Check for Detection Message Number 17";
BA_ "SignalDescription" SG_ 90 LRRF1_Det_MC_17 "Message Count for Detection Message Number 17";
BA_ "SignalDescription" SG_ 90 LRRF1_CAN_SCAN_INDEX_2LSB_119 "The two LSB of scan index 119";
BA_ "SignalDescription" SG_ 90 LRRF1_CAN_SCAN_INDEX_2LSB_118 "The two LSB of scan index 118";
BA_ "SignalDescription" SG_ 90 LRRF1_CAN_SCAN_INDEX_2LSB_117 "The two LSB of scan index 117";
BA_ "SignalDescription" SG_ 90 LRRF1_CAN_SCAN_INDEX_2LSB_116 "The two LSB of scan index 116";
BA_ "SignalDescription" SG_ 90 LRRF1_CAN_SCAN_INDEX_2LSB_115 "The two LSB of scan index 115";
BA_ "SignalDescription" SG_ 90 LRRF1_CAN_SCAN_INDEX_2LSB_114 "The two LSB of scan index 114";
BA_ "GenSigStartValue" SG_ 90 LRRF1_CAN_DET_RANGE_RATE_119 8192;
BA_ "SignalDescription" SG_ 90 LRRF1_CAN_DET_RANGE_RATE_119 "Detected object range rate 119";
BA_ "GenSigStartValue" SG_ 90 LRRF1_CAN_DET_RANGE_RATE_118 8192;
BA_ "SignalDescription" SG_ 90 LRRF1_CAN_DET_RANGE_RATE_118 "Detected object range rate 118";
BA_ "GenSigStartValue" SG_ 90 LRRF1_CAN_DET_RANGE_RATE_117 8192;
BA_ "SignalDescription" SG_ 90 LRRF1_CAN_DET_RANGE_RATE_117 "Detected object range rate 117";
BA_ "GenSigStartValue" SG_ 90 LRRF1_CAN_DET_RANGE_RATE_116 8192;
BA_ "SignalDescription" SG_ 90 LRRF1_CAN_DET_RANGE_RATE_116 "Detected object range rate 116";
BA_ "GenSigStartValue" SG_ 90 LRRF1_CAN_DET_RANGE_RATE_115 8192;
BA_ "SignalDescription" SG_ 90 LRRF1_CAN_DET_RANGE_RATE_115 "Detected object range rate 115";
BA_ "GenSigStartValue" SG_ 90 LRRF1_CAN_DET_RANGE_RATE_114 8192;
BA_ "SignalDescription" SG_ 90 LRRF1_CAN_DET_RANGE_RATE_114 "Detected object range rate 114";
BA_ "SignalDescription" SG_ 90 LRRF1_CAN_DET_RANGE_119 "Detected object range 119";
BA_ "SignalDescription" SG_ 90 LRRF1_CAN_DET_RANGE_118 "Detected object range 118";
BA_ "SignalDescription" SG_ 90 LRRF1_CAN_DET_RANGE_117 "Detected object range 117";
BA_ "SignalDescription" SG_ 90 LRRF1_CAN_DET_RANGE_116 "Detected object range 116";
BA_ "SignalDescription" SG_ 90 LRRF1_CAN_DET_RANGE_115 "Detected object range 115";
BA_ "SignalDescription" SG_ 90 LRRF1_CAN_DET_RANGE_114 "Detected object range 114";
BA_ "SignalDescription" SG_ 90 LRRF1_CAN_DET_SUPER_RES_TAR_0015 "Super resolution target 119";
BA_ "SystemSignalLongSymbol" SG_ 90 LRRF1_CAN_DET_SUPER_RES_TAR_0015 "LRRF1_CAN_DET_SUPER_RES_TARGET_119";
BA_ "SignalDescription" SG_ 90 LRRF1_CAN_DET_SUPER_RES_TAR_0016 "Super resolution target 118";
BA_ "SystemSignalLongSymbol" SG_ 90 LRRF1_CAN_DET_SUPER_RES_TAR_0016 "LRRF1_CAN_DET_SUPER_RES_TARGET_118";
BA_ "SignalDescription" SG_ 90 LRRF1_CAN_DET_SUPER_RES_TAR_0017 "Super resolution target 117";
BA_ "SystemSignalLongSymbol" SG_ 90 LRRF1_CAN_DET_SUPER_RES_TAR_0017 "LRRF1_CAN_DET_SUPER_RES_TARGET_117";
BA_ "SignalDescription" SG_ 90 LRRF1_CAN_DET_SUPER_RES_TAR_0018 "Super resolution target 116";
BA_ "SystemSignalLongSymbol" SG_ 90 LRRF1_CAN_DET_SUPER_RES_TAR_0018 "LRRF1_CAN_DET_SUPER_RES_TARGET_116";
BA_ "SignalDescription" SG_ 90 LRRF1_CAN_DET_SUPER_RES_TAR_0019 "Super resolution target 115";
BA_ "SystemSignalLongSymbol" SG_ 90 LRRF1_CAN_DET_SUPER_RES_TAR_0019 "LRRF1_CAN_DET_SUPER_RES_TARGET_115";
BA_ "SignalDescription" SG_ 90 LRRF1_CAN_DET_SUPER_RES_TAR_0020 "Super resolution target 114";
BA_ "SystemSignalLongSymbol" SG_ 90 LRRF1_CAN_DET_SUPER_RES_TAR_0020 "LRRF1_CAN_DET_SUPER_RES_TARGET_114";
BA_ "SignalDescription" SG_ 90 LRRF1_CAN_DET_HOST_VEH_CLUT_0015 "Host vehicle clutter 119";
BA_ "SystemSignalLongSymbol" SG_ 90 LRRF1_CAN_DET_HOST_VEH_CLUT_0015 "LRRF1_CAN_DET_HOST_VEH_CLUTTER_119";
BA_ "SignalDescription" SG_ 90 LRRF1_CAN_DET_HOST_VEH_CLUT_0016 "Host vehicle clutter 118";
BA_ "SystemSignalLongSymbol" SG_ 90 LRRF1_CAN_DET_HOST_VEH_CLUT_0016 "LRRF1_CAN_DET_HOST_VEH_CLUTTER_118";
BA_ "SignalDescription" SG_ 90 LRRF1_CAN_DET_HOST_VEH_CLUT_0017 "Host vehicle clutter 117";
BA_ "SystemSignalLongSymbol" SG_ 90 LRRF1_CAN_DET_HOST_VEH_CLUT_0017 "LRRF1_CAN_DET_HOST_VEH_CLUTTER_117";
BA_ "SignalDescription" SG_ 90 LRRF1_CAN_DET_HOST_VEH_CLUT_0018 "Host vehicle clutter 116";
BA_ "SystemSignalLongSymbol" SG_ 90 LRRF1_CAN_DET_HOST_VEH_CLUT_0018 "LRRF1_CAN_DET_HOST_VEH_CLUTTER_116";
BA_ "SignalDescription" SG_ 90 LRRF1_CAN_DET_HOST_VEH_CLUT_0019 "Host vehicle clutter 115";
BA_ "SystemSignalLongSymbol" SG_ 90 LRRF1_CAN_DET_HOST_VEH_CLUT_0019 "LRRF1_CAN_DET_HOST_VEH_CLUTTER_115";
BA_ "SignalDescription" SG_ 90 LRRF1_CAN_DET_HOST_VEH_CLUT_0020 "Host vehicle clutter 114";
BA_ "SystemSignalLongSymbol" SG_ 90 LRRF1_CAN_DET_HOST_VEH_CLUT_0020 "LRRF1_CAN_DET_HOST_VEH_CLUTTER_114";
BA_ "GenSigStartValue" SG_ 90 LRRF1_CAN_DET_ELEVATION_119 63.8646288209607;
BA_ "SignalDescription" SG_ 90 LRRF1_CAN_DET_ELEVATION_119 "Detected object elevation position 119";
BA_ "GenSigStartValue" SG_ 90 LRRF1_CAN_DET_ELEVATION_118 63.8646288209607;
BA_ "SignalDescription" SG_ 90 LRRF1_CAN_DET_ELEVATION_118 "Detected object elevation position 118";
BA_ "GenSigStartValue" SG_ 90 LRRF1_CAN_DET_ELEVATION_117 63.8646288209607;
BA_ "SignalDescription" SG_ 90 LRRF1_CAN_DET_ELEVATION_117 "Detected object elevation position 117";
BA_ "GenSigStartValue" SG_ 90 LRRF1_CAN_DET_ELEVATION_116 63.8646288209607;
BA_ "SignalDescription" SG_ 90 LRRF1_CAN_DET_ELEVATION_116 "Detected object elevation position 116";
BA_ "GenSigStartValue" SG_ 90 LRRF1_CAN_DET_ELEVATION_115 63.8646288209607;
BA_ "SignalDescription" SG_ 90 LRRF1_CAN_DET_ELEVATION_115 "Detected object elevation position 115";
BA_ "GenSigStartValue" SG_ 90 LRRF1_CAN_DET_ELEVATION_114 63.8646288209607;
BA_ "SignalDescription" SG_ 90 LRRF1_CAN_DET_ELEVATION_114 "Detected object elevation position 114";
BA_ "SignalDescription" SG_ 90 LRRF1_CAN_DET_CONFID_ELEVAT_0015 "Elevation Angle Confidence 119";
BA_ "SystemSignalLongSymbol" SG_ 90 LRRF1_CAN_DET_CONFID_ELEVAT_0015 "LRRF1_CAN_DET_CONFID_ELEVATION_119";
BA_ "SignalDescription" SG_ 90 LRRF1_CAN_DET_CONFID_ELEVAT_0016 "Elevation Angle Confidence 118";
BA_ "SystemSignalLongSymbol" SG_ 90 LRRF1_CAN_DET_CONFID_ELEVAT_0016 "LRRF1_CAN_DET_CONFID_ELEVATION_118";
BA_ "SignalDescription" SG_ 90 LRRF1_CAN_DET_CONFID_ELEVAT_0017 "Elevation Angle Confidence 117";
BA_ "SystemSignalLongSymbol" SG_ 90 LRRF1_CAN_DET_CONFID_ELEVAT_0017 "LRRF1_CAN_DET_CONFID_ELEVATION_117";
BA_ "SignalDescription" SG_ 90 LRRF1_CAN_DET_CONFID_ELEVAT_0018 "Elevation Angle Confidence 116";
BA_ "SystemSignalLongSymbol" SG_ 90 LRRF1_CAN_DET_CONFID_ELEVAT_0018 "LRRF1_CAN_DET_CONFID_ELEVATION_116";
BA_ "SignalDescription" SG_ 90 LRRF1_CAN_DET_CONFID_ELEVAT_0019 "Elevation Angle Confidence 115";
BA_ "SystemSignalLongSymbol" SG_ 90 LRRF1_CAN_DET_CONFID_ELEVAT_0019 "LRRF1_CAN_DET_CONFID_ELEVATION_115";
BA_ "SignalDescription" SG_ 90 LRRF1_CAN_DET_CONFID_ELEVAT_0020 "Elevation Angle Confidence 114";
BA_ "SystemSignalLongSymbol" SG_ 90 LRRF1_CAN_DET_CONFID_ELEVAT_0020 "LRRF1_CAN_DET_CONFID_ELEVATION_114";
BA_ "GenSigVtEn" SG_ 90 LRRF1_CAN_DET_CONFID_AZIMUTH_119 "TRUE";
BA_ "SignalDescription" SG_ 90 LRRF1_CAN_DET_CONFID_AZIMUTH_119 "Signal to noise level 119";
BA_ "GenSigVtEn" SG_ 90 LRRF1_CAN_DET_CONFID_AZIMUTH_118 "TRUE";
BA_ "SignalDescription" SG_ 90 LRRF1_CAN_DET_CONFID_AZIMUTH_118 "Signal to noise level 118";
BA_ "GenSigVtEn" SG_ 90 LRRF1_CAN_DET_CONFID_AZIMUTH_117 "TRUE";
BA_ "SignalDescription" SG_ 90 LRRF1_CAN_DET_CONFID_AZIMUTH_117 "Signal to noise level 117";
BA_ "GenSigVtEn" SG_ 90 LRRF1_CAN_DET_CONFID_AZIMUTH_116 "TRUE";
BA_ "SignalDescription" SG_ 90 LRRF1_CAN_DET_CONFID_AZIMUTH_116 "Signal to noise level 116";
BA_ "GenSigVtEn" SG_ 90 LRRF1_CAN_DET_CONFID_AZIMUTH_115 "TRUE";
BA_ "SignalDescription" SG_ 90 LRRF1_CAN_DET_CONFID_AZIMUTH_115 "Signal to noise level 115";
BA_ "GenSigVtEn" SG_ 90 LRRF1_CAN_DET_CONFID_AZIMUTH_114 "TRUE";
BA_ "SignalDescription" SG_ 90 LRRF1_CAN_DET_CONFID_AZIMUTH_114 "Signal to noise level 114";
BA_ "GenSigStartValue" SG_ 90 LRRF1_CAN_DET_AZIMUTH_119 8194.05320813772;
BA_ "SignalDescription" SG_ 90 LRRF1_CAN_DET_AZIMUTH_119 "Detected object azimuth position 119";
BA_ "GenSigStartValue" SG_ 90 LRRF1_CAN_DET_AZIMUTH_118 8194.05320813772;
BA_ "SignalDescription" SG_ 90 LRRF1_CAN_DET_AZIMUTH_118 "Detected object azimuth position 118";
BA_ "GenSigStartValue" SG_ 90 LRRF1_CAN_DET_AZIMUTH_117 8194.05320813772;
BA_ "SignalDescription" SG_ 90 LRRF1_CAN_DET_AZIMUTH_117 "Detected object azimuth position 117";
BA_ "GenSigStartValue" SG_ 90 LRRF1_CAN_DET_AZIMUTH_116 8194.05320813772;
BA_ "SignalDescription" SG_ 90 LRRF1_CAN_DET_AZIMUTH_116 "Detected object azimuth position 116";
BA_ "GenSigStartValue" SG_ 90 LRRF1_CAN_DET_AZIMUTH_115 8194.05320813772;
BA_ "SignalDescription" SG_ 90 LRRF1_CAN_DET_AZIMUTH_115 "Detected object azimuth position 115";
BA_ "GenSigStartValue" SG_ 90 LRRF1_CAN_DET_AZIMUTH_114 8194.05320813772;
BA_ "SignalDescription" SG_ 90 LRRF1_CAN_DET_AZIMUTH_114 "Detected object azimuth position 114";
BA_ "SignalDescription" SG_ 90 LRRF1_CAN_DET_AMPLITUDE_119 "Detected object amplitude 119";
BA_ "SignalDescription" SG_ 90 LRRF1_CAN_DET_AMPLITUDE_118 "Detected object amplitude 118";
BA_ "SignalDescription" SG_ 90 LRRF1_CAN_DET_AMPLITUDE_117 "Detected object amplitude 117";
BA_ "SignalDescription" SG_ 90 LRRF1_CAN_DET_AMPLITUDE_116 "Detected object amplitude 116";
BA_ "SignalDescription" SG_ 90 LRRF1_CAN_DET_AMPLITUDE_115 "Detected object amplitude 115";
BA_ "SignalDescription" SG_ 90 LRRF1_CAN_DET_AMPLITUDE_114 "Detected object amplitude 114";
BA_ "SignalDescription" SG_ 90 LRRF1_CAN_DET_VALID_LEVEL_119 "Detected object valid level 119";
BA_ "SignalDescription" SG_ 90 LRRF1_CAN_DET_VALID_LEVEL_118 "Detected object valid level 118";
BA_ "SignalDescription" SG_ 90 LRRF1_CAN_DET_VALID_LEVEL_117 "Detected object valid level 117";
BA_ "SignalDescription" SG_ 90 LRRF1_CAN_DET_VALID_LEVEL_116 "Detected object valid level 116";
BA_ "SignalDescription" SG_ 90 LRRF1_CAN_DET_VALID_LEVEL_115 "Detected object valid level 115";
BA_ "SignalDescription" SG_ 90 LRRF1_CAN_DET_VALID_LEVEL_114 "Detected object valid level 114";
BA_ "GenSigSendType" SG_ 89 LRRF1_CAN_DET_Near_TARGET_112 1;
BA_ "SignalDescription" SG_ 89 LRRF1_CAN_DET_Near_TARGET_112 "Near_Target_Discrimination";
BA_ "SignalDescription" SG_ 89 LRRF1_CAN_DET_Near_TARGET_111 "Near_Target_Discrimination";
BA_ "SignalDescription" SG_ 89 LRRF1_CAN_DET_Near_TARGET_110 "Near_Target_Discrimination";
BA_ "SignalDescription" SG_ 89 LRRF1_CAN_DET_Near_TARGET_109 "Near_Target_Discrimination";
BA_ "SignalDescription" SG_ 89 LRRF1_CAN_DET_Near_TARGET_108 "Near_Target_Discrimination";
BA_ "SignalDescription" SG_ 89 LRRF1_CAN_DET_Near_TARGET_107 "Near_Target_Discrimination";
BA_ "SignalDescription" SG_ 89 LRRF1_CAN_DET_Near_TARGET_106 "Near_Target_Discrimination";
BA_ "GenSigStartValue" SG_ 89 LRRF1_CAN_DET_ELEVATION_106 63.8646288209607;
BA_ "SignalDescription" SG_ 89 LRRF1_CAN_DET_ELEVATION_106 "Detected object elevation position 106";
BA_ "GenSigVtEn" SG_ 89 LRRF1_CAN_DET_CONFID_AZIMUTH_106 "TRUE";
BA_ "SignalDescription" SG_ 89 LRRF1_CAN_DET_CONFID_AZIMUTH_106 "Signal to noise level 106";
BA_ "SignalDescription" SG_ 89 LRRF1_CAN_DET_SUPER_RES_TAR_0021 "Super resolution target 106";
BA_ "SystemSignalLongSymbol" SG_ 89 LRRF1_CAN_DET_SUPER_RES_TAR_0021 "LRRF1_CAN_DET_SUPER_RES_TARGET_106";
BA_ "SignalDescription" SG_ 89 LRRF1_CAN_DET_CONFID_ELEVAT_0021 "Elevation Angle Confidence 106";
BA_ "SystemSignalLongSymbol" SG_ 89 LRRF1_CAN_DET_CONFID_ELEVAT_0021 "LRRF1_CAN_DET_CONFID_ELEVATION_106";
BA_ "SignalDescription" SG_ 89 LRRF1_CAN_DET_HOST_VEH_CLUT_0021 "Host vehicle clutter 106";
BA_ "SystemSignalLongSymbol" SG_ 89 LRRF1_CAN_DET_HOST_VEH_CLUT_0021 "LRRF1_CAN_DET_HOST_VEH_CLUTTER_106";
BA_ "SignalDescription" SG_ 89 LRRF1_CAN_DET_VALID_LEVEL_106 "Detected object valid level 106";
BA_ "GenSigStartValue" SG_ 89 LRRF1_CAN_DET_AZIMUTH_106 8194.05320813772;
BA_ "SignalDescription" SG_ 89 LRRF1_CAN_DET_AZIMUTH_106 "Detected object azimuth position 106";
BA_ "SignalDescription" SG_ 89 LRRF1_CAN_DET_RANGE_106 "Detected object range 106";
BA_ "GenSigStartValue" SG_ 89 LRRF1_CAN_DET_RANGE_RATE_106 8192;
BA_ "SignalDescription" SG_ 89 LRRF1_CAN_DET_RANGE_RATE_106 "Detected object range rate 106";
BA_ "SignalDescription" SG_ 89 LRRF1_CAN_DET_AMPLITUDE_106 "Detected object amplitude 106";
BA_ "SignalDescription" SG_ 89 LRRF1_CAN_SCAN_INDEX_2LSB_106 "The two LSB of scan index 106";
BA_ "SignalDescription" SG_ 89 LRRF1_Det_CRC_16 "Cyclic Redundancy Check for Detection Message Number 16";
BA_ "SignalDescription" SG_ 89 LRRF1_Det_MC_16 "Message Count for Detection Message Number 16";
BA_ "SignalDescription" SG_ 89 LRRF1_CAN_SCAN_INDEX_2LSB_112 "The two LSB of scan index 112";
BA_ "SignalDescription" SG_ 89 LRRF1_CAN_SCAN_INDEX_2LSB_111 "The two LSB of scan index 111";
BA_ "SignalDescription" SG_ 89 LRRF1_CAN_SCAN_INDEX_2LSB_110 "The two LSB of scan index 110";
BA_ "SignalDescription" SG_ 89 LRRF1_CAN_SCAN_INDEX_2LSB_109 "The two LSB of scan index 109";
BA_ "SignalDescription" SG_ 89 LRRF1_CAN_SCAN_INDEX_2LSB_108 "The two LSB of scan index 108";
BA_ "SignalDescription" SG_ 89 LRRF1_CAN_SCAN_INDEX_2LSB_107 "The two LSB of scan index 107";
BA_ "GenSigStartValue" SG_ 89 LRRF1_CAN_DET_RANGE_RATE_112 8192;
BA_ "SignalDescription" SG_ 89 LRRF1_CAN_DET_RANGE_RATE_112 "Detected object range rate 112";
BA_ "GenSigStartValue" SG_ 89 LRRF1_CAN_DET_RANGE_RATE_111 8192;
BA_ "SignalDescription" SG_ 89 LRRF1_CAN_DET_RANGE_RATE_111 "Detected object range rate 111";
BA_ "GenSigStartValue" SG_ 89 LRRF1_CAN_DET_RANGE_RATE_110 8192;
BA_ "SignalDescription" SG_ 89 LRRF1_CAN_DET_RANGE_RATE_110 "Detected object range rate 110";
BA_ "GenSigStartValue" SG_ 89 LRRF1_CAN_DET_RANGE_RATE_109 8192;
BA_ "SignalDescription" SG_ 89 LRRF1_CAN_DET_RANGE_RATE_109 "Detected object range rate 109";
BA_ "GenSigStartValue" SG_ 89 LRRF1_CAN_DET_RANGE_RATE_108 8192;
BA_ "SignalDescription" SG_ 89 LRRF1_CAN_DET_RANGE_RATE_108 "Detected object range rate 108";
BA_ "GenSigStartValue" SG_ 89 LRRF1_CAN_DET_RANGE_RATE_107 8192;
BA_ "SignalDescription" SG_ 89 LRRF1_CAN_DET_RANGE_RATE_107 "Detected object range rate 107";
BA_ "SignalDescription" SG_ 89 LRRF1_CAN_DET_RANGE_112 "Detected object range 112";
BA_ "SignalDescription" SG_ 89 LRRF1_CAN_DET_RANGE_111 "Detected object range 111";
BA_ "SignalDescription" SG_ 89 LRRF1_CAN_DET_RANGE_110 "Detected object range 110";
BA_ "SignalDescription" SG_ 89 LRRF1_CAN_DET_RANGE_109 "Detected object range 109";
BA_ "SignalDescription" SG_ 89 LRRF1_CAN_DET_RANGE_108 "Detected object range 108";
BA_ "SignalDescription" SG_ 89 LRRF1_CAN_DET_RANGE_107 "Detected object range 107";
BA_ "SignalDescription" SG_ 89 LRRF1_CAN_DET_SUPER_RES_TAR_0022 "Super resolution target 112";
BA_ "SystemSignalLongSymbol" SG_ 89 LRRF1_CAN_DET_SUPER_RES_TAR_0022 "LRRF1_CAN_DET_SUPER_RES_TARGET_112";
BA_ "SignalDescription" SG_ 89 LRRF1_CAN_DET_SUPER_RES_TAR_0023 "Super resolution target 111";
BA_ "SystemSignalLongSymbol" SG_ 89 LRRF1_CAN_DET_SUPER_RES_TAR_0023 "LRRF1_CAN_DET_SUPER_RES_TARGET_111";
BA_ "SignalDescription" SG_ 89 LRRF1_CAN_DET_SUPER_RES_TAR_0024 "Super resolution target 110";
BA_ "SystemSignalLongSymbol" SG_ 89 LRRF1_CAN_DET_SUPER_RES_TAR_0024 "LRRF1_CAN_DET_SUPER_RES_TARGET_110";
BA_ "SignalDescription" SG_ 89 LRRF1_CAN_DET_SUPER_RES_TAR_0025 "Super resolution target 109";
BA_ "SystemSignalLongSymbol" SG_ 89 LRRF1_CAN_DET_SUPER_RES_TAR_0025 "LRRF1_CAN_DET_SUPER_RES_TARGET_109";
BA_ "SignalDescription" SG_ 89 LRRF1_CAN_DET_SUPER_RES_TAR_0026 "Super resolution target 108";
BA_ "SystemSignalLongSymbol" SG_ 89 LRRF1_CAN_DET_SUPER_RES_TAR_0026 "LRRF1_CAN_DET_SUPER_RES_TARGET_108";
BA_ "SignalDescription" SG_ 89 LRRF1_CAN_DET_SUPER_RES_TAR_0027 "Super resolution target 107";
BA_ "SystemSignalLongSymbol" SG_ 89 LRRF1_CAN_DET_SUPER_RES_TAR_0027 "LRRF1_CAN_DET_SUPER_RES_TARGET_107";
BA_ "SignalDescription" SG_ 89 LRRF1_CAN_DET_HOST_VEH_CLUT_0022 "Host vehicle clutter 112";
BA_ "SystemSignalLongSymbol" SG_ 89 LRRF1_CAN_DET_HOST_VEH_CLUT_0022 "LRRF1_CAN_DET_HOST_VEH_CLUTTER_112";
BA_ "SignalDescription" SG_ 89 LRRF1_CAN_DET_HOST_VEH_CLUT_0023 "Host vehicle clutter 111";
BA_ "SystemSignalLongSymbol" SG_ 89 LRRF1_CAN_DET_HOST_VEH_CLUT_0023 "LRRF1_CAN_DET_HOST_VEH_CLUTTER_111";
BA_ "SignalDescription" SG_ 89 LRRF1_CAN_DET_HOST_VEH_CLUT_0024 "Host vehicle clutter 110";
BA_ "SystemSignalLongSymbol" SG_ 89 LRRF1_CAN_DET_HOST_VEH_CLUT_0024 "LRRF1_CAN_DET_HOST_VEH_CLUTTER_110";
BA_ "SignalDescription" SG_ 89 LRRF1_CAN_DET_HOST_VEH_CLUT_0025 "Host vehicle clutter 109";
BA_ "SystemSignalLongSymbol" SG_ 89 LRRF1_CAN_DET_HOST_VEH_CLUT_0025 "LRRF1_CAN_DET_HOST_VEH_CLUTTER_109";
BA_ "SignalDescription" SG_ 89 LRRF1_CAN_DET_HOST_VEH_CLUT_0026 "Host vehicle clutter 108";
BA_ "SystemSignalLongSymbol" SG_ 89 LRRF1_CAN_DET_HOST_VEH_CLUT_0026 "LRRF1_CAN_DET_HOST_VEH_CLUTTER_108";
BA_ "SignalDescription" SG_ 89 LRRF1_CAN_DET_HOST_VEH_CLUT_0027 "Host vehicle clutter 107";
BA_ "SystemSignalLongSymbol" SG_ 89 LRRF1_CAN_DET_HOST_VEH_CLUT_0027 "LRRF1_CAN_DET_HOST_VEH_CLUTTER_107";
BA_ "GenSigStartValue" SG_ 89 LRRF1_CAN_DET_ELEVATION_112 63.8646288209607;
BA_ "SignalDescription" SG_ 89 LRRF1_CAN_DET_ELEVATION_112 "Detected object elevation position 112";
BA_ "GenSigStartValue" SG_ 89 LRRF1_CAN_DET_ELEVATION_111 63.8646288209607;
BA_ "SignalDescription" SG_ 89 LRRF1_CAN_DET_ELEVATION_111 "Detected object elevation position 111";
BA_ "GenSigStartValue" SG_ 89 LRRF1_CAN_DET_ELEVATION_110 63.8646288209607;
BA_ "SignalDescription" SG_ 89 LRRF1_CAN_DET_ELEVATION_110 "Detected object elevation position 110";
BA_ "GenSigStartValue" SG_ 89 LRRF1_CAN_DET_ELEVATION_109 63.8646288209607;
BA_ "SignalDescription" SG_ 89 LRRF1_CAN_DET_ELEVATION_109 "Detected object elevation position 109";
BA_ "GenSigStartValue" SG_ 89 LRRF1_CAN_DET_ELEVATION_108 63.8646288209607;
BA_ "SignalDescription" SG_ 89 LRRF1_CAN_DET_ELEVATION_108 "Detected object elevation position 108";
BA_ "GenSigStartValue" SG_ 89 LRRF1_CAN_DET_ELEVATION_107 63.8646288209607;
BA_ "SignalDescription" SG_ 89 LRRF1_CAN_DET_ELEVATION_107 "Detected object elevation position 107";
BA_ "SignalDescription" SG_ 89 LRRF1_CAN_DET_CONFID_ELEVAT_0022 "Elevation Angle Confidence 112";
BA_ "SystemSignalLongSymbol" SG_ 89 LRRF1_CAN_DET_CONFID_ELEVAT_0022 "LRRF1_CAN_DET_CONFID_ELEVATION_112";
BA_ "SignalDescription" SG_ 89 LRRF1_CAN_DET_CONFID_ELEVAT_0023 "Elevation Angle Confidence 111";
BA_ "SystemSignalLongSymbol" SG_ 89 LRRF1_CAN_DET_CONFID_ELEVAT_0023 "LRRF1_CAN_DET_CONFID_ELEVATION_111";
BA_ "SignalDescription" SG_ 89 LRRF1_CAN_DET_CONFID_ELEVAT_0024 "Elevation Angle Confidence 110";
BA_ "SystemSignalLongSymbol" SG_ 89 LRRF1_CAN_DET_CONFID_ELEVAT_0024 "LRRF1_CAN_DET_CONFID_ELEVATION_110";
BA_ "SignalDescription" SG_ 89 LRRF1_CAN_DET_CONFID_ELEVAT_0025 "Elevation Angle Confidence 109";
BA_ "SystemSignalLongSymbol" SG_ 89 LRRF1_CAN_DET_CONFID_ELEVAT_0025 "LRRF1_CAN_DET_CONFID_ELEVATION_109";
BA_ "SignalDescription" SG_ 89 LRRF1_CAN_DET_CONFID_ELEVAT_0026 "Elevation Angle Confidence 108";
BA_ "SystemSignalLongSymbol" SG_ 89 LRRF1_CAN_DET_CONFID_ELEVAT_0026 "LRRF1_CAN_DET_CONFID_ELEVATION_108";
BA_ "SignalDescription" SG_ 89 LRRF1_CAN_DET_CONFID_ELEVAT_0027 "Elevation Angle Confidence 107";
BA_ "SystemSignalLongSymbol" SG_ 89 LRRF1_CAN_DET_CONFID_ELEVAT_0027 "LRRF1_CAN_DET_CONFID_ELEVATION_107";
BA_ "GenSigVtEn" SG_ 89 LRRF1_CAN_DET_CONFID_AZIMUTH_112 "TRUE";
BA_ "SignalDescription" SG_ 89 LRRF1_CAN_DET_CONFID_AZIMUTH_112 "Signal to noise level 112";
BA_ "GenSigVtEn" SG_ 89 LRRF1_CAN_DET_CONFID_AZIMUTH_111 "TRUE";
BA_ "SignalDescription" SG_ 89 LRRF1_CAN_DET_CONFID_AZIMUTH_111 "Signal to noise level 111";
BA_ "GenSigVtEn" SG_ 89 LRRF1_CAN_DET_CONFID_AZIMUTH_110 "TRUE";
BA_ "SignalDescription" SG_ 89 LRRF1_CAN_DET_CONFID_AZIMUTH_110 "Signal to noise level 110";
BA_ "GenSigVtEn" SG_ 89 LRRF1_CAN_DET_CONFID_AZIMUTH_109 "TRUE";
BA_ "SignalDescription" SG_ 89 LRRF1_CAN_DET_CONFID_AZIMUTH_109 "Signal to noise level 109";
BA_ "GenSigVtEn" SG_ 89 LRRF1_CAN_DET_CONFID_AZIMUTH_108 "TRUE";
BA_ "SignalDescription" SG_ 89 LRRF1_CAN_DET_CONFID_AZIMUTH_108 "Signal to noise level 108";
BA_ "GenSigVtEn" SG_ 89 LRRF1_CAN_DET_CONFID_AZIMUTH_107 "TRUE";
BA_ "SignalDescription" SG_ 89 LRRF1_CAN_DET_CONFID_AZIMUTH_107 "Signal to noise level 107";
BA_ "GenSigStartValue" SG_ 89 LRRF1_CAN_DET_AZIMUTH_112 8194.05320813772;
BA_ "SignalDescription" SG_ 89 LRRF1_CAN_DET_AZIMUTH_112 "Detected object azimuth position 112";
BA_ "GenSigStartValue" SG_ 89 LRRF1_CAN_DET_AZIMUTH_111 8194.05320813772;
BA_ "SignalDescription" SG_ 89 LRRF1_CAN_DET_AZIMUTH_111 "Detected object azimuth position 111";
BA_ "GenSigStartValue" SG_ 89 LRRF1_CAN_DET_AZIMUTH_110 8194.05320813772;
BA_ "SignalDescription" SG_ 89 LRRF1_CAN_DET_AZIMUTH_110 "Detected object azimuth position 110";
BA_ "GenSigStartValue" SG_ 89 LRRF1_CAN_DET_AZIMUTH_109 8194.05320813772;
BA_ "SignalDescription" SG_ 89 LRRF1_CAN_DET_AZIMUTH_109 "Detected object azimuth position 109";
BA_ "GenSigStartValue" SG_ 89 LRRF1_CAN_DET_AZIMUTH_108 8194.05320813772;
BA_ "SignalDescription" SG_ 89 LRRF1_CAN_DET_AZIMUTH_108 "Detected object azimuth position 108";
BA_ "GenSigStartValue" SG_ 89 LRRF1_CAN_DET_AZIMUTH_107 8194.05320813772;
BA_ "SignalDescription" SG_ 89 LRRF1_CAN_DET_AZIMUTH_107 "Detected object azimuth position 107";
BA_ "SignalDescription" SG_ 89 LRRF1_CAN_DET_AMPLITUDE_112 "Detected object amplitude 112";
BA_ "SignalDescription" SG_ 89 LRRF1_CAN_DET_AMPLITUDE_111 "Detected object amplitude 111";
BA_ "SignalDescription" SG_ 89 LRRF1_CAN_DET_AMPLITUDE_110 "Detected object amplitude 110";
BA_ "SignalDescription" SG_ 89 LRRF1_CAN_DET_AMPLITUDE_109 "Detected object amplitude 109";
BA_ "SignalDescription" SG_ 89 LRRF1_CAN_DET_AMPLITUDE_108 "Detected object amplitude 108";
BA_ "SignalDescription" SG_ 89 LRRF1_CAN_DET_AMPLITUDE_107 "Detected object amplitude 107";
BA_ "SignalDescription" SG_ 89 LRRF1_CAN_DET_VALID_LEVEL_112 "Detected object valid level 112";
BA_ "SignalDescription" SG_ 89 LRRF1_CAN_DET_VALID_LEVEL_111 "Detected object valid level 111";
BA_ "SignalDescription" SG_ 89 LRRF1_CAN_DET_VALID_LEVEL_110 "Detected object valid level 110";
BA_ "SignalDescription" SG_ 89 LRRF1_CAN_DET_VALID_LEVEL_109 "Detected object valid level 109";
BA_ "SignalDescription" SG_ 89 LRRF1_CAN_DET_VALID_LEVEL_108 "Detected object valid level 108";
BA_ "SignalDescription" SG_ 89 LRRF1_CAN_DET_VALID_LEVEL_107 "Detected object valid level 107";
BA_ "GenSigSendType" SG_ 88 LRRF1_CAN_DET_Near_TARGET_105 1;
BA_ "SignalDescription" SG_ 88 LRRF1_CAN_DET_Near_TARGET_105 "Near_Target_Discrimination";
BA_ "SignalDescription" SG_ 88 LRRF1_CAN_DET_Near_TARGET_104 "Near_Target_Discrimination";
BA_ "SignalDescription" SG_ 88 LRRF1_CAN_DET_Near_TARGET_103 "Near_Target_Discrimination";
BA_ "SignalDescription" SG_ 88 LRRF1_CAN_DET_Near_TARGET_102 "Near_Target_Discrimination";
BA_ "SignalDescription" SG_ 88 LRRF1_CAN_DET_Near_TARGET_101 "Near_Target_Discrimination";
BA_ "SignalDescription" SG_ 88 LRRF1_CAN_DET_Near_TARGET_100 "Near_Target_Discrimination";
BA_ "SignalDescription" SG_ 88 LRRF1_CAN_DET_Near_TARGET_99 "Near_Target_Discrimination";
BA_ "GenSigStartValue" SG_ 88 LRRF1_CAN_DET_ELEVATION_99 63.8646288209607;
BA_ "SignalDescription" SG_ 88 LRRF1_CAN_DET_ELEVATION_99 "Detected object elevation position 99";
BA_ "GenSigVtEn" SG_ 88 LRRF1_CAN_DET_CONFID_AZIMUTH_99 "TRUE";
BA_ "SignalDescription" SG_ 88 LRRF1_CAN_DET_CONFID_AZIMUTH_99 "Signal to noise level 99";
BA_ "SignalDescription" SG_ 88 LRRF1_CAN_DET_SUPER_RES_TARGET_9 "Super resolution target 99";
BA_ "SystemSignalLongSymbol" SG_ 88 LRRF1_CAN_DET_SUPER_RES_TARGET_9 "LRRF1_CAN_DET_SUPER_RES_TARGET_99";
BA_ "SignalDescription" SG_ 88 LRRF1_CAN_DET_CONFID_ELEVATION_9 "Elevation Angle Confidence 99";
BA_ "SystemSignalLongSymbol" SG_ 88 LRRF1_CAN_DET_CONFID_ELEVATION_9 "LRRF1_CAN_DET_CONFID_ELEVATION_99";
BA_ "SignalDescription" SG_ 88 LRRF1_CAN_DET_HOST_VEH_CLUTTER_9 "Host vehicle clutter 99";
BA_ "SystemSignalLongSymbol" SG_ 88 LRRF1_CAN_DET_HOST_VEH_CLUTTER_9 "LRRF1_CAN_DET_HOST_VEH_CLUTTER_99";
BA_ "SignalDescription" SG_ 88 LRRF1_CAN_DET_VALID_LEVEL_99 "Detected object valid level 99";
BA_ "GenSigStartValue" SG_ 88 LRRF1_CAN_DET_AZIMUTH_99 8194.05320813772;
BA_ "SignalDescription" SG_ 88 LRRF1_CAN_DET_AZIMUTH_99 "Detected object azimuth position 99";
BA_ "SignalDescription" SG_ 88 LRRF1_CAN_DET_RANGE_99 "Detected object range 99";
BA_ "GenSigStartValue" SG_ 88 LRRF1_CAN_DET_RANGE_RATE_99 8192;
BA_ "SignalDescription" SG_ 88 LRRF1_CAN_DET_RANGE_RATE_99 "Detected object range rate 99";
BA_ "SignalDescription" SG_ 88 LRRF1_CAN_DET_AMPLITUDE_99 "Detected object amplitude 99";
BA_ "SignalDescription" SG_ 88 LRRF1_CAN_SCAN_INDEX_2LSB_99 "The two LSB of scan index 99";
BA_ "SignalDescription" SG_ 88 LRRF1_Det_CRC_15 "Cyclic Redundancy Check for Detection Message Number 15";
BA_ "SignalDescription" SG_ 88 LRRF1_Det_MC_15 "Message Count for Detection Message Number 15";
BA_ "SignalDescription" SG_ 88 LRRF1_CAN_SCAN_INDEX_2LSB_105 "The two LSB of scan index 105";
BA_ "SignalDescription" SG_ 88 LRRF1_CAN_SCAN_INDEX_2LSB_104 "The two LSB of scan index 104";
BA_ "SignalDescription" SG_ 88 LRRF1_CAN_SCAN_INDEX_2LSB_103 "The two LSB of scan index 103";
BA_ "SignalDescription" SG_ 88 LRRF1_CAN_SCAN_INDEX_2LSB_102 "The two LSB of scan index 102";
BA_ "SignalDescription" SG_ 88 LRRF1_CAN_SCAN_INDEX_2LSB_101 "The two LSB of scan index 101";
BA_ "SignalDescription" SG_ 88 LRRF1_CAN_SCAN_INDEX_2LSB_100 "The two LSB of scan index 100";
BA_ "GenSigStartValue" SG_ 88 LRRF1_CAN_DET_RANGE_RATE_105 8192;
BA_ "SignalDescription" SG_ 88 LRRF1_CAN_DET_RANGE_RATE_105 "Detected object range rate 105";
BA_ "GenSigStartValue" SG_ 88 LRRF1_CAN_DET_RANGE_RATE_104 8192;
BA_ "SignalDescription" SG_ 88 LRRF1_CAN_DET_RANGE_RATE_104 "Detected object range rate 104";
BA_ "GenSigStartValue" SG_ 88 LRRF1_CAN_DET_RANGE_RATE_103 8192;
BA_ "SignalDescription" SG_ 88 LRRF1_CAN_DET_RANGE_RATE_103 "Detected object range rate 103";
BA_ "GenSigStartValue" SG_ 88 LRRF1_CAN_DET_RANGE_RATE_102 8192;
BA_ "SignalDescription" SG_ 88 LRRF1_CAN_DET_RANGE_RATE_102 "Detected object range rate 102";
BA_ "GenSigStartValue" SG_ 88 LRRF1_CAN_DET_RANGE_RATE_101 8192;
BA_ "SignalDescription" SG_ 88 LRRF1_CAN_DET_RANGE_RATE_101 "Detected object range rate 101";
BA_ "GenSigStartValue" SG_ 88 LRRF1_CAN_DET_RANGE_RATE_100 8192;
BA_ "SignalDescription" SG_ 88 LRRF1_CAN_DET_RANGE_RATE_100 "Detected object range rate 100";
BA_ "SignalDescription" SG_ 88 LRRF1_CAN_DET_RANGE_105 "Detected object range 105";
BA_ "SignalDescription" SG_ 88 LRRF1_CAN_DET_RANGE_104 "Detected object range 104";
BA_ "SignalDescription" SG_ 88 LRRF1_CAN_DET_RANGE_103 "Detected object range 103";
BA_ "SignalDescription" SG_ 88 LRRF1_CAN_DET_RANGE_102 "Detected object range 102";
BA_ "SignalDescription" SG_ 88 LRRF1_CAN_DET_RANGE_101 "Detected object range 101";
BA_ "SignalDescription" SG_ 88 LRRF1_CAN_DET_RANGE_100 "Detected object range 100";
BA_ "SignalDescription" SG_ 88 LRRF1_CAN_DET_SUPER_RES_TAR_0028 "Super resolution target 105";
BA_ "SystemSignalLongSymbol" SG_ 88 LRRF1_CAN_DET_SUPER_RES_TAR_0028 "LRRF1_CAN_DET_SUPER_RES_TARGET_105";
BA_ "SignalDescription" SG_ 88 LRRF1_CAN_DET_SUPER_RES_TAR_0029 "Super resolution target 104";
BA_ "SystemSignalLongSymbol" SG_ 88 LRRF1_CAN_DET_SUPER_RES_TAR_0029 "LRRF1_CAN_DET_SUPER_RES_TARGET_104";
BA_ "SignalDescription" SG_ 88 LRRF1_CAN_DET_SUPER_RES_TAR_0030 "Super resolution target 103";
BA_ "SystemSignalLongSymbol" SG_ 88 LRRF1_CAN_DET_SUPER_RES_TAR_0030 "LRRF1_CAN_DET_SUPER_RES_TARGET_103";
BA_ "SignalDescription" SG_ 88 LRRF1_CAN_DET_SUPER_RES_TAR_0031 "Super resolution target 102";
BA_ "SystemSignalLongSymbol" SG_ 88 LRRF1_CAN_DET_SUPER_RES_TAR_0031 "LRRF1_CAN_DET_SUPER_RES_TARGET_102";
BA_ "SignalDescription" SG_ 88 LRRF1_CAN_DET_SUPER_RES_TAR_0032 "Super resolution target 101";
BA_ "SystemSignalLongSymbol" SG_ 88 LRRF1_CAN_DET_SUPER_RES_TAR_0032 "LRRF1_CAN_DET_SUPER_RES_TARGET_101";
BA_ "SignalDescription" SG_ 88 LRRF1_CAN_DET_SUPER_RES_TAR_0033 "Super resolution target 100";
BA_ "SystemSignalLongSymbol" SG_ 88 LRRF1_CAN_DET_SUPER_RES_TAR_0033 "LRRF1_CAN_DET_SUPER_RES_TARGET_100";
BA_ "SignalDescription" SG_ 88 LRRF1_CAN_DET_HOST_VEH_CLUT_0028 "Host vehicle clutter 105";
BA_ "SystemSignalLongSymbol" SG_ 88 LRRF1_CAN_DET_HOST_VEH_CLUT_0028 "LRRF1_CAN_DET_HOST_VEH_CLUTTER_105";
BA_ "SignalDescription" SG_ 88 LRRF1_CAN_DET_HOST_VEH_CLUT_0029 "Host vehicle clutter 104";
BA_ "SystemSignalLongSymbol" SG_ 88 LRRF1_CAN_DET_HOST_VEH_CLUT_0029 "LRRF1_CAN_DET_HOST_VEH_CLUTTER_104";
BA_ "SignalDescription" SG_ 88 LRRF1_CAN_DET_HOST_VEH_CLUT_0030 "Host vehicle clutter 103";
BA_ "SystemSignalLongSymbol" SG_ 88 LRRF1_CAN_DET_HOST_VEH_CLUT_0030 "LRRF1_CAN_DET_HOST_VEH_CLUTTER_103";
BA_ "SignalDescription" SG_ 88 LRRF1_CAN_DET_HOST_VEH_CLUT_0031 "Host vehicle clutter 102";
BA_ "SystemSignalLongSymbol" SG_ 88 LRRF1_CAN_DET_HOST_VEH_CLUT_0031 "LRRF1_CAN_DET_HOST_VEH_CLUTTER_102";
BA_ "SignalDescription" SG_ 88 LRRF1_CAN_DET_HOST_VEH_CLUT_0032 "Host vehicle clutter 101";
BA_ "SystemSignalLongSymbol" SG_ 88 LRRF1_CAN_DET_HOST_VEH_CLUT_0032 "LRRF1_CAN_DET_HOST_VEH_CLUTTER_101";
BA_ "SignalDescription" SG_ 88 LRRF1_CAN_DET_HOST_VEH_CLUT_0033 "Host vehicle clutter 100";
BA_ "SystemSignalLongSymbol" SG_ 88 LRRF1_CAN_DET_HOST_VEH_CLUT_0033 "LRRF1_CAN_DET_HOST_VEH_CLUTTER_100";
BA_ "GenSigStartValue" SG_ 88 LRRF1_CAN_DET_ELEVATION_105 63.8646288209607;
BA_ "SignalDescription" SG_ 88 LRRF1_CAN_DET_ELEVATION_105 "Detected object elevation position 105";
BA_ "GenSigStartValue" SG_ 88 LRRF1_CAN_DET_ELEVATION_104 63.8646288209607;
BA_ "SignalDescription" SG_ 88 LRRF1_CAN_DET_ELEVATION_104 "Detected object elevation position 104";
BA_ "GenSigStartValue" SG_ 88 LRRF1_CAN_DET_ELEVATION_103 63.8646288209607;
BA_ "SignalDescription" SG_ 88 LRRF1_CAN_DET_ELEVATION_103 "Detected object elevation position 103";
BA_ "GenSigStartValue" SG_ 88 LRRF1_CAN_DET_ELEVATION_102 63.8646288209607;
BA_ "SignalDescription" SG_ 88 LRRF1_CAN_DET_ELEVATION_102 "Detected object elevation position 102";
BA_ "GenSigStartValue" SG_ 88 LRRF1_CAN_DET_ELEVATION_101 63.8646288209607;
BA_ "SignalDescription" SG_ 88 LRRF1_CAN_DET_ELEVATION_101 "Detected object elevation position 101";
BA_ "GenSigStartValue" SG_ 88 LRRF1_CAN_DET_ELEVATION_100 63.8646288209607;
BA_ "SignalDescription" SG_ 88 LRRF1_CAN_DET_ELEVATION_100 "Detected object elevation position 100";
BA_ "SignalDescription" SG_ 88 LRRF1_CAN_DET_CONFID_ELEVAT_0028 "Elevation Angle Confidence 105";
BA_ "SystemSignalLongSymbol" SG_ 88 LRRF1_CAN_DET_CONFID_ELEVAT_0028 "LRRF1_CAN_DET_CONFID_ELEVATION_105";
BA_ "SignalDescription" SG_ 88 LRRF1_CAN_DET_CONFID_ELEVAT_0029 "Elevation Angle Confidence 104";
BA_ "SystemSignalLongSymbol" SG_ 88 LRRF1_CAN_DET_CONFID_ELEVAT_0029 "LRRF1_CAN_DET_CONFID_ELEVATION_104";
BA_ "SignalDescription" SG_ 88 LRRF1_CAN_DET_CONFID_ELEVAT_0030 "Elevation Angle Confidence 103";
BA_ "SystemSignalLongSymbol" SG_ 88 LRRF1_CAN_DET_CONFID_ELEVAT_0030 "LRRF1_CAN_DET_CONFID_ELEVATION_103";
BA_ "SignalDescription" SG_ 88 LRRF1_CAN_DET_CONFID_ELEVAT_0031 "Elevation Angle Confidence 102";
BA_ "SystemSignalLongSymbol" SG_ 88 LRRF1_CAN_DET_CONFID_ELEVAT_0031 "LRRF1_CAN_DET_CONFID_ELEVATION_102";
BA_ "SignalDescription" SG_ 88 LRRF1_CAN_DET_CONFID_ELEVAT_0032 "Elevation Angle Confidence 101";
BA_ "SystemSignalLongSymbol" SG_ 88 LRRF1_CAN_DET_CONFID_ELEVAT_0032 "LRRF1_CAN_DET_CONFID_ELEVATION_101";
BA_ "SignalDescription" SG_ 88 LRRF1_CAN_DET_CONFID_ELEVAT_0033 "Elevation Angle Confidence 100";
BA_ "SystemSignalLongSymbol" SG_ 88 LRRF1_CAN_DET_CONFID_ELEVAT_0033 "LRRF1_CAN_DET_CONFID_ELEVATION_100";
BA_ "GenSigVtEn" SG_ 88 LRRF1_CAN_DET_CONFID_AZIMUTH_105 "TRUE";
BA_ "SignalDescription" SG_ 88 LRRF1_CAN_DET_CONFID_AZIMUTH_105 "Signal to noise level 105";
BA_ "GenSigVtEn" SG_ 88 LRRF1_CAN_DET_CONFID_AZIMUTH_104 "TRUE";
BA_ "SignalDescription" SG_ 88 LRRF1_CAN_DET_CONFID_AZIMUTH_104 "Signal to noise level 104";
BA_ "GenSigVtEn" SG_ 88 LRRF1_CAN_DET_CONFID_AZIMUTH_103 "TRUE";
BA_ "SignalDescription" SG_ 88 LRRF1_CAN_DET_CONFID_AZIMUTH_103 "Signal to noise level 103";
BA_ "GenSigVtEn" SG_ 88 LRRF1_CAN_DET_CONFID_AZIMUTH_102 "TRUE";
BA_ "SignalDescription" SG_ 88 LRRF1_CAN_DET_CONFID_AZIMUTH_102 "Signal to noise level 102";
BA_ "GenSigVtEn" SG_ 88 LRRF1_CAN_DET_CONFID_AZIMUTH_101 "TRUE";
BA_ "SignalDescription" SG_ 88 LRRF1_CAN_DET_CONFID_AZIMUTH_101 "Signal to noise level 101";
BA_ "GenSigVtEn" SG_ 88 LRRF1_CAN_DET_CONFID_AZIMUTH_100 "TRUE";
BA_ "SignalDescription" SG_ 88 LRRF1_CAN_DET_CONFID_AZIMUTH_100 "Signal to noise level 100";
BA_ "GenSigStartValue" SG_ 88 LRRF1_CAN_DET_AZIMUTH_105 8194.05320813772;
BA_ "SignalDescription" SG_ 88 LRRF1_CAN_DET_AZIMUTH_105 "Detected object azimuth position 105";
BA_ "GenSigStartValue" SG_ 88 LRRF1_CAN_DET_AZIMUTH_104 8194.05320813772;
BA_ "SignalDescription" SG_ 88 LRRF1_CAN_DET_AZIMUTH_104 "Detected object azimuth position 104";
BA_ "GenSigStartValue" SG_ 88 LRRF1_CAN_DET_AZIMUTH_103 8194.05320813772;
BA_ "SignalDescription" SG_ 88 LRRF1_CAN_DET_AZIMUTH_103 "Detected object azimuth position 103";
BA_ "GenSigStartValue" SG_ 88 LRRF1_CAN_DET_AZIMUTH_102 8194.05320813772;
BA_ "SignalDescription" SG_ 88 LRRF1_CAN_DET_AZIMUTH_102 "Detected object azimuth position 102";
BA_ "GenSigStartValue" SG_ 88 LRRF1_CAN_DET_AZIMUTH_101 8194.05320813772;
BA_ "SignalDescription" SG_ 88 LRRF1_CAN_DET_AZIMUTH_101 "Detected object azimuth position 101";
BA_ "GenSigStartValue" SG_ 88 LRRF1_CAN_DET_AZIMUTH_100 8194.05320813772;
BA_ "SignalDescription" SG_ 88 LRRF1_CAN_DET_AZIMUTH_100 "Detected object azimuth position 100";
BA_ "SignalDescription" SG_ 88 LRRF1_CAN_DET_AMPLITUDE_105 "Detected object amplitude 105";
BA_ "SignalDescription" SG_ 88 LRRF1_CAN_DET_AMPLITUDE_104 "Detected object amplitude 104";
BA_ "SignalDescription" SG_ 88 LRRF1_CAN_DET_AMPLITUDE_103 "Detected object amplitude 103";
BA_ "SignalDescription" SG_ 88 LRRF1_CAN_DET_AMPLITUDE_102 "Detected object amplitude 102";
BA_ "SignalDescription" SG_ 88 LRRF1_CAN_DET_AMPLITUDE_101 "Detected object amplitude 101";
BA_ "SignalDescription" SG_ 88 LRRF1_CAN_DET_AMPLITUDE_100 "Detected object amplitude 100";
BA_ "SignalDescription" SG_ 88 LRRF1_CAN_DET_VALID_LEVEL_105 "Detected object valid level 105";
BA_ "SignalDescription" SG_ 88 LRRF1_CAN_DET_VALID_LEVEL_104 "Detected object valid level 104";
BA_ "SignalDescription" SG_ 88 LRRF1_CAN_DET_VALID_LEVEL_103 "Detected object valid level 103";
BA_ "SignalDescription" SG_ 88 LRRF1_CAN_DET_VALID_LEVEL_102 "Detected object valid level 102";
BA_ "SignalDescription" SG_ 88 LRRF1_CAN_DET_VALID_LEVEL_101 "Detected object valid level 101";
BA_ "SignalDescription" SG_ 88 LRRF1_CAN_DET_VALID_LEVEL_100 "Detected object valid level 100";
BA_ "GenSigSendType" SG_ 87 LRRF1_CAN_DET_Near_TARGET_98 1;
BA_ "SignalDescription" SG_ 87 LRRF1_CAN_DET_Near_TARGET_98 "Near_Target_Discrimination";
BA_ "SignalDescription" SG_ 87 LRRF1_CAN_DET_Near_TARGET_97 "Near_Target_Discrimination";
BA_ "SignalDescription" SG_ 87 LRRF1_CAN_DET_Near_TARGET_96 "Near_Target_Discrimination";
BA_ "SignalDescription" SG_ 87 LRRF1_CAN_DET_Near_TARGET_95 "Near_Target_Discrimination";
BA_ "SignalDescription" SG_ 87 LRRF1_CAN_DET_Near_TARGET_94 "Near_Target_Discrimination";
BA_ "SignalDescription" SG_ 87 LRRF1_CAN_DET_Near_TARGET_93 "Near_Target_Discrimination";
BA_ "SignalDescription" SG_ 87 LRRF1_CAN_DET_Near_TARGET_92 "Near_Target_Discrimination";
BA_ "GenSigStartValue" SG_ 87 LRRF1_CAN_DET_ELEVATION_92 63.8646288209607;
BA_ "SignalDescription" SG_ 87 LRRF1_CAN_DET_ELEVATION_92 "Detected object elevation position 92";
BA_ "GenSigVtEn" SG_ 87 LRRF1_CAN_DET_CONFID_AZIMUTH_92 "TRUE";
BA_ "SignalDescription" SG_ 87 LRRF1_CAN_DET_CONFID_AZIMUTH_92 "Signal to noise level 92";
BA_ "SignalDescription" SG_ 87 LRRF1_CAN_DET_SUPER_RES_TAR_0034 "Super resolution target 92";
BA_ "SystemSignalLongSymbol" SG_ 87 LRRF1_CAN_DET_SUPER_RES_TAR_0034 "LRRF1_CAN_DET_SUPER_RES_TARGET_92";
BA_ "SignalDescription" SG_ 87 LRRF1_CAN_DET_CONFID_ELEVAT_0034 "Elevation Angle Confidence 92";
BA_ "SystemSignalLongSymbol" SG_ 87 LRRF1_CAN_DET_CONFID_ELEVAT_0034 "LRRF1_CAN_DET_CONFID_ELEVATION_92";
BA_ "SignalDescription" SG_ 87 LRRF1_CAN_DET_HOST_VEH_CLUT_0034 "Host vehicle clutter 92";
BA_ "SystemSignalLongSymbol" SG_ 87 LRRF1_CAN_DET_HOST_VEH_CLUT_0034 "LRRF1_CAN_DET_HOST_VEH_CLUTTER_92";
BA_ "SignalDescription" SG_ 87 LRRF1_CAN_DET_VALID_LEVEL_92 "Detected object valid level 92";
BA_ "GenSigStartValue" SG_ 87 LRRF1_CAN_DET_AZIMUTH_92 8194.05320813772;
BA_ "SignalDescription" SG_ 87 LRRF1_CAN_DET_AZIMUTH_92 "Detected object azimuth position 92";
BA_ "SignalDescription" SG_ 87 LRRF1_CAN_DET_RANGE_92 "Detected object range 92";
BA_ "GenSigStartValue" SG_ 87 LRRF1_CAN_DET_RANGE_RATE_92 8192;
BA_ "SignalDescription" SG_ 87 LRRF1_CAN_DET_RANGE_RATE_92 "Detected object range rate 92";
BA_ "SignalDescription" SG_ 87 LRRF1_CAN_DET_AMPLITUDE_92 "Detected object amplitude 92";
BA_ "SignalDescription" SG_ 87 LRRF1_CAN_SCAN_INDEX_2LSB_92 "The two LSB of scan index 92";
BA_ "SignalDescription" SG_ 87 LRRF1_Det_CRC_14 "Cyclic Redundancy Check for Detection Message Number 14";
BA_ "SignalDescription" SG_ 87 LRRF1_Det_MC_14 "Message Count for Detection Message Number 14";
BA_ "SignalDescription" SG_ 87 LRRF1_CAN_SCAN_INDEX_2LSB_98 "The two LSB of scan index 98";
BA_ "SignalDescription" SG_ 87 LRRF1_CAN_SCAN_INDEX_2LSB_97 "The two LSB of scan index 97";
BA_ "SignalDescription" SG_ 87 LRRF1_CAN_SCAN_INDEX_2LSB_96 "The two LSB of scan index 96";
BA_ "SignalDescription" SG_ 87 LRRF1_CAN_SCAN_INDEX_2LSB_95 "The two LSB of scan index 95";
BA_ "SignalDescription" SG_ 87 LRRF1_CAN_SCAN_INDEX_2LSB_94 "The two LSB of scan index 94";
BA_ "SignalDescription" SG_ 87 LRRF1_CAN_SCAN_INDEX_2LSB_93 "The two LSB of scan index 93";
BA_ "GenSigStartValue" SG_ 87 LRRF1_CAN_DET_RANGE_RATE_98 8192;
BA_ "SignalDescription" SG_ 87 LRRF1_CAN_DET_RANGE_RATE_98 "Detected object range rate 98";
BA_ "GenSigStartValue" SG_ 87 LRRF1_CAN_DET_RANGE_RATE_97 8192;
BA_ "SignalDescription" SG_ 87 LRRF1_CAN_DET_RANGE_RATE_97 "Detected object range rate 97";
BA_ "GenSigStartValue" SG_ 87 LRRF1_CAN_DET_RANGE_RATE_96 8192;
BA_ "SignalDescription" SG_ 87 LRRF1_CAN_DET_RANGE_RATE_96 "Detected object range rate 96";
BA_ "GenSigStartValue" SG_ 87 LRRF1_CAN_DET_RANGE_RATE_95 8192;
BA_ "SignalDescription" SG_ 87 LRRF1_CAN_DET_RANGE_RATE_95 "Detected object range rate 95";
BA_ "GenSigStartValue" SG_ 87 LRRF1_CAN_DET_RANGE_RATE_94 8192;
BA_ "SignalDescription" SG_ 87 LRRF1_CAN_DET_RANGE_RATE_94 "Detected object range rate 94";
BA_ "GenSigStartValue" SG_ 87 LRRF1_CAN_DET_RANGE_RATE_93 8192;
BA_ "SignalDescription" SG_ 87 LRRF1_CAN_DET_RANGE_RATE_93 "Detected object range rate 93";
BA_ "SignalDescription" SG_ 87 LRRF1_CAN_DET_RANGE_98 "Detected object range 98";
BA_ "SignalDescription" SG_ 87 LRRF1_CAN_DET_RANGE_97 "Detected object range 97";
BA_ "SignalDescription" SG_ 87 LRRF1_CAN_DET_RANGE_96 "Detected object range 96";
BA_ "SignalDescription" SG_ 87 LRRF1_CAN_DET_RANGE_95 "Detected object range 95";
BA_ "SignalDescription" SG_ 87 LRRF1_CAN_DET_RANGE_94 "Detected object range 94";
BA_ "SignalDescription" SG_ 87 LRRF1_CAN_DET_RANGE_93 "Detected object range 93";
BA_ "SignalDescription" SG_ 87 LRRF1_CAN_DET_SUPER_RES_TAR_0035 "Super resolution target 98";
BA_ "SystemSignalLongSymbol" SG_ 87 LRRF1_CAN_DET_SUPER_RES_TAR_0035 "LRRF1_CAN_DET_SUPER_RES_TARGET_98";
BA_ "SignalDescription" SG_ 87 LRRF1_CAN_DET_SUPER_RES_TAR_0036 "Super resolution target 97";
BA_ "SystemSignalLongSymbol" SG_ 87 LRRF1_CAN_DET_SUPER_RES_TAR_0036 "LRRF1_CAN_DET_SUPER_RES_TARGET_97";
BA_ "SignalDescription" SG_ 87 LRRF1_CAN_DET_SUPER_RES_TAR_0037 "Super resolution target 96";
BA_ "SystemSignalLongSymbol" SG_ 87 LRRF1_CAN_DET_SUPER_RES_TAR_0037 "LRRF1_CAN_DET_SUPER_RES_TARGET_96";
BA_ "SignalDescription" SG_ 87 LRRF1_CAN_DET_SUPER_RES_TAR_0038 "Super resolution target 95";
BA_ "SystemSignalLongSymbol" SG_ 87 LRRF1_CAN_DET_SUPER_RES_TAR_0038 "LRRF1_CAN_DET_SUPER_RES_TARGET_95";
BA_ "SignalDescription" SG_ 87 LRRF1_CAN_DET_SUPER_RES_TAR_0039 "Super resolution target 94";
BA_ "SystemSignalLongSymbol" SG_ 87 LRRF1_CAN_DET_SUPER_RES_TAR_0039 "LRRF1_CAN_DET_SUPER_RES_TARGET_94";
BA_ "SignalDescription" SG_ 87 LRRF1_CAN_DET_SUPER_RES_TAR_0040 "Super resolution target 93";
BA_ "SystemSignalLongSymbol" SG_ 87 LRRF1_CAN_DET_SUPER_RES_TAR_0040 "LRRF1_CAN_DET_SUPER_RES_TARGET_93";
BA_ "SignalDescription" SG_ 87 LRRF1_CAN_DET_HOST_VEH_CLUT_0035 "Host vehicle clutter 98";
BA_ "SystemSignalLongSymbol" SG_ 87 LRRF1_CAN_DET_HOST_VEH_CLUT_0035 "LRRF1_CAN_DET_HOST_VEH_CLUTTER_98";
BA_ "SignalDescription" SG_ 87 LRRF1_CAN_DET_HOST_VEH_CLUT_0036 "Host vehicle clutter 97";
BA_ "SystemSignalLongSymbol" SG_ 87 LRRF1_CAN_DET_HOST_VEH_CLUT_0036 "LRRF1_CAN_DET_HOST_VEH_CLUTTER_97";
BA_ "SignalDescription" SG_ 87 LRRF1_CAN_DET_HOST_VEH_CLUT_0037 "Host vehicle clutter 96";
BA_ "SystemSignalLongSymbol" SG_ 87 LRRF1_CAN_DET_HOST_VEH_CLUT_0037 "LRRF1_CAN_DET_HOST_VEH_CLUTTER_96";
BA_ "SignalDescription" SG_ 87 LRRF1_CAN_DET_HOST_VEH_CLUT_0038 "Host vehicle clutter 95";
BA_ "SystemSignalLongSymbol" SG_ 87 LRRF1_CAN_DET_HOST_VEH_CLUT_0038 "LRRF1_CAN_DET_HOST_VEH_CLUTTER_95";
BA_ "SignalDescription" SG_ 87 LRRF1_CAN_DET_HOST_VEH_CLUT_0039 "Host vehicle clutter 94";
BA_ "SystemSignalLongSymbol" SG_ 87 LRRF1_CAN_DET_HOST_VEH_CLUT_0039 "LRRF1_CAN_DET_HOST_VEH_CLUTTER_94";
BA_ "SignalDescription" SG_ 87 LRRF1_CAN_DET_HOST_VEH_CLUT_0040 "Host vehicle clutter 93";
BA_ "SystemSignalLongSymbol" SG_ 87 LRRF1_CAN_DET_HOST_VEH_CLUT_0040 "LRRF1_CAN_DET_HOST_VEH_CLUTTER_93";
BA_ "GenSigStartValue" SG_ 87 LRRF1_CAN_DET_ELEVATION_98 63.8646288209607;
BA_ "SignalDescription" SG_ 87 LRRF1_CAN_DET_ELEVATION_98 "Detected object elevation position 98";
BA_ "GenSigStartValue" SG_ 87 LRRF1_CAN_DET_ELEVATION_97 63.8646288209607;
BA_ "SignalDescription" SG_ 87 LRRF1_CAN_DET_ELEVATION_97 "Detected object elevation position 97";
BA_ "GenSigStartValue" SG_ 87 LRRF1_CAN_DET_ELEVATION_96 63.8646288209607;
BA_ "SignalDescription" SG_ 87 LRRF1_CAN_DET_ELEVATION_96 "Detected object elevation position 96";
BA_ "GenSigStartValue" SG_ 87 LRRF1_CAN_DET_ELEVATION_95 63.8646288209607;
BA_ "SignalDescription" SG_ 87 LRRF1_CAN_DET_ELEVATION_95 "Detected object elevation position 95";
BA_ "GenSigStartValue" SG_ 87 LRRF1_CAN_DET_ELEVATION_94 63.8646288209607;
BA_ "SignalDescription" SG_ 87 LRRF1_CAN_DET_ELEVATION_94 "Detected object elevation position 94";
BA_ "GenSigStartValue" SG_ 87 LRRF1_CAN_DET_ELEVATION_93 63.8646288209607;
BA_ "SignalDescription" SG_ 87 LRRF1_CAN_DET_ELEVATION_93 "Detected object elevation position 93";
BA_ "SignalDescription" SG_ 87 LRRF1_CAN_DET_CONFID_ELEVAT_0035 "Elevation Angle Confidence 98";
BA_ "SystemSignalLongSymbol" SG_ 87 LRRF1_CAN_DET_CONFID_ELEVAT_0035 "LRRF1_CAN_DET_CONFID_ELEVATION_98";
BA_ "SignalDescription" SG_ 87 LRRF1_CAN_DET_CONFID_ELEVAT_0036 "Elevation Angle Confidence 97";
BA_ "SystemSignalLongSymbol" SG_ 87 LRRF1_CAN_DET_CONFID_ELEVAT_0036 "LRRF1_CAN_DET_CONFID_ELEVATION_97";
BA_ "SignalDescription" SG_ 87 LRRF1_CAN_DET_CONFID_ELEVAT_0037 "Elevation Angle Confidence 96";
BA_ "SystemSignalLongSymbol" SG_ 87 LRRF1_CAN_DET_CONFID_ELEVAT_0037 "LRRF1_CAN_DET_CONFID_ELEVATION_96";
BA_ "SignalDescription" SG_ 87 LRRF1_CAN_DET_CONFID_ELEVAT_0038 "Elevation Angle Confidence 95";
BA_ "SystemSignalLongSymbol" SG_ 87 LRRF1_CAN_DET_CONFID_ELEVAT_0038 "LRRF1_CAN_DET_CONFID_ELEVATION_95";
BA_ "SignalDescription" SG_ 87 LRRF1_CAN_DET_CONFID_ELEVAT_0039 "Elevation Angle Confidence 94";
BA_ "SystemSignalLongSymbol" SG_ 87 LRRF1_CAN_DET_CONFID_ELEVAT_0039 "LRRF1_CAN_DET_CONFID_ELEVATION_94";
BA_ "SignalDescription" SG_ 87 LRRF1_CAN_DET_CONFID_ELEVAT_0040 "Elevation Angle Confidence 93";
BA_ "SystemSignalLongSymbol" SG_ 87 LRRF1_CAN_DET_CONFID_ELEVAT_0040 "LRRF1_CAN_DET_CONFID_ELEVATION_93";
BA_ "GenSigVtEn" SG_ 87 LRRF1_CAN_DET_CONFID_AZIMUTH_98 "TRUE";
BA_ "SignalDescription" SG_ 87 LRRF1_CAN_DET_CONFID_AZIMUTH_98 "Signal to noise level 98";
BA_ "GenSigVtEn" SG_ 87 LRRF1_CAN_DET_CONFID_AZIMUTH_97 "TRUE";
BA_ "SignalDescription" SG_ 87 LRRF1_CAN_DET_CONFID_AZIMUTH_97 "Signal to noise level 97";
BA_ "GenSigVtEn" SG_ 87 LRRF1_CAN_DET_CONFID_AZIMUTH_96 "TRUE";
BA_ "SignalDescription" SG_ 87 LRRF1_CAN_DET_CONFID_AZIMUTH_96 "Signal to noise level 96";
BA_ "GenSigVtEn" SG_ 87 LRRF1_CAN_DET_CONFID_AZIMUTH_95 "TRUE";
BA_ "SignalDescription" SG_ 87 LRRF1_CAN_DET_CONFID_AZIMUTH_95 "Signal to noise level 95";
BA_ "GenSigVtEn" SG_ 87 LRRF1_CAN_DET_CONFID_AZIMUTH_94 "TRUE";
BA_ "SignalDescription" SG_ 87 LRRF1_CAN_DET_CONFID_AZIMUTH_94 "Signal to noise level 94";
BA_ "GenSigVtEn" SG_ 87 LRRF1_CAN_DET_CONFID_AZIMUTH_93 "TRUE";
BA_ "SignalDescription" SG_ 87 LRRF1_CAN_DET_CONFID_AZIMUTH_93 "Signal to noise level 93";
BA_ "GenSigStartValue" SG_ 87 LRRF1_CAN_DET_AZIMUTH_98 8194.05320813772;
BA_ "SignalDescription" SG_ 87 LRRF1_CAN_DET_AZIMUTH_98 "Detected object azimuth position 98";
BA_ "GenSigStartValue" SG_ 87 LRRF1_CAN_DET_AZIMUTH_97 8194.05320813772;
BA_ "SignalDescription" SG_ 87 LRRF1_CAN_DET_AZIMUTH_97 "Detected object azimuth position 97";
BA_ "GenSigStartValue" SG_ 87 LRRF1_CAN_DET_AZIMUTH_96 8194.05320813772;
BA_ "SignalDescription" SG_ 87 LRRF1_CAN_DET_AZIMUTH_96 "Detected object azimuth position 96";
BA_ "GenSigStartValue" SG_ 87 LRRF1_CAN_DET_AZIMUTH_95 8194.05320813772;
BA_ "SignalDescription" SG_ 87 LRRF1_CAN_DET_AZIMUTH_95 "Detected object azimuth position 95";
BA_ "GenSigStartValue" SG_ 87 LRRF1_CAN_DET_AZIMUTH_94 8194.05320813772;
BA_ "SignalDescription" SG_ 87 LRRF1_CAN_DET_AZIMUTH_94 "Detected object azimuth position 94";
BA_ "GenSigStartValue" SG_ 87 LRRF1_CAN_DET_AZIMUTH_93 8194.05320813772;
BA_ "SignalDescription" SG_ 87 LRRF1_CAN_DET_AZIMUTH_93 "Detected object azimuth position 93";
BA_ "SignalDescription" SG_ 87 LRRF1_CAN_DET_AMPLITUDE_98 "Detected object amplitude 98";
BA_ "SignalDescription" SG_ 87 LRRF1_CAN_DET_AMPLITUDE_97 "Detected object amplitude 97";
BA_ "SignalDescription" SG_ 87 LRRF1_CAN_DET_AMPLITUDE_96 "Detected object amplitude 96";
BA_ "SignalDescription" SG_ 87 LRRF1_CAN_DET_AMPLITUDE_95 "Detected object amplitude 95";
BA_ "SignalDescription" SG_ 87 LRRF1_CAN_DET_AMPLITUDE_94 "Detected object amplitude 94";
BA_ "SignalDescription" SG_ 87 LRRF1_CAN_DET_AMPLITUDE_93 "Detected object amplitude 93";
BA_ "SignalDescription" SG_ 87 LRRF1_CAN_DET_VALID_LEVEL_98 "Detected object valid level 98";
BA_ "SignalDescription" SG_ 87 LRRF1_CAN_DET_VALID_LEVEL_97 "Detected object valid level 97";
BA_ "SignalDescription" SG_ 87 LRRF1_CAN_DET_VALID_LEVEL_96 "Detected object valid level 96";
BA_ "SignalDescription" SG_ 87 LRRF1_CAN_DET_VALID_LEVEL_95 "Detected object valid level 95";
BA_ "SignalDescription" SG_ 87 LRRF1_CAN_DET_VALID_LEVEL_94 "Detected object valid level 94";
BA_ "SignalDescription" SG_ 87 LRRF1_CAN_DET_VALID_LEVEL_93 "Detected object valid level 93";
BA_ "GenSigSendType" SG_ 86 LRRF1_CAN_DET_Near_TARGET_91 1;
BA_ "SignalDescription" SG_ 86 LRRF1_CAN_DET_Near_TARGET_91 "Near_Target_Discrimination";
BA_ "SignalDescription" SG_ 86 LRRF1_CAN_DET_Near_TARGET_90 "Near_Target_Discrimination";
BA_ "SignalDescription" SG_ 86 LRRF1_CAN_DET_Near_TARGET_89 "Near_Target_Discrimination";
BA_ "SignalDescription" SG_ 86 LRRF1_CAN_DET_Near_TARGET_88 "Near_Target_Discrimination";
BA_ "SignalDescription" SG_ 86 LRRF1_CAN_DET_Near_TARGET_87 "Near_Target_Discrimination";
BA_ "SignalDescription" SG_ 86 LRRF1_CAN_DET_Near_TARGET_86 "Near_Target_Discrimination";
BA_ "SignalDescription" SG_ 86 LRRF1_CAN_DET_Near_TARGET_85 "Near_Target_Discrimination";
BA_ "GenSigStartValue" SG_ 86 LRRF1_CAN_DET_ELEVATION_85 63.8646288209607;
BA_ "SignalDescription" SG_ 86 LRRF1_CAN_DET_ELEVATION_85 "Detected object elevation position 85";
BA_ "GenSigVtEn" SG_ 86 LRRF1_CAN_DET_CONFID_AZIMUTH_85 "TRUE";
BA_ "SignalDescription" SG_ 86 LRRF1_CAN_DET_CONFID_AZIMUTH_85 "Signal to noise level 85";
BA_ "SignalDescription" SG_ 86 LRRF1_CAN_DET_SUPER_RES_TARGET_8 "Super resolution target 85";
BA_ "SystemSignalLongSymbol" SG_ 86 LRRF1_CAN_DET_SUPER_RES_TARGET_8 "LRRF1_CAN_DET_SUPER_RES_TARGET_85";
BA_ "SignalDescription" SG_ 86 LRRF1_CAN_DET_CONFID_ELEVATION_8 "Elevation Angle Confidence 85";
BA_ "SystemSignalLongSymbol" SG_ 86 LRRF1_CAN_DET_CONFID_ELEVATION_8 "LRRF1_CAN_DET_CONFID_ELEVATION_85";
BA_ "SignalDescription" SG_ 86 LRRF1_CAN_DET_HOST_VEH_CLUTTER_8 "Host vehicle clutter 85";
BA_ "SystemSignalLongSymbol" SG_ 86 LRRF1_CAN_DET_HOST_VEH_CLUTTER_8 "LRRF1_CAN_DET_HOST_VEH_CLUTTER_85";
BA_ "SignalDescription" SG_ 86 LRRF1_CAN_DET_VALID_LEVEL_85 "Detected object valid level 85";
BA_ "GenSigStartValue" SG_ 86 LRRF1_CAN_DET_AZIMUTH_85 8194.05320813772;
BA_ "SignalDescription" SG_ 86 LRRF1_CAN_DET_AZIMUTH_85 "Detected object azimuth position 85";
BA_ "SignalDescription" SG_ 86 LRRF1_CAN_DET_RANGE_85 "Detected object range 85";
BA_ "GenSigStartValue" SG_ 86 LRRF1_CAN_DET_RANGE_RATE_85 8192;
BA_ "SignalDescription" SG_ 86 LRRF1_CAN_DET_RANGE_RATE_85 "Detected object range rate 85";
BA_ "SignalDescription" SG_ 86 LRRF1_CAN_DET_AMPLITUDE_85 "Detected object amplitude 85";
BA_ "SignalDescription" SG_ 86 LRRF1_CAN_SCAN_INDEX_2LSB_85 "The two LSB of scan index 85";
BA_ "SignalDescription" SG_ 86 LRRF1_Det_CRC_13 "Cyclic Redundancy Check for Detection Message Number 13";
BA_ "SignalDescription" SG_ 86 LRRF1_Det_MC_13 "Message Count for Detection Message Number 13";
BA_ "SignalDescription" SG_ 86 LRRF1_CAN_SCAN_INDEX_2LSB_91 "The two LSB of scan index 91";
BA_ "SignalDescription" SG_ 86 LRRF1_CAN_SCAN_INDEX_2LSB_90 "The two LSB of scan index 90";
BA_ "SignalDescription" SG_ 86 LRRF1_CAN_SCAN_INDEX_2LSB_89 "The two LSB of scan index 89";
BA_ "SignalDescription" SG_ 86 LRRF1_CAN_SCAN_INDEX_2LSB_88 "The two LSB of scan index 88";
BA_ "SignalDescription" SG_ 86 LRRF1_CAN_SCAN_INDEX_2LSB_87 "The two LSB of scan index 87";
BA_ "SignalDescription" SG_ 86 LRRF1_CAN_SCAN_INDEX_2LSB_86 "The two LSB of scan index 86";
BA_ "GenSigStartValue" SG_ 86 LRRF1_CAN_DET_RANGE_RATE_91 8192;
BA_ "SignalDescription" SG_ 86 LRRF1_CAN_DET_RANGE_RATE_91 "Detected object range rate 91";
BA_ "GenSigStartValue" SG_ 86 LRRF1_CAN_DET_RANGE_RATE_90 8192;
BA_ "SignalDescription" SG_ 86 LRRF1_CAN_DET_RANGE_RATE_90 "Detected object range rate 90";
BA_ "GenSigStartValue" SG_ 86 LRRF1_CAN_DET_RANGE_RATE_89 8192;
BA_ "SignalDescription" SG_ 86 LRRF1_CAN_DET_RANGE_RATE_89 "Detected object range rate 89";
BA_ "GenSigStartValue" SG_ 86 LRRF1_CAN_DET_RANGE_RATE_88 8192;
BA_ "SignalDescription" SG_ 86 LRRF1_CAN_DET_RANGE_RATE_88 "Detected object range rate 88";
BA_ "GenSigStartValue" SG_ 86 LRRF1_CAN_DET_RANGE_RATE_87 8192;
BA_ "SignalDescription" SG_ 86 LRRF1_CAN_DET_RANGE_RATE_87 "Detected object range rate 87";
BA_ "GenSigStartValue" SG_ 86 LRRF1_CAN_DET_RANGE_RATE_86 8192;
BA_ "SignalDescription" SG_ 86 LRRF1_CAN_DET_RANGE_RATE_86 "Detected object range rate 86";
BA_ "SignalDescription" SG_ 86 LRRF1_CAN_DET_RANGE_91 "Detected object range 91";
BA_ "SignalDescription" SG_ 86 LRRF1_CAN_DET_RANGE_90 "Detected object range 90";
BA_ "SignalDescription" SG_ 86 LRRF1_CAN_DET_RANGE_89 "Detected object range 89";
BA_ "SignalDescription" SG_ 86 LRRF1_CAN_DET_RANGE_88 "Detected object range 88";
BA_ "SignalDescription" SG_ 86 LRRF1_CAN_DET_RANGE_87 "Detected object range 87";
BA_ "SignalDescription" SG_ 86 LRRF1_CAN_DET_RANGE_86 "Detected object range 86";
BA_ "SignalDescription" SG_ 86 LRRF1_CAN_DET_SUPER_RES_TAR_0041 "Super resolution target 91";
BA_ "SystemSignalLongSymbol" SG_ 86 LRRF1_CAN_DET_SUPER_RES_TAR_0041 "LRRF1_CAN_DET_SUPER_RES_TARGET_91";
BA_ "SignalDescription" SG_ 86 LRRF1_CAN_DET_SUPER_RES_TAR_0042 "Super resolution target 90";
BA_ "SystemSignalLongSymbol" SG_ 86 LRRF1_CAN_DET_SUPER_RES_TAR_0042 "LRRF1_CAN_DET_SUPER_RES_TARGET_90";
BA_ "SignalDescription" SG_ 86 LRRF1_CAN_DET_SUPER_RES_TAR_0043 "Super resolution target 89";
BA_ "SystemSignalLongSymbol" SG_ 86 LRRF1_CAN_DET_SUPER_RES_TAR_0043 "LRRF1_CAN_DET_SUPER_RES_TARGET_89";
BA_ "SignalDescription" SG_ 86 LRRF1_CAN_DET_SUPER_RES_TAR_0044 "Super resolution target 88";
BA_ "SystemSignalLongSymbol" SG_ 86 LRRF1_CAN_DET_SUPER_RES_TAR_0044 "LRRF1_CAN_DET_SUPER_RES_TARGET_88";
BA_ "SignalDescription" SG_ 86 LRRF1_CAN_DET_SUPER_RES_TAR_0045 "Super resolution target 87";
BA_ "SystemSignalLongSymbol" SG_ 86 LRRF1_CAN_DET_SUPER_RES_TAR_0045 "LRRF1_CAN_DET_SUPER_RES_TARGET_87";
BA_ "SignalDescription" SG_ 86 LRRF1_CAN_DET_SUPER_RES_TAR_0046 "Super resolution target 86";
BA_ "SystemSignalLongSymbol" SG_ 86 LRRF1_CAN_DET_SUPER_RES_TAR_0046 "LRRF1_CAN_DET_SUPER_RES_TARGET_86";
BA_ "SignalDescription" SG_ 86 LRRF1_CAN_DET_HOST_VEH_CLUT_0041 "Host vehicle clutter 91";
BA_ "SystemSignalLongSymbol" SG_ 86 LRRF1_CAN_DET_HOST_VEH_CLUT_0041 "LRRF1_CAN_DET_HOST_VEH_CLUTTER_91";
BA_ "SignalDescription" SG_ 86 LRRF1_CAN_DET_HOST_VEH_CLUT_0042 "Host vehicle clutter 90";
BA_ "SystemSignalLongSymbol" SG_ 86 LRRF1_CAN_DET_HOST_VEH_CLUT_0042 "LRRF1_CAN_DET_HOST_VEH_CLUTTER_90";
BA_ "SignalDescription" SG_ 86 LRRF1_CAN_DET_HOST_VEH_CLUT_0043 "Host vehicle clutter 89";
BA_ "SystemSignalLongSymbol" SG_ 86 LRRF1_CAN_DET_HOST_VEH_CLUT_0043 "LRRF1_CAN_DET_HOST_VEH_CLUTTER_89";
BA_ "SignalDescription" SG_ 86 LRRF1_CAN_DET_HOST_VEH_CLUT_0044 "Host vehicle clutter 88";
BA_ "SystemSignalLongSymbol" SG_ 86 LRRF1_CAN_DET_HOST_VEH_CLUT_0044 "LRRF1_CAN_DET_HOST_VEH_CLUTTER_88";
BA_ "SignalDescription" SG_ 86 LRRF1_CAN_DET_HOST_VEH_CLUT_0045 "Host vehicle clutter 87";
BA_ "SystemSignalLongSymbol" SG_ 86 LRRF1_CAN_DET_HOST_VEH_CLUT_0045 "LRRF1_CAN_DET_HOST_VEH_CLUTTER_87";
BA_ "SignalDescription" SG_ 86 LRRF1_CAN_DET_HOST_VEH_CLUT_0046 "Host vehicle clutter 86";
BA_ "SystemSignalLongSymbol" SG_ 86 LRRF1_CAN_DET_HOST_VEH_CLUT_0046 "LRRF1_CAN_DET_HOST_VEH_CLUTTER_86";
BA_ "GenSigStartValue" SG_ 86 LRRF1_CAN_DET_ELEVATION_91 63.8646288209607;
BA_ "SignalDescription" SG_ 86 LRRF1_CAN_DET_ELEVATION_91 "Detected object elevation position 91";
BA_ "GenSigStartValue" SG_ 86 LRRF1_CAN_DET_ELEVATION_90 63.8646288209607;
BA_ "SignalDescription" SG_ 86 LRRF1_CAN_DET_ELEVATION_90 "Detected object elevation position 90";
BA_ "GenSigStartValue" SG_ 86 LRRF1_CAN_DET_ELEVATION_89 63.8646288209607;
BA_ "SignalDescription" SG_ 86 LRRF1_CAN_DET_ELEVATION_89 "Detected object elevation position 89";
BA_ "GenSigStartValue" SG_ 86 LRRF1_CAN_DET_ELEVATION_88 63.8646288209607;
BA_ "SignalDescription" SG_ 86 LRRF1_CAN_DET_ELEVATION_88 "Detected object elevation position 88";
BA_ "GenSigStartValue" SG_ 86 LRRF1_CAN_DET_ELEVATION_87 63.8646288209607;
BA_ "SignalDescription" SG_ 86 LRRF1_CAN_DET_ELEVATION_87 "Detected object elevation position 87";
BA_ "GenSigStartValue" SG_ 86 LRRF1_CAN_DET_ELEVATION_86 63.8646288209607;
BA_ "SignalDescription" SG_ 86 LRRF1_CAN_DET_ELEVATION_86 "Detected object elevation position 86";
BA_ "SignalDescription" SG_ 86 LRRF1_CAN_DET_CONFID_ELEVAT_0041 "Elevation Angle Confidence 91";
BA_ "SystemSignalLongSymbol" SG_ 86 LRRF1_CAN_DET_CONFID_ELEVAT_0041 "LRRF1_CAN_DET_CONFID_ELEVATION_91";
BA_ "SignalDescription" SG_ 86 LRRF1_CAN_DET_CONFID_ELEVAT_0042 "Elevation Angle Confidence 90";
BA_ "SystemSignalLongSymbol" SG_ 86 LRRF1_CAN_DET_CONFID_ELEVAT_0042 "LRRF1_CAN_DET_CONFID_ELEVATION_90";
BA_ "SignalDescription" SG_ 86 LRRF1_CAN_DET_CONFID_ELEVAT_0043 "Elevation Angle Confidence 89";
BA_ "SystemSignalLongSymbol" SG_ 86 LRRF1_CAN_DET_CONFID_ELEVAT_0043 "LRRF1_CAN_DET_CONFID_ELEVATION_89";
BA_ "SignalDescription" SG_ 86 LRRF1_CAN_DET_CONFID_ELEVAT_0044 "Elevation Angle Confidence 88";
BA_ "SystemSignalLongSymbol" SG_ 86 LRRF1_CAN_DET_CONFID_ELEVAT_0044 "LRRF1_CAN_DET_CONFID_ELEVATION_88";
BA_ "SignalDescription" SG_ 86 LRRF1_CAN_DET_CONFID_ELEVAT_0045 "Elevation Angle Confidence 87";
BA_ "SystemSignalLongSymbol" SG_ 86 LRRF1_CAN_DET_CONFID_ELEVAT_0045 "LRRF1_CAN_DET_CONFID_ELEVATION_87";
BA_ "SignalDescription" SG_ 86 LRRF1_CAN_DET_CONFID_ELEVAT_0046 "Elevation Angle Confidence 86";
BA_ "SystemSignalLongSymbol" SG_ 86 LRRF1_CAN_DET_CONFID_ELEVAT_0046 "LRRF1_CAN_DET_CONFID_ELEVATION_86";
BA_ "GenSigVtEn" SG_ 86 LRRF1_CAN_DET_CONFID_AZIMUTH_91 "TRUE";
BA_ "SignalDescription" SG_ 86 LRRF1_CAN_DET_CONFID_AZIMUTH_91 "Signal to noise level 91";
BA_ "GenSigVtEn" SG_ 86 LRRF1_CAN_DET_CONFID_AZIMUTH_90 "TRUE";
BA_ "SignalDescription" SG_ 86 LRRF1_CAN_DET_CONFID_AZIMUTH_90 "Signal to noise level 90";
BA_ "GenSigVtEn" SG_ 86 LRRF1_CAN_DET_CONFID_AZIMUTH_89 "TRUE";
BA_ "SignalDescription" SG_ 86 LRRF1_CAN_DET_CONFID_AZIMUTH_89 "Signal to noise level 89";
BA_ "GenSigVtEn" SG_ 86 LRRF1_CAN_DET_CONFID_AZIMUTH_88 "TRUE";
BA_ "SignalDescription" SG_ 86 LRRF1_CAN_DET_CONFID_AZIMUTH_88 "Signal to noise level 88";
BA_ "GenSigVtEn" SG_ 86 LRRF1_CAN_DET_CONFID_AZIMUTH_87 "TRUE";
BA_ "SignalDescription" SG_ 86 LRRF1_CAN_DET_CONFID_AZIMUTH_87 "Signal to noise level 87";
BA_ "GenSigVtEn" SG_ 86 LRRF1_CAN_DET_CONFID_AZIMUTH_86 "TRUE";
BA_ "SignalDescription" SG_ 86 LRRF1_CAN_DET_CONFID_AZIMUTH_86 "Signal to noise level 86";
BA_ "GenSigStartValue" SG_ 86 LRRF1_CAN_DET_AZIMUTH_91 8194.05320813772;
BA_ "SignalDescription" SG_ 86 LRRF1_CAN_DET_AZIMUTH_91 "Detected object azimuth position 91";
BA_ "GenSigStartValue" SG_ 86 LRRF1_CAN_DET_AZIMUTH_90 8194.05320813772;
BA_ "SignalDescription" SG_ 86 LRRF1_CAN_DET_AZIMUTH_90 "Detected object azimuth position 90";
BA_ "GenSigStartValue" SG_ 86 LRRF1_CAN_DET_AZIMUTH_89 8194.05320813772;
BA_ "SignalDescription" SG_ 86 LRRF1_CAN_DET_AZIMUTH_89 "Detected object azimuth position 89";
BA_ "GenSigStartValue" SG_ 86 LRRF1_CAN_DET_AZIMUTH_88 8194.05320813772;
BA_ "SignalDescription" SG_ 86 LRRF1_CAN_DET_AZIMUTH_88 "Detected object azimuth position 88";
BA_ "GenSigStartValue" SG_ 86 LRRF1_CAN_DET_AZIMUTH_87 8194.05320813772;
BA_ "SignalDescription" SG_ 86 LRRF1_CAN_DET_AZIMUTH_87 "Detected object azimuth position 87";
BA_ "GenSigStartValue" SG_ 86 LRRF1_CAN_DET_AZIMUTH_86 8194.05320813772;
BA_ "SignalDescription" SG_ 86 LRRF1_CAN_DET_AZIMUTH_86 "Detected object azimuth position 86";
BA_ "SignalDescription" SG_ 86 LRRF1_CAN_DET_AMPLITUDE_91 "Detected object amplitude 91";
BA_ "SignalDescription" SG_ 86 LRRF1_CAN_DET_AMPLITUDE_90 "Detected object amplitude 90";
BA_ "SignalDescription" SG_ 86 LRRF1_CAN_DET_AMPLITUDE_89 "Detected object amplitude 89";
BA_ "SignalDescription" SG_ 86 LRRF1_CAN_DET_AMPLITUDE_88 "Detected object amplitude 88";
BA_ "SignalDescription" SG_ 86 LRRF1_CAN_DET_AMPLITUDE_87 "Detected object amplitude 87";
BA_ "SignalDescription" SG_ 86 LRRF1_CAN_DET_AMPLITUDE_86 "Detected object amplitude 86";
BA_ "SignalDescription" SG_ 86 LRRF1_CAN_DET_VALID_LEVEL_91 "Detected object valid level 91";
BA_ "SignalDescription" SG_ 86 LRRF1_CAN_DET_VALID_LEVEL_90 "Detected object valid level 90";
BA_ "SignalDescription" SG_ 86 LRRF1_CAN_DET_VALID_LEVEL_89 "Detected object valid level 89";
BA_ "SignalDescription" SG_ 86 LRRF1_CAN_DET_VALID_LEVEL_88 "Detected object valid level 88";
BA_ "SignalDescription" SG_ 86 LRRF1_CAN_DET_VALID_LEVEL_87 "Detected object valid level 87";
BA_ "SignalDescription" SG_ 86 LRRF1_CAN_DET_VALID_LEVEL_86 "Detected object valid level 86";
BA_ "GenSigSendType" SG_ 85 LRRF1_CAN_DET_Near_TARGET_84 1;
BA_ "SignalDescription" SG_ 85 LRRF1_CAN_DET_Near_TARGET_84 "Near_Target_Discrimination";
BA_ "SignalDescription" SG_ 85 LRRF1_CAN_DET_Near_TARGET_83 "Near_Target_Discrimination";
BA_ "SignalDescription" SG_ 85 LRRF1_CAN_DET_Near_TARGET_82 "Near_Target_Discrimination";
BA_ "SignalDescription" SG_ 85 LRRF1_CAN_DET_Near_TARGET_81 "Near_Target_Discrimination";
BA_ "SignalDescription" SG_ 85 LRRF1_CAN_DET_Near_TARGET_80 "Near_Target_Discrimination";
BA_ "SignalDescription" SG_ 85 LRRF1_CAN_DET_Near_TARGET_79 "Near_Target_Discrimination";
BA_ "SignalDescription" SG_ 85 LRRF1_CAN_DET_Near_TARGET_78 "Near_Target_Discrimination";
BA_ "GenSigStartValue" SG_ 85 LRRF1_CAN_DET_ELEVATION_78 63.8646288209607;
BA_ "SignalDescription" SG_ 85 LRRF1_CAN_DET_ELEVATION_78 "Detected object elevation position 78";
BA_ "GenSigVtEn" SG_ 85 LRRF1_CAN_DET_CONFID_AZIMUTH_78 "TRUE";
BA_ "SignalDescription" SG_ 85 LRRF1_CAN_DET_CONFID_AZIMUTH_78 "Signal to noise level 78";
BA_ "SignalDescription" SG_ 85 LRRF1_CAN_DET_SUPER_RES_TARGET_7 "Super resolution target 78";
BA_ "SystemSignalLongSymbol" SG_ 85 LRRF1_CAN_DET_SUPER_RES_TARGET_7 "LRRF1_CAN_DET_SUPER_RES_TARGET_78";
BA_ "SignalDescription" SG_ 85 LRRF1_CAN_DET_CONFID_ELEVATION_7 "Elevation Angle Confidence 78";
BA_ "SystemSignalLongSymbol" SG_ 85 LRRF1_CAN_DET_CONFID_ELEVATION_7 "LRRF1_CAN_DET_CONFID_ELEVATION_78";
BA_ "SignalDescription" SG_ 85 LRRF1_CAN_DET_HOST_VEH_CLUTTER_7 "Host vehicle clutter 78";
BA_ "SystemSignalLongSymbol" SG_ 85 LRRF1_CAN_DET_HOST_VEH_CLUTTER_7 "LRRF1_CAN_DET_HOST_VEH_CLUTTER_78";
BA_ "SignalDescription" SG_ 85 LRRF1_CAN_DET_VALID_LEVEL_78 "Detected object valid level 78";
BA_ "GenSigStartValue" SG_ 85 LRRF1_CAN_DET_AZIMUTH_78 8194.05320813772;
BA_ "SignalDescription" SG_ 85 LRRF1_CAN_DET_AZIMUTH_78 "Detected object azimuth position 78";
BA_ "SignalDescription" SG_ 85 LRRF1_CAN_DET_RANGE_78 "Detected object range 78";
BA_ "GenSigStartValue" SG_ 85 LRRF1_CAN_DET_RANGE_RATE_78 8192;
BA_ "SignalDescription" SG_ 85 LRRF1_CAN_DET_RANGE_RATE_78 "Detected object range rate 78";
BA_ "SignalDescription" SG_ 85 LRRF1_CAN_DET_AMPLITUDE_78 "Detected object amplitude 78";
BA_ "SignalDescription" SG_ 85 LRRF1_CAN_SCAN_INDEX_2LSB_78 "The two LSB of scan index 78";
BA_ "SignalDescription" SG_ 85 LRRF1_Det_CRC_12 "Cyclic Redundancy Check for Detection Message Number 12";
BA_ "SignalDescription" SG_ 85 LRRF1_Det_MC_12 "Message Count for Detection Message Number 12";
BA_ "SignalDescription" SG_ 85 LRRF1_CAN_SCAN_INDEX_2LSB_84 "The two LSB of scan index 84";
BA_ "SignalDescription" SG_ 85 LRRF1_CAN_SCAN_INDEX_2LSB_83 "The two LSB of scan index 83";
BA_ "SignalDescription" SG_ 85 LRRF1_CAN_SCAN_INDEX_2LSB_82 "The two LSB of scan index 82";
BA_ "SignalDescription" SG_ 85 LRRF1_CAN_SCAN_INDEX_2LSB_81 "The two LSB of scan index 81";
BA_ "SignalDescription" SG_ 85 LRRF1_CAN_SCAN_INDEX_2LSB_80 "The two LSB of scan index 80";
BA_ "SignalDescription" SG_ 85 LRRF1_CAN_SCAN_INDEX_2LSB_79 "The two LSB of scan index 79";
BA_ "GenSigStartValue" SG_ 85 LRRF1_CAN_DET_RANGE_RATE_84 8192;
BA_ "SignalDescription" SG_ 85 LRRF1_CAN_DET_RANGE_RATE_84 "Detected object range rate 84";
BA_ "GenSigStartValue" SG_ 85 LRRF1_CAN_DET_RANGE_RATE_83 8192;
BA_ "SignalDescription" SG_ 85 LRRF1_CAN_DET_RANGE_RATE_83 "Detected object range rate 83";
BA_ "GenSigStartValue" SG_ 85 LRRF1_CAN_DET_RANGE_RATE_82 8192;
BA_ "SignalDescription" SG_ 85 LRRF1_CAN_DET_RANGE_RATE_82 "Detected object range rate 82";
BA_ "GenSigStartValue" SG_ 85 LRRF1_CAN_DET_RANGE_RATE_81 8192;
BA_ "SignalDescription" SG_ 85 LRRF1_CAN_DET_RANGE_RATE_81 "Detected object range rate 81";
BA_ "GenSigStartValue" SG_ 85 LRRF1_CAN_DET_RANGE_RATE_80 8192;
BA_ "SignalDescription" SG_ 85 LRRF1_CAN_DET_RANGE_RATE_80 "Detected object range rate 80";
BA_ "GenSigStartValue" SG_ 85 LRRF1_CAN_DET_RANGE_RATE_79 8192;
BA_ "SignalDescription" SG_ 85 LRRF1_CAN_DET_RANGE_RATE_79 "Detected object range rate 79";
BA_ "SignalDescription" SG_ 85 LRRF1_CAN_DET_RANGE_84 "Detected object range 84";
BA_ "SignalDescription" SG_ 85 LRRF1_CAN_DET_RANGE_83 "Detected object range 83";
BA_ "SignalDescription" SG_ 85 LRRF1_CAN_DET_RANGE_82 "Detected object range 82";
BA_ "SignalDescription" SG_ 85 LRRF1_CAN_DET_RANGE_81 "Detected object range 81";
BA_ "SignalDescription" SG_ 85 LRRF1_CAN_DET_RANGE_80 "Detected object range 80";
BA_ "SignalDescription" SG_ 85 LRRF1_CAN_DET_RANGE_79 "Detected object range 79";
BA_ "SignalDescription" SG_ 85 LRRF1_CAN_DET_SUPER_RES_TAR_0047 "Super resolution target 84";
BA_ "SystemSignalLongSymbol" SG_ 85 LRRF1_CAN_DET_SUPER_RES_TAR_0047 "LRRF1_CAN_DET_SUPER_RES_TARGET_84";
BA_ "SignalDescription" SG_ 85 LRRF1_CAN_DET_SUPER_RES_TAR_0048 "Super resolution target 83";
BA_ "SystemSignalLongSymbol" SG_ 85 LRRF1_CAN_DET_SUPER_RES_TAR_0048 "LRRF1_CAN_DET_SUPER_RES_TARGET_83";
BA_ "SignalDescription" SG_ 85 LRRF1_CAN_DET_SUPER_RES_TAR_0049 "Super resolution target 82";
BA_ "SystemSignalLongSymbol" SG_ 85 LRRF1_CAN_DET_SUPER_RES_TAR_0049 "LRRF1_CAN_DET_SUPER_RES_TARGET_82";
BA_ "SignalDescription" SG_ 85 LRRF1_CAN_DET_SUPER_RES_TAR_0050 "Super resolution target 81";
BA_ "SystemSignalLongSymbol" SG_ 85 LRRF1_CAN_DET_SUPER_RES_TAR_0050 "LRRF1_CAN_DET_SUPER_RES_TARGET_81";
BA_ "SignalDescription" SG_ 85 LRRF1_CAN_DET_SUPER_RES_TAR_0051 "Super resolution target 80";
BA_ "SystemSignalLongSymbol" SG_ 85 LRRF1_CAN_DET_SUPER_RES_TAR_0051 "LRRF1_CAN_DET_SUPER_RES_TARGET_80";
BA_ "SignalDescription" SG_ 85 LRRF1_CAN_DET_SUPER_RES_TAR_0052 "Super resolution target 79";
BA_ "SystemSignalLongSymbol" SG_ 85 LRRF1_CAN_DET_SUPER_RES_TAR_0052 "LRRF1_CAN_DET_SUPER_RES_TARGET_79";
BA_ "SignalDescription" SG_ 85 LRRF1_CAN_DET_HOST_VEH_CLUT_0047 "Host vehicle clutter 84";
BA_ "SystemSignalLongSymbol" SG_ 85 LRRF1_CAN_DET_HOST_VEH_CLUT_0047 "LRRF1_CAN_DET_HOST_VEH_CLUTTER_84";
BA_ "SignalDescription" SG_ 85 LRRF1_CAN_DET_HOST_VEH_CLUT_0048 "Host vehicle clutter 83";
BA_ "SystemSignalLongSymbol" SG_ 85 LRRF1_CAN_DET_HOST_VEH_CLUT_0048 "LRRF1_CAN_DET_HOST_VEH_CLUTTER_83";
BA_ "SignalDescription" SG_ 85 LRRF1_CAN_DET_HOST_VEH_CLUT_0049 "Host vehicle clutter 82";
BA_ "SystemSignalLongSymbol" SG_ 85 LRRF1_CAN_DET_HOST_VEH_CLUT_0049 "LRRF1_CAN_DET_HOST_VEH_CLUTTER_82";
BA_ "SignalDescription" SG_ 85 LRRF1_CAN_DET_HOST_VEH_CLUT_0050 "Host vehicle clutter 81";
BA_ "SystemSignalLongSymbol" SG_ 85 LRRF1_CAN_DET_HOST_VEH_CLUT_0050 "LRRF1_CAN_DET_HOST_VEH_CLUTTER_81";
BA_ "SignalDescription" SG_ 85 LRRF1_CAN_DET_HOST_VEH_CLUT_0051 "Host vehicle clutter 80";
BA_ "SystemSignalLongSymbol" SG_ 85 LRRF1_CAN_DET_HOST_VEH_CLUT_0051 "LRRF1_CAN_DET_HOST_VEH_CLUTTER_80";
BA_ "SignalDescription" SG_ 85 LRRF1_CAN_DET_HOST_VEH_CLUT_0052 "Host vehicle clutter 79";
BA_ "SystemSignalLongSymbol" SG_ 85 LRRF1_CAN_DET_HOST_VEH_CLUT_0052 "LRRF1_CAN_DET_HOST_VEH_CLUTTER_79";
BA_ "GenSigStartValue" SG_ 85 LRRF1_CAN_DET_ELEVATION_84 63.8646288209607;
BA_ "SignalDescription" SG_ 85 LRRF1_CAN_DET_ELEVATION_84 "Detected object elevation position 84";
BA_ "GenSigStartValue" SG_ 85 LRRF1_CAN_DET_ELEVATION_83 63.8646288209607;
BA_ "SignalDescription" SG_ 85 LRRF1_CAN_DET_ELEVATION_83 "Detected object elevation position 83";
BA_ "GenSigStartValue" SG_ 85 LRRF1_CAN_DET_ELEVATION_82 63.8646288209607;
BA_ "SignalDescription" SG_ 85 LRRF1_CAN_DET_ELEVATION_82 "Detected object elevation position 82";
BA_ "GenSigStartValue" SG_ 85 LRRF1_CAN_DET_ELEVATION_81 63.8646288209607;
BA_ "SignalDescription" SG_ 85 LRRF1_CAN_DET_ELEVATION_81 "Detected object elevation position 81";
BA_ "GenSigStartValue" SG_ 85 LRRF1_CAN_DET_ELEVATION_80 63.8646288209607;
BA_ "SignalDescription" SG_ 85 LRRF1_CAN_DET_ELEVATION_80 "Detected object elevation position 80";
BA_ "GenSigStartValue" SG_ 85 LRRF1_CAN_DET_ELEVATION_79 63.8646288209607;
BA_ "SignalDescription" SG_ 85 LRRF1_CAN_DET_ELEVATION_79 "Detected object elevation position 79";
BA_ "SignalDescription" SG_ 85 LRRF1_CAN_DET_CONFID_ELEVAT_0047 "Elevation Angle Confidence 84";
BA_ "SystemSignalLongSymbol" SG_ 85 LRRF1_CAN_DET_CONFID_ELEVAT_0047 "LRRF1_CAN_DET_CONFID_ELEVATION_84";
BA_ "SignalDescription" SG_ 85 LRRF1_CAN_DET_CONFID_ELEVAT_0048 "Elevation Angle Confidence 83";
BA_ "SystemSignalLongSymbol" SG_ 85 LRRF1_CAN_DET_CONFID_ELEVAT_0048 "LRRF1_CAN_DET_CONFID_ELEVATION_83";
BA_ "SignalDescription" SG_ 85 LRRF1_CAN_DET_CONFID_ELEVAT_0049 "Elevation Angle Confidence 82";
BA_ "SystemSignalLongSymbol" SG_ 85 LRRF1_CAN_DET_CONFID_ELEVAT_0049 "LRRF1_CAN_DET_CONFID_ELEVATION_82";
BA_ "SignalDescription" SG_ 85 LRRF1_CAN_DET_CONFID_ELEVAT_0050 "Elevation Angle Confidence 81";
BA_ "SystemSignalLongSymbol" SG_ 85 LRRF1_CAN_DET_CONFID_ELEVAT_0050 "LRRF1_CAN_DET_CONFID_ELEVATION_81";
BA_ "SignalDescription" SG_ 85 LRRF1_CAN_DET_CONFID_ELEVAT_0051 "Elevation Angle Confidence 80";
BA_ "SystemSignalLongSymbol" SG_ 85 LRRF1_CAN_DET_CONFID_ELEVAT_0051 "LRRF1_CAN_DET_CONFID_ELEVATION_80";
BA_ "SignalDescription" SG_ 85 LRRF1_CAN_DET_CONFID_ELEVAT_0052 "Elevation Angle Confidence 79";
BA_ "SystemSignalLongSymbol" SG_ 85 LRRF1_CAN_DET_CONFID_ELEVAT_0052 "LRRF1_CAN_DET_CONFID_ELEVATION_79";
BA_ "GenSigVtEn" SG_ 85 LRRF1_CAN_DET_CONFID_AZIMUTH_84 "TRUE";
BA_ "SignalDescription" SG_ 85 LRRF1_CAN_DET_CONFID_AZIMUTH_84 "Signal to noise level 84";
BA_ "GenSigVtEn" SG_ 85 LRRF1_CAN_DET_CONFID_AZIMUTH_83 "TRUE";
BA_ "SignalDescription" SG_ 85 LRRF1_CAN_DET_CONFID_AZIMUTH_83 "Signal to noise level 83";
BA_ "GenSigVtEn" SG_ 85 LRRF1_CAN_DET_CONFID_AZIMUTH_82 "TRUE";
BA_ "SignalDescription" SG_ 85 LRRF1_CAN_DET_CONFID_AZIMUTH_82 "Signal to noise level 82";
BA_ "GenSigVtEn" SG_ 85 LRRF1_CAN_DET_CONFID_AZIMUTH_81 "TRUE";
BA_ "SignalDescription" SG_ 85 LRRF1_CAN_DET_CONFID_AZIMUTH_81 "Signal to noise level 81";
BA_ "GenSigVtEn" SG_ 85 LRRF1_CAN_DET_CONFID_AZIMUTH_80 "TRUE";
BA_ "SignalDescription" SG_ 85 LRRF1_CAN_DET_CONFID_AZIMUTH_80 "Signal to noise level 80";
BA_ "GenSigVtEn" SG_ 85 LRRF1_CAN_DET_CONFID_AZIMUTH_79 "TRUE";
BA_ "SignalDescription" SG_ 85 LRRF1_CAN_DET_CONFID_AZIMUTH_79 "Signal to noise level 79";
BA_ "GenSigStartValue" SG_ 85 LRRF1_CAN_DET_AZIMUTH_84 8194.05320813772;
BA_ "SignalDescription" SG_ 85 LRRF1_CAN_DET_AZIMUTH_84 "Detected object azimuth position 84";
BA_ "GenSigStartValue" SG_ 85 LRRF1_CAN_DET_AZIMUTH_83 8194.05320813772;
BA_ "SignalDescription" SG_ 85 LRRF1_CAN_DET_AZIMUTH_83 "Detected object azimuth position 83";
BA_ "GenSigStartValue" SG_ 85 LRRF1_CAN_DET_AZIMUTH_82 8194.05320813772;
BA_ "SignalDescription" SG_ 85 LRRF1_CAN_DET_AZIMUTH_82 "Detected object azimuth position 82";
BA_ "GenSigStartValue" SG_ 85 LRRF1_CAN_DET_AZIMUTH_81 8194.05320813772;
BA_ "SignalDescription" SG_ 85 LRRF1_CAN_DET_AZIMUTH_81 "Detected object azimuth position 81";
BA_ "GenSigStartValue" SG_ 85 LRRF1_CAN_DET_AZIMUTH_80 8194.05320813772;
BA_ "SignalDescription" SG_ 85 LRRF1_CAN_DET_AZIMUTH_80 "Detected object azimuth position 80";
BA_ "GenSigStartValue" SG_ 85 LRRF1_CAN_DET_AZIMUTH_79 8194.05320813772;
BA_ "SignalDescription" SG_ 85 LRRF1_CAN_DET_AZIMUTH_79 "Detected object azimuth position 79";
BA_ "SignalDescription" SG_ 85 LRRF1_CAN_DET_AMPLITUDE_84 "Detected object amplitude 84";
BA_ "SignalDescription" SG_ 85 LRRF1_CAN_DET_AMPLITUDE_83 "Detected object amplitude 83";
BA_ "SignalDescription" SG_ 85 LRRF1_CAN_DET_AMPLITUDE_82 "Detected object amplitude 82";
BA_ "SignalDescription" SG_ 85 LRRF1_CAN_DET_AMPLITUDE_81 "Detected object amplitude 81";
BA_ "SignalDescription" SG_ 85 LRRF1_CAN_DET_AMPLITUDE_80 "Detected object amplitude 80";
BA_ "SignalDescription" SG_ 85 LRRF1_CAN_DET_AMPLITUDE_79 "Detected object amplitude 79";
BA_ "SignalDescription" SG_ 85 LRRF1_CAN_DET_VALID_LEVEL_84 "Detected object valid level 84";
BA_ "SignalDescription" SG_ 85 LRRF1_CAN_DET_VALID_LEVEL_83 "Detected object valid level 83";
BA_ "SignalDescription" SG_ 85 LRRF1_CAN_DET_VALID_LEVEL_82 "Detected object valid level 82";
BA_ "SignalDescription" SG_ 85 LRRF1_CAN_DET_VALID_LEVEL_81 "Detected object valid level 81";
BA_ "SignalDescription" SG_ 85 LRRF1_CAN_DET_VALID_LEVEL_80 "Detected object valid level 80";
BA_ "SignalDescription" SG_ 85 LRRF1_CAN_DET_VALID_LEVEL_79 "Detected object valid level 79";
VAL_ 91 LRRF1_CAN_DET_CONFID_AZIMUTH_120 3 "Low" 2 "Medium_Low" 1 "Medium_High" 0 "High" ;
VAL_ 91 LRRF1_CAN_DET_CONFID_AZIMUTH_126 3 "Low" 2 "Medium_Low" 1 "Medium_High" 0 "High" ;
VAL_ 91 LRRF1_CAN_DET_CONFID_AZIMUTH_125 3 "Low" 2 "Medium_Low" 1 "Medium_High" 0 "High" ;
VAL_ 91 LRRF1_CAN_DET_CONFID_AZIMUTH_124 3 "Low" 2 "Medium_Low" 1 "Medium_High" 0 "High" ;
VAL_ 91 LRRF1_CAN_DET_CONFID_AZIMUTH_123 3 "Low" 2 "Medium_Low" 1 "Medium_High" 0 "High" ;
VAL_ 91 LRRF1_CAN_DET_CONFID_AZIMUTH_122 3 "Low" 2 "Medium_Low" 1 "Medium_High" 0 "High" ;
VAL_ 91 LRRF1_CAN_DET_CONFID_AZIMUTH_121 3 "Low" 2 "Medium_Low" 1 "Medium_High" 0 "High" ;
VAL_ 90 LRRF1_CAN_DET_CONFID_AZIMUTH_113 3 "Low" 2 "Medium_Low" 1 "Medium_High" 0 "High" ;
VAL_ 90 LRRF1_CAN_DET_CONFID_AZIMUTH_119 3 "Low" 2 "Medium_Low" 1 "Medium_High" 0 "High" ;
VAL_ 90 LRRF1_CAN_DET_CONFID_AZIMUTH_118 3 "Low" 2 "Medium_Low" 1 "Medium_High" 0 "High" ;
VAL_ 90 LRRF1_CAN_DET_CONFID_AZIMUTH_117 3 "Low" 2 "Medium_Low" 1 "Medium_High" 0 "High" ;
VAL_ 90 LRRF1_CAN_DET_CONFID_AZIMUTH_116 3 "Low" 2 "Medium_Low" 1 "Medium_High" 0 "High" ;
VAL_ 90 LRRF1_CAN_DET_CONFID_AZIMUTH_115 3 "Low" 2 "Medium_Low" 1 "Medium_High" 0 "High" ;
VAL_ 90 LRRF1_CAN_DET_CONFID_AZIMUTH_114 3 "Low" 2 "Medium_Low" 1 "Medium_High" 0 "High" ;
VAL_ 89 LRRF1_CAN_DET_CONFID_AZIMUTH_106 3 "Low" 2 "Medium_Low" 1 "Medium_High" 0 "High" ;
VAL_ 89 LRRF1_CAN_DET_CONFID_AZIMUTH_112 3 "Low" 2 "Medium_Low" 1 "Medium_High" 0 "High" ;
VAL_ 89 LRRF1_CAN_DET_CONFID_AZIMUTH_111 3 "Low" 2 "Medium_Low" 1 "Medium_High" 0 "High" ;
VAL_ 89 LRRF1_CAN_DET_CONFID_AZIMUTH_110 3 "Low" 2 "Medium_Low" 1 "Medium_High" 0 "High" ;
VAL_ 89 LRRF1_CAN_DET_CONFID_AZIMUTH_109 3 "Low" 2 "Medium_Low" 1 "Medium_High" 0 "High" ;
VAL_ 89 LRRF1_CAN_DET_CONFID_AZIMUTH_108 3 "Low" 2 "Medium_Low" 1 "Medium_High" 0 "High" ;
VAL_ 89 LRRF1_CAN_DET_CONFID_AZIMUTH_107 3 "Low" 2 "Medium_Low" 1 "Medium_High" 0 "High" ;
VAL_ 88 LRRF1_CAN_DET_CONFID_AZIMUTH_99 3 "Low" 2 "Medium_Low" 1 "Medium_High" 0 "High" ;
VAL_ 88 LRRF1_CAN_DET_CONFID_AZIMUTH_105 3 "Low" 2 "Medium_Low" 1 "Medium_High" 0 "High" ;
VAL_ 88 LRRF1_CAN_DET_CONFID_AZIMUTH_104 3 "Low" 2 "Medium_Low" 1 "Medium_High" 0 "High" ;
VAL_ 88 LRRF1_CAN_DET_CONFID_AZIMUTH_103 3 "Low" 2 "Medium_Low" 1 "Medium_High" 0 "High" ;
VAL_ 88 LRRF1_CAN_DET_CONFID_AZIMUTH_102 3 "Low" 2 "Medium_Low" 1 "Medium_High" 0 "High" ;
VAL_ 88 LRRF1_CAN_DET_CONFID_AZIMUTH_101 3 "Low" 2 "Medium_Low" 1 "Medium_High" 0 "High" ;
VAL_ 88 LRRF1_CAN_DET_CONFID_AZIMUTH_100 3 "Low" 2 "Medium_Low" 1 "Medium_High" 0 "High" ;
VAL_ 87 LRRF1_CAN_DET_CONFID_AZIMUTH_92 3 "Low" 2 "Medium_Low" 1 "Medium_High" 0 "High" ;
VAL_ 87 LRRF1_CAN_DET_CONFID_AZIMUTH_98 3 "Low" 2 "Medium_Low" 1 "Medium_High" 0 "High" ;
VAL_ 87 LRRF1_CAN_DET_CONFID_AZIMUTH_97 3 "Low" 2 "Medium_Low" 1 "Medium_High" 0 "High" ;
VAL_ 87 LRRF1_CAN_DET_CONFID_AZIMUTH_96 3 "Low" 2 "Medium_Low" 1 "Medium_High" 0 "High" ;
VAL_ 87 LRRF1_CAN_DET_CONFID_AZIMUTH_95 3 "Low" 2 "Medium_Low" 1 "Medium_High" 0 "High" ;
VAL_ 87 LRRF1_CAN_DET_CONFID_AZIMUTH_94 3 "Low" 2 "Medium_Low" 1 "Medium_High" 0 "High" ;
VAL_ 87 LRRF1_CAN_DET_CONFID_AZIMUTH_93 3 "Low" 2 "Medium_Low" 1 "Medium_High" 0 "High" ;
VAL_ 86 LRRF1_CAN_DET_CONFID_AZIMUTH_85 3 "Low" 2 "Medium_Low" 1 "Medium_High" 0 "High" ;
VAL_ 86 LRRF1_CAN_DET_CONFID_AZIMUTH_91 3 "Low" 2 "Medium_Low" 1 "Medium_High" 0 "High" ;
VAL_ 86 LRRF1_CAN_DET_CONFID_AZIMUTH_90 3 "Low" 2 "Medium_Low" 1 "Medium_High" 0 "High" ;
VAL_ 86 LRRF1_CAN_DET_CONFID_AZIMUTH_89 3 "Low" 2 "Medium_Low" 1 "Medium_High" 0 "High" ;
VAL_ 86 LRRF1_CAN_DET_CONFID_AZIMUTH_88 3 "Low" 2 "Medium_Low" 1 "Medium_High" 0 "High" ;
VAL_ 86 LRRF1_CAN_DET_CONFID_AZIMUTH_87 3 "Low" 2 "Medium_Low" 1 "Medium_High" 0 "High" ;
VAL_ 86 LRRF1_CAN_DET_CONFID_AZIMUTH_86 3 "Low" 2 "Medium_Low" 1 "Medium_High" 0 "High" ;
VAL_ 85 LRRF1_CAN_DET_CONFID_AZIMUTH_78 3 "Low" 2 "Medium_Low" 1 "Medium_High" 0 "High" ;
VAL_ 85 LRRF1_CAN_DET_CONFID_AZIMUTH_84 3 "Low" 2 "Medium_Low" 1 "Medium_High" 0 "High" ;
VAL_ 85 LRRF1_CAN_DET_CONFID_AZIMUTH_83 3 "Low" 2 "Medium_Low" 1 "Medium_High" 0 "High" ;
VAL_ 85 LRRF1_CAN_DET_CONFID_AZIMUTH_82 3 "Low" 2 "Medium_Low" 1 "Medium_High" 0 "High" ;
VAL_ 85 LRRF1_CAN_DET_CONFID_AZIMUTH_81 3 "Low" 2 "Medium_Low" 1 "Medium_High" 0 "High" ;
VAL_ 85 LRRF1_CAN_DET_CONFID_AZIMUTH_80 3 "Low" 2 "Medium_Low" 1 "Medium_High" 0 "High" ;
VAL_ 85 LRRF1_CAN_DET_CONFID_AZIMUTH_79 3 "Low" 2 "Medium_Low" 1 "Medium_High" 0 "High" ;
SIG_GROUP_ 91 LRRF1_Detection_120_126 1 : LRRF1_CAN_DET_Near_TARGET_126 LRRF1_CAN_DET_Near_TARGET_125 LRRF1_CAN_DET_Near_TARGET_124 LRRF1_CAN_DET_Near_TARGET_123 LRRF1_CAN_DET_Near_TARGET_122 LRRF1_CAN_DET_Near_TARGET_121 LRRF1_CAN_DET_Near_TARGET_120 LRRF1_Det_CRC_18 LRRF1_CAN_DET_VALID_LEVEL_123 LRRF1_CAN_DET_VALID_LEVEL_122 LRRF1_CAN_DET_VALID_LEVEL_121 LRRF1_CAN_DET_RANGE_123 LRRF1_CAN_DET_AMPLITUDE_120 LRRF1_CAN_DET_ELEVATION_120 LRRF1_CAN_DET_AZIMUTH_120 LRRF1_CAN_DET_VALID_LEVEL_120 LRRF1_CAN_SCAN_INDEX_2LSB_124 LRRF1_CAN_DET_VALID_LEVEL_124 LRRF1_CAN_DET_VALID_LEVEL_126 LRRF1_CAN_DET_RANGE_122 LRRF1_CAN_DET_RANGE_121 LRRF1_CAN_DET_AMPLITUDE_121 LRRF1_CAN_DET_AMPLITUDE_122 LRRF1_CAN_DET_SUPER_RES_TAR_0011 LRRF1_CAN_DET_SUPER_RES_TAR_0013 LRRF1_CAN_DET_HOST_VEH_CLUT_0011 LRRF1_CAN_DET_HOST_VEH_CLUT_0012 LRRF1_CAN_DET_ELEVATION_125 LRRF1_CAN_DET_ELEVATION_126 LRRF1_CAN_DET_AMPLITUDE_125 LRRF1_CAN_DET_ELEVATION_123 LRRF1_CAN_DET_AMPLITUDE_123 LRRF1_CAN_DET_ELEVATION_122 LRRF1_CAN_DET_CONFID_ELEVAT_0009 LRRF1_CAN_DET_AZIMUTH_122 LRRF1_CAN_DET_CONFID_ELEVAT_0008 LRRF1_CAN_DET_AZIMUTH_121 LRRF1_CAN_DET_CONFID_AZIMUTH_122 LRRF1_CAN_DET_AZIMUTH_125 LRRF1_CAN_DET_AZIMUTH_124 LRRF1_CAN_DET_AZIMUTH_123 LRRF1_CAN_DET_CONFID_AZIMUTH_121 LRRF1_CAN_DET_VALID_LEVEL_125 LRRF1_CAN_DET_CONFID_AZIMUTH_123 LRRF1_CAN_DET_CONFID_AZIMUTH_125 LRRF1_CAN_DET_CONFID_ELEVAT_0011 LRRF1_CAN_DET_CONFID_ELEVAT_0013 LRRF1_CAN_DET_CONFID_AZIMUTH_124 LRRF1_CAN_DET_CONFID_ELEVAT_0012 LRRF1_CAN_DET_AMPLITUDE_124 LRRF1_CAN_DET_ELEVATION_124 LRRF1_CAN_DET_AZIMUTH_126 LRRF1_CAN_DET_HOST_VEH_CLUT_0013 LRRF1_CAN_DET_HOST_VEH_CLUT_0010 LRRF1_CAN_DET_HOST_VEH_CLUT_0008 LRRF1_CAN_DET_AMPLITUDE_126 LRRF1_CAN_SCAN_INDEX_2LSB_125 LRRF1_CAN_DET_RANGE_RATE_125 LRRF1_CAN_DET_RANGE_124 LRRF1_CAN_DET_HOST_VEH_CLUT_0009 LRRF1_CAN_DET_CONFID_AZIMUTH_126 LRRF1_CAN_DET_SUPER_RES_TAR_0012 LRRF1_CAN_DET_CONFID_ELEVAT_0010 LRRF1_CAN_DET_SUPER_RES_TAR_0010 LRRF1_CAN_DET_SUPER_RES_TAR_0008 LRRF1_CAN_DET_SUPER_RES_TAR_0009 LRRF1_CAN_DET_ELEVATION_121 LRRF1_CAN_DET_CONFID_AZIMUTH_120 LRRF1_CAN_DET_SUPER_RES_TAR_0007 LRRF1_CAN_DET_HOST_VEH_CLUT_0007 LRRF1_CAN_DET_CONFID_ELEVAT_0007 LRRF1_CAN_DET_RANGE_120 LRRF1_CAN_SCAN_INDEX_2LSB_120 LRRF1_CAN_DET_RANGE_RATE_120 LRRF1_Det_MC_18 LRRF1_CAN_SCAN_INDEX_2LSB_126 LRRF1_CAN_DET_RANGE_RATE_121 LRRF1_CAN_SCAN_INDEX_2LSB_123 LRRF1_CAN_SCAN_INDEX_2LSB_121 LRRF1_CAN_SCAN_INDEX_2LSB_122 LRRF1_CAN_DET_RANGE_RATE_126 LRRF1_CAN_DET_RANGE_RATE_124 LRRF1_CAN_DET_RANGE_125 LRRF1_CAN_DET_RANGE_RATE_123 LRRF1_CAN_DET_RANGE_RATE_122 LRRF1_CAN_DET_RANGE_126;
SIG_GROUP_ 90 LRRF1_Detection_113_119 1 : LRRF1_CAN_DET_Near_TARGET_119 LRRF1_CAN_DET_Near_TARGET_118 LRRF1_CAN_DET_Near_TARGET_117 LRRF1_CAN_DET_Near_TARGET_116 LRRF1_CAN_DET_Near_TARGET_115 LRRF1_CAN_DET_Near_TARGET_114 LRRF1_CAN_DET_Near_TARGET_113 LRRF1_CAN_DET_ELEVATION_113 LRRF1_CAN_DET_CONFID_AZIMUTH_113 LRRF1_CAN_DET_VALID_LEVEL_114 LRRF1_CAN_DET_AZIMUTH_113 LRRF1_CAN_DET_VALID_LEVEL_115 LRRF1_CAN_DET_SUPER_RES_TAR_0014 LRRF1_CAN_DET_VALID_LEVEL_116 LRRF1_CAN_DET_VALID_LEVEL_117 LRRF1_CAN_DET_VALID_LEVEL_113 LRRF1_CAN_DET_AMPLITUDE_113 LRRF1_CAN_DET_RANGE_113 LRRF1_CAN_DET_RANGE_RATE_119 LRRF1_CAN_DET_VALID_LEVEL_119 LRRF1_CAN_DET_RANGE_RATE_113 LRRF1_Det_MC_17 LRRF1_Det_CRC_17 LRRF1_CAN_SCAN_INDEX_2LSB_113 LRRF1_CAN_SCAN_INDEX_2LSB_115 LRRF1_CAN_SCAN_INDEX_2LSB_117 LRRF1_CAN_DET_VALID_LEVEL_118 LRRF1_CAN_DET_HOST_VEH_CLUT_0018 LRRF1_CAN_DET_AZIMUTH_116 LRRF1_CAN_DET_AMPLITUDE_115 LRRF1_CAN_DET_AMPLITUDE_117 LRRF1_CAN_DET_AMPLITUDE_118 LRRF1_CAN_DET_AMPLITUDE_119 LRRF1_CAN_DET_AZIMUTH_119 LRRF1_CAN_DET_AZIMUTH_118 LRRF1_CAN_DET_AZIMUTH_117 LRRF1_CAN_DET_AZIMUTH_115 LRRF1_CAN_DET_AMPLITUDE_114 LRRF1_CAN_DET_CONFID_ELEVAT_0016 LRRF1_CAN_DET_ELEVATION_119 LRRF1_CAN_DET_HOST_VEH_CLUT_0017 LRRF1_CAN_DET_CONFID_AZIMUTH_119 LRRF1_CAN_DET_CONFID_AZIMUTH_115 LRRF1_CAN_DET_ELEVATION_118 LRRF1_CAN_DET_ELEVATION_115 LRRF1_CAN_DET_CONFID_AZIMUTH_116 LRRF1_CAN_DET_ELEVATION_117 LRRF1_CAN_DET_ELEVATION_114 LRRF1_CAN_DET_HOST_VEH_CLUT_0019 LRRF1_CAN_DET_AZIMUTH_114 LRRF1_CAN_DET_CONFID_ELEVAT_0014 LRRF1_CAN_DET_CONFID_ELEVAT_0017 LRRF1_CAN_DET_CONFID_AZIMUTH_114 LRRF1_CAN_DET_ELEVATION_116 LRRF1_CAN_DET_HOST_VEH_CLUT_0014 LRRF1_CAN_DET_CONFID_AZIMUTH_118 LRRF1_CAN_DET_HOST_VEH_CLUT_0016 LRRF1_CAN_DET_SUPER_RES_TAR_0017 LRRF1_CAN_DET_CONFID_ELEVAT_0020 LRRF1_CAN_DET_SUPER_RES_TAR_0020 LRRF1_CAN_DET_SUPER_RES_TAR_0019 LRRF1_CAN_DET_AMPLITUDE_116 LRRF1_CAN_DET_SUPER_RES_TAR_0018 LRRF1_CAN_DET_CONFID_AZIMUTH_117 LRRF1_CAN_DET_HOST_VEH_CLUT_0015 LRRF1_CAN_DET_CONFID_ELEVAT_0018 LRRF1_CAN_SCAN_INDEX_2LSB_116 LRRF1_CAN_DET_CONFID_ELEVAT_0019 LRRF1_CAN_SCAN_INDEX_2LSB_119 LRRF1_CAN_SCAN_INDEX_2LSB_118 LRRF1_CAN_SCAN_INDEX_2LSB_114 LRRF1_CAN_DET_SUPER_RES_TAR_0016 LRRF1_CAN_DET_RANGE_RATE_117 LRRF1_CAN_DET_SUPER_RES_TAR_0015 LRRF1_CAN_DET_RANGE_RATE_115 LRRF1_CAN_DET_RANGE_RATE_116 LRRF1_CAN_DET_RANGE_RATE_118 LRRF1_CAN_DET_HOST_VEH_CLUT_0020 LRRF1_CAN_DET_RANGE_114 LRRF1_CAN_DET_RANGE_115 LRRF1_CAN_DET_RANGE_117 LRRF1_CAN_DET_RANGE_119 LRRF1_CAN_DET_RANGE_118 LRRF1_CAN_DET_RANGE_116 LRRF1_CAN_DET_RANGE_RATE_114 LRRF1_CAN_DET_CONFID_ELEVAT_0015;
SIG_GROUP_ 89 LRRF1_Detection_106_112 1 : LRRF1_CAN_DET_Near_TARGET_112 LRRF1_CAN_DET_Near_TARGET_111 LRRF1_CAN_DET_Near_TARGET_110 LRRF1_CAN_DET_Near_TARGET_109 LRRF1_CAN_DET_Near_TARGET_108 LRRF1_CAN_DET_Near_TARGET_107 LRRF1_CAN_DET_Near_TARGET_106 LRRF1_CAN_DET_ELEVATION_106 LRRF1_CAN_DET_VALID_LEVEL_107 LRRF1_CAN_DET_CONFID_AZIMUTH_106 LRRF1_CAN_DET_VALID_LEVEL_111 LRRF1_CAN_DET_SUPER_RES_TAR_0021 LRRF1_CAN_DET_CONFID_ELEVAT_0021 LRRF1_CAN_DET_HOST_VEH_CLUT_0021 LRRF1_CAN_DET_AMPLITUDE_111 LRRF1_CAN_DET_VALID_LEVEL_108 LRRF1_CAN_DET_AMPLITUDE_108 LRRF1_CAN_DET_VALID_LEVEL_110 LRRF1_CAN_DET_VALID_LEVEL_106 LRRF1_CAN_DET_AZIMUTH_107 LRRF1_CAN_DET_VALID_LEVEL_112 LRRF1_CAN_DET_AMPLITUDE_110 LRRF1_CAN_DET_AZIMUTH_106 LRRF1_CAN_DET_RANGE_106 LRRF1_CAN_DET_RANGE_RATE_106 LRRF1_CAN_DET_RANGE_108 LRRF1_CAN_DET_AZIMUTH_109 LRRF1_CAN_SCAN_INDEX_2LSB_109 LRRF1_CAN_DET_AZIMUTH_110 LRRF1_CAN_SCAN_INDEX_2LSB_110 LRRF1_CAN_DET_RANGE_110 LRRF1_CAN_DET_RANGE_112 LRRF1_CAN_DET_RANGE_107 LRRF1_CAN_DET_RANGE_RATE_111 LRRF1_CAN_DET_RANGE_109 LRRF1_CAN_DET_VALID_LEVEL_109 LRRF1_CAN_DET_AZIMUTH_112 LRRF1_CAN_DET_HOST_VEH_CLUT_0026 LRRF1_CAN_DET_CONFID_AZIMUTH_111 LRRF1_CAN_DET_SUPER_RES_TAR_0024 LRRF1_CAN_DET_ELEVATION_109 LRRF1_CAN_DET_ELEVATION_107 LRRF1_CAN_DET_RANGE_RATE_107 LRRF1_Det_CRC_16 LRRF1_Det_MC_16 LRRF1_CAN_DET_AMPLITUDE_106 LRRF1_CAN_SCAN_INDEX_2LSB_112 LRRF1_CAN_SCAN_INDEX_2LSB_106 LRRF1_CAN_DET_RANGE_111 LRRF1_CAN_DET_AMPLITUDE_109 LRRF1_CAN_DET_CONFID_AZIMUTH_107 LRRF1_CAN_DET_HOST_VEH_CLUT_0027 LRRF1_CAN_DET_AZIMUTH_111 LRRF1_CAN_DET_CONFID_AZIMUTH_108 LRRF1_CAN_DET_CONFID_ELEVAT_0027 LRRF1_CAN_DET_CONFID_ELEVAT_0022 LRRF1_CAN_DET_AMPLITUDE_112 LRRF1_CAN_DET_AMPLITUDE_107 LRRF1_CAN_DET_CONFID_AZIMUTH_109 LRRF1_CAN_DET_CONFID_AZIMUTH_112 LRRF1_CAN_DET_CONFID_AZIMUTH_110 LRRF1_CAN_DET_CONFID_ELEVAT_0026 LRRF1_CAN_DET_SUPER_RES_TAR_0023 LRRF1_CAN_DET_CONFID_ELEVAT_0025 LRRF1_CAN_SCAN_INDEX_2LSB_111 LRRF1_CAN_DET_AZIMUTH_108 LRRF1_CAN_DET_CONFID_ELEVAT_0023 LRRF1_CAN_DET_ELEVATION_110 LRRF1_CAN_DET_SUPER_RES_TAR_0026 LRRF1_CAN_DET_ELEVATION_111 LRRF1_CAN_DET_ELEVATION_108 LRRF1_CAN_DET_CONFID_ELEVAT_0024 LRRF1_CAN_DET_SUPER_RES_TAR_0027 LRRF1_CAN_SCAN_INDEX_2LSB_107 LRRF1_CAN_DET_HOST_VEH_CLUT_0023 LRRF1_CAN_DET_RANGE_RATE_112 LRRF1_CAN_SCAN_INDEX_2LSB_108 LRRF1_CAN_DET_HOST_VEH_CLUT_0024 LRRF1_CAN_DET_HOST_VEH_CLUT_0025 LRRF1_CAN_DET_SUPER_RES_TAR_0025 LRRF1_CAN_DET_RANGE_RATE_110 LRRF1_CAN_DET_ELEVATION_112 LRRF1_CAN_DET_RANGE_RATE_109 LRRF1_CAN_DET_RANGE_RATE_108 LRRF1_CAN_DET_HOST_VEH_CLUT_0022 LRRF1_CAN_DET_SUPER_RES_TAR_0022;
SIG_GROUP_ 88 LRRF1_Detection_099_105 1 : LRRF1_CAN_DET_Near_TARGET_105 LRRF1_CAN_DET_Near_TARGET_104 LRRF1_CAN_DET_Near_TARGET_103 LRRF1_CAN_DET_Near_TARGET_102 LRRF1_CAN_DET_Near_TARGET_101 LRRF1_CAN_DET_Near_TARGET_100 LRRF1_CAN_DET_Near_TARGET_99 LRRF1_CAN_DET_VALID_LEVEL_105 LRRF1_CAN_DET_ELEVATION_99 LRRF1_CAN_SCAN_INDEX_2LSB_99 LRRF1_CAN_DET_RANGE_RATE_100 LRRF1_CAN_DET_CONFID_AZIMUTH_99 LRRF1_CAN_DET_RANGE_RATE_99 LRRF1_CAN_DET_SUPER_RES_TARGET_9 LRRF1_CAN_DET_AZIMUTH_99 LRRF1_CAN_DET_RANGE_99 LRRF1_CAN_DET_CONFID_ELEVATION_9 LRRF1_CAN_DET_VALID_LEVEL_99 LRRF1_CAN_DET_VALID_LEVEL_100 LRRF1_CAN_DET_AZIMUTH_105 LRRF1_CAN_DET_AZIMUTH_101 LRRF1_CAN_DET_AMPLITUDE_104 LRRF1_CAN_DET_VALID_LEVEL_101 LRRF1_CAN_DET_VALID_LEVEL_102 LRRF1_CAN_DET_VALID_LEVEL_104 LRRF1_CAN_DET_RANGE_RATE_101 LRRF1_CAN_DET_AMPLITUDE_99 LRRF1_CAN_DET_RANGE_RATE_104 LRRF1_CAN_DET_VALID_LEVEL_103 LRRF1_CAN_DET_AMPLITUDE_103 LRRF1_CAN_DET_ELEVATION_102 LRRF1_CAN_DET_ELEVATION_100 LRRF1_Det_MC_15 LRRF1_Det_CRC_15 LRRF1_CAN_DET_RANGE_100 LRRF1_CAN_DET_CONFID_ELEVAT_0028 LRRF1_CAN_DET_CONFID_ELEVAT_0033 LRRF1_CAN_DET_CONFID_AZIMUTH_103 LRRF1_CAN_DET_HOST_VEH_CLUTTER_9 LRRF1_CAN_DET_SUPER_RES_TAR_0029 LRRF1_CAN_DET_RANGE_102 LRRF1_CAN_DET_AMPLITUDE_100 LRRF1_CAN_DET_ELEVATION_104 LRRF1_CAN_DET_AZIMUTH_100 LRRF1_CAN_DET_ELEVATION_101 LRRF1_CAN_DET_AZIMUTH_104 LRRF1_CAN_DET_HOST_VEH_CLUT_0031 LRRF1_CAN_DET_SUPER_RES_TAR_0028 LRRF1_CAN_DET_CONFID_AZIMUTH_105 LRRF1_CAN_DET_RANGE_101 LRRF1_CAN_DET_RANGE_104 LRRF1_CAN_DET_CONFID_ELEVAT_0032 LRRF1_CAN_SCAN_INDEX_2LSB_102 LRRF1_CAN_SCAN_INDEX_2LSB_100 LRRF1_CAN_DET_AMPLITUDE_101 LRRF1_CAN_DET_RANGE_103 LRRF1_CAN_DET_CONFID_ELEVAT_0030 LRRF1_CAN_SCAN_INDEX_2LSB_105 LRRF1_CAN_DET_RANGE_RATE_102 LRRF1_CAN_DET_RANGE_105 LRRF1_CAN_DET_AZIMUTH_102 LRRF1_CAN_DET_ELEVATION_103 LRRF1_CAN_DET_ELEVATION_105 LRRF1_CAN_DET_HOST_VEH_CLUT_0033 LRRF1_CAN_DET_SUPER_RES_TAR_0030 LRRF1_CAN_DET_AMPLITUDE_102 LRRF1_CAN_DET_HOST_VEH_CLUT_0032 LRRF1_CAN_DET_SUPER_RES_TAR_0031 LRRF1_CAN_DET_CONFID_AZIMUTH_104 LRRF1_CAN_DET_SUPER_RES_TAR_0032 LRRF1_CAN_SCAN_INDEX_2LSB_104 LRRF1_CAN_DET_AMPLITUDE_105 LRRF1_CAN_DET_CONFID_ELEVAT_0029 LRRF1_CAN_SCAN_INDEX_2LSB_101 LRRF1_CAN_DET_CONFID_AZIMUTH_101 LRRF1_CAN_SCAN_INDEX_2LSB_103 LRRF1_CAN_DET_AZIMUTH_103 LRRF1_CAN_DET_CONFID_ELEVAT_0031 LRRF1_CAN_DET_HOST_VEH_CLUT_0028 LRRF1_CAN_DET_CONFID_AZIMUTH_100 LRRF1_CAN_DET_CONFID_AZIMUTH_102 LRRF1_CAN_DET_HOST_VEH_CLUT_0029 LRRF1_CAN_DET_RANGE_RATE_103 LRRF1_CAN_DET_SUPER_RES_TAR_0033 LRRF1_CAN_DET_RANGE_RATE_105 LRRF1_CAN_DET_HOST_VEH_CLUT_0030;
SIG_GROUP_ 87 LRRF1_Detection_092_098 1 : LRRF1_CAN_DET_Near_TARGET_98 LRRF1_CAN_DET_Near_TARGET_97 LRRF1_CAN_DET_Near_TARGET_96 LRRF1_CAN_DET_Near_TARGET_95 LRRF1_CAN_DET_Near_TARGET_94 LRRF1_CAN_DET_Near_TARGET_93 LRRF1_CAN_DET_Near_TARGET_92 LRRF1_CAN_DET_ELEVATION_92 LRRF1_CAN_DET_RANGE_97 LRRF1_CAN_DET_CONFID_AZIMUTH_92 LRRF1_CAN_DET_SUPER_RES_TAR_0034 LRRF1_CAN_DET_AZIMUTH_93 LRRF1_CAN_DET_AZIMUTH_95 LRRF1_CAN_DET_AZIMUTH_92 LRRF1_CAN_DET_VALID_LEVEL_98 LRRF1_CAN_DET_AZIMUTH_98 LRRF1_CAN_DET_HOST_VEH_CLUT_0034 LRRF1_CAN_DET_AZIMUTH_94 LRRF1_CAN_DET_RANGE_95 LRRF1_CAN_DET_RANGE_92 LRRF1_CAN_DET_VALID_LEVEL_92 LRRF1_CAN_DET_RANGE_93 LRRF1_CAN_DET_AZIMUTH_96 LRRF1_CAN_DET_VALID_LEVEL_93 LRRF1_CAN_DET_VALID_LEVEL_95 LRRF1_CAN_DET_VALID_LEVEL_94 LRRF1_CAN_DET_VALID_LEVEL_96 LRRF1_CAN_DET_AMPLITUDE_98 LRRF1_CAN_DET_CONFID_ELEVAT_0034 LRRF1_CAN_DET_ELEVATION_94 LRRF1_CAN_DET_RANGE_RATE_92 LRRF1_CAN_SCAN_INDEX_2LSB_92 LRRF1_CAN_DET_AMPLITUDE_92 LRRF1_Det_CRC_14 LRRF1_Det_MC_14 LRRF1_CAN_DET_SUPER_RES_TAR_0035 LRRF1_CAN_DET_SUPER_RES_TAR_0036 LRRF1_CAN_DET_SUPER_RES_TAR_0037 LRRF1_CAN_DET_VALID_LEVEL_97 LRRF1_CAN_DET_ELEVATION_93 LRRF1_CAN_DET_AMPLITUDE_93 LRRF1_CAN_DET_AZIMUTH_97 LRRF1_CAN_DET_AMPLITUDE_97 LRRF1_CAN_DET_CONFID_ELEVAT_0037 LRRF1_CAN_DET_AMPLITUDE_94 LRRF1_CAN_DET_CONFID_AZIMUTH_94 LRRF1_CAN_DET_ELEVATION_98 LRRF1_CAN_DET_AMPLITUDE_95 LRRF1_CAN_DET_SUPER_RES_TAR_0040 LRRF1_CAN_DET_CONFID_AZIMUTH_93 LRRF1_CAN_DET_RANGE_94 LRRF1_CAN_DET_SUPER_RES_TAR_0039 LRRF1_CAN_DET_CONFID_ELEVAT_0035 LRRF1_CAN_DET_CONFID_AZIMUTH_95 LRRF1_CAN_DET_CONFID_AZIMUTH_97 LRRF1_CAN_DET_CONFID_AZIMUTH_96 LRRF1_CAN_DET_CONFID_ELEVAT_0038 LRRF1_CAN_DET_CONFID_ELEVAT_0040 LRRF1_CAN_DET_ELEVATION_97 LRRF1_CAN_DET_CONFID_ELEVAT_0036 LRRF1_CAN_DET_RANGE_98 LRRF1_CAN_DET_SUPER_RES_TAR_0038 LRRF1_CAN_DET_HOST_VEH_CLUT_0039 LRRF1_CAN_SCAN_INDEX_2LSB_98 LRRF1_CAN_DET_ELEVATION_95 LRRF1_CAN_DET_RANGE_RATE_97 LRRF1_CAN_DET_ELEVATION_96 LRRF1_CAN_DET_HOST_VEH_CLUT_0040 LRRF1_CAN_DET_RANGE_RATE_94 LRRF1_CAN_DET_HOST_VEH_CLUT_0038 LRRF1_CAN_DET_RANGE_96 LRRF1_CAN_DET_HOST_VEH_CLUT_0035 LRRF1_CAN_SCAN_INDEX_2LSB_93 LRRF1_CAN_DET_RANGE_RATE_98 LRRF1_CAN_SCAN_INDEX_2LSB_96 LRRF1_CAN_SCAN_INDEX_2LSB_95 LRRF1_CAN_SCAN_INDEX_2LSB_97 LRRF1_CAN_DET_AMPLITUDE_96 LRRF1_CAN_DET_HOST_VEH_CLUT_0037 LRRF1_CAN_DET_HOST_VEH_CLUT_0036 LRRF1_CAN_DET_CONFID_AZIMUTH_98 LRRF1_CAN_DET_RANGE_RATE_93 LRRF1_CAN_DET_CONFID_ELEVAT_0039 LRRF1_CAN_DET_RANGE_RATE_95 LRRF1_CAN_DET_RANGE_RATE_96 LRRF1_CAN_SCAN_INDEX_2LSB_94;
SIG_GROUP_ 86 LRRF1_Detection_085_091 1 : LRRF1_CAN_DET_Near_TARGET_91 LRRF1_CAN_DET_Near_TARGET_90 LRRF1_CAN_DET_Near_TARGET_89 LRRF1_CAN_DET_Near_TARGET_88 LRRF1_CAN_DET_Near_TARGET_87 LRRF1_CAN_DET_Near_TARGET_86 LRRF1_CAN_DET_Near_TARGET_85 LRRF1_CAN_DET_ELEVATION_85 LRRF1_CAN_DET_AZIMUTH_90 LRRF1_CAN_DET_VALID_LEVEL_85 LRRF1_CAN_DET_AMPLITUDE_85 LRRF1_CAN_DET_VALID_LEVEL_91 LRRF1_CAN_DET_VALID_LEVEL_88 LRRF1_CAN_DET_AMPLITUDE_86 LRRF1_CAN_DET_VALID_LEVEL_89 LRRF1_CAN_DET_AMPLITUDE_87 LRRF1_CAN_DET_VALID_LEVEL_90 LRRF1_CAN_DET_CONFID_AZIMUTH_85 LRRF1_CAN_DET_SUPER_RES_TARGET_8 LRRF1_CAN_DET_CONFID_ELEVATION_8 LRRF1_CAN_DET_HOST_VEH_CLUTTER_8 LRRF1_CAN_DET_AZIMUTH_85 LRRF1_CAN_DET_RANGE_85 LRRF1_CAN_DET_RANGE_RATE_85 LRRF1_CAN_DET_AMPLITUDE_89 LRRF1_CAN_DET_VALID_LEVEL_87 LRRF1_CAN_DET_VALID_LEVEL_86 LRRF1_CAN_DET_AMPLITUDE_90 LRRF1_CAN_DET_AMPLITUDE_88 LRRF1_CAN_DET_SUPER_RES_TAR_0042 LRRF1_CAN_DET_SUPER_RES_TAR_0043 LRRF1_CAN_DET_SUPER_RES_TAR_0044 LRRF1_CAN_DET_ELEVATION_91 LRRF1_CAN_DET_CONFID_ELEVAT_0043 LRRF1_CAN_DET_CONFID_ELEVAT_0045 LRRF1_CAN_DET_AZIMUTH_91 LRRF1_CAN_DET_HOST_VEH_CLUT_0041 LRRF1_CAN_DET_AZIMUTH_86 LRRF1_CAN_DET_AZIMUTH_88 LRRF1_CAN_DET_AZIMUTH_89 LRRF1_CAN_DET_AMPLITUDE_91 LRRF1_CAN_DET_CONFID_AZIMUTH_88 LRRF1_CAN_DET_ELEVATION_86 LRRF1_CAN_DET_CONFID_AZIMUTH_87 LRRF1_CAN_DET_CONFID_AZIMUTH_89 LRRF1_CAN_DET_CONFID_AZIMUTH_90 LRRF1_CAN_DET_ELEVATION_87 LRRF1_CAN_DET_CONFID_AZIMUTH_86 LRRF1_Det_CRC_13 LRRF1_Det_MC_13 LRRF1_CAN_DET_RANGE_87 LRRF1_CAN_DET_SUPER_RES_TAR_0041 LRRF1_CAN_DET_RANGE_86 LRRF1_CAN_DET_CONFID_AZIMUTH_91 LRRF1_CAN_DET_RANGE_88 LRRF1_CAN_DET_SUPER_RES_TAR_0046 LRRF1_CAN_DET_AZIMUTH_87 LRRF1_CAN_SCAN_INDEX_2LSB_85 LRRF1_CAN_DET_ELEVATION_90 LRRF1_CAN_DET_RANGE_89 LRRF1_CAN_DET_CONFID_ELEVAT_0042 LRRF1_CAN_DET_ELEVATION_88 LRRF1_CAN_DET_CONFID_ELEVAT_0041 LRRF1_CAN_DET_RANGE_90 LRRF1_CAN_DET_HOST_VEH_CLUT_0046 LRRF1_CAN_DET_HOST_VEH_CLUT_0042 LRRF1_CAN_DET_RANGE_91 LRRF1_CAN_DET_CONFID_ELEVAT_0044 LRRF1_CAN_SCAN_INDEX_2LSB_91 LRRF1_CAN_SCAN_INDEX_2LSB_90 LRRF1_CAN_DET_CONFID_ELEVAT_0046 LRRF1_CAN_DET_HOST_VEH_CLUT_0043 LRRF1_CAN_DET_ELEVATION_89 LRRF1_CAN_DET_RANGE_RATE_87 LRRF1_CAN_SCAN_INDEX_2LSB_89 LRRF1_CAN_DET_HOST_VEH_CLUT_0044 LRRF1_CAN_SCAN_INDEX_2LSB_88 LRRF1_CAN_DET_HOST_VEH_CLUT_0045 LRRF1_CAN_DET_SUPER_RES_TAR_0045 LRRF1_CAN_DET_RANGE_RATE_88 LRRF1_CAN_DET_RANGE_RATE_89 LRRF1_CAN_DET_RANGE_RATE_90 LRRF1_CAN_DET_RANGE_RATE_91 LRRF1_CAN_SCAN_INDEX_2LSB_87 LRRF1_CAN_SCAN_INDEX_2LSB_86 LRRF1_CAN_DET_RANGE_RATE_86;
SIG_GROUP_ 85 LRRF1_Detection_078_084 1 : LRRF1_CAN_DET_Near_TARGET_84 LRRF1_CAN_DET_Near_TARGET_83 LRRF1_CAN_DET_Near_TARGET_82 LRRF1_CAN_DET_Near_TARGET_81 LRRF1_CAN_DET_Near_TARGET_80 LRRF1_CAN_DET_Near_TARGET_79 LRRF1_CAN_DET_Near_TARGET_78 LRRF1_CAN_DET_ELEVATION_78 LRRF1_CAN_DET_VALID_LEVEL_79 LRRF1_CAN_DET_CONFID_AZIMUTH_78 LRRF1_CAN_DET_VALID_LEVEL_80 LRRF1_CAN_DET_AMPLITUDE_78 LRRF1_CAN_DET_HOST_VEH_CLUTTER_7 LRRF1_CAN_DET_SUPER_RES_TARGET_7 LRRF1_CAN_DET_CONFID_ELEVATION_7 LRRF1_CAN_DET_VALID_LEVEL_78 LRRF1_CAN_DET_VALID_LEVEL_81 LRRF1_CAN_DET_AZIMUTH_78 LRRF1_CAN_DET_VALID_LEVEL_83 LRRF1_CAN_DET_RANGE_78 LRRF1_CAN_DET_AMPLITUDE_80 LRRF1_CAN_SCAN_INDEX_2LSB_78 LRRF1_CAN_DET_RANGE_RATE_78 LRRF1_CAN_DET_RANGE_81 LRRF1_CAN_DET_VALID_LEVEL_82 LRRF1_CAN_DET_AMPLITUDE_79 LRRF1_Det_CRC_12 LRRF1_CAN_SCAN_INDEX_2LSB_82 LRRF1_CAN_DET_RANGE_RATE_83 LRRF1_CAN_DET_AMPLITUDE_82 LRRF1_CAN_DET_AZIMUTH_80 LRRF1_CAN_DET_AZIMUTH_82 LRRF1_CAN_DET_RANGE_82 LRRF1_Det_MC_12 LRRF1_CAN_DET_SUPER_RES_TAR_0051 LRRF1_CAN_DET_ELEVATION_81 LRRF1_CAN_DET_AMPLITUDE_84 LRRF1_CAN_DET_AMPLITUDE_83 LRRF1_CAN_DET_CONFID_ELEVAT_0049 LRRF1_CAN_DET_AZIMUTH_81 LRRF1_CAN_DET_VALID_LEVEL_84 LRRF1_CAN_DET_AZIMUTH_79 LRRF1_CAN_DET_CONFID_AZIMUTH_80 LRRF1_CAN_DET_AMPLITUDE_81 LRRF1_CAN_DET_AZIMUTH_84 LRRF1_CAN_DET_AZIMUTH_83 LRRF1_CAN_DET_CONFID_AZIMUTH_84 LRRF1_CAN_DET_RANGE_RATE_81 LRRF1_CAN_DET_SUPER_RES_TAR_0049 LRRF1_CAN_DET_RANGE_79 LRRF1_CAN_DET_SUPER_RES_TAR_0047 LRRF1_CAN_DET_RANGE_80 LRRF1_CAN_DET_CONFID_AZIMUTH_79 LRRF1_CAN_DET_SUPER_RES_TAR_0048 LRRF1_CAN_DET_ELEVATION_79 LRRF1_CAN_DET_HOST_VEH_CLUT_0052 LRRF1_CAN_SCAN_INDEX_2LSB_84 LRRF1_CAN_DET_CONFID_ELEVAT_0050 LRRF1_CAN_DET_ELEVATION_82 LRRF1_CAN_DET_SUPER_RES_TAR_0052 LRRF1_CAN_DET_HOST_VEH_CLUT_0047 LRRF1_CAN_DET_CONFID_ELEVAT_0047 LRRF1_CAN_DET_CONFID_ELEVAT_0048 LRRF1_CAN_DET_ELEVATION_80 LRRF1_CAN_DET_HOST_VEH_CLUT_0048 LRRF1_CAN_DET_CONFID_ELEVAT_0052 LRRF1_CAN_DET_CONFID_AZIMUTH_81 LRRF1_CAN_DET_HOST_VEH_CLUT_0051 LRRF1_CAN_DET_HOST_VEH_CLUT_0050 LRRF1_CAN_SCAN_INDEX_2LSB_81 LRRF1_CAN_DET_ELEVATION_83 LRRF1_CAN_SCAN_INDEX_2LSB_79 LRRF1_CAN_DET_HOST_VEH_CLUT_0049 LRRF1_CAN_DET_RANGE_RATE_82 LRRF1_CAN_DET_CONFID_ELEVAT_0051 LRRF1_CAN_DET_ELEVATION_84 LRRF1_CAN_DET_RANGE_RATE_80 LRRF1_CAN_DET_CONFID_AZIMUTH_82 LRRF1_CAN_DET_RANGE_RATE_79 LRRF1_CAN_DET_CONFID_AZIMUTH_83 LRRF1_CAN_DET_RANGE_83 LRRF1_CAN_DET_RANGE_84 LRRF1_CAN_DET_SUPER_RES_TAR_0050 LRRF1_CAN_DET_RANGE_RATE_84 LRRF1_CAN_SCAN_INDEX_2LSB_80 LRRF1_CAN_SCAN_INDEX_2LSB_83;
