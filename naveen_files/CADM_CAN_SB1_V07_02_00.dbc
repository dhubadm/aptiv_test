VERSION ""

NS_ :

BS_:

BU_: External_Tool CADM LRRF MRRRL MRRRR

BO_ 84 LRRF1_Detection_071_077: 64 LRRF
 SG_ LRRF1_CAN_DET_Near_TARGET_77 : 454|1@0+ (1,0) [0|1] ""  CADM
 SG_ LRRF1_CAN_DET_Near_TARGET_76 : 453|1@0+ (1,0) [0|1] ""  CADM
 SG_ LRRF1_CAN_DET_Near_TARGET_75 : 452|1@0+ (1,0) [0|1] ""  CADM
 SG_ LRRF1_CAN_DET_Near_TARGET_74 : 451|1@0+ (1,0) [0|1] ""  CADM
 SG_ LRRF1_CAN_DET_Near_TARGET_72 : 449|1@0+ (1,0) [0|1] ""  CADM
 SG_ LRRF1_CAN_DET_Near_TARGET_73 : 450|1@0+ (1,0) [0|1] ""  CADM
 SG_ LRRF1_CAN_DET_Near_TARGET_71 : 448|1@0+ (1,0) [0|1] ""  CADM
 SG_ LRRF1_CAN_DET_ELEVATION_71 : 63|7@0+ (0.002748,-0.1745) [-0.1745|0.174496] "rad"  CADM
 SG_ LRRF1_CAN_DET_CONFID_AZIMUTH_71 : 33|2@0+ (1,0) [0|3] ""  CADM
 SG_ LRRF1_CAN_DET_SUPER_RES_TAR_0053 : 56|1@0+ (1,0) [0|1] ""  CADM
 SG_ LRRF1_CAN_DET_CONFID_ELEVAT_0053 : 48|1@0+ (1,0) [0|1] ""  CADM
 SG_ LRRF1_CAN_DET_HOST_VEH_CLUT_0053 : 49|1@0+ (1,0) [0|1] ""  CADM
 SG_ LRRF1_CAN_DET_VALID_LEVEL_71 : 0|1@0+ (1,0) [0|1] ""  CADM
 SG_ LRRF1_CAN_DET_AZIMUTH_71 : 47|14@0+ (0.0003834,-3.1416) [-3.1416|3.1396422] "rad"  CADM
 SG_ LRRF1_CAN_DET_RANGE_71 : 31|14@0+ (0.015625,0) [0|255.984375] "m"  CADM
 SG_ LRRF1_CAN_DET_RANGE_RATE_71 : 15|14@0+ (0.015625,-128) [-128|127.984375] "m/s"  CADM
 SG_ LRRF1_CAN_DET_AMPLITUDE_71 : 7|7@0+ (1,-64) [-64|63] "dBsm"  CADM
 SG_ LRRF1_CAN_SCAN_INDEX_2LSB_71 : 17|2@0+ (1,0) [0|3] ""  CADM
 SG_ LRRF1_Det_CRC_11 : 503|16@0+ (1,0) [0|65535] ""  CADM
 SG_ LRRF1_Det_MC_11 : 491|4@0+ (1,0) [0|15] ""  CADM
 SG_ LRRF1_CAN_SCAN_INDEX_2LSB_77 : 401|2@0+ (1,0) [0|3] ""  CADM
 SG_ LRRF1_CAN_SCAN_INDEX_2LSB_76 : 337|2@0+ (1,0) [0|3] ""  CADM
 SG_ LRRF1_CAN_SCAN_INDEX_2LSB_75 : 273|2@0+ (1,0) [0|3] ""  CADM
 SG_ LRRF1_CAN_SCAN_INDEX_2LSB_74 : 209|2@0+ (1,0) [0|3] ""  CADM
 SG_ LRRF1_CAN_SCAN_INDEX_2LSB_73 : 145|2@0+ (1,0) [0|3] ""  CADM
 SG_ LRRF1_CAN_SCAN_INDEX_2LSB_72 : 81|2@0+ (1,0) [0|3] ""  CADM
 SG_ LRRF1_CAN_DET_RANGE_RATE_77 : 399|14@0+ (0.015625,-128) [-128|127.984375] "m/s"  CADM
 SG_ LRRF1_CAN_DET_RANGE_RATE_76 : 335|14@0+ (0.015625,-128) [-128|127.984375] "m/s"  CADM
 SG_ LRRF1_CAN_DET_RANGE_RATE_75 : 271|14@0+ (0.015625,-128) [-128|127.984375] "m/s"  CADM
 SG_ LRRF1_CAN_DET_RANGE_RATE_74 : 207|14@0+ (0.015625,-128) [-128|127.984375] "m/s"  CADM
 SG_ LRRF1_CAN_DET_RANGE_RATE_73 : 143|14@0+ (0.015625,-128) [-128|127.984375] "m/s"  CADM
 SG_ LRRF1_CAN_DET_RANGE_RATE_72 : 79|14@0+ (0.015625,-128) [-128|127.984375] "m/s"  CADM
 SG_ LRRF1_CAN_DET_RANGE_77 : 415|14@0+ (0.015625,0) [0|255.984375] "m"  CADM
 SG_ LRRF1_CAN_DET_RANGE_76 : 351|14@0+ (0.015625,0) [0|255.984375] "m"  CADM
 SG_ LRRF1_CAN_DET_RANGE_75 : 287|14@0+ (0.015625,0) [0|255.984375] "m"  CADM
 SG_ LRRF1_CAN_DET_RANGE_74 : 223|14@0+ (0.015625,0) [0|255.984375] "m"  CADM
 SG_ LRRF1_CAN_DET_RANGE_73 : 159|14@0+ (0.015625,0) [0|255.984375] "m"  CADM
 SG_ LRRF1_CAN_DET_RANGE_72 : 95|14@0+ (0.015625,0) [0|255.984375] "m"  CADM
 SG_ LRRF1_CAN_DET_SUPER_RES_TAR_0054 : 432|1@0+ (1,0) [0|1] ""  CADM
 SG_ LRRF1_CAN_DET_SUPER_RES_TAR_0055 : 368|1@0+ (1,0) [0|1] ""  CADM
 SG_ LRRF1_CAN_DET_SUPER_RES_TAR_0056 : 304|1@0+ (1,0) [0|1] ""  CADM
 SG_ LRRF1_CAN_DET_SUPER_RES_TAR_0057 : 240|1@0+ (1,0) [0|1] ""  CADM
 SG_ LRRF1_CAN_DET_SUPER_RES_TAR_0058 : 176|1@0+ (1,0) [0|1] ""  CADM
 SG_ LRRF1_CAN_DET_SUPER_RES_TAR_0059 : 112|1@0+ (1,0) [0|1] ""  CADM
 SG_ LRRF1_CAN_DET_HOST_VEH_CLUT_0054 : 433|1@0+ (1,0) [0|1] ""  CADM
 SG_ LRRF1_CAN_DET_HOST_VEH_CLUT_0055 : 369|1@0+ (1,0) [0|1] ""  CADM
 SG_ LRRF1_CAN_DET_HOST_VEH_CLUT_0056 : 305|1@0+ (1,0) [0|1] ""  CADM
 SG_ LRRF1_CAN_DET_HOST_VEH_CLUT_0057 : 241|1@0+ (1,0) [0|1] ""  CADM
 SG_ LRRF1_CAN_DET_HOST_VEH_CLUT_0058 : 177|1@0+ (1,0) [0|1] ""  CADM
 SG_ LRRF1_CAN_DET_HOST_VEH_CLUT_0059 : 113|1@0+ (1,0) [0|1] ""  CADM
 SG_ LRRF1_CAN_DET_ELEVATION_77 : 447|7@0+ (0.002748,-0.1745) [-0.1745|0.174496] "rad"  CADM
 SG_ LRRF1_CAN_DET_ELEVATION_76 : 383|7@0+ (0.002748,-0.1745) [-0.1745|0.174496] "rad"  CADM
 SG_ LRRF1_CAN_DET_ELEVATION_75 : 319|7@0+ (0.002748,-0.1745) [-0.1745|0.174496] "rad"  CADM
 SG_ LRRF1_CAN_DET_ELEVATION_74 : 255|7@0+ (0.002748,-0.1745) [-0.1745|0.174496] "rad"  CADM
 SG_ LRRF1_CAN_DET_ELEVATION_73 : 191|7@0+ (0.002748,-0.1745) [-0.1745|0.174496] "rad"  CADM
 SG_ LRRF1_CAN_DET_ELEVATION_72 : 127|7@0+ (0.002748,-0.1745) [-0.1745|0.174496] "rad"  CADM
 SG_ LRRF1_CAN_DET_CONFID_ELEVAT_0054 : 440|1@0+ (1,0) [0|1] ""  CADM
 SG_ LRRF1_CAN_DET_CONFID_ELEVAT_0055 : 376|1@0+ (1,0) [0|1] ""  CADM
 SG_ LRRF1_CAN_DET_CONFID_ELEVAT_0056 : 312|1@0+ (1,0) [0|1] ""  CADM
 SG_ LRRF1_CAN_DET_CONFID_ELEVAT_0057 : 248|1@0+ (1,0) [0|1] ""  CADM
 SG_ LRRF1_CAN_DET_CONFID_ELEVAT_0058 : 184|1@0+ (1,0) [0|1] ""  CADM
 SG_ LRRF1_CAN_DET_CONFID_ELEVAT_0059 : 120|1@0+ (1,0) [0|1] ""  CADM
 SG_ LRRF1_CAN_DET_CONFID_AZIMUTH_77 : 417|2@0+ (1,0) [0|3] ""  CADM
 SG_ LRRF1_CAN_DET_CONFID_AZIMUTH_76 : 353|2@0+ (1,0) [0|3] ""  CADM
 SG_ LRRF1_CAN_DET_CONFID_AZIMUTH_75 : 289|2@0+ (1,0) [0|3] ""  CADM
 SG_ LRRF1_CAN_DET_CONFID_AZIMUTH_74 : 225|2@0+ (1,0) [0|3] ""  CADM
 SG_ LRRF1_CAN_DET_CONFID_AZIMUTH_73 : 161|2@0+ (1,0) [0|3] ""  CADM
 SG_ LRRF1_CAN_DET_CONFID_AZIMUTH_72 : 97|2@0+ (1,0) [0|3] ""  CADM
 SG_ LRRF1_CAN_DET_AZIMUTH_77 : 431|14@0+ (0.0003834,-3.1416) [-3.1416|3.1396422] "rad"  CADM
 SG_ LRRF1_CAN_DET_AZIMUTH_76 : 367|14@0+ (0.0003834,-3.1416) [-3.1416|3.1396422] "rad"  CADM
 SG_ LRRF1_CAN_DET_AZIMUTH_75 : 303|14@0+ (0.0003834,-3.1416) [-3.1416|3.1396422] "rad"  CADM
 SG_ LRRF1_CAN_DET_AZIMUTH_74 : 239|14@0+ (0.0003834,-3.1416) [-3.1416|3.1396422] "rad"  CADM
 SG_ LRRF1_CAN_DET_AZIMUTH_73 : 175|14@0+ (0.0003834,-3.1416) [-3.1416|3.1396422] "rad"  CADM
 SG_ LRRF1_CAN_DET_AZIMUTH_72 : 111|14@0+ (0.0003834,-3.1416) [-3.1416|3.1396422] "rad"  CADM
 SG_ LRRF1_CAN_DET_AMPLITUDE_77 : 391|7@0+ (1,-64) [-64|63] "dBsm"  CADM
 SG_ LRRF1_CAN_DET_AMPLITUDE_76 : 327|7@0+ (1,-64) [-64|63] "dBsm"  CADM
 SG_ LRRF1_CAN_DET_AMPLITUDE_75 : 263|7@0+ (1,-64) [-64|63] "dBsm"  CADM
 SG_ LRRF1_CAN_DET_AMPLITUDE_74 : 199|7@0+ (1,-64) [-64|63] "dBsm"  CADM
 SG_ LRRF1_CAN_DET_AMPLITUDE_73 : 135|7@0+ (1,-64) [-64|63] "dBsm"  CADM
 SG_ LRRF1_CAN_DET_AMPLITUDE_72 : 71|7@0+ (1,-64) [-64|63] "dBsm"  CADM
 SG_ LRRF1_CAN_DET_VALID_LEVEL_77 : 384|1@0+ (1,0) [0|1] ""  CADM
 SG_ LRRF1_CAN_DET_VALID_LEVEL_76 : 320|1@0+ (1,0) [0|1] ""  CADM
 SG_ LRRF1_CAN_DET_VALID_LEVEL_75 : 256|1@0+ (1,0) [0|1] ""  CADM
 SG_ LRRF1_CAN_DET_VALID_LEVEL_74 : 192|1@0+ (1,0) [0|1] ""  CADM
 SG_ LRRF1_CAN_DET_VALID_LEVEL_73 : 128|1@0+ (1,0) [0|1] ""  CADM
 SG_ LRRF1_CAN_DET_VALID_LEVEL_72 : 64|1@0+ (1,0) [0|1] ""  CADM

BO_ 83 LRRF1_Detection_064_070: 64 LRRF
 SG_ LRRF1_CAN_DET_Near_TARGET_70 : 454|1@0+ (1,0) [0|1] ""  CADM
 SG_ LRRF1_CAN_DET_Near_TARGET_69 : 453|1@0+ (1,0) [0|1] ""  CADM
 SG_ LRRF1_CAN_DET_Near_TARGET_68 : 452|1@0+ (1,0) [0|1] ""  CADM
 SG_ LRRF1_CAN_DET_Near_TARGET_67 : 451|1@0+ (1,0) [0|1] ""  CADM
 SG_ LRRF1_CAN_DET_Near_TARGET_66 : 450|1@0+ (1,0) [0|1] ""  CADM
 SG_ LRRF1_CAN_DET_Near_TARGET_65 : 449|1@0+ (1,0) [0|1] ""  CADM
 SG_ LRRF1_CAN_DET_Near_TARGET_64 : 448|1@0+ (1,0) [0|1] ""  CADM
 SG_ LRRF1_CAN_DET_ELEVATION_64 : 63|7@0+ (0.002748,-0.1745) [-0.1745|0.174496] "rad"  CADM
 SG_ LRRF1_CAN_DET_CONFID_AZIMUTH_64 : 33|2@0+ (1,0) [0|3] ""  CADM
 SG_ LRRF1_CAN_DET_SUPER_RES_TARGET_6 : 56|1@0+ (1,0) [0|1] ""  CADM
 SG_ LRRF1_CAN_DET_CONFID_ELEVATION_6 : 48|1@0+ (1,0) [0|1] ""  CADM
 SG_ LRRF1_CAN_DET_HOST_VEH_CLUTTER_6 : 49|1@0+ (1,0) [0|1] ""  CADM
 SG_ LRRF1_CAN_DET_VALID_LEVEL_64 : 0|1@0+ (1,0) [0|1] ""  CADM
 SG_ LRRF1_CAN_DET_AZIMUTH_64 : 47|14@0+ (0.0003834,-3.1416) [-3.1416|3.1396422] "rad"  CADM
 SG_ LRRF1_CAN_DET_RANGE_64 : 31|14@0+ (0.015625,0) [0|255.984375] "m"  CADM
 SG_ LRRF1_CAN_DET_RANGE_RATE_64 : 15|14@0+ (0.015625,-128) [-128|127.984375] "m/s"  CADM
 SG_ LRRF1_CAN_DET_AMPLITUDE_64 : 7|7@0+ (1,-64) [-64|63] "dBsm"  CADM
 SG_ LRRF1_CAN_SCAN_INDEX_2LSB_64 : 17|2@0+ (1,0) [0|3] ""  CADM
 SG_ LRRF1_Det_CRC_10 : 503|16@0+ (1,0) [0|65535] ""  CADM
 SG_ LRRF1_Det_MC_10 : 491|4@0+ (1,0) [0|15] ""  CADM
 SG_ LRRF1_CAN_SCAN_INDEX_2LSB_70 : 401|2@0+ (1,0) [0|3] ""  CADM
 SG_ LRRF1_CAN_SCAN_INDEX_2LSB_69 : 337|2@0+ (1,0) [0|3] ""  CADM
 SG_ LRRF1_CAN_SCAN_INDEX_2LSB_68 : 273|2@0+ (1,0) [0|3] ""  CADM
 SG_ LRRF1_CAN_SCAN_INDEX_2LSB_67 : 209|2@0+ (1,0) [0|3] ""  CADM
 SG_ LRRF1_CAN_SCAN_INDEX_2LSB_66 : 145|2@0+ (1,0) [0|3] ""  CADM
 SG_ LRRF1_CAN_SCAN_INDEX_2LSB_65 : 81|2@0+ (1,0) [0|3] ""  CADM
 SG_ LRRF1_CAN_DET_RANGE_RATE_70 : 399|14@0+ (0.015625,-128) [-128|127.984375] "m/s"  CADM
 SG_ LRRF1_CAN_DET_RANGE_RATE_69 : 335|14@0+ (0.015625,-128) [-128|127.984375] "m/s"  CADM
 SG_ LRRF1_CAN_DET_RANGE_RATE_68 : 271|14@0+ (0.015625,-128) [-128|127.984375] "m/s"  CADM
 SG_ LRRF1_CAN_DET_RANGE_RATE_67 : 207|14@0+ (0.015625,-128) [-128|127.984375] "m/s"  CADM
 SG_ LRRF1_CAN_DET_RANGE_RATE_66 : 143|14@0+ (0.015625,-128) [-128|127.984375] "m/s"  CADM
 SG_ LRRF1_CAN_DET_RANGE_RATE_65 : 79|14@0+ (0.015625,-128) [-128|127.984375] "m/s"  CADM
 SG_ LRRF1_CAN_DET_RANGE_70 : 415|14@0+ (0.015625,0) [0|255.984375] "m"  CADM
 SG_ LRRF1_CAN_DET_RANGE_69 : 351|14@0+ (0.015625,0) [0|255.984375] "m"  CADM
 SG_ LRRF1_CAN_DET_RANGE_68 : 287|14@0+ (0.015625,0) [0|255.984375] "m"  CADM
 SG_ LRRF1_CAN_DET_RANGE_67 : 223|14@0+ (0.015625,0) [0|255.984375] "m"  CADM
 SG_ LRRF1_CAN_DET_RANGE_66 : 159|14@0+ (0.015625,0) [0|255.984375] "m"  CADM
 SG_ LRRF1_CAN_DET_RANGE_65 : 95|14@0+ (0.015625,0) [0|255.984375] "m"  CADM
 SG_ LRRF1_CAN_DET_SUPER_RES_TAR_0060 : 432|1@0+ (1,0) [0|1] ""  CADM
 SG_ LRRF1_CAN_DET_SUPER_RES_TAR_0061 : 368|1@0+ (1,0) [0|1] ""  CADM
 SG_ LRRF1_CAN_DET_SUPER_RES_TAR_0062 : 304|1@0+ (1,0) [0|1] ""  CADM
 SG_ LRRF1_CAN_DET_SUPER_RES_TAR_0063 : 240|1@0+ (1,0) [0|1] ""  CADM
 SG_ LRRF1_CAN_DET_SUPER_RES_TAR_0064 : 176|1@0+ (1,0) [0|1] ""  CADM
 SG_ LRRF1_CAN_DET_SUPER_RES_TAR_0065 : 112|1@0+ (1,0) [0|1] ""  CADM
 SG_ LRRF1_CAN_DET_HOST_VEH_CLUT_0060 : 433|1@0+ (1,0) [0|1] ""  CADM
 SG_ LRRF1_CAN_DET_HOST_VEH_CLUT_0061 : 369|1@0+ (1,0) [0|1] ""  CADM
 SG_ LRRF1_CAN_DET_HOST_VEH_CLUT_0062 : 305|1@0+ (1,0) [0|1] ""  CADM
 SG_ LRRF1_CAN_DET_HOST_VEH_CLUT_0063 : 241|1@0+ (1,0) [0|1] ""  CADM
 SG_ LRRF1_CAN_DET_HOST_VEH_CLUT_0064 : 177|1@0+ (1,0) [0|1] ""  CADM
 SG_ LRRF1_CAN_DET_HOST_VEH_CLUT_0065 : 113|1@0+ (1,0) [0|1] ""  CADM
 SG_ LRRF1_CAN_DET_ELEVATION_70 : 447|7@0+ (0.002748,-0.1745) [-0.1745|0.174496] "rad"  CADM
 SG_ LRRF1_CAN_DET_ELEVATION_69 : 383|7@0+ (0.002748,-0.1745) [-0.1745|0.174496] "rad"  CADM
 SG_ LRRF1_CAN_DET_ELEVATION_68 : 319|7@0+ (0.002748,-0.1745) [-0.1745|0.174496] "rad"  CADM
 SG_ LRRF1_CAN_DET_ELEVATION_67 : 255|7@0+ (0.002748,-0.1745) [-0.1745|0.174496] "rad"  CADM
 SG_ LRRF1_CAN_DET_ELEVATION_66 : 191|7@0+ (0.002748,-0.1745) [-0.1745|0.174496] "rad"  CADM
 SG_ LRRF1_CAN_DET_ELEVATION_65 : 127|7@0+ (0.002748,-0.1745) [-0.1745|0.174496] "rad"  CADM
 SG_ LRRF1_CAN_DET_CONFID_ELEVAT_0060 : 440|1@0+ (1,0) [0|1] ""  CADM
 SG_ LRRF1_CAN_DET_CONFID_ELEVAT_0061 : 376|1@0+ (1,0) [0|1] ""  CADM
 SG_ LRRF1_CAN_DET_CONFID_ELEVAT_0062 : 312|1@0+ (1,0) [0|1] ""  CADM
 SG_ LRRF1_CAN_DET_CONFID_ELEVAT_0063 : 248|1@0+ (1,0) [0|1] ""  CADM
 SG_ LRRF1_CAN_DET_CONFID_ELEVAT_0064 : 184|1@0+ (1,0) [0|1] ""  CADM
 SG_ LRRF1_CAN_DET_CONFID_ELEVAT_0065 : 120|1@0+ (1,0) [0|1] ""  CADM
 SG_ LRRF1_CAN_DET_CONFID_AZIMUTH_70 : 417|2@0+ (1,0) [0|3] ""  CADM
 SG_ LRRF1_CAN_DET_CONFID_AZIMUTH_69 : 353|2@0+ (1,0) [0|3] ""  CADM
 SG_ LRRF1_CAN_DET_CONFID_AZIMUTH_68 : 289|2@0+ (1,0) [0|3] ""  CADM
 SG_ LRRF1_CAN_DET_CONFID_AZIMUTH_67 : 225|2@0+ (1,0) [0|3] ""  CADM
 SG_ LRRF1_CAN_DET_CONFID_AZIMUTH_66 : 161|2@0+ (1,0) [0|3] ""  CADM
 SG_ LRRF1_CAN_DET_CONFID_AZIMUTH_65 : 97|2@0+ (1,0) [0|3] ""  CADM
 SG_ LRRF1_CAN_DET_AZIMUTH_70 : 431|14@0+ (0.0003834,-3.1416) [-3.1416|3.1396422] "rad"  CADM
 SG_ LRRF1_CAN_DET_AZIMUTH_69 : 367|14@0+ (0.0003834,-3.1416) [-3.1416|3.1396422] "rad"  CADM
 SG_ LRRF1_CAN_DET_AZIMUTH_68 : 303|14@0+ (0.0003834,-3.1416) [-3.1416|3.1396422] "rad"  CADM
 SG_ LRRF1_CAN_DET_AZIMUTH_67 : 239|14@0+ (0.0003834,-3.1416) [-3.1416|3.1396422] "rad"  CADM
 SG_ LRRF1_CAN_DET_AZIMUTH_66 : 175|14@0+ (0.0003834,-3.1416) [-3.1416|3.1396422] "rad"  CADM
 SG_ LRRF1_CAN_DET_AZIMUTH_65 : 111|14@0+ (0.0003834,-3.1416) [-3.1416|3.1396422] "rad"  CADM
 SG_ LRRF1_CAN_DET_AMPLITUDE_70 : 391|7@0+ (1,-64) [-64|63] "dBsm"  CADM
 SG_ LRRF1_CAN_DET_AMPLITUDE_69 : 327|7@0+ (1,-64) [-64|63] "dBsm"  CADM
 SG_ LRRF1_CAN_DET_AMPLITUDE_68 : 263|7@0+ (1,-64) [-64|63] "dBsm"  CADM
 SG_ LRRF1_CAN_DET_AMPLITUDE_67 : 199|7@0+ (1,-64) [-64|63] "dBsm"  CADM
 SG_ LRRF1_CAN_DET_AMPLITUDE_66 : 135|7@0+ (1,-64) [-64|63] "dBsm"  CADM
 SG_ LRRF1_CAN_DET_AMPLITUDE_65 : 71|7@0+ (1,-64) [-64|63] "dBsm"  CADM
 SG_ LRRF1_CAN_DET_VALID_LEVEL_70 : 384|1@0+ (1,0) [0|1] ""  CADM
 SG_ LRRF1_CAN_DET_VALID_LEVEL_69 : 320|1@0+ (1,0) [0|1] ""  CADM
 SG_ LRRF1_CAN_DET_VALID_LEVEL_68 : 256|1@0+ (1,0) [0|1] ""  CADM
 SG_ LRRF1_CAN_DET_VALID_LEVEL_67 : 192|1@0+ (1,0) [0|1] ""  CADM
 SG_ LRRF1_CAN_DET_VALID_LEVEL_66 : 128|1@0+ (1,0) [0|1] ""  CADM
 SG_ LRRF1_CAN_DET_VALID_LEVEL_65 : 64|1@0+ (1,0) [0|1] ""  CADM

BO_ 82 LRRF1_Detection_057_063: 64 LRRF
 SG_ LRRF1_CAN_DET_Near_TARGET_63 : 454|1@0+ (1,0) [0|1] ""  CADM
 SG_ LRRF1_CAN_DET_Near_TARGET_62 : 453|1@0+ (1,0) [0|1] ""  CADM
 SG_ LRRF1_CAN_DET_Near_TARGET_61 : 452|1@0+ (1,0) [0|1] ""  CADM
 SG_ LRRF1_CAN_DET_Near_TARGET_60 : 451|1@0+ (1,0) [0|1] ""  CADM
 SG_ LRRF1_CAN_DET_Near_TARGET_59 : 450|1@0+ (1,0) [0|1] ""  CADM
 SG_ LRRF1_CAN_DET_Near_TARGET_58 : 449|1@0+ (1,0) [0|1] ""  CADM
 SG_ LRRF1_CAN_DET_Near_TARGET_57 : 448|1@0+ (1,0) [0|1] ""  CADM
 SG_ LRRF1_CAN_DET_ELEVATION_57 : 63|7@0+ (0.002748,-0.1745) [-0.1745|0.174496] "rad"  CADM
 SG_ LRRF1_CAN_DET_CONFID_AZIMUTH_57 : 33|2@0+ (1,0) [0|3] ""  CADM
 SG_ LRRF1_CAN_DET_SUPER_RES_TAR_0066 : 56|1@0+ (1,0) [0|1] ""  CADM
 SG_ LRRF1_CAN_DET_CONFID_ELEVAT_0066 : 48|1@0+ (1,0) [0|1] ""  CADM
 SG_ LRRF1_CAN_DET_HOST_VEH_CLUT_0066 : 49|1@0+ (1,0) [0|1] ""  CADM
 SG_ LRRF1_CAN_DET_VALID_LEVEL_57 : 0|1@0+ (1,0) [0|1] ""  CADM
 SG_ LRRF1_CAN_DET_AZIMUTH_57 : 47|14@0+ (0.0003834,-3.1416) [-3.1416|3.1396422] "rad"  CADM
 SG_ LRRF1_CAN_DET_RANGE_57 : 31|14@0+ (0.015625,0) [0|255.984375] "m"  CADM
 SG_ LRRF1_CAN_DET_RANGE_RATE_57 : 15|14@0+ (0.015625,-128) [-128|127.984375] "m/s"  CADM
 SG_ LRRF1_CAN_DET_AMPLITUDE_57 : 7|7@0+ (1,-64) [-64|63] "dBsm"  CADM
 SG_ LRRF1_CAN_SCAN_INDEX_2LSB_57 : 17|2@0+ (1,0) [0|3] ""  CADM
 SG_ LRRF1_Det_CRC_09 : 503|16@0+ (1,0) [0|65535] ""  CADM
 SG_ LRRF1_Det_MC_09 : 491|4@0+ (1,0) [0|15] ""  CADM
 SG_ LRRF1_CAN_SCAN_INDEX_2LSB_63 : 401|2@0+ (1,0) [0|3] ""  CADM
 SG_ LRRF1_CAN_SCAN_INDEX_2LSB_62 : 337|2@0+ (1,0) [0|3] ""  CADM
 SG_ LRRF1_CAN_SCAN_INDEX_2LSB_61 : 273|2@0+ (1,0) [0|3] ""  CADM
 SG_ LRRF1_CAN_SCAN_INDEX_2LSB_60 : 209|2@0+ (1,0) [0|3] ""  CADM
 SG_ LRRF1_CAN_SCAN_INDEX_2LSB_59 : 145|2@0+ (1,0) [0|3] ""  CADM
 SG_ LRRF1_CAN_SCAN_INDEX_2LSB_58 : 81|2@0+ (1,0) [0|3] ""  CADM
 SG_ LRRF1_CAN_DET_RANGE_RATE_63 : 399|14@0+ (0.015625,-128) [-128|127.984375] "m/s"  CADM
 SG_ LRRF1_CAN_DET_RANGE_RATE_62 : 335|14@0+ (0.015625,-128) [-128|127.984375] "m/s"  CADM
 SG_ LRRF1_CAN_DET_RANGE_RATE_61 : 271|14@0+ (0.015625,-128) [-128|127.984375] "m/s"  CADM
 SG_ LRRF1_CAN_DET_RANGE_RATE_60 : 207|14@0+ (0.015625,-128) [-128|127.984375] "m/s"  CADM
 SG_ LRRF1_CAN_DET_RANGE_RATE_59 : 143|14@0+ (0.015625,-128) [-128|127.984375] "m/s"  CADM
 SG_ LRRF1_CAN_DET_RANGE_RATE_58 : 79|14@0+ (0.015625,-128) [-128|127.984375] "m/s"  CADM
 SG_ LRRF1_CAN_DET_RANGE_63 : 415|14@0+ (0.015625,0) [0|255.984375] "m"  CADM
 SG_ LRRF1_CAN_DET_RANGE_62 : 351|14@0+ (0.015625,0) [0|255.984375] "m"  CADM
 SG_ LRRF1_CAN_DET_RANGE_61 : 287|14@0+ (0.015625,0) [0|255.984375] "m"  CADM
 SG_ LRRF1_CAN_DET_RANGE_60 : 223|14@0+ (0.015625,0) [0|255.984375] "m"  CADM
 SG_ LRRF1_CAN_DET_RANGE_59 : 159|14@0+ (0.015625,0) [0|255.984375] "m"  CADM
 SG_ LRRF1_CAN_DET_RANGE_58 : 95|14@0+ (0.015625,0) [0|255.984375] "m"  CADM
 SG_ LRRF1_CAN_DET_SUPER_RES_TAR_0067 : 432|1@0+ (1,0) [0|1] ""  CADM
 SG_ LRRF1_CAN_DET_SUPER_RES_TAR_0068 : 368|1@0+ (1,0) [0|1] ""  CADM
 SG_ LRRF1_CAN_DET_SUPER_RES_TAR_0069 : 304|1@0+ (1,0) [0|1] ""  CADM
 SG_ LRRF1_CAN_DET_SUPER_RES_TAR_0070 : 240|1@0+ (1,0) [0|1] ""  CADM
 SG_ LRRF1_CAN_DET_SUPER_RES_TAR_0071 : 176|1@0+ (1,0) [0|1] ""  CADM
 SG_ LRRF1_CAN_DET_SUPER_RES_TAR_0072 : 112|1@0+ (1,0) [0|1] ""  CADM
 SG_ LRRF1_CAN_DET_HOST_VEH_CLUT_0067 : 433|1@0+ (1,0) [0|1] ""  CADM
 SG_ LRRF1_CAN_DET_HOST_VEH_CLUT_0068 : 369|1@0+ (1,0) [0|1] ""  CADM
 SG_ LRRF1_CAN_DET_HOST_VEH_CLUT_0069 : 305|1@0+ (1,0) [0|1] ""  CADM
 SG_ LRRF1_CAN_DET_HOST_VEH_CLUT_0070 : 241|1@0+ (1,0) [0|1] ""  CADM
 SG_ LRRF1_CAN_DET_HOST_VEH_CLUT_0071 : 177|1@0+ (1,0) [0|1] ""  CADM
 SG_ LRRF1_CAN_DET_HOST_VEH_CLUT_0072 : 113|1@0+ (1,0) [0|1] ""  CADM
 SG_ LRRF1_CAN_DET_ELEVATION_63 : 447|7@0+ (0.002748,-0.1745) [-0.1745|0.174496] "rad"  CADM
 SG_ LRRF1_CAN_DET_ELEVATION_62 : 383|7@0+ (0.002748,-0.1745) [-0.1745|0.174496] "rad"  CADM
 SG_ LRRF1_CAN_DET_ELEVATION_61 : 319|7@0+ (0.002748,-0.1745) [-0.1745|0.174496] "rad"  CADM
 SG_ LRRF1_CAN_DET_ELEVATION_60 : 255|7@0+ (0.002748,-0.1745) [-0.1745|0.174496] "rad"  CADM
 SG_ LRRF1_CAN_DET_ELEVATION_59 : 191|7@0+ (0.002748,-0.1745) [-0.1745|0.174496] "rad"  CADM
 SG_ LRRF1_CAN_DET_ELEVATION_58 : 127|7@0+ (0.002748,-0.1745) [-0.1745|0.174496] "rad"  CADM
 SG_ LRRF1_CAN_DET_CONFID_ELEVAT_0067 : 440|1@0+ (1,0) [0|1] ""  CADM
 SG_ LRRF1_CAN_DET_CONFID_ELEVAT_0068 : 376|1@0+ (1,0) [0|1] ""  CADM
 SG_ LRRF1_CAN_DET_CONFID_ELEVAT_0069 : 312|1@0+ (1,0) [0|1] ""  CADM
 SG_ LRRF1_CAN_DET_CONFID_ELEVAT_0070 : 248|1@0+ (1,0) [0|1] ""  CADM
 SG_ LRRF1_CAN_DET_CONFID_ELEVAT_0071 : 184|1@0+ (1,0) [0|1] ""  CADM
 SG_ LRRF1_CAN_DET_CONFID_ELEVAT_0072 : 120|1@0+ (1,0) [0|1] ""  CADM
 SG_ LRRF1_CAN_DET_CONFID_AZIMUTH_63 : 417|2@0+ (1,0) [0|3] ""  CADM
 SG_ LRRF1_CAN_DET_CONFID_AZIMUTH_62 : 353|2@0+ (1,0) [0|3] ""  CADM
 SG_ LRRF1_CAN_DET_CONFID_AZIMUTH_61 : 289|2@0+ (1,0) [0|3] ""  CADM
 SG_ LRRF1_CAN_DET_CONFID_AZIMUTH_60 : 225|2@0+ (1,0) [0|3] ""  CADM
 SG_ LRRF1_CAN_DET_CONFID_AZIMUTH_59 : 161|2@0+ (1,0) [0|3] ""  CADM
 SG_ LRRF1_CAN_DET_CONFID_AZIMUTH_58 : 97|2@0+ (1,0) [0|3] ""  CADM
 SG_ LRRF1_CAN_DET_AZIMUTH_63 : 431|14@0+ (0.0003834,-3.1416) [-3.1416|3.1396422] "rad"  CADM
 SG_ LRRF1_CAN_DET_AZIMUTH_62 : 367|14@0+ (0.0003834,-3.1416) [-3.1416|3.1396422] "rad"  CADM
 SG_ LRRF1_CAN_DET_AZIMUTH_61 : 303|14@0+ (0.0003834,-3.1416) [-3.1416|3.1396422] "rad"  CADM
 SG_ LRRF1_CAN_DET_AZIMUTH_60 : 239|14@0+ (0.0003834,-3.1416) [-3.1416|3.1396422] "rad"  CADM
 SG_ LRRF1_CAN_DET_AZIMUTH_59 : 175|14@0+ (0.0003834,-3.1416) [-3.1416|3.1396422] "rad"  CADM
 SG_ LRRF1_CAN_DET_AZIMUTH_58 : 111|14@0+ (0.0003834,-3.1416) [-3.1416|3.1396422] "rad"  CADM
 SG_ LRRF1_CAN_DET_AMPLITUDE_63 : 391|7@0+ (1,-64) [-64|63] "dBsm"  CADM
 SG_ LRRF1_CAN_DET_AMPLITUDE_62 : 327|7@0+ (1,-64) [-64|63] "dBsm"  CADM
 SG_ LRRF1_CAN_DET_AMPLITUDE_61 : 263|7@0+ (1,-64) [-64|63] "dBsm"  CADM
 SG_ LRRF1_CAN_DET_AMPLITUDE_60 : 199|7@0+ (1,-64) [-64|63] "dBsm"  CADM
 SG_ LRRF1_CAN_DET_AMPLITUDE_59 : 135|7@0+ (1,-64) [-64|63] "dBsm"  CADM
 SG_ LRRF1_CAN_DET_AMPLITUDE_58 : 71|7@0+ (1,-64) [-64|63] "dBsm"  CADM
 SG_ LRRF1_CAN_DET_VALID_LEVEL_63 : 384|1@0+ (1,0) [0|1] ""  CADM
 SG_ LRRF1_CAN_DET_VALID_LEVEL_62 : 320|1@0+ (1,0) [0|1] ""  CADM
 SG_ LRRF1_CAN_DET_VALID_LEVEL_61 : 256|1@0+ (1,0) [0|1] ""  CADM
 SG_ LRRF1_CAN_DET_VALID_LEVEL_60 : 192|1@0+ (1,0) [0|1] ""  CADM
 SG_ LRRF1_CAN_DET_VALID_LEVEL_59 : 128|1@0+ (1,0) [0|1] ""  CADM
 SG_ LRRF1_CAN_DET_VALID_LEVEL_58 : 64|1@0+ (1,0) [0|1] ""  CADM

BO_ 80 LRRF1_Detection_043_049: 64 LRRF
 SG_ LRRF1_CAN_DET_Near_TARGET_49 : 454|1@0+ (1,0) [0|1] ""  CADM
 SG_ LRRF1_CAN_DET_Near_TARGET_48 : 453|1@0+ (1,0) [0|1] ""  CADM
 SG_ LRRF1_CAN_DET_Near_TARGET_47 : 452|1@0+ (1,0) [0|1] ""  CADM
 SG_ LRRF1_CAN_DET_Near_TARGET_46 : 451|1@0+ (1,0) [0|1] ""  CADM
 SG_ LRRF1_CAN_DET_Near_TARGET_45 : 450|1@0+ (1,0) [0|1] ""  CADM
 SG_ LRRF1_CAN_DET_Near_TARGET_44 : 449|1@0+ (1,0) [0|1] ""  CADM
 SG_ LRRF1_CAN_DET_Near_TARGET_43 : 448|1@0+ (1,0) [0|1] ""  CADM
 SG_ LRRF1_CAN_DET_ELEVATION_43 : 63|7@0+ (0.002748,-0.1745) [-0.1745|0.174496] "rad"  CADM
 SG_ LRRF1_CAN_DET_CONFID_AZIMUTH_43 : 33|2@0+ (1,0) [0|3] ""  CADM
 SG_ LRRF1_CAN_DET_SUPER_RES_TARGET_4 : 56|1@0+ (1,0) [0|1] ""  CADM
 SG_ LRRF1_CAN_DET_CONFID_ELEVATION_4 : 48|1@0+ (1,0) [0|1] ""  CADM
 SG_ LRRF1_CAN_DET_HOST_VEH_CLUTTER_4 : 49|1@0+ (1,0) [0|1] ""  CADM
 SG_ LRRF1_CAN_DET_VALID_LEVEL_43 : 0|1@0+ (1,0) [0|1] ""  CADM
 SG_ LRRF1_CAN_DET_AZIMUTH_43 : 47|14@0+ (0.0003834,-3.1416) [-3.1416|3.1396422] "rad"  CADM
 SG_ LRRF1_CAN_DET_RANGE_43 : 31|14@0+ (0.015625,0) [0|255.984375] "m"  CADM
 SG_ LRRF1_CAN_DET_RANGE_RATE_43 : 15|14@0+ (0.015625,-128) [-128|127.984375] "m/s"  CADM
 SG_ LRRF1_CAN_DET_AMPLITUDE_43 : 7|7@0+ (1,-64) [-64|63] "dBsm"  CADM
 SG_ LRRF1_CAN_SCAN_INDEX_2LSB_43 : 17|2@0+ (1,0) [0|3] ""  CADM
 SG_ LRRF1_Det_CRC_07 : 503|16@0+ (1,0) [0|65535] ""  CADM
 SG_ LRRF1_Det_MC_07 : 491|4@0+ (1,0) [0|15] ""  CADM
 SG_ LRRF1_CAN_SCAN_INDEX_2LSB_49 : 401|2@0+ (1,0) [0|3] ""  CADM
 SG_ LRRF1_CAN_SCAN_INDEX_2LSB_48 : 337|2@0+ (1,0) [0|3] ""  CADM
 SG_ LRRF1_CAN_SCAN_INDEX_2LSB_47 : 273|2@0+ (1,0) [0|3] ""  CADM
 SG_ LRRF1_CAN_SCAN_INDEX_2LSB_46 : 209|2@0+ (1,0) [0|3] ""  CADM
 SG_ LRRF1_CAN_SCAN_INDEX_2LSB_45 : 145|2@0+ (1,0) [0|3] ""  CADM
 SG_ LRRF1_CAN_SCAN_INDEX_2LSB_44 : 81|2@0+ (1,0) [0|3] ""  CADM
 SG_ LRRF1_CAN_DET_RANGE_RATE_49 : 399|14@0+ (0.015625,-128) [-128|127.984375] "m/s"  CADM
 SG_ LRRF1_CAN_DET_RANGE_RATE_48 : 335|14@0+ (0.015625,-128) [-128|127.984375] "m/s"  CADM
 SG_ LRRF1_CAN_DET_RANGE_RATE_47 : 271|14@0+ (0.015625,-128) [-128|127.984375] "m/s"  CADM
 SG_ LRRF1_CAN_DET_RANGE_RATE_46 : 207|14@0+ (0.015625,-128) [-128|127.984375] "m/s"  CADM
 SG_ LRRF1_CAN_DET_RANGE_RATE_45 : 143|14@0+ (0.015625,-128) [-128|127.984375] "m/s"  CADM
 SG_ LRRF1_CAN_DET_RANGE_RATE_44 : 79|14@0+ (0.015625,-128) [-128|127.984375] "m/s"  CADM
 SG_ LRRF1_CAN_DET_RANGE_49 : 415|14@0+ (0.015625,0) [0|255.984375] "m"  CADM
 SG_ LRRF1_CAN_DET_RANGE_48 : 351|14@0+ (0.015625,0) [0|255.984375] "m"  CADM
 SG_ LRRF1_CAN_DET_RANGE_47 : 287|14@0+ (0.015625,0) [0|255.984375] "m"  CADM
 SG_ LRRF1_CAN_DET_RANGE_46 : 223|14@0+ (0.015625,0) [0|255.984375] "m"  CADM
 SG_ LRRF1_CAN_DET_RANGE_45 : 159|14@0+ (0.015625,0) [0|255.984375] "m"  CADM
 SG_ LRRF1_CAN_DET_RANGE_44 : 95|14@0+ (0.015625,0) [0|255.984375] "m"  CADM
 SG_ LRRF1_CAN_DET_SUPER_RES_TAR_0073 : 432|1@0+ (1,0) [0|1] ""  CADM
 SG_ LRRF1_CAN_DET_SUPER_RES_TAR_0074 : 368|1@0+ (1,0) [0|1] ""  CADM
 SG_ LRRF1_CAN_DET_SUPER_RES_TAR_0075 : 304|1@0+ (1,0) [0|1] ""  CADM
 SG_ LRRF1_CAN_DET_SUPER_RES_TAR_0076 : 240|1@0+ (1,0) [0|1] ""  CADM
 SG_ LRRF1_CAN_DET_SUPER_RES_TAR_0077 : 176|1@0+ (1,0) [0|1] ""  CADM
 SG_ LRRF1_CAN_DET_SUPER_RES_TAR_0078 : 112|1@0+ (1,0) [0|1] ""  CADM
 SG_ LRRF1_CAN_DET_HOST_VEH_CLUT_0073 : 433|1@0+ (1,0) [0|1] ""  CADM
 SG_ LRRF1_CAN_DET_HOST_VEH_CLUT_0074 : 369|1@0+ (1,0) [0|1] ""  CADM
 SG_ LRRF1_CAN_DET_HOST_VEH_CLUT_0075 : 305|1@0+ (1,0) [0|1] ""  CADM
 SG_ LRRF1_CAN_DET_HOST_VEH_CLUT_0076 : 241|1@0+ (1,0) [0|1] ""  CADM
 SG_ LRRF1_CAN_DET_HOST_VEH_CLUT_0077 : 177|1@0+ (1,0) [0|1] ""  CADM
 SG_ LRRF1_CAN_DET_HOST_VEH_CLUT_0078 : 113|1@0+ (1,0) [0|1] ""  CADM
 SG_ LRRF1_CAN_DET_ELEVATION_49 : 447|7@0+ (0.002748,-0.1745) [-0.1745|0.174496] "rad"  CADM
 SG_ LRRF1_CAN_DET_ELEVATION_48 : 383|7@0+ (0.002748,-0.1745) [-0.1745|0.174496] "rad"  CADM
 SG_ LRRF1_CAN_DET_ELEVATION_47 : 319|7@0+ (0.002748,-0.1745) [-0.1745|0.174496] "rad"  CADM
 SG_ LRRF1_CAN_DET_ELEVATION_46 : 255|7@0+ (0.002748,-0.1745) [-0.1745|0.174496] "rad"  CADM
 SG_ LRRF1_CAN_DET_ELEVATION_45 : 191|7@0+ (0.002748,-0.1745) [-0.1745|0.174496] "rad"  CADM
 SG_ LRRF1_CAN_DET_ELEVATION_44 : 127|7@0+ (0.002748,-0.1745) [-0.1745|0.174496] "rad"  CADM
 SG_ LRRF1_CAN_DET_CONFID_ELEVAT_0073 : 440|1@0+ (1,0) [0|1] ""  CADM
 SG_ LRRF1_CAN_DET_CONFID_ELEVAT_0074 : 376|1@0+ (1,0) [0|1] ""  CADM
 SG_ LRRF1_CAN_DET_CONFID_ELEVAT_0075 : 312|1@0+ (1,0) [0|1] ""  CADM
 SG_ LRRF1_CAN_DET_CONFID_ELEVAT_0076 : 248|1@0+ (1,0) [0|1] ""  CADM
 SG_ LRRF1_CAN_DET_CONFID_ELEVAT_0077 : 184|1@0+ (1,0) [0|1] ""  CADM
 SG_ LRRF1_CAN_DET_CONFID_ELEVAT_0078 : 120|1@0+ (1,0) [0|1] ""  CADM
 SG_ LRRF1_CAN_DET_CONFID_AZIMUTH_49 : 417|2@0+ (1,0) [0|3] ""  CADM
 SG_ LRRF1_CAN_DET_CONFID_AZIMUTH_48 : 353|2@0+ (1,0) [0|3] ""  CADM
 SG_ LRRF1_CAN_DET_CONFID_AZIMUTH_47 : 289|2@0+ (1,0) [0|3] ""  CADM
 SG_ LRRF1_CAN_DET_CONFID_AZIMUTH_46 : 225|2@0+ (1,0) [0|3] ""  CADM
 SG_ LRRF1_CAN_DET_CONFID_AZIMUTH_45 : 161|2@0+ (1,0) [0|3] ""  CADM
 SG_ LRRF1_CAN_DET_CONFID_AZIMUTH_44 : 97|2@0+ (1,0) [0|3] ""  CADM
 SG_ LRRF1_CAN_DET_AZIMUTH_49 : 431|14@0+ (0.0003834,-3.1416) [-3.1416|3.1396422] "rad"  CADM
 SG_ LRRF1_CAN_DET_AZIMUTH_48 : 367|14@0+ (0.0003834,-3.1416) [-3.1416|3.1396422] "rad"  CADM
 SG_ LRRF1_CAN_DET_AZIMUTH_47 : 303|14@0+ (0.0003834,-3.1416) [-3.1416|3.1396422] "rad"  CADM
 SG_ LRRF1_CAN_DET_AZIMUTH_46 : 239|14@0+ (0.0003834,-3.1416) [-3.1416|3.1396422] "rad"  CADM
 SG_ LRRF1_CAN_DET_AZIMUTH_45 : 175|14@0+ (0.0003834,-3.1416) [-3.1416|3.1396422] "rad"  CADM
 SG_ LRRF1_CAN_DET_AZIMUTH_44 : 111|14@0+ (0.0003834,-3.1416) [-3.1416|3.1396422] "rad"  CADM
 SG_ LRRF1_CAN_DET_AMPLITUDE_49 : 391|7@0+ (1,-64) [-64|63] "dBsm"  CADM
 SG_ LRRF1_CAN_DET_AMPLITUDE_48 : 327|7@0+ (1,-64) [-64|63] "dBsm"  CADM
 SG_ LRRF1_CAN_DET_AMPLITUDE_47 : 263|7@0+ (1,-64) [-64|63] "dBsm"  CADM
 SG_ LRRF1_CAN_DET_AMPLITUDE_46 : 199|7@0+ (1,-64) [-64|63] "dBsm"  CADM
 SG_ LRRF1_CAN_DET_AMPLITUDE_45 : 135|7@0+ (1,-64) [-64|63] "dBsm"  CADM
 SG_ LRRF1_CAN_DET_AMPLITUDE_44 : 71|7@0+ (1,-64) [-64|63] "dBsm"  CADM
 SG_ LRRF1_CAN_DET_VALID_LEVEL_49 : 384|1@0+ (1,0) [0|1] ""  CADM
 SG_ LRRF1_CAN_DET_VALID_LEVEL_48 : 320|1@0+ (1,0) [0|1] ""  CADM
 SG_ LRRF1_CAN_DET_VALID_LEVEL_47 : 256|1@0+ (1,0) [0|1] ""  CADM
 SG_ LRRF1_CAN_DET_VALID_LEVEL_46 : 192|1@0+ (1,0) [0|1] ""  CADM
 SG_ LRRF1_CAN_DET_VALID_LEVEL_45 : 128|1@0+ (1,0) [0|1] ""  CADM
 SG_ LRRF1_CAN_DET_VALID_LEVEL_44 : 64|1@0+ (1,0) [0|1] ""  CADM

BO_ 79 LRRF1_Detection_036_042: 64 LRRF
 SG_ LRRF1_CAN_DET_Near_TARGET_42 : 454|1@0+ (1,0) [0|1] ""  CADM
 SG_ LRRF1_CAN_DET_Near_TARGET_41 : 453|1@0+ (1,0) [0|1] ""  CADM
 SG_ LRRF1_CAN_DET_Near_TARGET_39 : 451|1@0+ (1,0) [0|1] ""  CADM
 SG_ LRRF1_CAN_DET_Near_TARGET_40 : 452|1@0+ (1,0) [0|1] ""  CADM
 SG_ LRRF1_CAN_DET_Near_TARGET_38 : 450|1@0+ (1,0) [0|1] ""  CADM
 SG_ LRRF1_CAN_DET_Near_TARGET_37 : 449|1@0+ (1,0) [0|1] ""  CADM
 SG_ LRRF1_CAN_DET_Near_TARGET_36 : 448|1@0+ (1,0) [0|1] ""  CADM
 SG_ LRRF1_CAN_DET_ELEVATION_36 : 63|7@0+ (0.002748,-0.1745) [-0.1745|0.174496] "rad"  CADM
 SG_ LRRF1_CAN_DET_CONFID_AZIMUTH_36 : 33|2@0+ (1,0) [0|3] ""  CADM
 SG_ LRRF1_CAN_DET_SUPER_RES_TARGET_3 : 56|1@0+ (1,0) [0|1] ""  CADM
 SG_ LRRF1_CAN_DET_CONFID_ELEVATION_3 : 48|1@0+ (1,0) [0|1] ""  CADM
 SG_ LRRF1_CAN_DET_HOST_VEH_CLUTTER_3 : 49|1@0+ (1,0) [0|1] ""  CADM
 SG_ LRRF1_CAN_DET_VALID_LEVEL_36 : 0|1@0+ (1,0) [0|1] ""  CADM
 SG_ LRRF1_CAN_DET_AZIMUTH_36 : 47|14@0+ (0.0003834,-3.1416) [-3.1416|3.1396422] "rad"  CADM
 SG_ LRRF1_CAN_DET_RANGE_36 : 31|14@0+ (0.015625,0) [0|255.984375] "m"  CADM
 SG_ LRRF1_CAN_DET_RANGE_RATE_36 : 15|14@0+ (0.015625,-128) [-128|127.984375] "m/s"  CADM
 SG_ LRRF1_CAN_DET_AMPLITUDE_36 : 7|7@0+ (1,-64) [-64|63] "dBsm"  CADM
 SG_ LRRF1_CAN_SCAN_INDEX_2LSB_36 : 17|2@0+ (1,0) [0|3] ""  CADM
 SG_ LRRF1_Det_CRC_06 : 503|16@0+ (1,0) [0|65535] ""  CADM
 SG_ LRRF1_Det_MC_06 : 491|4@0+ (1,0) [0|15] ""  CADM
 SG_ LRRF1_CAN_SCAN_INDEX_2LSB_42 : 401|2@0+ (1,0) [0|3] ""  CADM
 SG_ LRRF1_CAN_SCAN_INDEX_2LSB_41 : 337|2@0+ (1,0) [0|3] ""  CADM
 SG_ LRRF1_CAN_SCAN_INDEX_2LSB_40 : 273|2@0+ (1,0) [0|3] ""  CADM
 SG_ LRRF1_CAN_SCAN_INDEX_2LSB_39 : 209|2@0+ (1,0) [0|3] ""  CADM
 SG_ LRRF1_CAN_SCAN_INDEX_2LSB_38 : 145|2@0+ (1,0) [0|3] ""  CADM
 SG_ LRRF1_CAN_SCAN_INDEX_2LSB_37 : 81|2@0+ (1,0) [0|3] ""  CADM
 SG_ LRRF1_CAN_DET_RANGE_RATE_42 : 399|14@0+ (0.015625,-128) [-128|127.984375] "m/s"  CADM
 SG_ LRRF1_CAN_DET_RANGE_RATE_41 : 335|14@0+ (0.015625,-128) [-128|127.984375] "m/s"  CADM
 SG_ LRRF1_CAN_DET_RANGE_RATE_40 : 271|14@0+ (0.015625,-128) [-128|127.984375] "m/s"  CADM
 SG_ LRRF1_CAN_DET_RANGE_RATE_39 : 207|14@0+ (0.015625,-128) [-128|127.984375] "m/s"  CADM
 SG_ LRRF1_CAN_DET_RANGE_RATE_38 : 143|14@0+ (0.015625,-128) [-128|127.984375] "m/s"  CADM
 SG_ LRRF1_CAN_DET_RANGE_RATE_37 : 79|14@0+ (0.015625,-128) [-128|127.984375] "m/s"  CADM
 SG_ LRRF1_CAN_DET_RANGE_42 : 415|14@0+ (0.015625,0) [0|255.984375] "m"  CADM
 SG_ LRRF1_CAN_DET_RANGE_41 : 351|14@0+ (0.015625,0) [0|255.984375] "m"  CADM
 SG_ LRRF1_CAN_DET_RANGE_40 : 287|14@0+ (0.015625,0) [0|255.984375] "m"  CADM
 SG_ LRRF1_CAN_DET_RANGE_39 : 223|14@0+ (0.015625,0) [0|255.984375] "m"  CADM
 SG_ LRRF1_CAN_DET_RANGE_38 : 159|14@0+ (0.015625,0) [0|255.984375] "m"  CADM
 SG_ LRRF1_CAN_DET_RANGE_37 : 95|14@0+ (0.015625,0) [0|255.984375] "m"  CADM
 SG_ LRRF1_CAN_DET_SUPER_RES_TAR_0079 : 432|1@0+ (1,0) [0|1] ""  CADM
 SG_ LRRF1_CAN_DET_SUPER_RES_TAR_0080 : 368|1@0+ (1,0) [0|1] ""  CADM
 SG_ LRRF1_CAN_DET_SUPER_RES_TAR_0081 : 304|1@0+ (1,0) [0|1] ""  CADM
 SG_ LRRF1_CAN_DET_SUPER_RES_TAR_0082 : 240|1@0+ (1,0) [0|1] ""  CADM
 SG_ LRRF1_CAN_DET_SUPER_RES_TAR_0083 : 176|1@0+ (1,0) [0|1] ""  CADM
 SG_ LRRF1_CAN_DET_SUPER_RES_TAR_0084 : 112|1@0+ (1,0) [0|1] ""  CADM
 SG_ LRRF1_CAN_DET_HOST_VEH_CLUT_0079 : 433|1@0+ (1,0) [0|1] ""  CADM
 SG_ LRRF1_CAN_DET_HOST_VEH_CLUT_0080 : 369|1@0+ (1,0) [0|1] ""  CADM
 SG_ LRRF1_CAN_DET_HOST_VEH_CLUT_0081 : 305|1@0+ (1,0) [0|1] ""  CADM
 SG_ LRRF1_CAN_DET_HOST_VEH_CLUT_0082 : 241|1@0+ (1,0) [0|1] ""  CADM
 SG_ LRRF1_CAN_DET_HOST_VEH_CLUT_0083 : 177|1@0+ (1,0) [0|1] ""  CADM
 SG_ LRRF1_CAN_DET_HOST_VEH_CLUT_0084 : 113|1@0+ (1,0) [0|1] ""  CADM
 SG_ LRRF1_CAN_DET_ELEVATION_42 : 447|7@0+ (0.002748,-0.1745) [-0.1745|0.174496] "rad"  CADM
 SG_ LRRF1_CAN_DET_ELEVATION_41 : 383|7@0+ (0.002748,-0.1745) [-0.1745|0.174496] "rad"  CADM
 SG_ LRRF1_CAN_DET_ELEVATION_40 : 319|7@0+ (0.002748,-0.1745) [-0.1745|0.174496] "rad"  CADM
 SG_ LRRF1_CAN_DET_ELEVATION_39 : 255|7@0+ (0.002748,-0.1745) [-0.1745|0.174496] "rad"  CADM
 SG_ LRRF1_CAN_DET_ELEVATION_38 : 191|7@0+ (0.002748,-0.1745) [-0.1745|0.174496] "rad"  CADM
 SG_ LRRF1_CAN_DET_ELEVATION_37 : 127|7@0+ (0.002748,-0.1745) [-0.1745|0.174496] "rad"  CADM
 SG_ LRRF1_CAN_DET_CONFID_ELEVAT_0079 : 440|1@0+ (1,0) [0|1] ""  CADM
 SG_ LRRF1_CAN_DET_CONFID_ELEVAT_0080 : 376|1@0+ (1,0) [0|1] ""  CADM
 SG_ LRRF1_CAN_DET_CONFID_ELEVAT_0081 : 312|1@0+ (1,0) [0|1] ""  CADM
 SG_ LRRF1_CAN_DET_CONFID_ELEVAT_0082 : 248|1@0+ (1,0) [0|1] ""  CADM
 SG_ LRRF1_CAN_DET_CONFID_ELEVAT_0083 : 184|1@0+ (1,0) [0|1] ""  CADM
 SG_ LRRF1_CAN_DET_CONFID_ELEVAT_0084 : 120|1@0+ (1,0) [0|1] ""  CADM
 SG_ LRRF1_CAN_DET_CONFID_AZIMUTH_42 : 417|2@0+ (1,0) [0|3] ""  CADM
 SG_ LRRF1_CAN_DET_CONFID_AZIMUTH_41 : 353|2@0+ (1,0) [0|3] ""  CADM
 SG_ LRRF1_CAN_DET_CONFID_AZIMUTH_40 : 289|2@0+ (1,0) [0|3] ""  CADM
 SG_ LRRF1_CAN_DET_CONFID_AZIMUTH_39 : 225|2@0+ (1,0) [0|3] ""  CADM
 SG_ LRRF1_CAN_DET_CONFID_AZIMUTH_38 : 161|2@0+ (1,0) [0|3] ""  CADM
 SG_ LRRF1_CAN_DET_CONFID_AZIMUTH_37 : 97|2@0+ (1,0) [0|3] ""  CADM
 SG_ LRRF1_CAN_DET_AZIMUTH_42 : 431|14@0+ (0.0003834,-3.1416) [-3.1416|3.1396422] "rad"  CADM
 SG_ LRRF1_CAN_DET_AZIMUTH_41 : 367|14@0+ (0.0003834,-3.1416) [-3.1416|3.1396422] "rad"  CADM
 SG_ LRRF1_CAN_DET_AZIMUTH_40 : 303|14@0+ (0.0003834,-3.1416) [-3.1416|3.1396422] "rad"  CADM
 SG_ LRRF1_CAN_DET_AZIMUTH_39 : 239|14@0+ (0.0003834,-3.1416) [-3.1416|3.1396422] "rad"  CADM
 SG_ LRRF1_CAN_DET_AZIMUTH_38 : 175|14@0+ (0.0003834,-3.1416) [-3.1416|3.1396422] "rad"  CADM
 SG_ LRRF1_CAN_DET_AZIMUTH_37 : 111|14@0+ (0.0003834,-3.1416) [-3.1416|3.1396422] "rad"  CADM
 SG_ LRRF1_CAN_DET_AMPLITUDE_42 : 391|7@0+ (1,-64) [-64|63] "dBsm"  CADM
 SG_ LRRF1_CAN_DET_AMPLITUDE_41 : 327|7@0+ (1,-64) [-64|63] "dBsm"  CADM
 SG_ LRRF1_CAN_DET_AMPLITUDE_40 : 263|7@0+ (1,-64) [-64|63] "dBsm"  CADM
 SG_ LRRF1_CAN_DET_AMPLITUDE_39 : 199|7@0+ (1,-64) [-64|63] "dBsm"  CADM
 SG_ LRRF1_CAN_DET_AMPLITUDE_38 : 135|7@0+ (1,-64) [-64|63] "dBsm"  CADM
 SG_ LRRF1_CAN_DET_AMPLITUDE_37 : 71|7@0+ (1,-64) [-64|63] "dBsm"  CADM
 SG_ LRRF1_CAN_DET_VALID_LEVEL_42 : 384|1@0+ (1,0) [0|1] ""  CADM
 SG_ LRRF1_CAN_DET_VALID_LEVEL_41 : 320|1@0+ (1,0) [0|1] ""  CADM
 SG_ LRRF1_CAN_DET_VALID_LEVEL_40 : 256|1@0+ (1,0) [0|1] ""  CADM
 SG_ LRRF1_CAN_DET_VALID_LEVEL_39 : 192|1@0+ (1,0) [0|1] ""  CADM
 SG_ LRRF1_CAN_DET_VALID_LEVEL_38 : 128|1@0+ (1,0) [0|1] ""  CADM
 SG_ LRRF1_CAN_DET_VALID_LEVEL_37 : 64|1@0+ (1,0) [0|1] ""  CADM

BO_ 78 LRRF1_Detection_029_035: 64 LRRF
 SG_ LRRF1_CAN_DET_Near_TARGET_35 : 454|1@0+ (1,0) [0|1] ""  CADM
 SG_ LRRF1_CAN_DET_Near_TARGET_34 : 453|1@0+ (1,0) [0|1] ""  CADM
 SG_ LRRF1_CAN_DET_Near_TARGET_33 : 452|1@0+ (1,0) [0|1] ""  CADM
 SG_ LRRF1_CAN_DET_Near_TARGET_32 : 451|1@0+ (1,0) [0|1] ""  CADM
 SG_ LRRF1_CAN_DET_Near_TARGET_31 : 450|1@0+ (1,0) [0|1] ""  CADM
 SG_ LRRF1_CAN_DET_Near_TARGET_30 : 449|1@0+ (1,0) [0|1] ""  CADM
 SG_ LRRF1_CAN_DET_Near_TARGET_29 : 448|1@0+ (1,0) [0|1] ""  CADM
 SG_ LRRF1_CAN_DET_ELEVATION_29 : 63|7@0+ (0.002748,-0.1745) [-0.1745|0.174496] "rad"  CADM
 SG_ LRRF1_CAN_DET_CONFID_AZIMUTH_29 : 33|2@0+ (1,0) [0|3] ""  CADM
 SG_ LRRF1_CAN_DET_SUPER_RES_TARGET_2 : 56|1@0+ (1,0) [0|1] ""  CADM
 SG_ LRRF1_CAN_DET_CONFID_ELEVATION_2 : 48|1@0+ (1,0) [0|1] ""  CADM
 SG_ LRRF1_CAN_DET_HOST_VEH_CLUTTER_2 : 49|1@0+ (1,0) [0|1] ""  CADM
 SG_ LRRF1_CAN_DET_VALID_LEVEL_29 : 0|1@0+ (1,0) [0|1] ""  CADM
 SG_ LRRF1_CAN_DET_AZIMUTH_29 : 47|14@0+ (0.0003834,-3.1416) [-3.1416|3.1396422] "rad"  CADM
 SG_ LRRF1_CAN_DET_RANGE_29 : 31|14@0+ (0.015625,0) [0|255.984375] "m"  CADM
 SG_ LRRF1_CAN_DET_RANGE_RATE_29 : 15|14@0+ (0.015625,-128) [-128|127.984375] "m/s"  CADM
 SG_ LRRF1_CAN_DET_AMPLITUDE_29 : 7|7@0+ (1,-64) [-64|63] "dBsm"  CADM
 SG_ LRRF1_CAN_SCAN_INDEX_2LSB_29 : 17|2@0+ (1,0) [0|3] ""  CADM
 SG_ LRRF1_Det_CRC_05 : 503|16@0+ (1,0) [0|65535] ""  CADM
 SG_ LRRF1_Det_MC_05 : 491|4@0+ (1,0) [0|15] ""  CADM
 SG_ LRRF1_CAN_SCAN_INDEX_2LSB_35 : 401|2@0+ (1,0) [0|3] ""  CADM
 SG_ LRRF1_CAN_SCAN_INDEX_2LSB_34 : 337|2@0+ (1,0) [0|3] ""  CADM
 SG_ LRRF1_CAN_SCAN_INDEX_2LSB_33 : 273|2@0+ (1,0) [0|3] ""  CADM
 SG_ LRRF1_CAN_SCAN_INDEX_2LSB_32 : 209|2@0+ (1,0) [0|3] ""  CADM
 SG_ LRRF1_CAN_SCAN_INDEX_2LSB_31 : 145|2@0+ (1,0) [0|3] ""  CADM
 SG_ LRRF1_CAN_SCAN_INDEX_2LSB_30 : 81|2@0+ (1,0) [0|3] ""  CADM
 SG_ LRRF1_CAN_DET_RANGE_RATE_35 : 399|14@0+ (0.015625,-128) [-128|127.984375] "m/s"  CADM
 SG_ LRRF1_CAN_DET_RANGE_RATE_34 : 335|14@0+ (0.015625,-128) [-128|127.984375] "m/s"  CADM
 SG_ LRRF1_CAN_DET_RANGE_RATE_33 : 271|14@0+ (0.015625,-128) [-128|127.984375] "m/s"  CADM
 SG_ LRRF1_CAN_DET_RANGE_RATE_32 : 207|14@0+ (0.015625,-128) [-128|127.984375] "m/s"  CADM
 SG_ LRRF1_CAN_DET_RANGE_RATE_31 : 143|14@0+ (0.015625,-128) [-128|127.984375] "m/s"  CADM
 SG_ LRRF1_CAN_DET_RANGE_RATE_30 : 79|14@0+ (0.015625,-128) [-128|127.984375] "m/s"  CADM
 SG_ LRRF1_CAN_DET_RANGE_35 : 415|14@0+ (0.015625,0) [0|255.984375] "m"  CADM
 SG_ LRRF1_CAN_DET_RANGE_34 : 351|14@0+ (0.015625,0) [0|255.984375] "m"  CADM
 SG_ LRRF1_CAN_DET_RANGE_33 : 287|14@0+ (0.015625,0) [0|255.984375] "m"  CADM
 SG_ LRRF1_CAN_DET_RANGE_32 : 223|14@0+ (0.015625,0) [0|255.984375] "m"  CADM
 SG_ LRRF1_CAN_DET_RANGE_31 : 159|14@0+ (0.015625,0) [0|255.984375] "m"  CADM
 SG_ LRRF1_CAN_DET_RANGE_30 : 95|14@0+ (0.015625,0) [0|255.984375] "m"  CADM
 SG_ LRRF1_CAN_DET_SUPER_RES_TAR_0085 : 432|1@0+ (1,0) [0|1] ""  CADM
 SG_ LRRF1_CAN_DET_SUPER_RES_TAR_0086 : 368|1@0+ (1,0) [0|1] ""  CADM
 SG_ LRRF1_CAN_DET_SUPER_RES_TAR_0087 : 304|1@0+ (1,0) [0|1] ""  CADM
 SG_ LRRF1_CAN_DET_SUPER_RES_TAR_0088 : 240|1@0+ (1,0) [0|1] ""  CADM
 SG_ LRRF1_CAN_DET_SUPER_RES_TAR_0089 : 176|1@0+ (1,0) [0|1] ""  CADM
 SG_ LRRF1_CAN_DET_SUPER_RES_TAR_0090 : 112|1@0+ (1,0) [0|1] ""  CADM
 SG_ LRRF1_CAN_DET_HOST_VEH_CLUT_0085 : 433|1@0+ (1,0) [0|1] ""  CADM
 SG_ LRRF1_CAN_DET_HOST_VEH_CLUT_0086 : 369|1@0+ (1,0) [0|1] ""  CADM
 SG_ LRRF1_CAN_DET_HOST_VEH_CLUT_0087 : 305|1@0+ (1,0) [0|1] ""  CADM
 SG_ LRRF1_CAN_DET_HOST_VEH_CLUT_0088 : 241|1@0+ (1,0) [0|1] ""  CADM
 SG_ LRRF1_CAN_DET_HOST_VEH_CLUT_0089 : 177|1@0+ (1,0) [0|1] ""  CADM
 SG_ LRRF1_CAN_DET_HOST_VEH_CLUT_0090 : 113|1@0+ (1,0) [0|1] ""  CADM
 SG_ LRRF1_CAN_DET_ELEVATION_35 : 447|7@0+ (0.002748,-0.1745) [-0.1745|0.174496] "rad"  CADM
 SG_ LRRF1_CAN_DET_ELEVATION_34 : 383|7@0+ (0.002748,-0.1745) [-0.1745|0.174496] "rad"  CADM
 SG_ LRRF1_CAN_DET_ELEVATION_33 : 319|7@0+ (0.002748,-0.1745) [-0.1745|0.174496] "rad"  CADM
 SG_ LRRF1_CAN_DET_ELEVATION_32 : 255|7@0+ (0.002748,-0.1745) [-0.1745|0.174496] "rad"  CADM
 SG_ LRRF1_CAN_DET_ELEVATION_31 : 191|7@0+ (0.002748,-0.1745) [-0.1745|0.174496] "rad"  CADM
 SG_ LRRF1_CAN_DET_ELEVATION_30 : 127|7@0+ (0.002748,-0.1745) [-0.1745|0.174496] "rad"  CADM
 SG_ LRRF1_CAN_DET_CONFID_ELEVAT_0085 : 440|1@0+ (1,0) [0|1] ""  CADM
 SG_ LRRF1_CAN_DET_CONFID_ELEVAT_0086 : 376|1@0+ (1,0) [0|1] ""  CADM
 SG_ LRRF1_CAN_DET_CONFID_ELEVAT_0087 : 312|1@0+ (1,0) [0|1] ""  CADM
 SG_ LRRF1_CAN_DET_CONFID_ELEVAT_0088 : 248|1@0+ (1,0) [0|1] ""  CADM
 SG_ LRRF1_CAN_DET_CONFID_ELEVAT_0089 : 184|1@0+ (1,0) [0|1] ""  CADM
 SG_ LRRF1_CAN_DET_CONFID_ELEVAT_0090 : 120|1@0+ (1,0) [0|1] ""  CADM
 SG_ LRRF1_CAN_DET_CONFID_AZIMUTH_35 : 417|2@0+ (1,0) [0|3] ""  CADM
 SG_ LRRF1_CAN_DET_CONFID_AZIMUTH_34 : 353|2@0+ (1,0) [0|3] ""  CADM
 SG_ LRRF1_CAN_DET_CONFID_AZIMUTH_33 : 289|2@0+ (1,0) [0|3] ""  CADM
 SG_ LRRF1_CAN_DET_CONFID_AZIMUTH_32 : 225|2@0+ (1,0) [0|3] ""  CADM
 SG_ LRRF1_CAN_DET_CONFID_AZIMUTH_31 : 161|2@0+ (1,0) [0|3] ""  CADM
 SG_ LRRF1_CAN_DET_CONFID_AZIMUTH_30 : 97|2@0+ (1,0) [0|3] ""  CADM
 SG_ LRRF1_CAN_DET_AZIMUTH_35 : 431|14@0+ (0.0003834,-3.1416) [-3.1416|3.1396422] "rad"  CADM
 SG_ LRRF1_CAN_DET_AZIMUTH_34 : 367|14@0+ (0.0003834,-3.1416) [-3.1416|3.1396422] "rad"  CADM
 SG_ LRRF1_CAN_DET_AZIMUTH_33 : 303|14@0+ (0.0003834,-3.1416) [-3.1416|3.1396422] "rad"  CADM
 SG_ LRRF1_CAN_DET_AZIMUTH_32 : 239|14@0+ (0.0003834,-3.1416) [-3.1416|3.1396422] "rad"  CADM
 SG_ LRRF1_CAN_DET_AZIMUTH_31 : 175|14@0+ (0.0003834,-3.1416) [-3.1416|3.1396422] "rad"  CADM
 SG_ LRRF1_CAN_DET_AZIMUTH_30 : 111|14@0+ (0.0003834,-3.1416) [-3.1416|3.1396422] "rad"  CADM
 SG_ LRRF1_CAN_DET_AMPLITUDE_35 : 391|7@0+ (1,-64) [-64|63] "dBsm"  CADM
 SG_ LRRF1_CAN_DET_AMPLITUDE_34 : 327|7@0+ (1,-64) [-64|63] "dBsm"  CADM
 SG_ LRRF1_CAN_DET_AMPLITUDE_33 : 263|7@0+ (1,-64) [-64|63] "dBsm"  CADM
 SG_ LRRF1_CAN_DET_AMPLITUDE_32 : 199|7@0+ (1,-64) [-64|63] "dBsm"  CADM
 SG_ LRRF1_CAN_DET_AMPLITUDE_31 : 135|7@0+ (1,-64) [-64|63] "dBsm"  CADM
 SG_ LRRF1_CAN_DET_AMPLITUDE_30 : 71|7@0+ (1,-64) [-64|63] "dBsm"  CADM
 SG_ LRRF1_CAN_DET_VALID_LEVEL_35 : 384|1@0+ (1,0) [0|1] ""  CADM
 SG_ LRRF1_CAN_DET_VALID_LEVEL_34 : 320|1@0+ (1,0) [0|1] ""  CADM
 SG_ LRRF1_CAN_DET_VALID_LEVEL_33 : 256|1@0+ (1,0) [0|1] ""  CADM
 SG_ LRRF1_CAN_DET_VALID_LEVEL_32 : 192|1@0+ (1,0) [0|1] ""  CADM
 SG_ LRRF1_CAN_DET_VALID_LEVEL_31 : 128|1@0+ (1,0) [0|1] ""  CADM
 SG_ LRRF1_CAN_DET_VALID_LEVEL_30 : 64|1@0+ (1,0) [0|1] ""  CADM

BO_ 77 LRRF1_Detection_022_028: 64 LRRF
 SG_ LRRF1_CAN_DET_Near_TARGET_28 : 454|1@0+ (1,0) [0|1] ""  CADM
 SG_ LRRF1_CAN_DET_Near_TARGET_27 : 453|1@0+ (1,0) [0|1] ""  CADM
 SG_ LRRF1_CAN_DET_Near_TARGET_26 : 452|1@0+ (1,0) [0|1] ""  CADM
 SG_ LRRF1_CAN_DET_Near_TARGET_25 : 451|1@0+ (1,0) [0|1] ""  CADM
 SG_ LRRF1_CAN_DET_Near_TARGET_24 : 450|1@0+ (1,0) [0|1] ""  CADM
 SG_ LRRF1_CAN_DET_Near_TARGET_23 : 449|1@0+ (1,0) [0|1] ""  CADM
 SG_ LRRF1_CAN_DET_Near_TARGET_22 : 448|1@0+ (1,0) [0|1] ""  CADM
 SG_ LRRF1_CAN_DET_ELEVATION_22 : 63|7@0+ (0.002748,-0.1745) [-0.1745|0.174496] "rad"  CADM
 SG_ LRRF1_CAN_DET_CONFID_AZIMUTH_22 : 33|2@0+ (1,0) [0|3] ""  CADM
 SG_ LRRF1_CAN_DET_SUPER_RES_TAR_0091 : 56|1@0+ (1,0) [0|1] ""  CADM
 SG_ LRRF1_CAN_DET_CONFID_ELEVAT_0091 : 48|1@0+ (1,0) [0|1] ""  CADM
 SG_ LRRF1_CAN_DET_HOST_VEH_CLUT_0091 : 49|1@0+ (1,0) [0|1] ""  CADM
 SG_ LRRF1_CAN_DET_VALID_LEVEL_22 : 0|1@0+ (1,0) [0|1] ""  CADM
 SG_ LRRF1_CAN_DET_AZIMUTH_22 : 47|14@0+ (0.0003834,-3.1416) [-3.1416|3.1396422] "rad"  CADM
 SG_ LRRF1_CAN_DET_RANGE_22 : 31|14@0+ (0.015625,0) [0|255.984375] "m"  CADM
 SG_ LRRF1_CAN_DET_RANGE_RATE_22 : 15|14@0+ (0.015625,-128) [-128|127.984375] "m/s"  CADM
 SG_ LRRF1_CAN_DET_AMPLITUDE_22 : 7|7@0+ (1,-64) [-64|63] "dBsm"  CADM
 SG_ LRRF1_CAN_SCAN_INDEX_2LSB_22 : 17|2@0+ (1,0) [0|3] ""  CADM
 SG_ LRRF1_Det_CRC_04 : 503|16@0+ (1,0) [0|65535] ""  CADM
 SG_ LRRF1_Det_MC_04 : 491|4@0+ (1,0) [0|15] ""  CADM
 SG_ LRRF1_CAN_SCAN_INDEX_2LSB_28 : 401|2@0+ (1,0) [0|3] ""  CADM
 SG_ LRRF1_CAN_SCAN_INDEX_2LSB_27 : 337|2@0+ (1,0) [0|3] ""  CADM
 SG_ LRRF1_CAN_SCAN_INDEX_2LSB_26 : 273|2@0+ (1,0) [0|3] ""  CADM
 SG_ LRRF1_CAN_SCAN_INDEX_2LSB_25 : 209|2@0+ (1,0) [0|3] ""  CADM
 SG_ LRRF1_CAN_SCAN_INDEX_2LSB_24 : 145|2@0+ (1,0) [0|3] ""  CADM
 SG_ LRRF1_CAN_SCAN_INDEX_2LSB_23 : 81|2@0+ (1,0) [0|3] ""  CADM
 SG_ LRRF1_CAN_DET_RANGE_RATE_28 : 399|14@0+ (0.015625,-128) [-128|127.984375] "m/s"  CADM
 SG_ LRRF1_CAN_DET_RANGE_RATE_27 : 335|14@0+ (0.015625,-128) [-128|127.984375] "m/s"  CADM
 SG_ LRRF1_CAN_DET_RANGE_RATE_26 : 271|14@0+ (0.015625,-128) [-128|127.984375] "m/s"  CADM
 SG_ LRRF1_CAN_DET_RANGE_RATE_25 : 207|14@0+ (0.015625,-128) [-128|127.984375] "m/s"  CADM
 SG_ LRRF1_CAN_DET_RANGE_RATE_24 : 143|14@0+ (0.015625,-128) [-128|127.984375] "m/s"  CADM
 SG_ LRRF1_CAN_DET_RANGE_RATE_23 : 79|14@0+ (0.015625,-128) [-128|127.984375] "m/s"  CADM
 SG_ LRRF1_CAN_DET_RANGE_28 : 415|14@0+ (0.015625,0) [0|255.984375] "m"  CADM
 SG_ LRRF1_CAN_DET_RANGE_27 : 351|14@0+ (0.015625,0) [0|255.984375] "m"  CADM
 SG_ LRRF1_CAN_DET_RANGE_26 : 287|14@0+ (0.015625,0) [0|255.984375] "m"  CADM
 SG_ LRRF1_CAN_DET_RANGE_25 : 223|14@0+ (0.015625,0) [0|255.984375] "m"  CADM
 SG_ LRRF1_CAN_DET_RANGE_24 : 159|14@0+ (0.015625,0) [0|255.984375] "m"  CADM
 SG_ LRRF1_CAN_DET_RANGE_23 : 95|14@0+ (0.015625,0) [0|255.984375] "m"  CADM
 SG_ LRRF1_CAN_DET_SUPER_RES_TAR_0092 : 432|1@0+ (1,0) [0|1] ""  CADM
 SG_ LRRF1_CAN_DET_SUPER_RES_TAR_0093 : 368|1@0+ (1,0) [0|1] ""  CADM
 SG_ LRRF1_CAN_DET_SUPER_RES_TAR_0094 : 304|1@0+ (1,0) [0|1] ""  CADM
 SG_ LRRF1_CAN_DET_SUPER_RES_TAR_0095 : 240|1@0+ (1,0) [0|1] ""  CADM
 SG_ LRRF1_CAN_DET_SUPER_RES_TAR_0096 : 176|1@0+ (1,0) [0|1] ""  CADM
 SG_ LRRF1_CAN_DET_SUPER_RES_TAR_0097 : 112|1@0+ (1,0) [0|1] ""  CADM
 SG_ LRRF1_CAN_DET_HOST_VEH_CLUT_0092 : 433|1@0+ (1,0) [0|1] ""  CADM
 SG_ LRRF1_CAN_DET_HOST_VEH_CLUT_0093 : 369|1@0+ (1,0) [0|1] ""  CADM
 SG_ LRRF1_CAN_DET_HOST_VEH_CLUT_0094 : 305|1@0+ (1,0) [0|1] ""  CADM
 SG_ LRRF1_CAN_DET_HOST_VEH_CLUT_0095 : 241|1@0+ (1,0) [0|1] ""  CADM
 SG_ LRRF1_CAN_DET_HOST_VEH_CLUT_0096 : 177|1@0+ (1,0) [0|1] ""  CADM
 SG_ LRRF1_CAN_DET_HOST_VEH_CLUT_0097 : 113|1@0+ (1,0) [0|1] ""  CADM
 SG_ LRRF1_CAN_DET_ELEVATION_28 : 447|7@0+ (0.002748,-0.1745) [-0.1745|0.174496] "rad"  CADM
 SG_ LRRF1_CAN_DET_ELEVATION_27 : 383|7@0+ (0.002748,-0.1745) [-0.1745|0.174496] "rad"  CADM
 SG_ LRRF1_CAN_DET_ELEVATION_26 : 319|7@0+ (0.002748,-0.1745) [-0.1745|0.174496] "rad"  CADM
 SG_ LRRF1_CAN_DET_ELEVATION_25 : 255|7@0+ (0.002748,-0.1745) [-0.1745|0.174496] "rad"  CADM
 SG_ LRRF1_CAN_DET_ELEVATION_24 : 191|7@0+ (0.002748,-0.1745) [-0.1745|0.174496] "rad"  CADM
 SG_ LRRF1_CAN_DET_ELEVATION_23 : 127|7@0+ (0.002748,-0.1745) [-0.1745|0.174496] "rad"  CADM
 SG_ LRRF1_CAN_DET_CONFID_ELEVAT_0092 : 440|1@0+ (1,0) [0|1] ""  CADM
 SG_ LRRF1_CAN_DET_CONFID_ELEVAT_0093 : 376|1@0+ (1,0) [0|1] ""  CADM
 SG_ LRRF1_CAN_DET_CONFID_ELEVAT_0094 : 312|1@0+ (1,0) [0|1] ""  CADM
 SG_ LRRF1_CAN_DET_CONFID_ELEVAT_0095 : 248|1@0+ (1,0) [0|1] ""  CADM
 SG_ LRRF1_CAN_DET_CONFID_ELEVAT_0096 : 184|1@0+ (1,0) [0|1] ""  CADM
 SG_ LRRF1_CAN_DET_CONFID_ELEVAT_0097 : 120|1@0+ (1,0) [0|1] ""  CADM
 SG_ LRRF1_CAN_DET_CONFID_AZIMUTH_28 : 417|2@0+ (1,0) [0|3] ""  CADM
 SG_ LRRF1_CAN_DET_CONFID_AZIMUTH_27 : 353|2@0+ (1,0) [0|3] ""  CADM
 SG_ LRRF1_CAN_DET_CONFID_AZIMUTH_26 : 289|2@0+ (1,0) [0|3] ""  CADM
 SG_ LRRF1_CAN_DET_CONFID_AZIMUTH_25 : 225|2@0+ (1,0) [0|3] ""  CADM
 SG_ LRRF1_CAN_DET_CONFID_AZIMUTH_24 : 161|2@0+ (1,0) [0|3] ""  CADM
 SG_ LRRF1_CAN_DET_CONFID_AZIMUTH_23 : 97|2@0+ (1,0) [0|3] ""  CADM
 SG_ LRRF1_CAN_DET_AZIMUTH_28 : 431|14@0+ (0.0003834,-3.1416) [-3.1416|3.1396422] "rad"  CADM
 SG_ LRRF1_CAN_DET_AZIMUTH_27 : 367|14@0+ (0.0003834,-3.1416) [-3.1416|3.1396422] "rad"  CADM
 SG_ LRRF1_CAN_DET_AZIMUTH_26 : 303|14@0+ (0.0003834,-3.1416) [-3.1416|3.1396422] "rad"  CADM
 SG_ LRRF1_CAN_DET_AZIMUTH_25 : 239|14@0+ (0.0003834,-3.1416) [-3.1416|3.1396422] "rad"  CADM
 SG_ LRRF1_CAN_DET_AZIMUTH_24 : 175|14@0+ (0.0003834,-3.1416) [-3.1416|3.1396422] "rad"  CADM
 SG_ LRRF1_CAN_DET_AZIMUTH_23 : 111|14@0+ (0.0003834,-3.1416) [-3.1416|3.1396422] "rad"  CADM
 SG_ LRRF1_CAN_DET_AMPLITUDE_28 : 391|7@0+ (1,-64) [-64|63] "dBsm"  CADM
 SG_ LRRF1_CAN_DET_AMPLITUDE_27 : 327|7@0+ (1,-64) [-64|63] "dBsm"  CADM
 SG_ LRRF1_CAN_DET_AMPLITUDE_26 : 263|7@0+ (1,-64) [-64|63] "dBsm"  CADM
 SG_ LRRF1_CAN_DET_AMPLITUDE_25 : 199|7@0+ (1,-64) [-64|63] "dBsm"  CADM
 SG_ LRRF1_CAN_DET_AMPLITUDE_24 : 135|7@0+ (1,-64) [-64|63] "dBsm"  CADM
 SG_ LRRF1_CAN_DET_AMPLITUDE_23 : 71|7@0+ (1,-64) [-64|63] "dBsm"  CADM
 SG_ LRRF1_CAN_DET_VALID_LEVEL_28 : 384|1@0+ (1,0) [0|1] ""  CADM
 SG_ LRRF1_CAN_DET_VALID_LEVEL_27 : 320|1@0+ (1,0) [0|1] ""  CADM
 SG_ LRRF1_CAN_DET_VALID_LEVEL_26 : 256|1@0+ (1,0) [0|1] ""  CADM
 SG_ LRRF1_CAN_DET_VALID_LEVEL_25 : 192|1@0+ (1,0) [0|1] ""  CADM
 SG_ LRRF1_CAN_DET_VALID_LEVEL_24 : 128|1@0+ (1,0) [0|1] ""  CADM
 SG_ LRRF1_CAN_DET_VALID_LEVEL_23 : 64|1@0+ (1,0) [0|1] ""  CADM

BO_ 76 LRRF1_Detection_015_021: 64 LRRF
 SG_ LRRF1_CAN_DET_Near_TARGET_21 : 454|1@0+ (1,0) [0|1] ""  CADM
 SG_ LRRF1_CAN_DET_Near_TARGET_20 : 453|1@0+ (1,0) [0|1] ""  CADM
 SG_ LRRF1_CAN_DET_Near_TARGET_19 : 452|1@0+ (1,0) [0|1] ""  CADM
 SG_ LRRF1_CAN_DET_Near_TARGET_18 : 451|1@0+ (1,0) [0|1] ""  CADM
 SG_ LRRF1_CAN_DET_Near_TARGET_17 : 450|1@0+ (1,0) [0|1] ""  CADM
 SG_ LRRF1_CAN_DET_Near_TARGET_16 : 449|1@0+ (1,0) [0|1] ""  CADM
 SG_ LRRF1_CAN_DET_Near_TARGET_15 : 448|1@0+ (1,0) [0|1] ""  CADM
 SG_ LRRF1_CAN_DET_ELEVATION_15 : 63|7@0+ (0.002748,-0.1745) [-0.1745|0.174496] "rad"  CADM
 SG_ LRRF1_CAN_DET_CONFID_AZIMUTH_15 : 33|2@0+ (1,0) [0|3] ""  CADM
 SG_ LRRF1_CAN_DET_SUPER_RES_TAR_0098 : 56|1@0+ (1,0) [0|1] ""  CADM
 SG_ LRRF1_CAN_DET_CONFID_ELEVAT_0098 : 48|1@0+ (1,0) [0|1] ""  CADM
 SG_ LRRF1_CAN_DET_HOST_VEH_CLUT_0098 : 49|1@0+ (1,0) [0|1] ""  CADM
 SG_ LRRF1_CAN_DET_VALID_LEVEL_15 : 0|1@0+ (1,0) [0|1] ""  CADM
 SG_ LRRF1_CAN_DET_AZIMUTH_15 : 47|14@0+ (0.0003834,-3.1416) [-3.1416|3.1396422] "rad"  CADM
 SG_ LRRF1_CAN_DET_RANGE_15 : 31|14@0+ (0.015625,0) [0|255.984375] "m"  CADM
 SG_ LRRF1_CAN_DET_RANGE_RATE_15 : 15|14@0+ (0.015625,-128) [-128|127.984375] "m/s"  CADM
 SG_ LRRF1_CAN_DET_AMPLITUDE_15 : 7|7@0+ (1,-64) [-64|63] "dBsm"  CADM
 SG_ LRRF1_CAN_SCAN_INDEX_2LSB_15 : 17|2@0+ (1,0) [0|3] ""  CADM
 SG_ LRRF1_Det_CRC_03 : 503|16@0+ (1,0) [0|65535] ""  CADM
 SG_ LRRF1_Det_MC_03 : 491|4@0+ (1,0) [0|15] ""  CADM
 SG_ LRRF1_CAN_SCAN_INDEX_2LSB_21 : 401|2@0+ (1,0) [0|3] ""  CADM
 SG_ LRRF1_CAN_SCAN_INDEX_2LSB_20 : 337|2@0+ (1,0) [0|3] ""  CADM
 SG_ LRRF1_CAN_SCAN_INDEX_2LSB_19 : 273|2@0+ (1,0) [0|3] ""  CADM
 SG_ LRRF1_CAN_SCAN_INDEX_2LSB_18 : 209|2@0+ (1,0) [0|3] ""  CADM
 SG_ LRRF1_CAN_SCAN_INDEX_2LSB_17 : 145|2@0+ (1,0) [0|3] ""  CADM
 SG_ LRRF1_CAN_SCAN_INDEX_2LSB_16 : 81|2@0+ (1,0) [0|3] ""  CADM
 SG_ LRRF1_CAN_DET_RANGE_RATE_21 : 399|14@0+ (0.015625,-128) [-128|127.984375] "m/s"  CADM
 SG_ LRRF1_CAN_DET_RANGE_RATE_20 : 335|14@0+ (0.015625,-128) [-128|127.984375] "m/s"  CADM
 SG_ LRRF1_CAN_DET_RANGE_RATE_19 : 271|14@0+ (0.015625,-128) [-128|127.984375] "m/s"  CADM
 SG_ LRRF1_CAN_DET_RANGE_RATE_18 : 207|14@0+ (0.015625,-128) [-128|127.984375] "m/s"  CADM
 SG_ LRRF1_CAN_DET_RANGE_RATE_17 : 143|14@0+ (0.015625,-128) [-128|127.984375] "m/s"  CADM
 SG_ LRRF1_CAN_DET_RANGE_RATE_16 : 79|14@0+ (0.015625,-128) [-128|127.984375] "m/s"  CADM
 SG_ LRRF1_CAN_DET_RANGE_21 : 415|14@0+ (0.015625,0) [0|255.984375] "m"  CADM
 SG_ LRRF1_CAN_DET_RANGE_20 : 351|14@0+ (0.015625,0) [0|255.984375] "m"  CADM
 SG_ LRRF1_CAN_DET_RANGE_19 : 287|14@0+ (0.015625,0) [0|255.984375] "m"  CADM
 SG_ LRRF1_CAN_DET_RANGE_18 : 223|14@0+ (0.015625,0) [0|255.984375] "m"  CADM
 SG_ LRRF1_CAN_DET_RANGE_17 : 159|14@0+ (0.015625,0) [0|255.984375] "m"  CADM
 SG_ LRRF1_CAN_DET_RANGE_16 : 95|14@0+ (0.015625,0) [0|255.984375] "m"  CADM
 SG_ LRRF1_CAN_DET_SUPER_RES_TAR_0099 : 432|1@0+ (1,0) [0|1] ""  CADM
 SG_ LRRF1_CAN_DET_SUPER_RES_TAR_0100 : 368|1@0+ (1,0) [0|1] ""  CADM
 SG_ LRRF1_CAN_DET_SUPER_RES_TAR_0101 : 304|1@0+ (1,0) [0|1] ""  CADM
 SG_ LRRF1_CAN_DET_SUPER_RES_TAR_0102 : 240|1@0+ (1,0) [0|1] ""  CADM
 SG_ LRRF1_CAN_DET_SUPER_RES_TAR_0103 : 176|1@0+ (1,0) [0|1] ""  CADM
 SG_ LRRF1_CAN_DET_SUPER_RES_TAR_0104 : 112|1@0+ (1,0) [0|1] ""  CADM
 SG_ LRRF1_CAN_DET_HOST_VEH_CLUT_0099 : 433|1@0+ (1,0) [0|1] ""  CADM
 SG_ LRRF1_CAN_DET_HOST_VEH_CLUT_0100 : 369|1@0+ (1,0) [0|1] ""  CADM
 SG_ LRRF1_CAN_DET_HOST_VEH_CLUT_0101 : 305|1@0+ (1,0) [0|1] ""  CADM
 SG_ LRRF1_CAN_DET_HOST_VEH_CLUT_0102 : 241|1@0+ (1,0) [0|1] ""  CADM
 SG_ LRRF1_CAN_DET_HOST_VEH_CLUT_0103 : 177|1@0+ (1,0) [0|1] ""  CADM
 SG_ LRRF1_CAN_DET_HOST_VEH_CLUT_0104 : 113|1@0+ (1,0) [0|1] ""  CADM
 SG_ LRRF1_CAN_DET_ELEVATION_21 : 447|7@0+ (0.002748,-0.1745) [-0.1745|0.174496] "rad"  CADM
 SG_ LRRF1_CAN_DET_ELEVATION_20 : 383|7@0+ (0.002748,-0.1745) [-0.1745|0.174496] "rad"  CADM
 SG_ LRRF1_CAN_DET_ELEVATION_19 : 319|7@0+ (0.002748,-0.1745) [-0.1745|0.174496] "rad"  CADM
 SG_ LRRF1_CAN_DET_ELEVATION_18 : 255|7@0+ (0.002748,-0.1745) [-0.1745|0.174496] "rad"  CADM
 SG_ LRRF1_CAN_DET_ELEVATION_17 : 191|7@0+ (0.002748,-0.1745) [-0.1745|0.174496] "rad"  CADM
 SG_ LRRF1_CAN_DET_ELEVATION_16 : 127|7@0+ (0.002748,-0.1745) [-0.1745|0.174496] "rad"  CADM
 SG_ LRRF1_CAN_DET_CONFID_ELEVAT_0099 : 440|1@0+ (1,0) [0|1] ""  CADM
 SG_ LRRF1_CAN_DET_CONFID_ELEVAT_0100 : 376|1@0+ (1,0) [0|1] ""  CADM
 SG_ LRRF1_CAN_DET_CONFID_ELEVAT_0101 : 312|1@0+ (1,0) [0|1] ""  CADM
 SG_ LRRF1_CAN_DET_CONFID_ELEVAT_0102 : 248|1@0+ (1,0) [0|1] ""  CADM
 SG_ LRRF1_CAN_DET_CONFID_ELEVAT_0103 : 184|1@0+ (1,0) [0|1] ""  CADM
 SG_ LRRF1_CAN_DET_CONFID_ELEVAT_0104 : 120|1@0+ (1,0) [0|1] ""  CADM
 SG_ LRRF1_CAN_DET_CONFID_AZIMUTH_21 : 417|2@0+ (1,0) [0|3] ""  CADM
 SG_ LRRF1_CAN_DET_CONFID_AZIMUTH_20 : 353|2@0+ (1,0) [0|3] ""  CADM
 SG_ LRRF1_CAN_DET_CONFID_AZIMUTH_19 : 289|2@0+ (1,0) [0|3] ""  CADM
 SG_ LRRF1_CAN_DET_CONFID_AZIMUTH_18 : 225|2@0+ (1,0) [0|3] ""  CADM
 SG_ LRRF1_CAN_DET_CONFID_AZIMUTH_17 : 161|2@0+ (1,0) [0|3] ""  CADM
 SG_ LRRF1_CAN_DET_CONFID_AZIMUTH_16 : 97|2@0+ (1,0) [0|3] ""  CADM
 SG_ LRRF1_CAN_DET_AZIMUTH_21 : 431|14@0+ (0.0003834,-3.1416) [-3.1416|3.1396422] "rad"  CADM
 SG_ LRRF1_CAN_DET_AZIMUTH_20 : 367|14@0+ (0.0003834,-3.1416) [-3.1416|3.1396422] "rad"  CADM
 SG_ LRRF1_CAN_DET_AZIMUTH_19 : 303|14@0+ (0.0003834,-3.1416) [-3.1416|3.1396422] "rad"  CADM
 SG_ LRRF1_CAN_DET_AZIMUTH_18 : 239|14@0+ (0.0003834,-3.1416) [-3.1416|3.1396422] "rad"  CADM
 SG_ LRRF1_CAN_DET_AZIMUTH_17 : 175|14@0+ (0.0003834,-3.1416) [-3.1416|3.1396422] "rad"  CADM
 SG_ LRRF1_CAN_DET_AZIMUTH_16 : 111|14@0+ (0.0003834,-3.1416) [-3.1416|3.1396422] "rad"  CADM
 SG_ LRRF1_CAN_DET_AMPLITUDE_21 : 391|7@0+ (1,-64) [-64|63] "dBsm"  CADM
 SG_ LRRF1_CAN_DET_AMPLITUDE_20 : 327|7@0+ (1,-64) [-64|63] "dBsm"  CADM
 SG_ LRRF1_CAN_DET_AMPLITUDE_19 : 263|7@0+ (1,-64) [-64|63] "dBsm"  CADM
 SG_ LRRF1_CAN_DET_AMPLITUDE_18 : 199|7@0+ (1,-64) [-64|63] "dBsm"  CADM
 SG_ LRRF1_CAN_DET_AMPLITUDE_17 : 135|7@0+ (1,-64) [-64|63] "dBsm"  CADM
 SG_ LRRF1_CAN_DET_AMPLITUDE_16 : 71|7@0+ (1,-64) [-64|63] "dBsm"  CADM
 SG_ LRRF1_CAN_DET_VALID_LEVEL_21 : 384|1@0+ (1,0) [0|1] ""  CADM
 SG_ LRRF1_CAN_DET_VALID_LEVEL_20 : 320|1@0+ (1,0) [0|1] ""  CADM
 SG_ LRRF1_CAN_DET_VALID_LEVEL_19 : 256|1@0+ (1,0) [0|1] ""  CADM
 SG_ LRRF1_CAN_DET_VALID_LEVEL_18 : 192|1@0+ (1,0) [0|1] ""  CADM
 SG_ LRRF1_CAN_DET_VALID_LEVEL_17 : 128|1@0+ (1,0) [0|1] ""  CADM
 SG_ LRRF1_CAN_DET_VALID_LEVEL_16 : 64|1@0+ (1,0) [0|1] ""  CADM

BA_DEF_ SG_  "NWM_WakeupAllowed" ENUM  "0 No","1 Yes";
BA_DEF_ BO_  "GenMsgTimeoutTime" INT 0 2500;
BA_DEF_ BO_  "WakeupMessage" ENUM  "0 No","1 Yes";
BA_DEF_ SG_  "SignalDescription" STRING ;
BA_DEF_ SG_  "GenSigTimeoutTime_ABS_ESC" INT 0 100000;
BA_DEF_ SG_  "UsedOnPgmDBC" ENUM  "No","Yes";
BA_DEF_ BO_  "VFrameFormat" ENUM  "StandardCAN","ExtendedCAN","reserved","reserved","reserved","reserved","reserved","reserved","reserved","reserved","reserved","reserved","reserved","reserved","StandardCAN_FD","ExtendedCAN_FD";
BA_DEF_ BO_  "DiagConnection" INT 0 65535;
BA_DEF_ BO_  "CanTpBs" INT 0 255;
BA_DEF_ BO_  "EventRateOfChange" INT 10 10000;
BA_DEF_ BO_  "DiagState" ENUM  "No","Yes";
BA_DEF_ BO_  "DiagRequest" ENUM  "No","Yes";
BA_DEF_ BO_  "DiagResponse" ENUM  "No","Yes";
BA_DEF_ SG_  "GenSigCycleTime" INT 0 0;
BA_DEF_ SG_  "GenSigMarked" STRING ;
BA_DEF_ SG_  "GenSigVtName" STRING ;
BA_DEF_ SG_  "GenSigVtEn" STRING ;
BA_DEF_ SG_  "GenSigCmt" STRING ;
BA_DEF_ SG_  "GenSigSendType" ENUM  "Cyclic","OnWrite","vector_leerstring","OnChange","vector_leerstring","IfActive","vector_leerstring","NoSigSendType";
BA_DEF_ SG_  "GenSigInactiveValue" INT 0 100000;
BA_DEF_ SG_  "GenSigMissingSourceValue" INT 0 1000000000;
BA_DEF_ SG_  "GenSigStartValue" INT 0 1000000000;
BA_DEF_ BO_  "GenMsgILSupport" ENUM  "No","Yes";
BA_DEF_ BO_  "GenMsgSendType" ENUM  "FixedPeriodic","Event","EnabledPeriodic","NotUsed","NotUsed","EventPeriodic","NotUsed","NotUsed","NoMsgSendType";
BA_DEF_ BO_  "GenMsgCycleTime" INT 0 100000;
BA_DEF_ BO_  "GenMsgDelayTime" INT 0 10000;
BA_DEF_ BO_  "GenMsgNrOfRepetition" INT 0 100;
BA_DEF_ BO_  "GenMsgStartDelayTime" INT 0 10000;
BA_DEF_ BO_  "NetworkInitialization" ENUM  "No","Yes";
BA_DEF_ SG_  "SystemSignalLongSymbol" STRING ;
BA_DEF_DEF_  "NWM_WakeupAllowed" "0 No";
BA_DEF_DEF_  "GenMsgTimeoutTime" 2500;
BA_DEF_DEF_  "WakeupMessage" "0 No";
BA_DEF_DEF_  "SignalDescription" "";
BA_DEF_DEF_  "GenSigTimeoutTime_ABS_ESC" 0;
BA_DEF_DEF_  "UsedOnPgmDBC" "Yes";
BA_DEF_DEF_  "VFrameFormat" "StandardCAN_FD";
BA_DEF_DEF_  "DiagConnection" 0;
BA_DEF_DEF_  "CanTpBs" 255;
BA_DEF_DEF_  "EventRateOfChange" 10000;
BA_DEF_DEF_  "DiagState" "No";
BA_DEF_DEF_  "DiagRequest" "No";
BA_DEF_DEF_  "DiagResponse" "No";
BA_DEF_DEF_  "GenSigCycleTime" 0;
BA_DEF_DEF_  "GenSigMarked" "";
BA_DEF_DEF_  "GenSigVtName" "";
BA_DEF_DEF_  "GenSigVtEn" "";
BA_DEF_DEF_  "GenSigCmt" "";
BA_DEF_DEF_  "GenSigSendType" "NoSigSendType";
BA_DEF_DEF_  "GenSigInactiveValue" 0;
BA_DEF_DEF_  "GenSigMissingSourceValue" 0;
BA_DEF_DEF_  "GenSigStartValue" 0;
BA_DEF_DEF_  "GenMsgILSupport" "Yes";
BA_DEF_DEF_  "GenMsgSendType" "NoMsgSendType";
BA_DEF_DEF_  "GenMsgCycleTime" 0;
BA_DEF_DEF_  "GenMsgDelayTime" 0;
BA_DEF_DEF_  "GenMsgNrOfRepetition" 0;
BA_DEF_DEF_  "GenMsgStartDelayTime" 0;
BA_DEF_DEF_  "NetworkInitialization" "No";
BA_DEF_DEF_  "SystemSignalLongSymbol" "";
BA_ "GenMsgTimeoutTime" BO_ 84 0;
BA_ "GenMsgSendType" BO_ 84 1;
BA_ "GenMsgTimeoutTime" BO_ 83 0;
BA_ "GenMsgDelayTime" BO_ 83 20;
BA_ "GenMsgSendType" BO_ 83 1;
BA_ "GenMsgTimeoutTime" BO_ 82 0;
BA_ "GenMsgDelayTime" BO_ 82 20;
BA_ "GenMsgSendType" BO_ 82 1;
BA_ "GenMsgTimeoutTime" BO_ 80 0;
BA_ "GenMsgDelayTime" BO_ 80 20;
BA_ "GenMsgSendType" BO_ 80 1;
BA_ "GenMsgTimeoutTime" BO_ 79 0;
BA_ "GenMsgDelayTime" BO_ 79 20;
BA_ "GenMsgSendType" BO_ 79 1;
BA_ "GenMsgTimeoutTime" BO_ 78 0;
BA_ "GenMsgDelayTime" BO_ 78 20;
BA_ "GenMsgSendType" BO_ 78 1;
BA_ "GenMsgTimeoutTime" BO_ 77 0;
BA_ "GenMsgDelayTime" BO_ 77 20;
BA_ "GenMsgSendType" BO_ 77 1;
BA_ "GenMsgTimeoutTime" BO_ 76 0;
BA_ "GenMsgDelayTime" BO_ 76 20;
BA_ "GenMsgSendType" BO_ 76 1;
BA_ "GenSigSendType" SG_ 84 LRRF1_CAN_DET_Near_TARGET_77 1;
BA_ "SignalDescription" SG_ 84 LRRF1_CAN_DET_Near_TARGET_77 "Near_Target_Discrimination";
BA_ "SignalDescription" SG_ 84 LRRF1_CAN_DET_Near_TARGET_76 "Near_Target_Discrimination";
BA_ "SignalDescription" SG_ 84 LRRF1_CAN_DET_Near_TARGET_75 "Near_Target_Discrimination";
BA_ "SignalDescription" SG_ 84 LRRF1_CAN_DET_Near_TARGET_74 "Near_Target_Discrimination";
BA_ "SignalDescription" SG_ 84 LRRF1_CAN_DET_Near_TARGET_72 "Near_Target_Discrimination";
BA_ "SignalDescription" SG_ 84 LRRF1_CAN_DET_Near_TARGET_73 "Near_Target_Discrimination";
BA_ "SignalDescription" SG_ 84 LRRF1_CAN_DET_Near_TARGET_71 "Near_Target_Discrimination";
BA_ "GenSigStartValue" SG_ 84 LRRF1_CAN_DET_ELEVATION_71 63.8646288209607;
BA_ "SignalDescription" SG_ 84 LRRF1_CAN_DET_ELEVATION_71 "Detected object elevation position 71";
BA_ "GenSigVtEn" SG_ 84 LRRF1_CAN_DET_CONFID_AZIMUTH_71 "TRUE";
BA_ "SignalDescription" SG_ 84 LRRF1_CAN_DET_CONFID_AZIMUTH_71 "Signal to noise level 71";
BA_ "SignalDescription" SG_ 84 LRRF1_CAN_DET_SUPER_RES_TAR_0053 "Super resolution target 71";
BA_ "SystemSignalLongSymbol" SG_ 84 LRRF1_CAN_DET_SUPER_RES_TAR_0053 "LRRF1_CAN_DET_SUPER_RES_TARGET_71";
BA_ "SignalDescription" SG_ 84 LRRF1_CAN_DET_CONFID_ELEVAT_0053 "Elevation Angle Confidence 71";
BA_ "SystemSignalLongSymbol" SG_ 84 LRRF1_CAN_DET_CONFID_ELEVAT_0053 "LRRF1_CAN_DET_CONFID_ELEVATION_71";
BA_ "SignalDescription" SG_ 84 LRRF1_CAN_DET_HOST_VEH_CLUT_0053 "Host vehicle clutter 71";
BA_ "SystemSignalLongSymbol" SG_ 84 LRRF1_CAN_DET_HOST_VEH_CLUT_0053 "LRRF1_CAN_DET_HOST_VEH_CLUTTER_71";
BA_ "SignalDescription" SG_ 84 LRRF1_CAN_DET_VALID_LEVEL_71 "Detected object valid level 71";
BA_ "GenSigStartValue" SG_ 84 LRRF1_CAN_DET_AZIMUTH_71 8194.05320813772;
BA_ "SignalDescription" SG_ 84 LRRF1_CAN_DET_AZIMUTH_71 "Detected object azimuth position 71";
BA_ "SignalDescription" SG_ 84 LRRF1_CAN_DET_RANGE_71 "Detected object range 71";
BA_ "GenSigStartValue" SG_ 84 LRRF1_CAN_DET_RANGE_RATE_71 8192;
BA_ "SignalDescription" SG_ 84 LRRF1_CAN_DET_RANGE_RATE_71 "Detected object range rate 71";
BA_ "SignalDescription" SG_ 84 LRRF1_CAN_DET_AMPLITUDE_71 "Detected object amplitude 71";
BA_ "SignalDescription" SG_ 84 LRRF1_CAN_SCAN_INDEX_2LSB_71 "The two LSB of scan index 71";
BA_ "SignalDescription" SG_ 84 LRRF1_Det_CRC_11 "Cyclic Redundancy Check for Detection Message Number 11";
BA_ "SignalDescription" SG_ 84 LRRF1_Det_MC_11 "Message Count for Detection Message Number 11";
BA_ "SignalDescription" SG_ 84 LRRF1_CAN_SCAN_INDEX_2LSB_77 "The two LSB of scan index 77";
BA_ "SignalDescription" SG_ 84 LRRF1_CAN_SCAN_INDEX_2LSB_76 "The two LSB of scan index 76";
BA_ "SignalDescription" SG_ 84 LRRF1_CAN_SCAN_INDEX_2LSB_75 "The two LSB of scan index 75";
BA_ "SignalDescription" SG_ 84 LRRF1_CAN_SCAN_INDEX_2LSB_74 "The two LSB of scan index 74";
BA_ "SignalDescription" SG_ 84 LRRF1_CAN_SCAN_INDEX_2LSB_73 "The two LSB of scan index 73";
BA_ "SignalDescription" SG_ 84 LRRF1_CAN_SCAN_INDEX_2LSB_72 "The two LSB of scan index 72";
BA_ "GenSigStartValue" SG_ 84 LRRF1_CAN_DET_RANGE_RATE_77 8192;
BA_ "SignalDescription" SG_ 84 LRRF1_CAN_DET_RANGE_RATE_77 "Detected object range rate 77";
BA_ "GenSigStartValue" SG_ 84 LRRF1_CAN_DET_RANGE_RATE_76 8192;
BA_ "SignalDescription" SG_ 84 LRRF1_CAN_DET_RANGE_RATE_76 "Detected object range rate 76";
BA_ "GenSigStartValue" SG_ 84 LRRF1_CAN_DET_RANGE_RATE_75 8192;
BA_ "SignalDescription" SG_ 84 LRRF1_CAN_DET_RANGE_RATE_75 "Detected object range rate 75";
BA_ "GenSigStartValue" SG_ 84 LRRF1_CAN_DET_RANGE_RATE_74 8192;
BA_ "SignalDescription" SG_ 84 LRRF1_CAN_DET_RANGE_RATE_74 "Detected object range rate 74";
BA_ "GenSigStartValue" SG_ 84 LRRF1_CAN_DET_RANGE_RATE_73 8192;
BA_ "SignalDescription" SG_ 84 LRRF1_CAN_DET_RANGE_RATE_73 "Detected object range rate 73";
BA_ "GenSigStartValue" SG_ 84 LRRF1_CAN_DET_RANGE_RATE_72 8192;
BA_ "SignalDescription" SG_ 84 LRRF1_CAN_DET_RANGE_RATE_72 "Detected object range rate 72";
BA_ "SignalDescription" SG_ 84 LRRF1_CAN_DET_RANGE_77 "Detected object range 77";
BA_ "SignalDescription" SG_ 84 LRRF1_CAN_DET_RANGE_76 "Detected object range 76";
BA_ "SignalDescription" SG_ 84 LRRF1_CAN_DET_RANGE_75 "Detected object range 75";
BA_ "SignalDescription" SG_ 84 LRRF1_CAN_DET_RANGE_74 "Detected object range 74";
BA_ "SignalDescription" SG_ 84 LRRF1_CAN_DET_RANGE_73 "Detected object range 73";
BA_ "SignalDescription" SG_ 84 LRRF1_CAN_DET_RANGE_72 "Detected object range 72";
BA_ "SignalDescription" SG_ 84 LRRF1_CAN_DET_SUPER_RES_TAR_0054 "Super resolution target 77";
BA_ "SystemSignalLongSymbol" SG_ 84 LRRF1_CAN_DET_SUPER_RES_TAR_0054 "LRRF1_CAN_DET_SUPER_RES_TARGET_77";
BA_ "SignalDescription" SG_ 84 LRRF1_CAN_DET_SUPER_RES_TAR_0055 "Super resolution target 76";
BA_ "SystemSignalLongSymbol" SG_ 84 LRRF1_CAN_DET_SUPER_RES_TAR_0055 "LRRF1_CAN_DET_SUPER_RES_TARGET_76";
BA_ "SignalDescription" SG_ 84 LRRF1_CAN_DET_SUPER_RES_TAR_0056 "Super resolution target 75";
BA_ "SystemSignalLongSymbol" SG_ 84 LRRF1_CAN_DET_SUPER_RES_TAR_0056 "LRRF1_CAN_DET_SUPER_RES_TARGET_75";
BA_ "SignalDescription" SG_ 84 LRRF1_CAN_DET_SUPER_RES_TAR_0057 "Super resolution target 74";
BA_ "SystemSignalLongSymbol" SG_ 84 LRRF1_CAN_DET_SUPER_RES_TAR_0057 "LRRF1_CAN_DET_SUPER_RES_TARGET_74";
BA_ "SignalDescription" SG_ 84 LRRF1_CAN_DET_SUPER_RES_TAR_0058 "Super resolution target 73";
BA_ "SystemSignalLongSymbol" SG_ 84 LRRF1_CAN_DET_SUPER_RES_TAR_0058 "LRRF1_CAN_DET_SUPER_RES_TARGET_73";
BA_ "SignalDescription" SG_ 84 LRRF1_CAN_DET_SUPER_RES_TAR_0059 "Super resolution target 72";
BA_ "SystemSignalLongSymbol" SG_ 84 LRRF1_CAN_DET_SUPER_RES_TAR_0059 "LRRF1_CAN_DET_SUPER_RES_TARGET_72";
BA_ "SignalDescription" SG_ 84 LRRF1_CAN_DET_HOST_VEH_CLUT_0054 "Host vehicle clutter 77";
BA_ "SystemSignalLongSymbol" SG_ 84 LRRF1_CAN_DET_HOST_VEH_CLUT_0054 "LRRF1_CAN_DET_HOST_VEH_CLUTTER_77";
BA_ "SignalDescription" SG_ 84 LRRF1_CAN_DET_HOST_VEH_CLUT_0055 "Host vehicle clutter 76";
BA_ "SystemSignalLongSymbol" SG_ 84 LRRF1_CAN_DET_HOST_VEH_CLUT_0055 "LRRF1_CAN_DET_HOST_VEH_CLUTTER_76";
BA_ "SignalDescription" SG_ 84 LRRF1_CAN_DET_HOST_VEH_CLUT_0056 "Host vehicle clutter 75";
BA_ "SystemSignalLongSymbol" SG_ 84 LRRF1_CAN_DET_HOST_VEH_CLUT_0056 "LRRF1_CAN_DET_HOST_VEH_CLUTTER_75";
BA_ "SignalDescription" SG_ 84 LRRF1_CAN_DET_HOST_VEH_CLUT_0057 "Host vehicle clutter 74";
BA_ "SystemSignalLongSymbol" SG_ 84 LRRF1_CAN_DET_HOST_VEH_CLUT_0057 "LRRF1_CAN_DET_HOST_VEH_CLUTTER_74";
BA_ "SignalDescription" SG_ 84 LRRF1_CAN_DET_HOST_VEH_CLUT_0058 "Host vehicle clutter 73";
BA_ "SystemSignalLongSymbol" SG_ 84 LRRF1_CAN_DET_HOST_VEH_CLUT_0058 "LRRF1_CAN_DET_HOST_VEH_CLUTTER_73";
BA_ "SignalDescription" SG_ 84 LRRF1_CAN_DET_HOST_VEH_CLUT_0059 "Host vehicle clutter 72";
BA_ "SystemSignalLongSymbol" SG_ 84 LRRF1_CAN_DET_HOST_VEH_CLUT_0059 "LRRF1_CAN_DET_HOST_VEH_CLUTTER_72";
BA_ "GenSigStartValue" SG_ 84 LRRF1_CAN_DET_ELEVATION_77 63.8646288209607;
BA_ "SignalDescription" SG_ 84 LRRF1_CAN_DET_ELEVATION_77 "Detected object elevation position 77";
BA_ "GenSigStartValue" SG_ 84 LRRF1_CAN_DET_ELEVATION_76 63.8646288209607;
BA_ "SignalDescription" SG_ 84 LRRF1_CAN_DET_ELEVATION_76 "Detected object elevation position 76";
BA_ "GenSigStartValue" SG_ 84 LRRF1_CAN_DET_ELEVATION_75 63.8646288209607;
BA_ "SignalDescription" SG_ 84 LRRF1_CAN_DET_ELEVATION_75 "Detected object elevation position 75";
BA_ "GenSigStartValue" SG_ 84 LRRF1_CAN_DET_ELEVATION_74 63.8646288209607;
BA_ "SignalDescription" SG_ 84 LRRF1_CAN_DET_ELEVATION_74 "Detected object elevation position 74";
BA_ "GenSigStartValue" SG_ 84 LRRF1_CAN_DET_ELEVATION_73 63.8646288209607;
BA_ "SignalDescription" SG_ 84 LRRF1_CAN_DET_ELEVATION_73 "Detected object elevation position 73";
BA_ "GenSigStartValue" SG_ 84 LRRF1_CAN_DET_ELEVATION_72 63.8646288209607;
BA_ "SignalDescription" SG_ 84 LRRF1_CAN_DET_ELEVATION_72 "Detected object elevation position 72";
BA_ "SignalDescription" SG_ 84 LRRF1_CAN_DET_CONFID_ELEVAT_0054 "Elevation Angle Confidence 77";
BA_ "SystemSignalLongSymbol" SG_ 84 LRRF1_CAN_DET_CONFID_ELEVAT_0054 "LRRF1_CAN_DET_CONFID_ELEVATION_77";
BA_ "SignalDescription" SG_ 84 LRRF1_CAN_DET_CONFID_ELEVAT_0055 "Elevation Angle Confidence 76";
BA_ "SystemSignalLongSymbol" SG_ 84 LRRF1_CAN_DET_CONFID_ELEVAT_0055 "LRRF1_CAN_DET_CONFID_ELEVATION_76";
BA_ "SignalDescription" SG_ 84 LRRF1_CAN_DET_CONFID_ELEVAT_0056 "Elevation Angle Confidence 75";
BA_ "SystemSignalLongSymbol" SG_ 84 LRRF1_CAN_DET_CONFID_ELEVAT_0056 "LRRF1_CAN_DET_CONFID_ELEVATION_75";
BA_ "SignalDescription" SG_ 84 LRRF1_CAN_DET_CONFID_ELEVAT_0057 "Elevation Angle Confidence 74";
BA_ "SystemSignalLongSymbol" SG_ 84 LRRF1_CAN_DET_CONFID_ELEVAT_0057 "LRRF1_CAN_DET_CONFID_ELEVATION_74";
BA_ "SignalDescription" SG_ 84 LRRF1_CAN_DET_CONFID_ELEVAT_0058 "Elevation Angle Confidence 73";
BA_ "SystemSignalLongSymbol" SG_ 84 LRRF1_CAN_DET_CONFID_ELEVAT_0058 "LRRF1_CAN_DET_CONFID_ELEVATION_73";
BA_ "SignalDescription" SG_ 84 LRRF1_CAN_DET_CONFID_ELEVAT_0059 "Elevation Angle Confidence 72";
BA_ "SystemSignalLongSymbol" SG_ 84 LRRF1_CAN_DET_CONFID_ELEVAT_0059 "LRRF1_CAN_DET_CONFID_ELEVATION_72";
BA_ "GenSigVtEn" SG_ 84 LRRF1_CAN_DET_CONFID_AZIMUTH_77 "TRUE";
BA_ "SignalDescription" SG_ 84 LRRF1_CAN_DET_CONFID_AZIMUTH_77 "Signal to noise level 77";
BA_ "GenSigVtEn" SG_ 84 LRRF1_CAN_DET_CONFID_AZIMUTH_76 "TRUE";
BA_ "SignalDescription" SG_ 84 LRRF1_CAN_DET_CONFID_AZIMUTH_76 "Signal to noise level 76";
BA_ "GenSigVtEn" SG_ 84 LRRF1_CAN_DET_CONFID_AZIMUTH_75 "TRUE";
BA_ "SignalDescription" SG_ 84 LRRF1_CAN_DET_CONFID_AZIMUTH_75 "Signal to noise level 75";
BA_ "GenSigVtEn" SG_ 84 LRRF1_CAN_DET_CONFID_AZIMUTH_74 "TRUE";
BA_ "SignalDescription" SG_ 84 LRRF1_CAN_DET_CONFID_AZIMUTH_74 "Signal to noise level 74";
BA_ "GenSigVtEn" SG_ 84 LRRF1_CAN_DET_CONFID_AZIMUTH_73 "TRUE";
BA_ "SignalDescription" SG_ 84 LRRF1_CAN_DET_CONFID_AZIMUTH_73 "Signal to noise level 73";
BA_ "GenSigVtEn" SG_ 84 LRRF1_CAN_DET_CONFID_AZIMUTH_72 "TRUE";
BA_ "SignalDescription" SG_ 84 LRRF1_CAN_DET_CONFID_AZIMUTH_72 "Signal to noise level 72";
BA_ "GenSigStartValue" SG_ 84 LRRF1_CAN_DET_AZIMUTH_77 8194.05320813772;
BA_ "SignalDescription" SG_ 84 LRRF1_CAN_DET_AZIMUTH_77 "Detected object azimuth position 77";
BA_ "GenSigStartValue" SG_ 84 LRRF1_CAN_DET_AZIMUTH_76 8194.05320813772;
BA_ "SignalDescription" SG_ 84 LRRF1_CAN_DET_AZIMUTH_76 "Detected object azimuth position 76";
BA_ "GenSigStartValue" SG_ 84 LRRF1_CAN_DET_AZIMUTH_75 8194.05320813772;
BA_ "SignalDescription" SG_ 84 LRRF1_CAN_DET_AZIMUTH_75 "Detected object azimuth position 75";
BA_ "GenSigStartValue" SG_ 84 LRRF1_CAN_DET_AZIMUTH_74 8194.05320813772;
BA_ "SignalDescription" SG_ 84 LRRF1_CAN_DET_AZIMUTH_74 "Detected object azimuth position 74";
BA_ "GenSigStartValue" SG_ 84 LRRF1_CAN_DET_AZIMUTH_73 8194.05320813772;
BA_ "SignalDescription" SG_ 84 LRRF1_CAN_DET_AZIMUTH_73 "Detected object azimuth position 73";
BA_ "GenSigStartValue" SG_ 84 LRRF1_CAN_DET_AZIMUTH_72 8194.05320813772;
BA_ "SignalDescription" SG_ 84 LRRF1_CAN_DET_AZIMUTH_72 "Detected object azimuth position 72";
BA_ "SignalDescription" SG_ 84 LRRF1_CAN_DET_AMPLITUDE_77 "Detected object amplitude 77";
BA_ "SignalDescription" SG_ 84 LRRF1_CAN_DET_AMPLITUDE_76 "Detected object amplitude 76";
BA_ "SignalDescription" SG_ 84 LRRF1_CAN_DET_AMPLITUDE_75 "Detected object amplitude 75";
BA_ "SignalDescription" SG_ 84 LRRF1_CAN_DET_AMPLITUDE_74 "Detected object amplitude 74";
BA_ "SignalDescription" SG_ 84 LRRF1_CAN_DET_AMPLITUDE_73 "Detected object amplitude 73";
BA_ "SignalDescription" SG_ 84 LRRF1_CAN_DET_AMPLITUDE_72 "Detected object amplitude 72";
BA_ "SignalDescription" SG_ 84 LRRF1_CAN_DET_VALID_LEVEL_77 "Detected object valid level 77";
BA_ "SignalDescription" SG_ 84 LRRF1_CAN_DET_VALID_LEVEL_76 "Detected object valid level 76";
BA_ "SignalDescription" SG_ 84 LRRF1_CAN_DET_VALID_LEVEL_75 "Detected object valid level 75";
BA_ "SignalDescription" SG_ 84 LRRF1_CAN_DET_VALID_LEVEL_74 "Detected object valid level 74";
BA_ "SignalDescription" SG_ 84 LRRF1_CAN_DET_VALID_LEVEL_73 "Detected object valid level 73";
BA_ "SignalDescription" SG_ 84 LRRF1_CAN_DET_VALID_LEVEL_72 "Detected object valid level 72";
BA_ "GenSigSendType" SG_ 83 LRRF1_CAN_DET_Near_TARGET_70 1;
BA_ "SignalDescription" SG_ 83 LRRF1_CAN_DET_Near_TARGET_70 "Near_Target_Discrimination";
BA_ "SignalDescription" SG_ 83 LRRF1_CAN_DET_Near_TARGET_69 "Near_Target_Discrimination";
BA_ "SignalDescription" SG_ 83 LRRF1_CAN_DET_Near_TARGET_68 "Near_Target_Discrimination";
BA_ "SignalDescription" SG_ 83 LRRF1_CAN_DET_Near_TARGET_67 "Near_Target_Discrimination";
BA_ "SignalDescription" SG_ 83 LRRF1_CAN_DET_Near_TARGET_66 "Near_Target_Discrimination";
BA_ "SignalDescription" SG_ 83 LRRF1_CAN_DET_Near_TARGET_65 "Near_Target_Discrimination";
BA_ "SignalDescription" SG_ 83 LRRF1_CAN_DET_Near_TARGET_64 "Near_Target_Discrimination";
BA_ "GenSigStartValue" SG_ 83 LRRF1_CAN_DET_ELEVATION_64 63.8646288209607;
BA_ "SignalDescription" SG_ 83 LRRF1_CAN_DET_ELEVATION_64 "Detected object elevation position 64";
BA_ "GenSigVtEn" SG_ 83 LRRF1_CAN_DET_CONFID_AZIMUTH_64 "TRUE";
BA_ "SignalDescription" SG_ 83 LRRF1_CAN_DET_CONFID_AZIMUTH_64 "Signal to noise level 64";
BA_ "SignalDescription" SG_ 83 LRRF1_CAN_DET_SUPER_RES_TARGET_6 "Super resolution target 64";
BA_ "SystemSignalLongSymbol" SG_ 83 LRRF1_CAN_DET_SUPER_RES_TARGET_6 "LRRF1_CAN_DET_SUPER_RES_TARGET_64";
BA_ "SignalDescription" SG_ 83 LRRF1_CAN_DET_CONFID_ELEVATION_6 "Elevation Angle Confidence 64";
BA_ "SystemSignalLongSymbol" SG_ 83 LRRF1_CAN_DET_CONFID_ELEVATION_6 "LRRF1_CAN_DET_CONFID_ELEVATION_64";
BA_ "SignalDescription" SG_ 83 LRRF1_CAN_DET_HOST_VEH_CLUTTER_6 "Host vehicle clutter 64";
BA_ "SystemSignalLongSymbol" SG_ 83 LRRF1_CAN_DET_HOST_VEH_CLUTTER_6 "LRRF1_CAN_DET_HOST_VEH_CLUTTER_64";
BA_ "SignalDescription" SG_ 83 LRRF1_CAN_DET_VALID_LEVEL_64 "Detected object valid level 64";
BA_ "GenSigStartValue" SG_ 83 LRRF1_CAN_DET_AZIMUTH_64 8194.05320813772;
BA_ "SignalDescription" SG_ 83 LRRF1_CAN_DET_AZIMUTH_64 "Detected object azimuth position 64";
BA_ "SignalDescription" SG_ 83 LRRF1_CAN_DET_RANGE_64 "Detected object range 64";
BA_ "GenSigStartValue" SG_ 83 LRRF1_CAN_DET_RANGE_RATE_64 8192;
BA_ "SignalDescription" SG_ 83 LRRF1_CAN_DET_RANGE_RATE_64 "Detected object range rate 64";
BA_ "SignalDescription" SG_ 83 LRRF1_CAN_DET_AMPLITUDE_64 "Detected object amplitude 64";
BA_ "SignalDescription" SG_ 83 LRRF1_CAN_SCAN_INDEX_2LSB_64 "The two LSB of scan index 64";
BA_ "SignalDescription" SG_ 83 LRRF1_Det_CRC_10 "Cyclic Redundancy Check for Detection Message Number 10";
BA_ "SignalDescription" SG_ 83 LRRF1_Det_MC_10 "Message Count for Detection Message Number 10";
BA_ "SignalDescription" SG_ 83 LRRF1_CAN_SCAN_INDEX_2LSB_70 "The two LSB of scan index 70";
BA_ "SignalDescription" SG_ 83 LRRF1_CAN_SCAN_INDEX_2LSB_69 "The two LSB of scan index 69";
BA_ "SignalDescription" SG_ 83 LRRF1_CAN_SCAN_INDEX_2LSB_68 "The two LSB of scan index 68";
BA_ "SignalDescription" SG_ 83 LRRF1_CAN_SCAN_INDEX_2LSB_67 "The two LSB of scan index 67";
BA_ "SignalDescription" SG_ 83 LRRF1_CAN_SCAN_INDEX_2LSB_66 "The two LSB of scan index 66";
BA_ "SignalDescription" SG_ 83 LRRF1_CAN_SCAN_INDEX_2LSB_65 "The two LSB of scan index 65";
BA_ "GenSigStartValue" SG_ 83 LRRF1_CAN_DET_RANGE_RATE_70 8192;
BA_ "SignalDescription" SG_ 83 LRRF1_CAN_DET_RANGE_RATE_70 "Detected object range rate 70";
BA_ "GenSigStartValue" SG_ 83 LRRF1_CAN_DET_RANGE_RATE_69 8192;
BA_ "SignalDescription" SG_ 83 LRRF1_CAN_DET_RANGE_RATE_69 "Detected object range rate 69";
BA_ "GenSigStartValue" SG_ 83 LRRF1_CAN_DET_RANGE_RATE_68 8192;
BA_ "SignalDescription" SG_ 83 LRRF1_CAN_DET_RANGE_RATE_68 "Detected object range rate 68";
BA_ "GenSigStartValue" SG_ 83 LRRF1_CAN_DET_RANGE_RATE_67 8192;
BA_ "SignalDescription" SG_ 83 LRRF1_CAN_DET_RANGE_RATE_67 "Detected object range rate 67";
BA_ "GenSigStartValue" SG_ 83 LRRF1_CAN_DET_RANGE_RATE_66 8192;
BA_ "SignalDescription" SG_ 83 LRRF1_CAN_DET_RANGE_RATE_66 "Detected object range rate 66";
BA_ "GenSigStartValue" SG_ 83 LRRF1_CAN_DET_RANGE_RATE_65 8192;
BA_ "SignalDescription" SG_ 83 LRRF1_CAN_DET_RANGE_RATE_65 "Detected object range rate 65";
BA_ "SignalDescription" SG_ 83 LRRF1_CAN_DET_RANGE_70 "Detected object range 70";
BA_ "SignalDescription" SG_ 83 LRRF1_CAN_DET_RANGE_69 "Detected object range 69";
BA_ "SignalDescription" SG_ 83 LRRF1_CAN_DET_RANGE_68 "Detected object range 68";
BA_ "SignalDescription" SG_ 83 LRRF1_CAN_DET_RANGE_67 "Detected object range 67";
BA_ "SignalDescription" SG_ 83 LRRF1_CAN_DET_RANGE_66 "Detected object range 66";
BA_ "SignalDescription" SG_ 83 LRRF1_CAN_DET_RANGE_65 "Detected object range 65";
BA_ "SignalDescription" SG_ 83 LRRF1_CAN_DET_SUPER_RES_TAR_0060 "Super resolution target 70";
BA_ "SystemSignalLongSymbol" SG_ 83 LRRF1_CAN_DET_SUPER_RES_TAR_0060 "LRRF1_CAN_DET_SUPER_RES_TARGET_70";
BA_ "SignalDescription" SG_ 83 LRRF1_CAN_DET_SUPER_RES_TAR_0061 "Super resolution target 69";
BA_ "SystemSignalLongSymbol" SG_ 83 LRRF1_CAN_DET_SUPER_RES_TAR_0061 "LRRF1_CAN_DET_SUPER_RES_TARGET_69";
BA_ "SignalDescription" SG_ 83 LRRF1_CAN_DET_SUPER_RES_TAR_0062 "Super resolution target 68";
BA_ "SystemSignalLongSymbol" SG_ 83 LRRF1_CAN_DET_SUPER_RES_TAR_0062 "LRRF1_CAN_DET_SUPER_RES_TARGET_68";
BA_ "SignalDescription" SG_ 83 LRRF1_CAN_DET_SUPER_RES_TAR_0063 "Super resolution target 67";
BA_ "SystemSignalLongSymbol" SG_ 83 LRRF1_CAN_DET_SUPER_RES_TAR_0063 "LRRF1_CAN_DET_SUPER_RES_TARGET_67";
BA_ "SignalDescription" SG_ 83 LRRF1_CAN_DET_SUPER_RES_TAR_0064 "Super resolution target 66";
BA_ "SystemSignalLongSymbol" SG_ 83 LRRF1_CAN_DET_SUPER_RES_TAR_0064 "LRRF1_CAN_DET_SUPER_RES_TARGET_66";
BA_ "SignalDescription" SG_ 83 LRRF1_CAN_DET_SUPER_RES_TAR_0065 "Super resolution target 65";
BA_ "SystemSignalLongSymbol" SG_ 83 LRRF1_CAN_DET_SUPER_RES_TAR_0065 "LRRF1_CAN_DET_SUPER_RES_TARGET_65";
BA_ "SignalDescription" SG_ 83 LRRF1_CAN_DET_HOST_VEH_CLUT_0060 "Host vehicle clutter 70";
BA_ "SystemSignalLongSymbol" SG_ 83 LRRF1_CAN_DET_HOST_VEH_CLUT_0060 "LRRF1_CAN_DET_HOST_VEH_CLUTTER_70";
BA_ "SignalDescription" SG_ 83 LRRF1_CAN_DET_HOST_VEH_CLUT_0061 "Host vehicle clutter 69";
BA_ "SystemSignalLongSymbol" SG_ 83 LRRF1_CAN_DET_HOST_VEH_CLUT_0061 "LRRF1_CAN_DET_HOST_VEH_CLUTTER_69";
BA_ "SignalDescription" SG_ 83 LRRF1_CAN_DET_HOST_VEH_CLUT_0062 "Host vehicle clutter 68";
BA_ "SystemSignalLongSymbol" SG_ 83 LRRF1_CAN_DET_HOST_VEH_CLUT_0062 "LRRF1_CAN_DET_HOST_VEH_CLUTTER_68";
BA_ "SignalDescription" SG_ 83 LRRF1_CAN_DET_HOST_VEH_CLUT_0063 "Host vehicle clutter 67";
BA_ "SystemSignalLongSymbol" SG_ 83 LRRF1_CAN_DET_HOST_VEH_CLUT_0063 "LRRF1_CAN_DET_HOST_VEH_CLUTTER_67";
BA_ "SignalDescription" SG_ 83 LRRF1_CAN_DET_HOST_VEH_CLUT_0064 "Host vehicle clutter 66";
BA_ "SystemSignalLongSymbol" SG_ 83 LRRF1_CAN_DET_HOST_VEH_CLUT_0064 "LRRF1_CAN_DET_HOST_VEH_CLUTTER_66";
BA_ "SignalDescription" SG_ 83 LRRF1_CAN_DET_HOST_VEH_CLUT_0065 "Host vehicle clutter 65";
BA_ "SystemSignalLongSymbol" SG_ 83 LRRF1_CAN_DET_HOST_VEH_CLUT_0065 "LRRF1_CAN_DET_HOST_VEH_CLUTTER_65";
BA_ "GenSigStartValue" SG_ 83 LRRF1_CAN_DET_ELEVATION_70 63.8646288209607;
BA_ "SignalDescription" SG_ 83 LRRF1_CAN_DET_ELEVATION_70 "Detected object elevation position 70";
BA_ "GenSigStartValue" SG_ 83 LRRF1_CAN_DET_ELEVATION_69 63.8646288209607;
BA_ "SignalDescription" SG_ 83 LRRF1_CAN_DET_ELEVATION_69 "Detected object elevation position 69";
BA_ "GenSigStartValue" SG_ 83 LRRF1_CAN_DET_ELEVATION_68 63.8646288209607;
BA_ "SignalDescription" SG_ 83 LRRF1_CAN_DET_ELEVATION_68 "Detected object elevation position 68";
BA_ "GenSigStartValue" SG_ 83 LRRF1_CAN_DET_ELEVATION_67 63.8646288209607;
BA_ "SignalDescription" SG_ 83 LRRF1_CAN_DET_ELEVATION_67 "Detected object elevation position 67";
BA_ "GenSigStartValue" SG_ 83 LRRF1_CAN_DET_ELEVATION_66 63.8646288209607;
BA_ "SignalDescription" SG_ 83 LRRF1_CAN_DET_ELEVATION_66 "Detected object elevation position 66";
BA_ "GenSigStartValue" SG_ 83 LRRF1_CAN_DET_ELEVATION_65 63.8646288209607;
BA_ "SignalDescription" SG_ 83 LRRF1_CAN_DET_ELEVATION_65 "Detected object elevation position 65";
BA_ "SignalDescription" SG_ 83 LRRF1_CAN_DET_CONFID_ELEVAT_0060 "Elevation Angle Confidence 70";
BA_ "SystemSignalLongSymbol" SG_ 83 LRRF1_CAN_DET_CONFID_ELEVAT_0060 "LRRF1_CAN_DET_CONFID_ELEVATION_70";
BA_ "SignalDescription" SG_ 83 LRRF1_CAN_DET_CONFID_ELEVAT_0061 "Elevation Angle Confidence 69";
BA_ "SystemSignalLongSymbol" SG_ 83 LRRF1_CAN_DET_CONFID_ELEVAT_0061 "LRRF1_CAN_DET_CONFID_ELEVATION_69";
BA_ "SignalDescription" SG_ 83 LRRF1_CAN_DET_CONFID_ELEVAT_0062 "Elevation Angle Confidence 68";
BA_ "SystemSignalLongSymbol" SG_ 83 LRRF1_CAN_DET_CONFID_ELEVAT_0062 "LRRF1_CAN_DET_CONFID_ELEVATION_68";
BA_ "SignalDescription" SG_ 83 LRRF1_CAN_DET_CONFID_ELEVAT_0063 "Elevation Angle Confidence 67";
BA_ "SystemSignalLongSymbol" SG_ 83 LRRF1_CAN_DET_CONFID_ELEVAT_0063 "LRRF1_CAN_DET_CONFID_ELEVATION_67";
BA_ "SignalDescription" SG_ 83 LRRF1_CAN_DET_CONFID_ELEVAT_0064 "Elevation Angle Confidence 66";
BA_ "SystemSignalLongSymbol" SG_ 83 LRRF1_CAN_DET_CONFID_ELEVAT_0064 "LRRF1_CAN_DET_CONFID_ELEVATION_66";
BA_ "SignalDescription" SG_ 83 LRRF1_CAN_DET_CONFID_ELEVAT_0065 "Elevation Angle Confidence 65";
BA_ "SystemSignalLongSymbol" SG_ 83 LRRF1_CAN_DET_CONFID_ELEVAT_0065 "LRRF1_CAN_DET_CONFID_ELEVATION_65";
BA_ "GenSigVtEn" SG_ 83 LRRF1_CAN_DET_CONFID_AZIMUTH_70 "TRUE";
BA_ "SignalDescription" SG_ 83 LRRF1_CAN_DET_CONFID_AZIMUTH_70 "Signal to noise level 70";
BA_ "GenSigVtEn" SG_ 83 LRRF1_CAN_DET_CONFID_AZIMUTH_69 "TRUE";
BA_ "SignalDescription" SG_ 83 LRRF1_CAN_DET_CONFID_AZIMUTH_69 "Signal to noise level 69";
BA_ "GenSigVtEn" SG_ 83 LRRF1_CAN_DET_CONFID_AZIMUTH_68 "TRUE";
BA_ "SignalDescription" SG_ 83 LRRF1_CAN_DET_CONFID_AZIMUTH_68 "Signal to noise level 68";
BA_ "GenSigVtEn" SG_ 83 LRRF1_CAN_DET_CONFID_AZIMUTH_67 "TRUE";
BA_ "SignalDescription" SG_ 83 LRRF1_CAN_DET_CONFID_AZIMUTH_67 "Signal to noise level 67";
BA_ "GenSigVtEn" SG_ 83 LRRF1_CAN_DET_CONFID_AZIMUTH_66 "TRUE";
BA_ "SignalDescription" SG_ 83 LRRF1_CAN_DET_CONFID_AZIMUTH_66 "Signal to noise level 66";
BA_ "GenSigVtEn" SG_ 83 LRRF1_CAN_DET_CONFID_AZIMUTH_65 "TRUE";
BA_ "SignalDescription" SG_ 83 LRRF1_CAN_DET_CONFID_AZIMUTH_65 "Signal to noise level 65";
BA_ "GenSigStartValue" SG_ 83 LRRF1_CAN_DET_AZIMUTH_70 8194.05320813772;
BA_ "SignalDescription" SG_ 83 LRRF1_CAN_DET_AZIMUTH_70 "Detected object azimuth position 70";
BA_ "GenSigStartValue" SG_ 83 LRRF1_CAN_DET_AZIMUTH_69 8194.05320813772;
BA_ "SignalDescription" SG_ 83 LRRF1_CAN_DET_AZIMUTH_69 "Detected object azimuth position 69";
BA_ "GenSigStartValue" SG_ 83 LRRF1_CAN_DET_AZIMUTH_68 8194.05320813772;
BA_ "SignalDescription" SG_ 83 LRRF1_CAN_DET_AZIMUTH_68 "Detected object azimuth position 68";
BA_ "GenSigStartValue" SG_ 83 LRRF1_CAN_DET_AZIMUTH_67 8194.05320813772;
BA_ "SignalDescription" SG_ 83 LRRF1_CAN_DET_AZIMUTH_67 "Detected object azimuth position 67";
BA_ "GenSigStartValue" SG_ 83 LRRF1_CAN_DET_AZIMUTH_66 8194.05320813772;
BA_ "SignalDescription" SG_ 83 LRRF1_CAN_DET_AZIMUTH_66 "Detected object azimuth position 66";
BA_ "GenSigStartValue" SG_ 83 LRRF1_CAN_DET_AZIMUTH_65 8194.05320813772;
BA_ "SignalDescription" SG_ 83 LRRF1_CAN_DET_AZIMUTH_65 "Detected object azimuth position 65";
BA_ "SignalDescription" SG_ 83 LRRF1_CAN_DET_AMPLITUDE_70 "Detected object amplitude 70";
BA_ "SignalDescription" SG_ 83 LRRF1_CAN_DET_AMPLITUDE_69 "Detected object amplitude 69";
BA_ "SignalDescription" SG_ 83 LRRF1_CAN_DET_AMPLITUDE_68 "Detected object amplitude 68";
BA_ "SignalDescription" SG_ 83 LRRF1_CAN_DET_AMPLITUDE_67 "Detected object amplitude 67";
BA_ "SignalDescription" SG_ 83 LRRF1_CAN_DET_AMPLITUDE_66 "Detected object amplitude 66";
BA_ "SignalDescription" SG_ 83 LRRF1_CAN_DET_AMPLITUDE_65 "Detected object amplitude 65";
BA_ "SignalDescription" SG_ 83 LRRF1_CAN_DET_VALID_LEVEL_70 "Detected object valid level 70";
BA_ "SignalDescription" SG_ 83 LRRF1_CAN_DET_VALID_LEVEL_69 "Detected object valid level 69";
BA_ "SignalDescription" SG_ 83 LRRF1_CAN_DET_VALID_LEVEL_68 "Detected object valid level 68";
BA_ "SignalDescription" SG_ 83 LRRF1_CAN_DET_VALID_LEVEL_67 "Detected object valid level 67";
BA_ "SignalDescription" SG_ 83 LRRF1_CAN_DET_VALID_LEVEL_66 "Detected object valid level 66";
BA_ "SignalDescription" SG_ 83 LRRF1_CAN_DET_VALID_LEVEL_65 "Detected object valid level 65";
BA_ "GenSigSendType" SG_ 82 LRRF1_CAN_DET_Near_TARGET_63 1;
BA_ "SignalDescription" SG_ 82 LRRF1_CAN_DET_Near_TARGET_63 "Near_Target_Discrimination";
BA_ "SignalDescription" SG_ 82 LRRF1_CAN_DET_Near_TARGET_62 "Near_Target_Discrimination";
BA_ "SignalDescription" SG_ 82 LRRF1_CAN_DET_Near_TARGET_61 "Near_Target_Discrimination";
BA_ "SignalDescription" SG_ 82 LRRF1_CAN_DET_Near_TARGET_60 "Near_Target_Discrimination";
BA_ "SignalDescription" SG_ 82 LRRF1_CAN_DET_Near_TARGET_59 "Near_Target_Discrimination";
BA_ "SignalDescription" SG_ 82 LRRF1_CAN_DET_Near_TARGET_58 "Near_Target_Discrimination";
BA_ "SignalDescription" SG_ 82 LRRF1_CAN_DET_Near_TARGET_57 "Near_Target_Discrimination";
BA_ "GenSigStartValue" SG_ 82 LRRF1_CAN_DET_ELEVATION_57 63.8646288209607;
BA_ "SignalDescription" SG_ 82 LRRF1_CAN_DET_ELEVATION_57 "Detected object elevation position 59";
BA_ "GenSigVtEn" SG_ 82 LRRF1_CAN_DET_CONFID_AZIMUTH_57 "TRUE";
BA_ "SignalDescription" SG_ 82 LRRF1_CAN_DET_CONFID_AZIMUTH_57 "Signal to noise level 59";
BA_ "SignalDescription" SG_ 82 LRRF1_CAN_DET_SUPER_RES_TAR_0066 "Super resolution target 59";
BA_ "SystemSignalLongSymbol" SG_ 82 LRRF1_CAN_DET_SUPER_RES_TAR_0066 "LRRF1_CAN_DET_SUPER_RES_TARGET_57";
BA_ "SignalDescription" SG_ 82 LRRF1_CAN_DET_CONFID_ELEVAT_0066 "Elevation Angle Confidence 59";
BA_ "SystemSignalLongSymbol" SG_ 82 LRRF1_CAN_DET_CONFID_ELEVAT_0066 "LRRF1_CAN_DET_CONFID_ELEVATION_57";
BA_ "SignalDescription" SG_ 82 LRRF1_CAN_DET_HOST_VEH_CLUT_0066 "Host vehicle clutter 59";
BA_ "SystemSignalLongSymbol" SG_ 82 LRRF1_CAN_DET_HOST_VEH_CLUT_0066 "LRRF1_CAN_DET_HOST_VEH_CLUTTER_57";
BA_ "SignalDescription" SG_ 82 LRRF1_CAN_DET_VALID_LEVEL_57 "Detected object valid level 59";
BA_ "GenSigStartValue" SG_ 82 LRRF1_CAN_DET_AZIMUTH_57 8194.05320813772;
BA_ "SignalDescription" SG_ 82 LRRF1_CAN_DET_AZIMUTH_57 "Detected object azimuth position 59";
BA_ "SignalDescription" SG_ 82 LRRF1_CAN_DET_RANGE_57 "Detected object range 59";
BA_ "GenSigStartValue" SG_ 82 LRRF1_CAN_DET_RANGE_RATE_57 8192;
BA_ "SignalDescription" SG_ 82 LRRF1_CAN_DET_RANGE_RATE_57 "Detected object range rate 59";
BA_ "SignalDescription" SG_ 82 LRRF1_CAN_DET_AMPLITUDE_57 "Detected object amplitude 59";
BA_ "SignalDescription" SG_ 82 LRRF1_CAN_SCAN_INDEX_2LSB_57 "The two LSB of scan index 59";
BA_ "SignalDescription" SG_ 82 LRRF1_Det_CRC_09 "Cyclic Redundancy Check for Detection Message Number 9";
BA_ "SignalDescription" SG_ 82 LRRF1_Det_MC_09 "Message Count for Detection Message Number 9";
BA_ "SignalDescription" SG_ 82 LRRF1_CAN_SCAN_INDEX_2LSB_63 "The two LSB of scan index 63";
BA_ "SignalDescription" SG_ 82 LRRF1_CAN_SCAN_INDEX_2LSB_62 "The two LSB of scan index 62";
BA_ "SignalDescription" SG_ 82 LRRF1_CAN_SCAN_INDEX_2LSB_61 "The two LSB of scan index 61";
BA_ "SignalDescription" SG_ 82 LRRF1_CAN_SCAN_INDEX_2LSB_60 "The two LSB of scan index 60";
BA_ "SignalDescription" SG_ 82 LRRF1_CAN_SCAN_INDEX_2LSB_59 "The two LSB of scan index 59";
BA_ "SignalDescription" SG_ 82 LRRF1_CAN_SCAN_INDEX_2LSB_58 "The two LSB of scan index 59";
BA_ "GenSigStartValue" SG_ 82 LRRF1_CAN_DET_RANGE_RATE_63 8192;
BA_ "SignalDescription" SG_ 82 LRRF1_CAN_DET_RANGE_RATE_63 "Detected object range rate 63";
BA_ "GenSigStartValue" SG_ 82 LRRF1_CAN_DET_RANGE_RATE_62 8192;
BA_ "SignalDescription" SG_ 82 LRRF1_CAN_DET_RANGE_RATE_62 "Detected object range rate 62";
BA_ "GenSigStartValue" SG_ 82 LRRF1_CAN_DET_RANGE_RATE_61 8192;
BA_ "SignalDescription" SG_ 82 LRRF1_CAN_DET_RANGE_RATE_61 "Detected object range rate 61";
BA_ "GenSigStartValue" SG_ 82 LRRF1_CAN_DET_RANGE_RATE_60 8192;
BA_ "SignalDescription" SG_ 82 LRRF1_CAN_DET_RANGE_RATE_60 "Detected object range rate 60";
BA_ "GenSigStartValue" SG_ 82 LRRF1_CAN_DET_RANGE_RATE_59 8192;
BA_ "SignalDescription" SG_ 82 LRRF1_CAN_DET_RANGE_RATE_59 "Detected object range rate 59";
BA_ "GenSigStartValue" SG_ 82 LRRF1_CAN_DET_RANGE_RATE_58 8192;
BA_ "SignalDescription" SG_ 82 LRRF1_CAN_DET_RANGE_RATE_58 "Detected object range rate 59";
BA_ "SignalDescription" SG_ 82 LRRF1_CAN_DET_RANGE_63 "Detected object range 63";
BA_ "SignalDescription" SG_ 82 LRRF1_CAN_DET_RANGE_62 "Detected object range 62";
BA_ "SignalDescription" SG_ 82 LRRF1_CAN_DET_RANGE_61 "Detected object range 61";
BA_ "SignalDescription" SG_ 82 LRRF1_CAN_DET_RANGE_60 "Detected object range 60";
BA_ "SignalDescription" SG_ 82 LRRF1_CAN_DET_RANGE_59 "Detected object range 59";
BA_ "SignalDescription" SG_ 82 LRRF1_CAN_DET_RANGE_58 "Detected object range 59";
BA_ "SignalDescription" SG_ 82 LRRF1_CAN_DET_SUPER_RES_TAR_0067 "Super resolution target 63";
BA_ "SystemSignalLongSymbol" SG_ 82 LRRF1_CAN_DET_SUPER_RES_TAR_0067 "LRRF1_CAN_DET_SUPER_RES_TARGET_63";
BA_ "SignalDescription" SG_ 82 LRRF1_CAN_DET_SUPER_RES_TAR_0068 "Super resolution target 62";
BA_ "SystemSignalLongSymbol" SG_ 82 LRRF1_CAN_DET_SUPER_RES_TAR_0068 "LRRF1_CAN_DET_SUPER_RES_TARGET_62";
BA_ "SignalDescription" SG_ 82 LRRF1_CAN_DET_SUPER_RES_TAR_0069 "Super resolution target 61";
BA_ "SystemSignalLongSymbol" SG_ 82 LRRF1_CAN_DET_SUPER_RES_TAR_0069 "LRRF1_CAN_DET_SUPER_RES_TARGET_61";
BA_ "SignalDescription" SG_ 82 LRRF1_CAN_DET_SUPER_RES_TAR_0070 "Super resolution target 60";
BA_ "SystemSignalLongSymbol" SG_ 82 LRRF1_CAN_DET_SUPER_RES_TAR_0070 "LRRF1_CAN_DET_SUPER_RES_TARGET_60";
BA_ "SignalDescription" SG_ 82 LRRF1_CAN_DET_SUPER_RES_TAR_0071 "Super resolution target 59";
BA_ "SystemSignalLongSymbol" SG_ 82 LRRF1_CAN_DET_SUPER_RES_TAR_0071 "LRRF1_CAN_DET_SUPER_RES_TARGET_59";
BA_ "SignalDescription" SG_ 82 LRRF1_CAN_DET_SUPER_RES_TAR_0072 "Super resolution target 59";
BA_ "SystemSignalLongSymbol" SG_ 82 LRRF1_CAN_DET_SUPER_RES_TAR_0072 "LRRF1_CAN_DET_SUPER_RES_TARGET_58";
BA_ "SignalDescription" SG_ 82 LRRF1_CAN_DET_HOST_VEH_CLUT_0067 "Host vehicle clutter 63";
BA_ "SystemSignalLongSymbol" SG_ 82 LRRF1_CAN_DET_HOST_VEH_CLUT_0067 "LRRF1_CAN_DET_HOST_VEH_CLUTTER_63";
BA_ "SignalDescription" SG_ 82 LRRF1_CAN_DET_HOST_VEH_CLUT_0068 "Host vehicle clutter 62";
BA_ "SystemSignalLongSymbol" SG_ 82 LRRF1_CAN_DET_HOST_VEH_CLUT_0068 "LRRF1_CAN_DET_HOST_VEH_CLUTTER_62";
BA_ "SignalDescription" SG_ 82 LRRF1_CAN_DET_HOST_VEH_CLUT_0069 "Host vehicle clutter 61";
BA_ "SystemSignalLongSymbol" SG_ 82 LRRF1_CAN_DET_HOST_VEH_CLUT_0069 "LRRF1_CAN_DET_HOST_VEH_CLUTTER_61";
BA_ "SignalDescription" SG_ 82 LRRF1_CAN_DET_HOST_VEH_CLUT_0070 "Host vehicle clutter 60";
BA_ "SystemSignalLongSymbol" SG_ 82 LRRF1_CAN_DET_HOST_VEH_CLUT_0070 "LRRF1_CAN_DET_HOST_VEH_CLUTTER_60";
BA_ "SignalDescription" SG_ 82 LRRF1_CAN_DET_HOST_VEH_CLUT_0071 "Host vehicle clutter 59";
BA_ "SystemSignalLongSymbol" SG_ 82 LRRF1_CAN_DET_HOST_VEH_CLUT_0071 "LRRF1_CAN_DET_HOST_VEH_CLUTTER_59";
BA_ "SignalDescription" SG_ 82 LRRF1_CAN_DET_HOST_VEH_CLUT_0072 "Host vehicle clutter 59";
BA_ "SystemSignalLongSymbol" SG_ 82 LRRF1_CAN_DET_HOST_VEH_CLUT_0072 "LRRF1_CAN_DET_HOST_VEH_CLUTTER_58";
BA_ "GenSigStartValue" SG_ 82 LRRF1_CAN_DET_ELEVATION_63 63.8646288209607;
BA_ "SignalDescription" SG_ 82 LRRF1_CAN_DET_ELEVATION_63 "Detected object elevation position 63";
BA_ "GenSigStartValue" SG_ 82 LRRF1_CAN_DET_ELEVATION_62 63.8646288209607;
BA_ "SignalDescription" SG_ 82 LRRF1_CAN_DET_ELEVATION_62 "Detected object elevation position 62";
BA_ "GenSigStartValue" SG_ 82 LRRF1_CAN_DET_ELEVATION_61 63.8646288209607;
BA_ "SignalDescription" SG_ 82 LRRF1_CAN_DET_ELEVATION_61 "Detected object elevation position 61";
BA_ "GenSigStartValue" SG_ 82 LRRF1_CAN_DET_ELEVATION_60 63.8646288209607;
BA_ "SignalDescription" SG_ 82 LRRF1_CAN_DET_ELEVATION_60 "Detected object elevation position 60";
BA_ "GenSigStartValue" SG_ 82 LRRF1_CAN_DET_ELEVATION_59 63.8646288209607;
BA_ "SignalDescription" SG_ 82 LRRF1_CAN_DET_ELEVATION_59 "Detected object elevation position 59";
BA_ "GenSigStartValue" SG_ 82 LRRF1_CAN_DET_ELEVATION_58 63.8646288209607;
BA_ "SignalDescription" SG_ 82 LRRF1_CAN_DET_ELEVATION_58 "Detected object elevation position 59";
BA_ "SignalDescription" SG_ 82 LRRF1_CAN_DET_CONFID_ELEVAT_0067 "Elevation Angle Confidence 63";
BA_ "SystemSignalLongSymbol" SG_ 82 LRRF1_CAN_DET_CONFID_ELEVAT_0067 "LRRF1_CAN_DET_CONFID_ELEVATION_63";
BA_ "SignalDescription" SG_ 82 LRRF1_CAN_DET_CONFID_ELEVAT_0068 "Elevation Angle Confidence 62";
BA_ "SystemSignalLongSymbol" SG_ 82 LRRF1_CAN_DET_CONFID_ELEVAT_0068 "LRRF1_CAN_DET_CONFID_ELEVATION_62";
BA_ "SignalDescription" SG_ 82 LRRF1_CAN_DET_CONFID_ELEVAT_0069 "Elevation Angle Confidence 61";
BA_ "SystemSignalLongSymbol" SG_ 82 LRRF1_CAN_DET_CONFID_ELEVAT_0069 "LRRF1_CAN_DET_CONFID_ELEVATION_61";
BA_ "SignalDescription" SG_ 82 LRRF1_CAN_DET_CONFID_ELEVAT_0070 "Elevation Angle Confidence 60";
BA_ "SystemSignalLongSymbol" SG_ 82 LRRF1_CAN_DET_CONFID_ELEVAT_0070 "LRRF1_CAN_DET_CONFID_ELEVATION_60";
BA_ "SignalDescription" SG_ 82 LRRF1_CAN_DET_CONFID_ELEVAT_0071 "Elevation Angle Confidence 59";
BA_ "SystemSignalLongSymbol" SG_ 82 LRRF1_CAN_DET_CONFID_ELEVAT_0071 "LRRF1_CAN_DET_CONFID_ELEVATION_59";
BA_ "SignalDescription" SG_ 82 LRRF1_CAN_DET_CONFID_ELEVAT_0072 "Elevation Angle Confidence 59";
BA_ "SystemSignalLongSymbol" SG_ 82 LRRF1_CAN_DET_CONFID_ELEVAT_0072 "LRRF1_CAN_DET_CONFID_ELEVATION_58";
BA_ "GenSigVtEn" SG_ 82 LRRF1_CAN_DET_CONFID_AZIMUTH_63 "TRUE";
BA_ "SignalDescription" SG_ 82 LRRF1_CAN_DET_CONFID_AZIMUTH_63 "Signal to noise level 63";
BA_ "GenSigVtEn" SG_ 82 LRRF1_CAN_DET_CONFID_AZIMUTH_62 "TRUE";
BA_ "SignalDescription" SG_ 82 LRRF1_CAN_DET_CONFID_AZIMUTH_62 "Signal to noise level 62";
BA_ "GenSigVtEn" SG_ 82 LRRF1_CAN_DET_CONFID_AZIMUTH_61 "TRUE";
BA_ "SignalDescription" SG_ 82 LRRF1_CAN_DET_CONFID_AZIMUTH_61 "Signal to noise level 61";
BA_ "GenSigVtEn" SG_ 82 LRRF1_CAN_DET_CONFID_AZIMUTH_60 "TRUE";
BA_ "SignalDescription" SG_ 82 LRRF1_CAN_DET_CONFID_AZIMUTH_60 "Signal to noise level 60";
BA_ "GenSigVtEn" SG_ 82 LRRF1_CAN_DET_CONFID_AZIMUTH_59 "TRUE";
BA_ "SignalDescription" SG_ 82 LRRF1_CAN_DET_CONFID_AZIMUTH_59 "Signal to noise level 59";
BA_ "GenSigVtEn" SG_ 82 LRRF1_CAN_DET_CONFID_AZIMUTH_58 "TRUE";
BA_ "SignalDescription" SG_ 82 LRRF1_CAN_DET_CONFID_AZIMUTH_58 "Signal to noise level 59";
BA_ "GenSigStartValue" SG_ 82 LRRF1_CAN_DET_AZIMUTH_63 8194.05320813772;
BA_ "SignalDescription" SG_ 82 LRRF1_CAN_DET_AZIMUTH_63 "Detected object azimuth position 63";
BA_ "GenSigStartValue" SG_ 82 LRRF1_CAN_DET_AZIMUTH_62 8194.05320813772;
BA_ "SignalDescription" SG_ 82 LRRF1_CAN_DET_AZIMUTH_62 "Detected object azimuth position 62";
BA_ "GenSigStartValue" SG_ 82 LRRF1_CAN_DET_AZIMUTH_61 8194.05320813772;
BA_ "SignalDescription" SG_ 82 LRRF1_CAN_DET_AZIMUTH_61 "Detected object azimuth position 61";
BA_ "GenSigStartValue" SG_ 82 LRRF1_CAN_DET_AZIMUTH_60 8194.05320813772;
BA_ "SignalDescription" SG_ 82 LRRF1_CAN_DET_AZIMUTH_60 "Detected object azimuth position 60";
BA_ "GenSigStartValue" SG_ 82 LRRF1_CAN_DET_AZIMUTH_59 8194.05320813772;
BA_ "SignalDescription" SG_ 82 LRRF1_CAN_DET_AZIMUTH_59 "Detected object azimuth position 59";
BA_ "GenSigStartValue" SG_ 82 LRRF1_CAN_DET_AZIMUTH_58 8194.05320813772;
BA_ "SignalDescription" SG_ 82 LRRF1_CAN_DET_AZIMUTH_58 "Detected object azimuth position 59";
BA_ "SignalDescription" SG_ 82 LRRF1_CAN_DET_AMPLITUDE_63 "Detected object amplitude 63";
BA_ "SignalDescription" SG_ 82 LRRF1_CAN_DET_AMPLITUDE_62 "Detected object amplitude 62";
BA_ "SignalDescription" SG_ 82 LRRF1_CAN_DET_AMPLITUDE_61 "Detected object amplitude 61";
BA_ "SignalDescription" SG_ 82 LRRF1_CAN_DET_AMPLITUDE_60 "Detected object amplitude 60";
BA_ "SignalDescription" SG_ 82 LRRF1_CAN_DET_AMPLITUDE_59 "Detected object amplitude 59";
BA_ "SignalDescription" SG_ 82 LRRF1_CAN_DET_AMPLITUDE_58 "Detected object amplitude 59";
BA_ "SignalDescription" SG_ 82 LRRF1_CAN_DET_VALID_LEVEL_63 "Detected object valid level 63";
BA_ "SignalDescription" SG_ 82 LRRF1_CAN_DET_VALID_LEVEL_62 "Detected object valid level 62";
BA_ "SignalDescription" SG_ 82 LRRF1_CAN_DET_VALID_LEVEL_61 "Detected object valid level 61";
BA_ "SignalDescription" SG_ 82 LRRF1_CAN_DET_VALID_LEVEL_60 "Detected object valid level 60";
BA_ "SignalDescription" SG_ 82 LRRF1_CAN_DET_VALID_LEVEL_59 "Detected object valid level 59";
BA_ "SignalDescription" SG_ 82 LRRF1_CAN_DET_VALID_LEVEL_58 "Detected object valid level 59";
BA_ "GenSigSendType" SG_ 80 LRRF1_CAN_DET_Near_TARGET_49 1;
BA_ "SignalDescription" SG_ 80 LRRF1_CAN_DET_Near_TARGET_49 "Near_Target_Discrimination";
BA_ "SignalDescription" SG_ 80 LRRF1_CAN_DET_Near_TARGET_48 "Near_Target_Discrimination";
BA_ "SignalDescription" SG_ 80 LRRF1_CAN_DET_Near_TARGET_47 "Near_Target_Discrimination";
BA_ "SignalDescription" SG_ 80 LRRF1_CAN_DET_Near_TARGET_46 "Near_Target_Discrimination";
BA_ "SignalDescription" SG_ 80 LRRF1_CAN_DET_Near_TARGET_45 "Near_Target_Discrimination";
BA_ "SignalDescription" SG_ 80 LRRF1_CAN_DET_Near_TARGET_44 "Near_Target_Discrimination";
BA_ "SignalDescription" SG_ 80 LRRF1_CAN_DET_Near_TARGET_43 "Near_Target_Discrimination";
BA_ "GenSigStartValue" SG_ 80 LRRF1_CAN_DET_ELEVATION_43 63.8646288209607;
BA_ "SignalDescription" SG_ 80 LRRF1_CAN_DET_ELEVATION_43 "Detected object elevation position 43";
BA_ "GenSigVtEn" SG_ 80 LRRF1_CAN_DET_CONFID_AZIMUTH_43 "TRUE";
BA_ "SignalDescription" SG_ 80 LRRF1_CAN_DET_CONFID_AZIMUTH_43 "Signal to noise level 43";
BA_ "SignalDescription" SG_ 80 LRRF1_CAN_DET_SUPER_RES_TARGET_4 "Super resolution target 43";
BA_ "SystemSignalLongSymbol" SG_ 80 LRRF1_CAN_DET_SUPER_RES_TARGET_4 "LRRF1_CAN_DET_SUPER_RES_TARGET_43";
BA_ "SignalDescription" SG_ 80 LRRF1_CAN_DET_CONFID_ELEVATION_4 "Elevation Angle Confidence 43";
BA_ "SystemSignalLongSymbol" SG_ 80 LRRF1_CAN_DET_CONFID_ELEVATION_4 "LRRF1_CAN_DET_CONFID_ELEVATION_43";
BA_ "SignalDescription" SG_ 80 LRRF1_CAN_DET_HOST_VEH_CLUTTER_4 "Host vehicle clutter 43";
BA_ "SystemSignalLongSymbol" SG_ 80 LRRF1_CAN_DET_HOST_VEH_CLUTTER_4 "LRRF1_CAN_DET_HOST_VEH_CLUTTER_43";
BA_ "SignalDescription" SG_ 80 LRRF1_CAN_DET_VALID_LEVEL_43 "Detected object valid level 43";
BA_ "GenSigStartValue" SG_ 80 LRRF1_CAN_DET_AZIMUTH_43 8194.05320813772;
BA_ "SignalDescription" SG_ 80 LRRF1_CAN_DET_AZIMUTH_43 "Detected object azimuth position 43";
BA_ "SignalDescription" SG_ 80 LRRF1_CAN_DET_RANGE_43 "Detected object range 43";
BA_ "GenSigStartValue" SG_ 80 LRRF1_CAN_DET_RANGE_RATE_43 8192;
BA_ "SignalDescription" SG_ 80 LRRF1_CAN_DET_RANGE_RATE_43 "Detected object range rate 43";
BA_ "SignalDescription" SG_ 80 LRRF1_CAN_DET_AMPLITUDE_43 "Detected object amplitude 43";
BA_ "SignalDescription" SG_ 80 LRRF1_CAN_SCAN_INDEX_2LSB_43 "The two LSB of scan index 43";
BA_ "SignalDescription" SG_ 80 LRRF1_Det_CRC_07 "Cyclic Redundancy Check for Detection Message Number 7";
BA_ "SignalDescription" SG_ 80 LRRF1_Det_MC_07 "Message Count for Detection Message Number 7";
BA_ "SignalDescription" SG_ 80 LRRF1_CAN_SCAN_INDEX_2LSB_49 "The two LSB of scan index 49";
BA_ "SignalDescription" SG_ 80 LRRF1_CAN_SCAN_INDEX_2LSB_48 "The two LSB of scan index 48";
BA_ "SignalDescription" SG_ 80 LRRF1_CAN_SCAN_INDEX_2LSB_47 "The two LSB of scan index 47";
BA_ "SignalDescription" SG_ 80 LRRF1_CAN_SCAN_INDEX_2LSB_46 "The two LSB of scan index 46";
BA_ "SignalDescription" SG_ 80 LRRF1_CAN_SCAN_INDEX_2LSB_45 "The two LSB of scan index 45";
BA_ "SignalDescription" SG_ 80 LRRF1_CAN_SCAN_INDEX_2LSB_44 "The two LSB of scan index 44";
BA_ "GenSigStartValue" SG_ 80 LRRF1_CAN_DET_RANGE_RATE_49 8192;
BA_ "SignalDescription" SG_ 80 LRRF1_CAN_DET_RANGE_RATE_49 "Detected object range rate 49";
BA_ "GenSigStartValue" SG_ 80 LRRF1_CAN_DET_RANGE_RATE_48 8192;
BA_ "SignalDescription" SG_ 80 LRRF1_CAN_DET_RANGE_RATE_48 "Detected object range rate 48";
BA_ "GenSigStartValue" SG_ 80 LRRF1_CAN_DET_RANGE_RATE_47 8192;
BA_ "SignalDescription" SG_ 80 LRRF1_CAN_DET_RANGE_RATE_47 "Detected object range rate 47";
BA_ "GenSigStartValue" SG_ 80 LRRF1_CAN_DET_RANGE_RATE_46 8192;
BA_ "SignalDescription" SG_ 80 LRRF1_CAN_DET_RANGE_RATE_46 "Detected object range rate 46";
BA_ "GenSigStartValue" SG_ 80 LRRF1_CAN_DET_RANGE_RATE_45 8192;
BA_ "SignalDescription" SG_ 80 LRRF1_CAN_DET_RANGE_RATE_45 "Detected object range rate 45";
BA_ "GenSigStartValue" SG_ 80 LRRF1_CAN_DET_RANGE_RATE_44 8192;
BA_ "SignalDescription" SG_ 80 LRRF1_CAN_DET_RANGE_RATE_44 "Detected object range rate 44";
BA_ "SignalDescription" SG_ 80 LRRF1_CAN_DET_RANGE_49 "Detected object range 49";
BA_ "SignalDescription" SG_ 80 LRRF1_CAN_DET_RANGE_48 "Detected object range 48";
BA_ "SignalDescription" SG_ 80 LRRF1_CAN_DET_RANGE_47 "Detected object range 47";
BA_ "SignalDescription" SG_ 80 LRRF1_CAN_DET_RANGE_46 "Detected object range 46";
BA_ "SignalDescription" SG_ 80 LRRF1_CAN_DET_RANGE_45 "Detected object range 45";
BA_ "SignalDescription" SG_ 80 LRRF1_CAN_DET_RANGE_44 "Detected object range 44";
BA_ "SignalDescription" SG_ 80 LRRF1_CAN_DET_SUPER_RES_TAR_0073 "Super resolution target 49";
BA_ "SystemSignalLongSymbol" SG_ 80 LRRF1_CAN_DET_SUPER_RES_TAR_0073 "LRRF1_CAN_DET_SUPER_RES_TARGET_49";
BA_ "SignalDescription" SG_ 80 LRRF1_CAN_DET_SUPER_RES_TAR_0074 "Super resolution target 48";
BA_ "SystemSignalLongSymbol" SG_ 80 LRRF1_CAN_DET_SUPER_RES_TAR_0074 "LRRF1_CAN_DET_SUPER_RES_TARGET_48";
BA_ "SignalDescription" SG_ 80 LRRF1_CAN_DET_SUPER_RES_TAR_0075 "Super resolution target 47";
BA_ "SystemSignalLongSymbol" SG_ 80 LRRF1_CAN_DET_SUPER_RES_TAR_0075 "LRRF1_CAN_DET_SUPER_RES_TARGET_47";
BA_ "SignalDescription" SG_ 80 LRRF1_CAN_DET_SUPER_RES_TAR_0076 "Super resolution target 46";
BA_ "SystemSignalLongSymbol" SG_ 80 LRRF1_CAN_DET_SUPER_RES_TAR_0076 "LRRF1_CAN_DET_SUPER_RES_TARGET_46";
BA_ "SignalDescription" SG_ 80 LRRF1_CAN_DET_SUPER_RES_TAR_0077 "Super resolution target 45";
BA_ "SystemSignalLongSymbol" SG_ 80 LRRF1_CAN_DET_SUPER_RES_TAR_0077 "LRRF1_CAN_DET_SUPER_RES_TARGET_45";
BA_ "SignalDescription" SG_ 80 LRRF1_CAN_DET_SUPER_RES_TAR_0078 "Super resolution target 44";
BA_ "SystemSignalLongSymbol" SG_ 80 LRRF1_CAN_DET_SUPER_RES_TAR_0078 "LRRF1_CAN_DET_SUPER_RES_TARGET_44";
BA_ "SignalDescription" SG_ 80 LRRF1_CAN_DET_HOST_VEH_CLUT_0073 "Host vehicle clutter 49";
BA_ "SystemSignalLongSymbol" SG_ 80 LRRF1_CAN_DET_HOST_VEH_CLUT_0073 "LRRF1_CAN_DET_HOST_VEH_CLUTTER_49";
BA_ "SignalDescription" SG_ 80 LRRF1_CAN_DET_HOST_VEH_CLUT_0074 "Host vehicle clutter 48";
BA_ "SystemSignalLongSymbol" SG_ 80 LRRF1_CAN_DET_HOST_VEH_CLUT_0074 "LRRF1_CAN_DET_HOST_VEH_CLUTTER_48";
BA_ "SignalDescription" SG_ 80 LRRF1_CAN_DET_HOST_VEH_CLUT_0075 "Host vehicle clutter 47";
BA_ "SystemSignalLongSymbol" SG_ 80 LRRF1_CAN_DET_HOST_VEH_CLUT_0075 "LRRF1_CAN_DET_HOST_VEH_CLUTTER_47";
BA_ "SignalDescription" SG_ 80 LRRF1_CAN_DET_HOST_VEH_CLUT_0076 "Host vehicle clutter 46";
BA_ "SystemSignalLongSymbol" SG_ 80 LRRF1_CAN_DET_HOST_VEH_CLUT_0076 "LRRF1_CAN_DET_HOST_VEH_CLUTTER_46";
BA_ "SignalDescription" SG_ 80 LRRF1_CAN_DET_HOST_VEH_CLUT_0077 "Host vehicle clutter 45";
BA_ "SystemSignalLongSymbol" SG_ 80 LRRF1_CAN_DET_HOST_VEH_CLUT_0077 "LRRF1_CAN_DET_HOST_VEH_CLUTTER_45";
BA_ "SignalDescription" SG_ 80 LRRF1_CAN_DET_HOST_VEH_CLUT_0078 "Host vehicle clutter 44";
BA_ "SystemSignalLongSymbol" SG_ 80 LRRF1_CAN_DET_HOST_VEH_CLUT_0078 "LRRF1_CAN_DET_HOST_VEH_CLUTTER_44";
BA_ "GenSigStartValue" SG_ 80 LRRF1_CAN_DET_ELEVATION_49 63.8646288209607;
BA_ "SignalDescription" SG_ 80 LRRF1_CAN_DET_ELEVATION_49 "Detected object elevation position 49";
BA_ "GenSigStartValue" SG_ 80 LRRF1_CAN_DET_ELEVATION_48 63.8646288209607;
BA_ "SignalDescription" SG_ 80 LRRF1_CAN_DET_ELEVATION_48 "Detected object elevation position 48";
BA_ "GenSigStartValue" SG_ 80 LRRF1_CAN_DET_ELEVATION_47 63.8646288209607;
BA_ "SignalDescription" SG_ 80 LRRF1_CAN_DET_ELEVATION_47 "Detected object elevation position 47";
BA_ "GenSigStartValue" SG_ 80 LRRF1_CAN_DET_ELEVATION_46 63.8646288209607;
BA_ "SignalDescription" SG_ 80 LRRF1_CAN_DET_ELEVATION_46 "Detected object elevation position 46";
BA_ "GenSigStartValue" SG_ 80 LRRF1_CAN_DET_ELEVATION_45 63.8646288209607;
BA_ "SignalDescription" SG_ 80 LRRF1_CAN_DET_ELEVATION_45 "Detected object elevation position 45";
BA_ "GenSigStartValue" SG_ 80 LRRF1_CAN_DET_ELEVATION_44 63.8646288209607;
BA_ "SignalDescription" SG_ 80 LRRF1_CAN_DET_ELEVATION_44 "Detected object elevation position 45";
BA_ "SignalDescription" SG_ 80 LRRF1_CAN_DET_CONFID_ELEVAT_0073 "Elevation Angle Confidence 49";
BA_ "SystemSignalLongSymbol" SG_ 80 LRRF1_CAN_DET_CONFID_ELEVAT_0073 "LRRF1_CAN_DET_CONFID_ELEVATION_49";
BA_ "SignalDescription" SG_ 80 LRRF1_CAN_DET_CONFID_ELEVAT_0074 "Elevation Angle Confidence 48";
BA_ "SystemSignalLongSymbol" SG_ 80 LRRF1_CAN_DET_CONFID_ELEVAT_0074 "LRRF1_CAN_DET_CONFID_ELEVATION_48";
BA_ "SignalDescription" SG_ 80 LRRF1_CAN_DET_CONFID_ELEVAT_0075 "Elevation Angle Confidence 47";
BA_ "SystemSignalLongSymbol" SG_ 80 LRRF1_CAN_DET_CONFID_ELEVAT_0075 "LRRF1_CAN_DET_CONFID_ELEVATION_47";
BA_ "SignalDescription" SG_ 80 LRRF1_CAN_DET_CONFID_ELEVAT_0076 "Elevation Angle Confidence 46";
BA_ "SystemSignalLongSymbol" SG_ 80 LRRF1_CAN_DET_CONFID_ELEVAT_0076 "LRRF1_CAN_DET_CONFID_ELEVATION_46";
BA_ "SignalDescription" SG_ 80 LRRF1_CAN_DET_CONFID_ELEVAT_0077 "Elevation Angle Confidence 45";
BA_ "SystemSignalLongSymbol" SG_ 80 LRRF1_CAN_DET_CONFID_ELEVAT_0077 "LRRF1_CAN_DET_CONFID_ELEVATION_45";
BA_ "SignalDescription" SG_ 80 LRRF1_CAN_DET_CONFID_ELEVAT_0078 "Elevation Angle Confidence 44";
BA_ "SystemSignalLongSymbol" SG_ 80 LRRF1_CAN_DET_CONFID_ELEVAT_0078 "LRRF1_CAN_DET_CONFID_ELEVATION_44";
BA_ "GenSigVtEn" SG_ 80 LRRF1_CAN_DET_CONFID_AZIMUTH_49 "TRUE";
BA_ "SignalDescription" SG_ 80 LRRF1_CAN_DET_CONFID_AZIMUTH_49 "Signal to noise level 49";
BA_ "GenSigVtEn" SG_ 80 LRRF1_CAN_DET_CONFID_AZIMUTH_48 "TRUE";
BA_ "SignalDescription" SG_ 80 LRRF1_CAN_DET_CONFID_AZIMUTH_48 "Signal to noise level 48";
BA_ "GenSigVtEn" SG_ 80 LRRF1_CAN_DET_CONFID_AZIMUTH_47 "TRUE";
BA_ "SignalDescription" SG_ 80 LRRF1_CAN_DET_CONFID_AZIMUTH_47 "Signal to noise level 47";
BA_ "GenSigVtEn" SG_ 80 LRRF1_CAN_DET_CONFID_AZIMUTH_46 "TRUE";
BA_ "SignalDescription" SG_ 80 LRRF1_CAN_DET_CONFID_AZIMUTH_46 "Signal to noise level 46";
BA_ "GenSigVtEn" SG_ 80 LRRF1_CAN_DET_CONFID_AZIMUTH_45 "TRUE";
BA_ "SignalDescription" SG_ 80 LRRF1_CAN_DET_CONFID_AZIMUTH_45 "Signal to noise level 45";
BA_ "GenSigVtEn" SG_ 80 LRRF1_CAN_DET_CONFID_AZIMUTH_44 "TRUE";
BA_ "SignalDescription" SG_ 80 LRRF1_CAN_DET_CONFID_AZIMUTH_44 "Signal to noise level 44";
BA_ "GenSigStartValue" SG_ 80 LRRF1_CAN_DET_AZIMUTH_49 8194.05320813772;
BA_ "SignalDescription" SG_ 80 LRRF1_CAN_DET_AZIMUTH_49 "Detected object azimuth position 49";
BA_ "GenSigStartValue" SG_ 80 LRRF1_CAN_DET_AZIMUTH_48 8194.05320813772;
BA_ "SignalDescription" SG_ 80 LRRF1_CAN_DET_AZIMUTH_48 "Detected object azimuth position 48";
BA_ "GenSigStartValue" SG_ 80 LRRF1_CAN_DET_AZIMUTH_47 8194.05320813772;
BA_ "SignalDescription" SG_ 80 LRRF1_CAN_DET_AZIMUTH_47 "Detected object azimuth position 47";
BA_ "GenSigStartValue" SG_ 80 LRRF1_CAN_DET_AZIMUTH_46 8194.05320813772;
BA_ "SignalDescription" SG_ 80 LRRF1_CAN_DET_AZIMUTH_46 "Detected object azimuth position 46";
BA_ "GenSigStartValue" SG_ 80 LRRF1_CAN_DET_AZIMUTH_45 8194.05320813772;
BA_ "SignalDescription" SG_ 80 LRRF1_CAN_DET_AZIMUTH_45 "Detected object azimuth position 45";
BA_ "GenSigStartValue" SG_ 80 LRRF1_CAN_DET_AZIMUTH_44 8194.05320813772;
BA_ "SignalDescription" SG_ 80 LRRF1_CAN_DET_AZIMUTH_44 "Detected object azimuth position 44";
BA_ "SignalDescription" SG_ 80 LRRF1_CAN_DET_AMPLITUDE_49 "Detected object amplitude 49";
BA_ "SignalDescription" SG_ 80 LRRF1_CAN_DET_AMPLITUDE_48 "Detected object amplitude 48";
BA_ "SignalDescription" SG_ 80 LRRF1_CAN_DET_AMPLITUDE_47 "Detected object amplitude 47";
BA_ "SignalDescription" SG_ 80 LRRF1_CAN_DET_AMPLITUDE_46 "Detected object amplitude 46";
BA_ "SignalDescription" SG_ 80 LRRF1_CAN_DET_AMPLITUDE_45 "Detected object amplitude 45";
BA_ "SignalDescription" SG_ 80 LRRF1_CAN_DET_AMPLITUDE_44 "Detected object amplitude 44";
BA_ "SignalDescription" SG_ 80 LRRF1_CAN_DET_VALID_LEVEL_49 "Detected object valid level 49";
BA_ "SignalDescription" SG_ 80 LRRF1_CAN_DET_VALID_LEVEL_48 "Detected object valid level 48";
BA_ "SignalDescription" SG_ 80 LRRF1_CAN_DET_VALID_LEVEL_47 "Detected object valid level 47";
BA_ "SignalDescription" SG_ 80 LRRF1_CAN_DET_VALID_LEVEL_46 "Detected object valid level 46";
BA_ "SignalDescription" SG_ 80 LRRF1_CAN_DET_VALID_LEVEL_45 "Detected object valid level 45";
BA_ "SignalDescription" SG_ 80 LRRF1_CAN_DET_VALID_LEVEL_44 "Detected object valid level 44";
BA_ "GenSigSendType" SG_ 79 LRRF1_CAN_DET_Near_TARGET_42 1;
BA_ "SignalDescription" SG_ 79 LRRF1_CAN_DET_Near_TARGET_42 "Near_Target_Discrimination";
BA_ "SignalDescription" SG_ 79 LRRF1_CAN_DET_Near_TARGET_41 "Near_Target_Discrimination";
BA_ "SignalDescription" SG_ 79 LRRF1_CAN_DET_Near_TARGET_39 "Near_Target_Discrimination";
BA_ "SignalDescription" SG_ 79 LRRF1_CAN_DET_Near_TARGET_40 "Near_Target_Discrimination";
BA_ "SignalDescription" SG_ 79 LRRF1_CAN_DET_Near_TARGET_38 "Near_Target_Discrimination";
BA_ "SignalDescription" SG_ 79 LRRF1_CAN_DET_Near_TARGET_37 "Near_Target_Discrimination";
BA_ "SignalDescription" SG_ 79 LRRF1_CAN_DET_Near_TARGET_36 "Near_Target_Discrimination";
BA_ "GenSigStartValue" SG_ 79 LRRF1_CAN_DET_ELEVATION_36 63.8646288209607;
BA_ "SignalDescription" SG_ 79 LRRF1_CAN_DET_ELEVATION_36 "Detected object elevation position 36";
BA_ "GenSigVtEn" SG_ 79 LRRF1_CAN_DET_CONFID_AZIMUTH_36 "TRUE";
BA_ "SignalDescription" SG_ 79 LRRF1_CAN_DET_CONFID_AZIMUTH_36 "Signal to noise level 36";
BA_ "SignalDescription" SG_ 79 LRRF1_CAN_DET_SUPER_RES_TARGET_3 "Super resolution target 36";
BA_ "SystemSignalLongSymbol" SG_ 79 LRRF1_CAN_DET_SUPER_RES_TARGET_3 "LRRF1_CAN_DET_SUPER_RES_TARGET_36";
BA_ "SignalDescription" SG_ 79 LRRF1_CAN_DET_CONFID_ELEVATION_3 "Elevation Angle Confidence 36";
BA_ "SystemSignalLongSymbol" SG_ 79 LRRF1_CAN_DET_CONFID_ELEVATION_3 "LRRF1_CAN_DET_CONFID_ELEVATION_36";
BA_ "SignalDescription" SG_ 79 LRRF1_CAN_DET_HOST_VEH_CLUTTER_3 "Host vehicle clutter 36";
BA_ "SystemSignalLongSymbol" SG_ 79 LRRF1_CAN_DET_HOST_VEH_CLUTTER_3 "LRRF1_CAN_DET_HOST_VEH_CLUTTER_36";
BA_ "SignalDescription" SG_ 79 LRRF1_CAN_DET_VALID_LEVEL_36 "Detected object valid level 36";
BA_ "GenSigStartValue" SG_ 79 LRRF1_CAN_DET_AZIMUTH_36 8194.05320813772;
BA_ "SignalDescription" SG_ 79 LRRF1_CAN_DET_AZIMUTH_36 "Detected object azimuth position 36";
BA_ "SignalDescription" SG_ 79 LRRF1_CAN_DET_RANGE_36 "Detected object range 36";
BA_ "GenSigStartValue" SG_ 79 LRRF1_CAN_DET_RANGE_RATE_36 8192;
BA_ "SignalDescription" SG_ 79 LRRF1_CAN_DET_RANGE_RATE_36 "Detected object range rate 36";
BA_ "SignalDescription" SG_ 79 LRRF1_CAN_DET_AMPLITUDE_36 "Detected object amplitude 36";
BA_ "SignalDescription" SG_ 79 LRRF1_CAN_SCAN_INDEX_2LSB_36 "The two LSB of scan index 36";
BA_ "SignalDescription" SG_ 79 LRRF1_Det_CRC_06 "Cyclic Redundancy Check for Detection Message Number 6";
BA_ "SignalDescription" SG_ 79 LRRF1_Det_MC_06 "Message Count for Detection Message Number 6";
BA_ "SignalDescription" SG_ 79 LRRF1_CAN_SCAN_INDEX_2LSB_42 "The two LSB of scan index 42";
BA_ "SignalDescription" SG_ 79 LRRF1_CAN_SCAN_INDEX_2LSB_41 "The two LSB of scan index 41";
BA_ "SignalDescription" SG_ 79 LRRF1_CAN_SCAN_INDEX_2LSB_40 "The two LSB of scan index 40";
BA_ "SignalDescription" SG_ 79 LRRF1_CAN_SCAN_INDEX_2LSB_39 "The two LSB of scan index 39";
BA_ "SignalDescription" SG_ 79 LRRF1_CAN_SCAN_INDEX_2LSB_38 "The two LSB of scan index 38";
BA_ "SignalDescription" SG_ 79 LRRF1_CAN_SCAN_INDEX_2LSB_37 "The two LSB of scan index 37";
BA_ "GenSigStartValue" SG_ 79 LRRF1_CAN_DET_RANGE_RATE_42 8192;
BA_ "SignalDescription" SG_ 79 LRRF1_CAN_DET_RANGE_RATE_42 "Detected object range rate 42";
BA_ "GenSigStartValue" SG_ 79 LRRF1_CAN_DET_RANGE_RATE_41 8192;
BA_ "SignalDescription" SG_ 79 LRRF1_CAN_DET_RANGE_RATE_41 "Detected object range rate 41";
BA_ "GenSigStartValue" SG_ 79 LRRF1_CAN_DET_RANGE_RATE_40 8192;
BA_ "SignalDescription" SG_ 79 LRRF1_CAN_DET_RANGE_RATE_40 "Detected object range rate 40";
BA_ "GenSigStartValue" SG_ 79 LRRF1_CAN_DET_RANGE_RATE_39 8192;
BA_ "SignalDescription" SG_ 79 LRRF1_CAN_DET_RANGE_RATE_39 "Detected object range rate 39";
BA_ "GenSigStartValue" SG_ 79 LRRF1_CAN_DET_RANGE_RATE_38 8192;
BA_ "SignalDescription" SG_ 79 LRRF1_CAN_DET_RANGE_RATE_38 "Detected object range rate 38";
BA_ "GenSigStartValue" SG_ 79 LRRF1_CAN_DET_RANGE_RATE_37 8192;
BA_ "SignalDescription" SG_ 79 LRRF1_CAN_DET_RANGE_RATE_37 "Detected object range rate 37";
BA_ "SignalDescription" SG_ 79 LRRF1_CAN_DET_RANGE_42 "Detected object range 42";
BA_ "SignalDescription" SG_ 79 LRRF1_CAN_DET_RANGE_41 "Detected object range 41";
BA_ "SignalDescription" SG_ 79 LRRF1_CAN_DET_RANGE_40 "Detected object range 40";
BA_ "SignalDescription" SG_ 79 LRRF1_CAN_DET_RANGE_39 "Detected object range 39";
BA_ "SignalDescription" SG_ 79 LRRF1_CAN_DET_RANGE_38 "Detected object range 38";
BA_ "SignalDescription" SG_ 79 LRRF1_CAN_DET_RANGE_37 "Detected object range 37";
BA_ "SignalDescription" SG_ 79 LRRF1_CAN_DET_SUPER_RES_TAR_0079 "Super resolution target 42";
BA_ "SystemSignalLongSymbol" SG_ 79 LRRF1_CAN_DET_SUPER_RES_TAR_0079 "LRRF1_CAN_DET_SUPER_RES_TARGET_42";
BA_ "SignalDescription" SG_ 79 LRRF1_CAN_DET_SUPER_RES_TAR_0080 "Super resolution target 41";
BA_ "SystemSignalLongSymbol" SG_ 79 LRRF1_CAN_DET_SUPER_RES_TAR_0080 "LRRF1_CAN_DET_SUPER_RES_TARGET_41";
BA_ "SignalDescription" SG_ 79 LRRF1_CAN_DET_SUPER_RES_TAR_0081 "Super resolution target 40";
BA_ "SystemSignalLongSymbol" SG_ 79 LRRF1_CAN_DET_SUPER_RES_TAR_0081 "LRRF1_CAN_DET_SUPER_RES_TARGET_40";
BA_ "SignalDescription" SG_ 79 LRRF1_CAN_DET_SUPER_RES_TAR_0082 "Super resolution target 39";
BA_ "SystemSignalLongSymbol" SG_ 79 LRRF1_CAN_DET_SUPER_RES_TAR_0082 "LRRF1_CAN_DET_SUPER_RES_TARGET_39";
BA_ "SignalDescription" SG_ 79 LRRF1_CAN_DET_SUPER_RES_TAR_0083 "Super resolution target 38";
BA_ "SystemSignalLongSymbol" SG_ 79 LRRF1_CAN_DET_SUPER_RES_TAR_0083 "LRRF1_CAN_DET_SUPER_RES_TARGET_38";
BA_ "SignalDescription" SG_ 79 LRRF1_CAN_DET_SUPER_RES_TAR_0084 "Super resolution target 37";
BA_ "SystemSignalLongSymbol" SG_ 79 LRRF1_CAN_DET_SUPER_RES_TAR_0084 "LRRF1_CAN_DET_SUPER_RES_TARGET_37";
BA_ "SignalDescription" SG_ 79 LRRF1_CAN_DET_HOST_VEH_CLUT_0079 "Host vehicle clutter 42";
BA_ "SystemSignalLongSymbol" SG_ 79 LRRF1_CAN_DET_HOST_VEH_CLUT_0079 "LRRF1_CAN_DET_HOST_VEH_CLUTTER_42";
BA_ "SignalDescription" SG_ 79 LRRF1_CAN_DET_HOST_VEH_CLUT_0080 "Host vehicle clutter 41";
BA_ "SystemSignalLongSymbol" SG_ 79 LRRF1_CAN_DET_HOST_VEH_CLUT_0080 "LRRF1_CAN_DET_HOST_VEH_CLUTTER_41";
BA_ "SignalDescription" SG_ 79 LRRF1_CAN_DET_HOST_VEH_CLUT_0081 "Host vehicle clutter 40";
BA_ "SystemSignalLongSymbol" SG_ 79 LRRF1_CAN_DET_HOST_VEH_CLUT_0081 "LRRF1_CAN_DET_HOST_VEH_CLUTTER_40";
BA_ "SignalDescription" SG_ 79 LRRF1_CAN_DET_HOST_VEH_CLUT_0082 "Host vehicle clutter 39";
BA_ "SystemSignalLongSymbol" SG_ 79 LRRF1_CAN_DET_HOST_VEH_CLUT_0082 "LRRF1_CAN_DET_HOST_VEH_CLUTTER_39";
BA_ "SignalDescription" SG_ 79 LRRF1_CAN_DET_HOST_VEH_CLUT_0083 "Host vehicle clutter 38";
BA_ "SystemSignalLongSymbol" SG_ 79 LRRF1_CAN_DET_HOST_VEH_CLUT_0083 "LRRF1_CAN_DET_HOST_VEH_CLUTTER_38";
BA_ "SignalDescription" SG_ 79 LRRF1_CAN_DET_HOST_VEH_CLUT_0084 "Host vehicle clutter 37";
BA_ "SystemSignalLongSymbol" SG_ 79 LRRF1_CAN_DET_HOST_VEH_CLUT_0084 "LRRF1_CAN_DET_HOST_VEH_CLUTTER_37";
BA_ "GenSigStartValue" SG_ 79 LRRF1_CAN_DET_ELEVATION_42 63.8646288209607;
BA_ "SignalDescription" SG_ 79 LRRF1_CAN_DET_ELEVATION_42 "Detected object elevation position 42";
BA_ "GenSigStartValue" SG_ 79 LRRF1_CAN_DET_ELEVATION_41 63.8646288209607;
BA_ "SignalDescription" SG_ 79 LRRF1_CAN_DET_ELEVATION_41 "Detected object elevation position 41";
BA_ "GenSigStartValue" SG_ 79 LRRF1_CAN_DET_ELEVATION_40 63.8646288209607;
BA_ "SignalDescription" SG_ 79 LRRF1_CAN_DET_ELEVATION_40 "Detected object elevation position 40";
BA_ "GenSigStartValue" SG_ 79 LRRF1_CAN_DET_ELEVATION_39 63.8646288209607;
BA_ "SignalDescription" SG_ 79 LRRF1_CAN_DET_ELEVATION_39 "Detected object elevation position 39";
BA_ "GenSigStartValue" SG_ 79 LRRF1_CAN_DET_ELEVATION_38 63.8646288209607;
BA_ "SignalDescription" SG_ 79 LRRF1_CAN_DET_ELEVATION_38 "Detected object elevation position 38";
BA_ "GenSigStartValue" SG_ 79 LRRF1_CAN_DET_ELEVATION_37 63.8646288209607;
BA_ "SignalDescription" SG_ 79 LRRF1_CAN_DET_ELEVATION_37 "Detected object elevation position 37";
BA_ "SignalDescription" SG_ 79 LRRF1_CAN_DET_CONFID_ELEVAT_0079 "Elevation Angle Confidence 42";
BA_ "SystemSignalLongSymbol" SG_ 79 LRRF1_CAN_DET_CONFID_ELEVAT_0079 "LRRF1_CAN_DET_CONFID_ELEVATION_42";
BA_ "SignalDescription" SG_ 79 LRRF1_CAN_DET_CONFID_ELEVAT_0080 "Elevation Angle Confidence 41";
BA_ "SystemSignalLongSymbol" SG_ 79 LRRF1_CAN_DET_CONFID_ELEVAT_0080 "LRRF1_CAN_DET_CONFID_ELEVATION_41";
BA_ "SignalDescription" SG_ 79 LRRF1_CAN_DET_CONFID_ELEVAT_0081 "Elevation Angle Confidence 40";
BA_ "SystemSignalLongSymbol" SG_ 79 LRRF1_CAN_DET_CONFID_ELEVAT_0081 "LRRF1_CAN_DET_CONFID_ELEVATION_40";
BA_ "SignalDescription" SG_ 79 LRRF1_CAN_DET_CONFID_ELEVAT_0082 "Elevation Angle Confidence 39";
BA_ "SystemSignalLongSymbol" SG_ 79 LRRF1_CAN_DET_CONFID_ELEVAT_0082 "LRRF1_CAN_DET_CONFID_ELEVATION_39";
BA_ "SignalDescription" SG_ 79 LRRF1_CAN_DET_CONFID_ELEVAT_0083 "Elevation Angle Confidence 38";
BA_ "SystemSignalLongSymbol" SG_ 79 LRRF1_CAN_DET_CONFID_ELEVAT_0083 "LRRF1_CAN_DET_CONFID_ELEVATION_38";
BA_ "SignalDescription" SG_ 79 LRRF1_CAN_DET_CONFID_ELEVAT_0084 "Elevation Angle Confidence 37";
BA_ "SystemSignalLongSymbol" SG_ 79 LRRF1_CAN_DET_CONFID_ELEVAT_0084 "LRRF1_CAN_DET_CONFID_ELEVATION_37";
BA_ "GenSigVtEn" SG_ 79 LRRF1_CAN_DET_CONFID_AZIMUTH_42 "TRUE";
BA_ "SignalDescription" SG_ 79 LRRF1_CAN_DET_CONFID_AZIMUTH_42 "Signal to noise level 42";
BA_ "GenSigVtEn" SG_ 79 LRRF1_CAN_DET_CONFID_AZIMUTH_41 "TRUE";
BA_ "SignalDescription" SG_ 79 LRRF1_CAN_DET_CONFID_AZIMUTH_41 "Signal to noise level 41";
BA_ "GenSigVtEn" SG_ 79 LRRF1_CAN_DET_CONFID_AZIMUTH_40 "TRUE";
BA_ "SignalDescription" SG_ 79 LRRF1_CAN_DET_CONFID_AZIMUTH_40 "Signal to noise level 40";
BA_ "GenSigVtEn" SG_ 79 LRRF1_CAN_DET_CONFID_AZIMUTH_39 "TRUE";
BA_ "SignalDescription" SG_ 79 LRRF1_CAN_DET_CONFID_AZIMUTH_39 "Signal to noise level 39";
BA_ "GenSigVtEn" SG_ 79 LRRF1_CAN_DET_CONFID_AZIMUTH_38 "TRUE";
BA_ "SignalDescription" SG_ 79 LRRF1_CAN_DET_CONFID_AZIMUTH_38 "Signal to noise level 38";
BA_ "GenSigVtEn" SG_ 79 LRRF1_CAN_DET_CONFID_AZIMUTH_37 "TRUE";
BA_ "SignalDescription" SG_ 79 LRRF1_CAN_DET_CONFID_AZIMUTH_37 "Signal to noise level 37";
BA_ "GenSigStartValue" SG_ 79 LRRF1_CAN_DET_AZIMUTH_42 8194.05320813772;
BA_ "SignalDescription" SG_ 79 LRRF1_CAN_DET_AZIMUTH_42 "Detected object azimuth position 42";
BA_ "GenSigStartValue" SG_ 79 LRRF1_CAN_DET_AZIMUTH_41 8194.05320813772;
BA_ "SignalDescription" SG_ 79 LRRF1_CAN_DET_AZIMUTH_41 "Detected object azimuth position 41";
BA_ "GenSigStartValue" SG_ 79 LRRF1_CAN_DET_AZIMUTH_40 8194.05320813772;
BA_ "SignalDescription" SG_ 79 LRRF1_CAN_DET_AZIMUTH_40 "Detected object azimuth position 40";
BA_ "GenSigStartValue" SG_ 79 LRRF1_CAN_DET_AZIMUTH_39 8194.05320813772;
BA_ "SignalDescription" SG_ 79 LRRF1_CAN_DET_AZIMUTH_39 "Detected object azimuth position 39";
BA_ "GenSigStartValue" SG_ 79 LRRF1_CAN_DET_AZIMUTH_38 8194.05320813772;
BA_ "SignalDescription" SG_ 79 LRRF1_CAN_DET_AZIMUTH_38 "Detected object azimuth position 38";
BA_ "GenSigStartValue" SG_ 79 LRRF1_CAN_DET_AZIMUTH_37 8194.05320813772;
BA_ "SignalDescription" SG_ 79 LRRF1_CAN_DET_AZIMUTH_37 "Detected object azimuth position 37";
BA_ "SignalDescription" SG_ 79 LRRF1_CAN_DET_AMPLITUDE_42 "Detected object amplitude 42";
BA_ "SignalDescription" SG_ 79 LRRF1_CAN_DET_AMPLITUDE_41 "Detected object amplitude 41";
BA_ "SignalDescription" SG_ 79 LRRF1_CAN_DET_AMPLITUDE_40 "Detected object amplitude 40";
BA_ "SignalDescription" SG_ 79 LRRF1_CAN_DET_AMPLITUDE_39 "Detected object amplitude 39";
BA_ "SignalDescription" SG_ 79 LRRF1_CAN_DET_AMPLITUDE_38 "Detected object amplitude 38";
BA_ "SignalDescription" SG_ 79 LRRF1_CAN_DET_AMPLITUDE_37 "Detected object amplitude 37";
BA_ "SignalDescription" SG_ 79 LRRF1_CAN_DET_VALID_LEVEL_42 "Detected object valid level 42";
BA_ "SignalDescription" SG_ 79 LRRF1_CAN_DET_VALID_LEVEL_41 "Detected object valid level 41";
BA_ "SignalDescription" SG_ 79 LRRF1_CAN_DET_VALID_LEVEL_40 "Detected object valid level 40";
BA_ "SignalDescription" SG_ 79 LRRF1_CAN_DET_VALID_LEVEL_39 "Detected object valid level 39";
BA_ "SignalDescription" SG_ 79 LRRF1_CAN_DET_VALID_LEVEL_38 "Detected object valid level 38";
BA_ "SignalDescription" SG_ 79 LRRF1_CAN_DET_VALID_LEVEL_37 "Detected object valid level 37";
BA_ "GenSigSendType" SG_ 78 LRRF1_CAN_DET_Near_TARGET_35 1;
BA_ "SignalDescription" SG_ 78 LRRF1_CAN_DET_Near_TARGET_35 "Near_Target_Discrimination";
BA_ "SignalDescription" SG_ 78 LRRF1_CAN_DET_Near_TARGET_34 "Near_Target_Discrimination";
BA_ "SignalDescription" SG_ 78 LRRF1_CAN_DET_Near_TARGET_33 "Near_Target_Discrimination";
BA_ "SignalDescription" SG_ 78 LRRF1_CAN_DET_Near_TARGET_32 "Near_Target_Discrimination";
BA_ "SignalDescription" SG_ 78 LRRF1_CAN_DET_Near_TARGET_31 "Near_Target_Discrimination";
BA_ "SignalDescription" SG_ 78 LRRF1_CAN_DET_Near_TARGET_30 "Near_Target_Discrimination";
BA_ "SignalDescription" SG_ 78 LRRF1_CAN_DET_Near_TARGET_29 "Near_Target_Discrimination";
BA_ "GenSigStartValue" SG_ 78 LRRF1_CAN_DET_ELEVATION_29 63.8646288209607;
BA_ "SignalDescription" SG_ 78 LRRF1_CAN_DET_ELEVATION_29 "Detected object elevation position 29";
BA_ "GenSigVtEn" SG_ 78 LRRF1_CAN_DET_CONFID_AZIMUTH_29 "TRUE";
BA_ "SignalDescription" SG_ 78 LRRF1_CAN_DET_CONFID_AZIMUTH_29 "Signal to noise level 29";
BA_ "SignalDescription" SG_ 78 LRRF1_CAN_DET_SUPER_RES_TARGET_2 "Super resolution target 29";
BA_ "SystemSignalLongSymbol" SG_ 78 LRRF1_CAN_DET_SUPER_RES_TARGET_2 "LRRF1_CAN_DET_SUPER_RES_TARGET_29";
BA_ "SignalDescription" SG_ 78 LRRF1_CAN_DET_CONFID_ELEVATION_2 "Elevation Angle Confidence 29";
BA_ "SystemSignalLongSymbol" SG_ 78 LRRF1_CAN_DET_CONFID_ELEVATION_2 "LRRF1_CAN_DET_CONFID_ELEVATION_29";
BA_ "SignalDescription" SG_ 78 LRRF1_CAN_DET_HOST_VEH_CLUTTER_2 "Host vehicle clutter 29";
BA_ "SystemSignalLongSymbol" SG_ 78 LRRF1_CAN_DET_HOST_VEH_CLUTTER_2 "LRRF1_CAN_DET_HOST_VEH_CLUTTER_29";
BA_ "SignalDescription" SG_ 78 LRRF1_CAN_DET_VALID_LEVEL_29 "Detected object valid level 29";
BA_ "GenSigStartValue" SG_ 78 LRRF1_CAN_DET_AZIMUTH_29 8194.05320813772;
BA_ "SignalDescription" SG_ 78 LRRF1_CAN_DET_AZIMUTH_29 "Detected object azimuth position 29";
BA_ "SignalDescription" SG_ 78 LRRF1_CAN_DET_RANGE_29 "Detected object range 29";
BA_ "GenSigStartValue" SG_ 78 LRRF1_CAN_DET_RANGE_RATE_29 8192;
BA_ "SignalDescription" SG_ 78 LRRF1_CAN_DET_RANGE_RATE_29 "Detected object range rate 29";
BA_ "SignalDescription" SG_ 78 LRRF1_CAN_DET_AMPLITUDE_29 "Detected object amplitude 29";
BA_ "SignalDescription" SG_ 78 LRRF1_CAN_SCAN_INDEX_2LSB_29 "The two LSB of scan index 29";
BA_ "SignalDescription" SG_ 78 LRRF1_Det_CRC_05 "Cyclic Redundancy Check for Detection Message Number 5";
BA_ "SignalDescription" SG_ 78 LRRF1_Det_MC_05 "Message Count for Detection Message Number 5";
BA_ "SignalDescription" SG_ 78 LRRF1_CAN_SCAN_INDEX_2LSB_35 "The two LSB of scan index 35";
BA_ "SignalDescription" SG_ 78 LRRF1_CAN_SCAN_INDEX_2LSB_34 "The two LSB of scan index 34";
BA_ "SignalDescription" SG_ 78 LRRF1_CAN_SCAN_INDEX_2LSB_33 "The two LSB of scan index 33";
BA_ "SignalDescription" SG_ 78 LRRF1_CAN_SCAN_INDEX_2LSB_32 "The two LSB of scan index 32";
BA_ "SignalDescription" SG_ 78 LRRF1_CAN_SCAN_INDEX_2LSB_31 "The two LSB of scan index 31";
BA_ "SignalDescription" SG_ 78 LRRF1_CAN_SCAN_INDEX_2LSB_30 "The two LSB of scan index 30";
BA_ "GenSigStartValue" SG_ 78 LRRF1_CAN_DET_RANGE_RATE_35 8192;
BA_ "SignalDescription" SG_ 78 LRRF1_CAN_DET_RANGE_RATE_35 "Detected object range rate 35";
BA_ "GenSigStartValue" SG_ 78 LRRF1_CAN_DET_RANGE_RATE_34 8192;
BA_ "SignalDescription" SG_ 78 LRRF1_CAN_DET_RANGE_RATE_34 "Detected object range rate 34";
BA_ "GenSigStartValue" SG_ 78 LRRF1_CAN_DET_RANGE_RATE_33 8192;
BA_ "SignalDescription" SG_ 78 LRRF1_CAN_DET_RANGE_RATE_33 "Detected object range rate 33";
BA_ "GenSigStartValue" SG_ 78 LRRF1_CAN_DET_RANGE_RATE_32 8192;
BA_ "SignalDescription" SG_ 78 LRRF1_CAN_DET_RANGE_RATE_32 "Detected object range rate 32";
BA_ "GenSigStartValue" SG_ 78 LRRF1_CAN_DET_RANGE_RATE_31 8192;
BA_ "SignalDescription" SG_ 78 LRRF1_CAN_DET_RANGE_RATE_31 "Detected object range rate 31";
BA_ "GenSigStartValue" SG_ 78 LRRF1_CAN_DET_RANGE_RATE_30 8192;
BA_ "SignalDescription" SG_ 78 LRRF1_CAN_DET_RANGE_RATE_30 "Detected object range rate 30";
BA_ "SignalDescription" SG_ 78 LRRF1_CAN_DET_RANGE_35 "Detected object range 35";
BA_ "SignalDescription" SG_ 78 LRRF1_CAN_DET_RANGE_34 "Detected object range 34";
BA_ "SignalDescription" SG_ 78 LRRF1_CAN_DET_RANGE_33 "Detected object range 33";
BA_ "SignalDescription" SG_ 78 LRRF1_CAN_DET_RANGE_32 "Detected object range 32";
BA_ "SignalDescription" SG_ 78 LRRF1_CAN_DET_RANGE_31 "Detected object range 31";
BA_ "SignalDescription" SG_ 78 LRRF1_CAN_DET_RANGE_30 "Detected object range 30";
BA_ "SignalDescription" SG_ 78 LRRF1_CAN_DET_SUPER_RES_TAR_0085 "Super resolution target 35";
BA_ "SystemSignalLongSymbol" SG_ 78 LRRF1_CAN_DET_SUPER_RES_TAR_0085 "LRRF1_CAN_DET_SUPER_RES_TARGET_35";
BA_ "SignalDescription" SG_ 78 LRRF1_CAN_DET_SUPER_RES_TAR_0086 "Super resolution target 34";
BA_ "SystemSignalLongSymbol" SG_ 78 LRRF1_CAN_DET_SUPER_RES_TAR_0086 "LRRF1_CAN_DET_SUPER_RES_TARGET_34";
BA_ "SignalDescription" SG_ 78 LRRF1_CAN_DET_SUPER_RES_TAR_0087 "Super resolution target 33";
BA_ "SystemSignalLongSymbol" SG_ 78 LRRF1_CAN_DET_SUPER_RES_TAR_0087 "LRRF1_CAN_DET_SUPER_RES_TARGET_33";
BA_ "SignalDescription" SG_ 78 LRRF1_CAN_DET_SUPER_RES_TAR_0088 "Super resolution target 32";
BA_ "SystemSignalLongSymbol" SG_ 78 LRRF1_CAN_DET_SUPER_RES_TAR_0088 "LRRF1_CAN_DET_SUPER_RES_TARGET_32";
BA_ "SignalDescription" SG_ 78 LRRF1_CAN_DET_SUPER_RES_TAR_0089 "Super resolution target 31";
BA_ "SystemSignalLongSymbol" SG_ 78 LRRF1_CAN_DET_SUPER_RES_TAR_0089 "LRRF1_CAN_DET_SUPER_RES_TARGET_31";
BA_ "SignalDescription" SG_ 78 LRRF1_CAN_DET_SUPER_RES_TAR_0090 "Super resolution target 30";
BA_ "SystemSignalLongSymbol" SG_ 78 LRRF1_CAN_DET_SUPER_RES_TAR_0090 "LRRF1_CAN_DET_SUPER_RES_TARGET_30";
BA_ "SignalDescription" SG_ 78 LRRF1_CAN_DET_HOST_VEH_CLUT_0085 "Host vehicle clutter 35";
BA_ "SystemSignalLongSymbol" SG_ 78 LRRF1_CAN_DET_HOST_VEH_CLUT_0085 "LRRF1_CAN_DET_HOST_VEH_CLUTTER_35";
BA_ "SignalDescription" SG_ 78 LRRF1_CAN_DET_HOST_VEH_CLUT_0086 "Host vehicle clutter 34";
BA_ "SystemSignalLongSymbol" SG_ 78 LRRF1_CAN_DET_HOST_VEH_CLUT_0086 "LRRF1_CAN_DET_HOST_VEH_CLUTTER_34";
BA_ "SignalDescription" SG_ 78 LRRF1_CAN_DET_HOST_VEH_CLUT_0087 "Host vehicle clutter 33";
BA_ "SystemSignalLongSymbol" SG_ 78 LRRF1_CAN_DET_HOST_VEH_CLUT_0087 "LRRF1_CAN_DET_HOST_VEH_CLUTTER_33";
BA_ "SignalDescription" SG_ 78 LRRF1_CAN_DET_HOST_VEH_CLUT_0088 "Host vehicle clutter 32";
BA_ "SystemSignalLongSymbol" SG_ 78 LRRF1_CAN_DET_HOST_VEH_CLUT_0088 "LRRF1_CAN_DET_HOST_VEH_CLUTTER_32";
BA_ "SignalDescription" SG_ 78 LRRF1_CAN_DET_HOST_VEH_CLUT_0089 "Host vehicle clutter 31";
BA_ "SystemSignalLongSymbol" SG_ 78 LRRF1_CAN_DET_HOST_VEH_CLUT_0089 "LRRF1_CAN_DET_HOST_VEH_CLUTTER_31";
BA_ "SignalDescription" SG_ 78 LRRF1_CAN_DET_HOST_VEH_CLUT_0090 "Host vehicle clutter 30";
BA_ "SystemSignalLongSymbol" SG_ 78 LRRF1_CAN_DET_HOST_VEH_CLUT_0090 "LRRF1_CAN_DET_HOST_VEH_CLUTTER_30";
BA_ "GenSigStartValue" SG_ 78 LRRF1_CAN_DET_ELEVATION_35 63.8646288209607;
BA_ "SignalDescription" SG_ 78 LRRF1_CAN_DET_ELEVATION_35 "Detected object elevation position 35";
BA_ "GenSigStartValue" SG_ 78 LRRF1_CAN_DET_ELEVATION_34 63.8646288209607;
BA_ "SignalDescription" SG_ 78 LRRF1_CAN_DET_ELEVATION_34 "Detected object elevation position 34";
BA_ "GenSigStartValue" SG_ 78 LRRF1_CAN_DET_ELEVATION_33 63.8646288209607;
BA_ "SignalDescription" SG_ 78 LRRF1_CAN_DET_ELEVATION_33 "Detected object elevation position 33";
BA_ "GenSigStartValue" SG_ 78 LRRF1_CAN_DET_ELEVATION_32 63.8646288209607;
BA_ "SignalDescription" SG_ 78 LRRF1_CAN_DET_ELEVATION_32 "Detected object elevation position 32";
BA_ "GenSigStartValue" SG_ 78 LRRF1_CAN_DET_ELEVATION_31 63.8646288209607;
BA_ "SignalDescription" SG_ 78 LRRF1_CAN_DET_ELEVATION_31 "Detected object elevation position 31";
BA_ "GenSigStartValue" SG_ 78 LRRF1_CAN_DET_ELEVATION_30 63.8646288209607;
BA_ "SignalDescription" SG_ 78 LRRF1_CAN_DET_ELEVATION_30 "Detected object elevation position 30";
BA_ "SignalDescription" SG_ 78 LRRF1_CAN_DET_CONFID_ELEVAT_0085 "Elevation Angle Confidence 35";
BA_ "SystemSignalLongSymbol" SG_ 78 LRRF1_CAN_DET_CONFID_ELEVAT_0085 "LRRF1_CAN_DET_CONFID_ELEVATION_35";
BA_ "SignalDescription" SG_ 78 LRRF1_CAN_DET_CONFID_ELEVAT_0086 "Elevation Angle Confidence 34";
BA_ "SystemSignalLongSymbol" SG_ 78 LRRF1_CAN_DET_CONFID_ELEVAT_0086 "LRRF1_CAN_DET_CONFID_ELEVATION_34";
BA_ "SignalDescription" SG_ 78 LRRF1_CAN_DET_CONFID_ELEVAT_0087 "Elevation Angle Confidence 33";
BA_ "SystemSignalLongSymbol" SG_ 78 LRRF1_CAN_DET_CONFID_ELEVAT_0087 "LRRF1_CAN_DET_CONFID_ELEVATION_33";
BA_ "SignalDescription" SG_ 78 LRRF1_CAN_DET_CONFID_ELEVAT_0088 "Elevation Angle Confidence 32";
BA_ "SystemSignalLongSymbol" SG_ 78 LRRF1_CAN_DET_CONFID_ELEVAT_0088 "LRRF1_CAN_DET_CONFID_ELEVATION_32";
BA_ "SignalDescription" SG_ 78 LRRF1_CAN_DET_CONFID_ELEVAT_0089 "Elevation Angle Confidence 31";
BA_ "SystemSignalLongSymbol" SG_ 78 LRRF1_CAN_DET_CONFID_ELEVAT_0089 "LRRF1_CAN_DET_CONFID_ELEVATION_31";
BA_ "SignalDescription" SG_ 78 LRRF1_CAN_DET_CONFID_ELEVAT_0090 "Elevation Angle Confidence 30";
BA_ "SystemSignalLongSymbol" SG_ 78 LRRF1_CAN_DET_CONFID_ELEVAT_0090 "LRRF1_CAN_DET_CONFID_ELEVATION_30";
BA_ "GenSigVtEn" SG_ 78 LRRF1_CAN_DET_CONFID_AZIMUTH_35 "TRUE";
BA_ "SignalDescription" SG_ 78 LRRF1_CAN_DET_CONFID_AZIMUTH_35 "Signal to noise level 35";
BA_ "GenSigVtEn" SG_ 78 LRRF1_CAN_DET_CONFID_AZIMUTH_34 "TRUE";
BA_ "SignalDescription" SG_ 78 LRRF1_CAN_DET_CONFID_AZIMUTH_34 "Signal to noise level 34";
BA_ "GenSigVtEn" SG_ 78 LRRF1_CAN_DET_CONFID_AZIMUTH_33 "TRUE";
BA_ "SignalDescription" SG_ 78 LRRF1_CAN_DET_CONFID_AZIMUTH_33 "Signal to noise level 33";
BA_ "GenSigVtEn" SG_ 78 LRRF1_CAN_DET_CONFID_AZIMUTH_32 "TRUE";
BA_ "SignalDescription" SG_ 78 LRRF1_CAN_DET_CONFID_AZIMUTH_32 "Signal to noise level 32";
BA_ "GenSigVtEn" SG_ 78 LRRF1_CAN_DET_CONFID_AZIMUTH_31 "TRUE";
BA_ "SignalDescription" SG_ 78 LRRF1_CAN_DET_CONFID_AZIMUTH_31 "Signal to noise level 31";
BA_ "GenSigVtEn" SG_ 78 LRRF1_CAN_DET_CONFID_AZIMUTH_30 "TRUE";
BA_ "SignalDescription" SG_ 78 LRRF1_CAN_DET_CONFID_AZIMUTH_30 "Signal to noise level 30";
BA_ "GenSigStartValue" SG_ 78 LRRF1_CAN_DET_AZIMUTH_35 8194.05320813772;
BA_ "SignalDescription" SG_ 78 LRRF1_CAN_DET_AZIMUTH_35 "Detected object azimuth position 35";
BA_ "GenSigStartValue" SG_ 78 LRRF1_CAN_DET_AZIMUTH_34 8194.05320813772;
BA_ "SignalDescription" SG_ 78 LRRF1_CAN_DET_AZIMUTH_34 "Detected object azimuth position 34";
BA_ "GenSigStartValue" SG_ 78 LRRF1_CAN_DET_AZIMUTH_33 8194.05320813772;
BA_ "SignalDescription" SG_ 78 LRRF1_CAN_DET_AZIMUTH_33 "Detected object azimuth position 33";
BA_ "GenSigStartValue" SG_ 78 LRRF1_CAN_DET_AZIMUTH_32 8194.05320813772;
BA_ "SignalDescription" SG_ 78 LRRF1_CAN_DET_AZIMUTH_32 "Detected object azimuth position 32";
BA_ "GenSigStartValue" SG_ 78 LRRF1_CAN_DET_AZIMUTH_31 8194.05320813772;
BA_ "SignalDescription" SG_ 78 LRRF1_CAN_DET_AZIMUTH_31 "Detected object azimuth position 31";
BA_ "GenSigStartValue" SG_ 78 LRRF1_CAN_DET_AZIMUTH_30 8194.05320813772;
BA_ "SignalDescription" SG_ 78 LRRF1_CAN_DET_AZIMUTH_30 "Detected object azimuth position 30";
BA_ "SignalDescription" SG_ 78 LRRF1_CAN_DET_AMPLITUDE_35 "Detected object amplitude 35";
BA_ "SignalDescription" SG_ 78 LRRF1_CAN_DET_AMPLITUDE_34 "Detected object amplitude 34";
BA_ "SignalDescription" SG_ 78 LRRF1_CAN_DET_AMPLITUDE_33 "Detected object amplitude 33";
BA_ "SignalDescription" SG_ 78 LRRF1_CAN_DET_AMPLITUDE_32 "Detected object amplitude 32";
BA_ "SignalDescription" SG_ 78 LRRF1_CAN_DET_AMPLITUDE_31 "Detected object amplitude 31";
BA_ "SignalDescription" SG_ 78 LRRF1_CAN_DET_AMPLITUDE_30 "Detected object amplitude 30";
BA_ "SignalDescription" SG_ 78 LRRF1_CAN_DET_VALID_LEVEL_35 "Detected object valid level 35";
BA_ "SignalDescription" SG_ 78 LRRF1_CAN_DET_VALID_LEVEL_34 "Detected object valid level 34";
BA_ "SignalDescription" SG_ 78 LRRF1_CAN_DET_VALID_LEVEL_33 "Detected object valid level 33";
BA_ "SignalDescription" SG_ 78 LRRF1_CAN_DET_VALID_LEVEL_32 "Detected object valid level 32";
BA_ "SignalDescription" SG_ 78 LRRF1_CAN_DET_VALID_LEVEL_31 "Detected object valid level 31";
BA_ "SignalDescription" SG_ 78 LRRF1_CAN_DET_VALID_LEVEL_30 "Detected object valid level 30";
BA_ "GenSigSendType" SG_ 77 LRRF1_CAN_DET_Near_TARGET_28 1;
BA_ "SignalDescription" SG_ 77 LRRF1_CAN_DET_Near_TARGET_28 "Near_Target_Discrimination";
BA_ "SignalDescription" SG_ 77 LRRF1_CAN_DET_Near_TARGET_27 "Near_Target_Discrimination";
BA_ "SignalDescription" SG_ 77 LRRF1_CAN_DET_Near_TARGET_26 "Near_Target_Discrimination";
BA_ "SignalDescription" SG_ 77 LRRF1_CAN_DET_Near_TARGET_25 "Near_Target_Discrimination";
BA_ "SignalDescription" SG_ 77 LRRF1_CAN_DET_Near_TARGET_24 "Near_Target_Discrimination";
BA_ "SignalDescription" SG_ 77 LRRF1_CAN_DET_Near_TARGET_23 "Near_Target_Discrimination";
BA_ "SignalDescription" SG_ 77 LRRF1_CAN_DET_Near_TARGET_22 "Near_Target_Discrimination";
BA_ "GenSigStartValue" SG_ 77 LRRF1_CAN_DET_ELEVATION_22 63.8646288209607;
BA_ "SignalDescription" SG_ 77 LRRF1_CAN_DET_ELEVATION_22 "Detected object elevation position 22";
BA_ "GenSigVtEn" SG_ 77 LRRF1_CAN_DET_CONFID_AZIMUTH_22 "TRUE";
BA_ "SignalDescription" SG_ 77 LRRF1_CAN_DET_CONFID_AZIMUTH_22 "Signal to noise level 22";
BA_ "SignalDescription" SG_ 77 LRRF1_CAN_DET_SUPER_RES_TAR_0091 "Super resolution target 22";
BA_ "SystemSignalLongSymbol" SG_ 77 LRRF1_CAN_DET_SUPER_RES_TAR_0091 "LRRF1_CAN_DET_SUPER_RES_TARGET_22";
BA_ "SignalDescription" SG_ 77 LRRF1_CAN_DET_CONFID_ELEVAT_0091 "Elevation Angle Confidence 22";
BA_ "SystemSignalLongSymbol" SG_ 77 LRRF1_CAN_DET_CONFID_ELEVAT_0091 "LRRF1_CAN_DET_CONFID_ELEVATION_22";
BA_ "SignalDescription" SG_ 77 LRRF1_CAN_DET_HOST_VEH_CLUT_0091 "Host vehicle clutter 22";
BA_ "SystemSignalLongSymbol" SG_ 77 LRRF1_CAN_DET_HOST_VEH_CLUT_0091 "LRRF1_CAN_DET_HOST_VEH_CLUTTER_22";
BA_ "SignalDescription" SG_ 77 LRRF1_CAN_DET_VALID_LEVEL_22 "Detected object valid level 22";
BA_ "GenSigStartValue" SG_ 77 LRRF1_CAN_DET_AZIMUTH_22 8194.05320813772;
BA_ "SignalDescription" SG_ 77 LRRF1_CAN_DET_AZIMUTH_22 "Detected object azimuth position 22";
BA_ "SignalDescription" SG_ 77 LRRF1_CAN_DET_RANGE_22 "Detected object range 22";
BA_ "GenSigStartValue" SG_ 77 LRRF1_CAN_DET_RANGE_RATE_22 8192;
BA_ "SignalDescription" SG_ 77 LRRF1_CAN_DET_RANGE_RATE_22 "Detected object range rate 22";
BA_ "SignalDescription" SG_ 77 LRRF1_CAN_DET_AMPLITUDE_22 "Detected object amplitude 22";
BA_ "SignalDescription" SG_ 77 LRRF1_CAN_SCAN_INDEX_2LSB_22 "The two LSB of scan index 22";
BA_ "SignalDescription" SG_ 77 LRRF1_Det_CRC_04 "Cyclic Redundancy Check for Detection Message Number 4";
BA_ "SignalDescription" SG_ 77 LRRF1_Det_MC_04 "Message Count for Detection Message Number 4";
BA_ "SignalDescription" SG_ 77 LRRF1_CAN_SCAN_INDEX_2LSB_28 "The two LSB of scan index 28";
BA_ "SignalDescription" SG_ 77 LRRF1_CAN_SCAN_INDEX_2LSB_27 "The two LSB of scan index 27";
BA_ "SignalDescription" SG_ 77 LRRF1_CAN_SCAN_INDEX_2LSB_26 "The two LSB of scan index 26";
BA_ "SignalDescription" SG_ 77 LRRF1_CAN_SCAN_INDEX_2LSB_25 "The two LSB of scan index 25";
BA_ "SignalDescription" SG_ 77 LRRF1_CAN_SCAN_INDEX_2LSB_24 "The two LSB of scan index 24";
BA_ "SignalDescription" SG_ 77 LRRF1_CAN_SCAN_INDEX_2LSB_23 "The two LSB of scan index 23";
BA_ "GenSigStartValue" SG_ 77 LRRF1_CAN_DET_RANGE_RATE_28 8192;
BA_ "SignalDescription" SG_ 77 LRRF1_CAN_DET_RANGE_RATE_28 "Detected object range rate 28";
BA_ "GenSigStartValue" SG_ 77 LRRF1_CAN_DET_RANGE_RATE_27 8192;
BA_ "SignalDescription" SG_ 77 LRRF1_CAN_DET_RANGE_RATE_27 "Detected object range rate 27";
BA_ "GenSigStartValue" SG_ 77 LRRF1_CAN_DET_RANGE_RATE_26 8192;
BA_ "SignalDescription" SG_ 77 LRRF1_CAN_DET_RANGE_RATE_26 "Detected object range rate 26";
BA_ "GenSigStartValue" SG_ 77 LRRF1_CAN_DET_RANGE_RATE_25 8192;
BA_ "SignalDescription" SG_ 77 LRRF1_CAN_DET_RANGE_RATE_25 "Detected object range rate 25";
BA_ "GenSigStartValue" SG_ 77 LRRF1_CAN_DET_RANGE_RATE_24 8192;
BA_ "SignalDescription" SG_ 77 LRRF1_CAN_DET_RANGE_RATE_24 "Detected object range rate 24";
BA_ "GenSigStartValue" SG_ 77 LRRF1_CAN_DET_RANGE_RATE_23 8192;
BA_ "SignalDescription" SG_ 77 LRRF1_CAN_DET_RANGE_RATE_23 "Detected object range rate 23";
BA_ "SignalDescription" SG_ 77 LRRF1_CAN_DET_RANGE_28 "Detected object range 28";
BA_ "SignalDescription" SG_ 77 LRRF1_CAN_DET_RANGE_27 "Detected object range 27";
BA_ "SignalDescription" SG_ 77 LRRF1_CAN_DET_RANGE_26 "Detected object range 26";
BA_ "SignalDescription" SG_ 77 LRRF1_CAN_DET_RANGE_25 "Detected object range 25";
BA_ "SignalDescription" SG_ 77 LRRF1_CAN_DET_RANGE_24 "Detected object range 24";
BA_ "SignalDescription" SG_ 77 LRRF1_CAN_DET_RANGE_23 "Detected object range 23";
BA_ "SignalDescription" SG_ 77 LRRF1_CAN_DET_SUPER_RES_TAR_0092 "Super resolution target 28";
BA_ "SystemSignalLongSymbol" SG_ 77 LRRF1_CAN_DET_SUPER_RES_TAR_0092 "LRRF1_CAN_DET_SUPER_RES_TARGET_28";
BA_ "SignalDescription" SG_ 77 LRRF1_CAN_DET_SUPER_RES_TAR_0093 "Super resolution target 27";
BA_ "SystemSignalLongSymbol" SG_ 77 LRRF1_CAN_DET_SUPER_RES_TAR_0093 "LRRF1_CAN_DET_SUPER_RES_TARGET_27";
BA_ "SignalDescription" SG_ 77 LRRF1_CAN_DET_SUPER_RES_TAR_0094 "Super resolution target 26";
BA_ "SystemSignalLongSymbol" SG_ 77 LRRF1_CAN_DET_SUPER_RES_TAR_0094 "LRRF1_CAN_DET_SUPER_RES_TARGET_26";
BA_ "SignalDescription" SG_ 77 LRRF1_CAN_DET_SUPER_RES_TAR_0095 "Super resolution target 25";
BA_ "SystemSignalLongSymbol" SG_ 77 LRRF1_CAN_DET_SUPER_RES_TAR_0095 "LRRF1_CAN_DET_SUPER_RES_TARGET_25";
BA_ "SignalDescription" SG_ 77 LRRF1_CAN_DET_SUPER_RES_TAR_0096 "Super resolution target 24";
BA_ "SystemSignalLongSymbol" SG_ 77 LRRF1_CAN_DET_SUPER_RES_TAR_0096 "LRRF1_CAN_DET_SUPER_RES_TARGET_24";
BA_ "SignalDescription" SG_ 77 LRRF1_CAN_DET_SUPER_RES_TAR_0097 "Super resolution target 23";
BA_ "SystemSignalLongSymbol" SG_ 77 LRRF1_CAN_DET_SUPER_RES_TAR_0097 "LRRF1_CAN_DET_SUPER_RES_TARGET_23";
BA_ "SignalDescription" SG_ 77 LRRF1_CAN_DET_HOST_VEH_CLUT_0092 "Host vehicle clutter 28";
BA_ "SystemSignalLongSymbol" SG_ 77 LRRF1_CAN_DET_HOST_VEH_CLUT_0092 "LRRF1_CAN_DET_HOST_VEH_CLUTTER_28";
BA_ "SignalDescription" SG_ 77 LRRF1_CAN_DET_HOST_VEH_CLUT_0093 "Host vehicle clutter 27";
BA_ "SystemSignalLongSymbol" SG_ 77 LRRF1_CAN_DET_HOST_VEH_CLUT_0093 "LRRF1_CAN_DET_HOST_VEH_CLUTTER_27";
BA_ "SignalDescription" SG_ 77 LRRF1_CAN_DET_HOST_VEH_CLUT_0094 "Host vehicle clutter 26";
BA_ "SystemSignalLongSymbol" SG_ 77 LRRF1_CAN_DET_HOST_VEH_CLUT_0094 "LRRF1_CAN_DET_HOST_VEH_CLUTTER_26";
BA_ "SignalDescription" SG_ 77 LRRF1_CAN_DET_HOST_VEH_CLUT_0095 "Host vehicle clutter 25";
BA_ "SystemSignalLongSymbol" SG_ 77 LRRF1_CAN_DET_HOST_VEH_CLUT_0095 "LRRF1_CAN_DET_HOST_VEH_CLUTTER_25";
BA_ "SignalDescription" SG_ 77 LRRF1_CAN_DET_HOST_VEH_CLUT_0096 "Host vehicle clutter 24";
BA_ "SystemSignalLongSymbol" SG_ 77 LRRF1_CAN_DET_HOST_VEH_CLUT_0096 "LRRF1_CAN_DET_HOST_VEH_CLUTTER_24";
BA_ "SignalDescription" SG_ 77 LRRF1_CAN_DET_HOST_VEH_CLUT_0097 "Host vehicle clutter 23";
BA_ "SystemSignalLongSymbol" SG_ 77 LRRF1_CAN_DET_HOST_VEH_CLUT_0097 "LRRF1_CAN_DET_HOST_VEH_CLUTTER_23";
BA_ "GenSigStartValue" SG_ 77 LRRF1_CAN_DET_ELEVATION_28 63.8646288209607;
BA_ "SignalDescription" SG_ 77 LRRF1_CAN_DET_ELEVATION_28 "Detected object elevation position 28";
BA_ "GenSigStartValue" SG_ 77 LRRF1_CAN_DET_ELEVATION_27 63.8646288209607;
BA_ "SignalDescription" SG_ 77 LRRF1_CAN_DET_ELEVATION_27 "Detected object elevation position 27";
BA_ "GenSigStartValue" SG_ 77 LRRF1_CAN_DET_ELEVATION_26 63.8646288209607;
BA_ "SignalDescription" SG_ 77 LRRF1_CAN_DET_ELEVATION_26 "Detected object elevation position 26";
BA_ "GenSigStartValue" SG_ 77 LRRF1_CAN_DET_ELEVATION_25 63.8646288209607;
BA_ "SignalDescription" SG_ 77 LRRF1_CAN_DET_ELEVATION_25 "Detected object elevation position 25";
BA_ "GenSigStartValue" SG_ 77 LRRF1_CAN_DET_ELEVATION_24 63.8646288209607;
BA_ "SignalDescription" SG_ 77 LRRF1_CAN_DET_ELEVATION_24 "Detected object elevation position 24";
BA_ "GenSigStartValue" SG_ 77 LRRF1_CAN_DET_ELEVATION_23 63.8646288209607;
BA_ "SignalDescription" SG_ 77 LRRF1_CAN_DET_ELEVATION_23 "Detected object elevation position 23";
BA_ "SignalDescription" SG_ 77 LRRF1_CAN_DET_CONFID_ELEVAT_0092 "Elevation Angle Confidence 28";
BA_ "SystemSignalLongSymbol" SG_ 77 LRRF1_CAN_DET_CONFID_ELEVAT_0092 "LRRF1_CAN_DET_CONFID_ELEVATION_28";
BA_ "SignalDescription" SG_ 77 LRRF1_CAN_DET_CONFID_ELEVAT_0093 "Elevation Angle Confidence 27";
BA_ "SystemSignalLongSymbol" SG_ 77 LRRF1_CAN_DET_CONFID_ELEVAT_0093 "LRRF1_CAN_DET_CONFID_ELEVATION_27";
BA_ "SignalDescription" SG_ 77 LRRF1_CAN_DET_CONFID_ELEVAT_0094 "Elevation Angle Confidence 26";
BA_ "SystemSignalLongSymbol" SG_ 77 LRRF1_CAN_DET_CONFID_ELEVAT_0094 "LRRF1_CAN_DET_CONFID_ELEVATION_26";
BA_ "SignalDescription" SG_ 77 LRRF1_CAN_DET_CONFID_ELEVAT_0095 "Elevation Angle Confidence 25";
BA_ "SystemSignalLongSymbol" SG_ 77 LRRF1_CAN_DET_CONFID_ELEVAT_0095 "LRRF1_CAN_DET_CONFID_ELEVATION_25";
BA_ "SignalDescription" SG_ 77 LRRF1_CAN_DET_CONFID_ELEVAT_0096 "Elevation Angle Confidence 24";
BA_ "SystemSignalLongSymbol" SG_ 77 LRRF1_CAN_DET_CONFID_ELEVAT_0096 "LRRF1_CAN_DET_CONFID_ELEVATION_24";
BA_ "SignalDescription" SG_ 77 LRRF1_CAN_DET_CONFID_ELEVAT_0097 "Elevation Angle Confidence 23";
BA_ "SystemSignalLongSymbol" SG_ 77 LRRF1_CAN_DET_CONFID_ELEVAT_0097 "LRRF1_CAN_DET_CONFID_ELEVATION_23";
BA_ "GenSigVtEn" SG_ 77 LRRF1_CAN_DET_CONFID_AZIMUTH_28 "TRUE";
BA_ "SignalDescription" SG_ 77 LRRF1_CAN_DET_CONFID_AZIMUTH_28 "Signal to noise level 28";
BA_ "GenSigVtEn" SG_ 77 LRRF1_CAN_DET_CONFID_AZIMUTH_27 "TRUE";
BA_ "SignalDescription" SG_ 77 LRRF1_CAN_DET_CONFID_AZIMUTH_27 "Signal to noise level 27";
BA_ "GenSigVtEn" SG_ 77 LRRF1_CAN_DET_CONFID_AZIMUTH_26 "TRUE";
BA_ "SignalDescription" SG_ 77 LRRF1_CAN_DET_CONFID_AZIMUTH_26 "Signal to noise level 26";
BA_ "GenSigVtEn" SG_ 77 LRRF1_CAN_DET_CONFID_AZIMUTH_25 "TRUE";
BA_ "SignalDescription" SG_ 77 LRRF1_CAN_DET_CONFID_AZIMUTH_25 "Signal to noise level 25";
BA_ "GenSigVtEn" SG_ 77 LRRF1_CAN_DET_CONFID_AZIMUTH_24 "TRUE";
BA_ "SignalDescription" SG_ 77 LRRF1_CAN_DET_CONFID_AZIMUTH_24 "Signal to noise level 24";
BA_ "GenSigVtEn" SG_ 77 LRRF1_CAN_DET_CONFID_AZIMUTH_23 "TRUE";
BA_ "SignalDescription" SG_ 77 LRRF1_CAN_DET_CONFID_AZIMUTH_23 "Signal to noise level 23";
BA_ "GenSigStartValue" SG_ 77 LRRF1_CAN_DET_AZIMUTH_28 8194.05320813772;
BA_ "SignalDescription" SG_ 77 LRRF1_CAN_DET_AZIMUTH_28 "Detected object azimuth position 28";
BA_ "GenSigStartValue" SG_ 77 LRRF1_CAN_DET_AZIMUTH_27 8194.05320813772;
BA_ "SignalDescription" SG_ 77 LRRF1_CAN_DET_AZIMUTH_27 "Detected object azimuth position 27";
BA_ "GenSigStartValue" SG_ 77 LRRF1_CAN_DET_AZIMUTH_26 8194.05320813772;
BA_ "SignalDescription" SG_ 77 LRRF1_CAN_DET_AZIMUTH_26 "Detected object azimuth position 26";
BA_ "GenSigStartValue" SG_ 77 LRRF1_CAN_DET_AZIMUTH_25 8194.05320813772;
BA_ "SignalDescription" SG_ 77 LRRF1_CAN_DET_AZIMUTH_25 "Detected object azimuth position 25";
BA_ "GenSigStartValue" SG_ 77 LRRF1_CAN_DET_AZIMUTH_24 8194.05320813772;
BA_ "SignalDescription" SG_ 77 LRRF1_CAN_DET_AZIMUTH_24 "Detected object azimuth position 24";
BA_ "GenSigStartValue" SG_ 77 LRRF1_CAN_DET_AZIMUTH_23 8194.05320813772;
BA_ "SignalDescription" SG_ 77 LRRF1_CAN_DET_AZIMUTH_23 "Detected object azimuth position 23";
BA_ "SignalDescription" SG_ 77 LRRF1_CAN_DET_AMPLITUDE_28 "Detected object amplitude 28";
BA_ "SignalDescription" SG_ 77 LRRF1_CAN_DET_AMPLITUDE_27 "Detected object amplitude 27";
BA_ "SignalDescription" SG_ 77 LRRF1_CAN_DET_AMPLITUDE_26 "Detected object amplitude 26";
BA_ "SignalDescription" SG_ 77 LRRF1_CAN_DET_AMPLITUDE_25 "Detected object amplitude 25";
BA_ "SignalDescription" SG_ 77 LRRF1_CAN_DET_AMPLITUDE_24 "Detected object amplitude 24";
BA_ "SignalDescription" SG_ 77 LRRF1_CAN_DET_AMPLITUDE_23 "Detected object amplitude 23";
BA_ "SignalDescription" SG_ 77 LRRF1_CAN_DET_VALID_LEVEL_28 "Detected object valid level 28";
BA_ "SignalDescription" SG_ 77 LRRF1_CAN_DET_VALID_LEVEL_27 "Detected object valid level 27";
BA_ "SignalDescription" SG_ 77 LRRF1_CAN_DET_VALID_LEVEL_26 "Detected object valid level 26";
BA_ "SignalDescription" SG_ 77 LRRF1_CAN_DET_VALID_LEVEL_25 "Detected object valid level 25";
BA_ "SignalDescription" SG_ 77 LRRF1_CAN_DET_VALID_LEVEL_24 "Detected object valid level 24";
BA_ "SignalDescription" SG_ 77 LRRF1_CAN_DET_VALID_LEVEL_23 "Detected object valid level 23";
BA_ "GenSigSendType" SG_ 76 LRRF1_CAN_DET_Near_TARGET_21 1;
BA_ "SignalDescription" SG_ 76 LRRF1_CAN_DET_Near_TARGET_21 "Near_Target_Discrimination";
BA_ "SignalDescription" SG_ 76 LRRF1_CAN_DET_Near_TARGET_20 "Near_Target_Discrimination";
BA_ "SignalDescription" SG_ 76 LRRF1_CAN_DET_Near_TARGET_19 "Near_Target_Discrimination";
BA_ "SignalDescription" SG_ 76 LRRF1_CAN_DET_Near_TARGET_18 "Near_Target_Discrimination";
BA_ "SignalDescription" SG_ 76 LRRF1_CAN_DET_Near_TARGET_17 "Near_Target_Discrimination";
BA_ "SignalDescription" SG_ 76 LRRF1_CAN_DET_Near_TARGET_16 "Near_Target_Discrimination";
BA_ "SignalDescription" SG_ 76 LRRF1_CAN_DET_Near_TARGET_15 "Near_Target_Discrimination";
BA_ "GenSigStartValue" SG_ 76 LRRF1_CAN_DET_ELEVATION_15 63.8646288209607;
BA_ "SignalDescription" SG_ 76 LRRF1_CAN_DET_ELEVATION_15 "Detected object elevation position 15";
BA_ "GenSigVtEn" SG_ 76 LRRF1_CAN_DET_CONFID_AZIMUTH_15 "TRUE";
BA_ "SignalDescription" SG_ 76 LRRF1_CAN_DET_CONFID_AZIMUTH_15 "Signal to noise level 15";
BA_ "SignalDescription" SG_ 76 LRRF1_CAN_DET_SUPER_RES_TAR_0098 "Super resolution target 15";
BA_ "SystemSignalLongSymbol" SG_ 76 LRRF1_CAN_DET_SUPER_RES_TAR_0098 "LRRF1_CAN_DET_SUPER_RES_TARGET_15";
BA_ "SignalDescription" SG_ 76 LRRF1_CAN_DET_CONFID_ELEVAT_0098 "Elevation Angle Confidence 15";
BA_ "SystemSignalLongSymbol" SG_ 76 LRRF1_CAN_DET_CONFID_ELEVAT_0098 "LRRF1_CAN_DET_CONFID_ELEVATION_15";
BA_ "SignalDescription" SG_ 76 LRRF1_CAN_DET_HOST_VEH_CLUT_0098 "Host vehicle clutter 15";
BA_ "SystemSignalLongSymbol" SG_ 76 LRRF1_CAN_DET_HOST_VEH_CLUT_0098 "LRRF1_CAN_DET_HOST_VEH_CLUTTER_15";
BA_ "SignalDescription" SG_ 76 LRRF1_CAN_DET_VALID_LEVEL_15 "Detected object valid level 15";
BA_ "GenSigStartValue" SG_ 76 LRRF1_CAN_DET_AZIMUTH_15 8194.05320813772;
BA_ "SignalDescription" SG_ 76 LRRF1_CAN_DET_AZIMUTH_15 "Detected object azimuth position 15";
BA_ "SignalDescription" SG_ 76 LRRF1_CAN_DET_RANGE_15 "Detected object range 15";
BA_ "GenSigStartValue" SG_ 76 LRRF1_CAN_DET_RANGE_RATE_15 8192;
BA_ "SignalDescription" SG_ 76 LRRF1_CAN_DET_RANGE_RATE_15 "Detected object range rate 15";
BA_ "SignalDescription" SG_ 76 LRRF1_CAN_DET_AMPLITUDE_15 "Detected object amplitude 15";
BA_ "SignalDescription" SG_ 76 LRRF1_CAN_SCAN_INDEX_2LSB_15 "The two LSB of scan index 15";
BA_ "SignalDescription" SG_ 76 LRRF1_Det_CRC_03 "Cyclic Redundancy Check for Detection Message Number 3";
BA_ "SignalDescription" SG_ 76 LRRF1_Det_MC_03 "Message Count for Detection Message Number 3";
BA_ "SignalDescription" SG_ 76 LRRF1_CAN_SCAN_INDEX_2LSB_21 "The two LSB of scan index 21";
BA_ "SignalDescription" SG_ 76 LRRF1_CAN_SCAN_INDEX_2LSB_20 "The two LSB of scan index 20";
BA_ "SignalDescription" SG_ 76 LRRF1_CAN_SCAN_INDEX_2LSB_19 "The two LSB of scan index 19";
BA_ "SignalDescription" SG_ 76 LRRF1_CAN_SCAN_INDEX_2LSB_18 "The two LSB of scan index 18";
BA_ "SignalDescription" SG_ 76 LRRF1_CAN_SCAN_INDEX_2LSB_17 "The two LSB of scan index 17";
BA_ "SignalDescription" SG_ 76 LRRF1_CAN_SCAN_INDEX_2LSB_16 "The two LSB of scan index 16";
BA_ "GenSigStartValue" SG_ 76 LRRF1_CAN_DET_RANGE_RATE_21 8192;
BA_ "SignalDescription" SG_ 76 LRRF1_CAN_DET_RANGE_RATE_21 "Detected object range rate 21";
BA_ "GenSigStartValue" SG_ 76 LRRF1_CAN_DET_RANGE_RATE_20 8192;
BA_ "SignalDescription" SG_ 76 LRRF1_CAN_DET_RANGE_RATE_20 "Detected object range rate 20";
BA_ "GenSigStartValue" SG_ 76 LRRF1_CAN_DET_RANGE_RATE_19 8192;
BA_ "SignalDescription" SG_ 76 LRRF1_CAN_DET_RANGE_RATE_19 "Detected object range rate 19";
BA_ "GenSigStartValue" SG_ 76 LRRF1_CAN_DET_RANGE_RATE_18 8192;
BA_ "SignalDescription" SG_ 76 LRRF1_CAN_DET_RANGE_RATE_18 "Detected object range rate 18";
BA_ "GenSigStartValue" SG_ 76 LRRF1_CAN_DET_RANGE_RATE_17 8192;
BA_ "SignalDescription" SG_ 76 LRRF1_CAN_DET_RANGE_RATE_17 "Detected object range rate 17";
BA_ "GenSigStartValue" SG_ 76 LRRF1_CAN_DET_RANGE_RATE_16 8192;
BA_ "SignalDescription" SG_ 76 LRRF1_CAN_DET_RANGE_RATE_16 "Detected object range rate 16";
BA_ "SignalDescription" SG_ 76 LRRF1_CAN_DET_RANGE_21 "Detected object range 21";
BA_ "SignalDescription" SG_ 76 LRRF1_CAN_DET_RANGE_20 "Detected object range 20";
BA_ "SignalDescription" SG_ 76 LRRF1_CAN_DET_RANGE_19 "Detected object range 19";
BA_ "SignalDescription" SG_ 76 LRRF1_CAN_DET_RANGE_18 "Detected object range 18";
BA_ "SignalDescription" SG_ 76 LRRF1_CAN_DET_RANGE_17 "Detected object range 17";
BA_ "SignalDescription" SG_ 76 LRRF1_CAN_DET_RANGE_16 "Detected object range 16";
BA_ "SignalDescription" SG_ 76 LRRF1_CAN_DET_SUPER_RES_TAR_0099 "Super resolution target 21";
BA_ "SystemSignalLongSymbol" SG_ 76 LRRF1_CAN_DET_SUPER_RES_TAR_0099 "LRRF1_CAN_DET_SUPER_RES_TARGET_21";
BA_ "SignalDescription" SG_ 76 LRRF1_CAN_DET_SUPER_RES_TAR_0100 "Super resolution target 20";
BA_ "SystemSignalLongSymbol" SG_ 76 LRRF1_CAN_DET_SUPER_RES_TAR_0100 "LRRF1_CAN_DET_SUPER_RES_TARGET_20";
BA_ "SignalDescription" SG_ 76 LRRF1_CAN_DET_SUPER_RES_TAR_0101 "Super resolution target 19";
BA_ "SystemSignalLongSymbol" SG_ 76 LRRF1_CAN_DET_SUPER_RES_TAR_0101 "LRRF1_CAN_DET_SUPER_RES_TARGET_19";
BA_ "SignalDescription" SG_ 76 LRRF1_CAN_DET_SUPER_RES_TAR_0102 "Super resolution target 18";
BA_ "SystemSignalLongSymbol" SG_ 76 LRRF1_CAN_DET_SUPER_RES_TAR_0102 "LRRF1_CAN_DET_SUPER_RES_TARGET_18";
BA_ "SignalDescription" SG_ 76 LRRF1_CAN_DET_SUPER_RES_TAR_0103 "Super resolution target 17";
BA_ "SystemSignalLongSymbol" SG_ 76 LRRF1_CAN_DET_SUPER_RES_TAR_0103 "LRRF1_CAN_DET_SUPER_RES_TARGET_17";
BA_ "SignalDescription" SG_ 76 LRRF1_CAN_DET_SUPER_RES_TAR_0104 "Super resolution target 16";
BA_ "SystemSignalLongSymbol" SG_ 76 LRRF1_CAN_DET_SUPER_RES_TAR_0104 "LRRF1_CAN_DET_SUPER_RES_TARGET_16";
BA_ "SignalDescription" SG_ 76 LRRF1_CAN_DET_HOST_VEH_CLUT_0099 "Host vehicle clutter 21";
BA_ "SystemSignalLongSymbol" SG_ 76 LRRF1_CAN_DET_HOST_VEH_CLUT_0099 "LRRF1_CAN_DET_HOST_VEH_CLUTTER_21";
BA_ "SignalDescription" SG_ 76 LRRF1_CAN_DET_HOST_VEH_CLUT_0100 "Host vehicle clutter 20";
BA_ "SystemSignalLongSymbol" SG_ 76 LRRF1_CAN_DET_HOST_VEH_CLUT_0100 "LRRF1_CAN_DET_HOST_VEH_CLUTTER_20";
BA_ "SignalDescription" SG_ 76 LRRF1_CAN_DET_HOST_VEH_CLUT_0101 "Host vehicle clutter 19";
BA_ "SystemSignalLongSymbol" SG_ 76 LRRF1_CAN_DET_HOST_VEH_CLUT_0101 "LRRF1_CAN_DET_HOST_VEH_CLUTTER_19";
BA_ "SignalDescription" SG_ 76 LRRF1_CAN_DET_HOST_VEH_CLUT_0102 "Host vehicle clutter 18";
BA_ "SystemSignalLongSymbol" SG_ 76 LRRF1_CAN_DET_HOST_VEH_CLUT_0102 "LRRF1_CAN_DET_HOST_VEH_CLUTTER_18";
BA_ "SignalDescription" SG_ 76 LRRF1_CAN_DET_HOST_VEH_CLUT_0103 "Host vehicle clutter 17";
BA_ "SystemSignalLongSymbol" SG_ 76 LRRF1_CAN_DET_HOST_VEH_CLUT_0103 "LRRF1_CAN_DET_HOST_VEH_CLUTTER_17";
BA_ "SignalDescription" SG_ 76 LRRF1_CAN_DET_HOST_VEH_CLUT_0104 "Host vehicle clutter 16";
BA_ "SystemSignalLongSymbol" SG_ 76 LRRF1_CAN_DET_HOST_VEH_CLUT_0104 "LRRF1_CAN_DET_HOST_VEH_CLUTTER_16";
BA_ "GenSigStartValue" SG_ 76 LRRF1_CAN_DET_ELEVATION_21 63.8646288209607;
BA_ "SignalDescription" SG_ 76 LRRF1_CAN_DET_ELEVATION_21 "Detected object elevation position 21";
BA_ "GenSigStartValue" SG_ 76 LRRF1_CAN_DET_ELEVATION_20 63.8646288209607;
BA_ "SignalDescription" SG_ 76 LRRF1_CAN_DET_ELEVATION_20 "Detected object elevation position 20";
BA_ "GenSigStartValue" SG_ 76 LRRF1_CAN_DET_ELEVATION_19 63.8646288209607;
BA_ "SignalDescription" SG_ 76 LRRF1_CAN_DET_ELEVATION_19 "Detected object elevation position 19";
BA_ "GenSigStartValue" SG_ 76 LRRF1_CAN_DET_ELEVATION_18 63.8646288209607;
BA_ "SignalDescription" SG_ 76 LRRF1_CAN_DET_ELEVATION_18 "Detected object elevation position 18";
BA_ "GenSigStartValue" SG_ 76 LRRF1_CAN_DET_ELEVATION_17 63.8646288209607;
BA_ "SignalDescription" SG_ 76 LRRF1_CAN_DET_ELEVATION_17 "Detected object elevation position 17";
BA_ "GenSigStartValue" SG_ 76 LRRF1_CAN_DET_ELEVATION_16 63.8646288209607;
BA_ "SignalDescription" SG_ 76 LRRF1_CAN_DET_ELEVATION_16 "Detected object elevation position 16";
BA_ "SignalDescription" SG_ 76 LRRF1_CAN_DET_CONFID_ELEVAT_0099 "Elevation Angle Confidence 21";
BA_ "SystemSignalLongSymbol" SG_ 76 LRRF1_CAN_DET_CONFID_ELEVAT_0099 "LRRF1_CAN_DET_CONFID_ELEVATION_21";
BA_ "SignalDescription" SG_ 76 LRRF1_CAN_DET_CONFID_ELEVAT_0100 "Elevation Angle Confidence 20";
BA_ "SystemSignalLongSymbol" SG_ 76 LRRF1_CAN_DET_CONFID_ELEVAT_0100 "LRRF1_CAN_DET_CONFID_ELEVATION_20";
BA_ "SignalDescription" SG_ 76 LRRF1_CAN_DET_CONFID_ELEVAT_0101 "Elevation Angle Confidence 19";
BA_ "SystemSignalLongSymbol" SG_ 76 LRRF1_CAN_DET_CONFID_ELEVAT_0101 "LRRF1_CAN_DET_CONFID_ELEVATION_19";
BA_ "SignalDescription" SG_ 76 LRRF1_CAN_DET_CONFID_ELEVAT_0102 "Elevation Angle Confidence 18";
BA_ "SystemSignalLongSymbol" SG_ 76 LRRF1_CAN_DET_CONFID_ELEVAT_0102 "LRRF1_CAN_DET_CONFID_ELEVATION_18";
BA_ "SignalDescription" SG_ 76 LRRF1_CAN_DET_CONFID_ELEVAT_0103 "Elevation Angle Confidence 17";
BA_ "SystemSignalLongSymbol" SG_ 76 LRRF1_CAN_DET_CONFID_ELEVAT_0103 "LRRF1_CAN_DET_CONFID_ELEVATION_17";
BA_ "SignalDescription" SG_ 76 LRRF1_CAN_DET_CONFID_ELEVAT_0104 "Elevation Angle Confidence 16";
BA_ "SystemSignalLongSymbol" SG_ 76 LRRF1_CAN_DET_CONFID_ELEVAT_0104 "LRRF1_CAN_DET_CONFID_ELEVATION_16";
BA_ "GenSigVtEn" SG_ 76 LRRF1_CAN_DET_CONFID_AZIMUTH_21 "TRUE";
BA_ "SignalDescription" SG_ 76 LRRF1_CAN_DET_CONFID_AZIMUTH_21 "Signal to noise level 21";
BA_ "GenSigVtEn" SG_ 76 LRRF1_CAN_DET_CONFID_AZIMUTH_20 "TRUE";
BA_ "SignalDescription" SG_ 76 LRRF1_CAN_DET_CONFID_AZIMUTH_20 "Signal to noise level 20";
BA_ "GenSigVtEn" SG_ 76 LRRF1_CAN_DET_CONFID_AZIMUTH_19 "TRUE";
BA_ "SignalDescription" SG_ 76 LRRF1_CAN_DET_CONFID_AZIMUTH_19 "Signal to noise level 19";
BA_ "GenSigVtEn" SG_ 76 LRRF1_CAN_DET_CONFID_AZIMUTH_18 "TRUE";
BA_ "SignalDescription" SG_ 76 LRRF1_CAN_DET_CONFID_AZIMUTH_18 "Signal to noise level 18";
BA_ "GenSigVtEn" SG_ 76 LRRF1_CAN_DET_CONFID_AZIMUTH_17 "TRUE";
BA_ "SignalDescription" SG_ 76 LRRF1_CAN_DET_CONFID_AZIMUTH_17 "Signal to noise level 17";
BA_ "GenSigVtEn" SG_ 76 LRRF1_CAN_DET_CONFID_AZIMUTH_16 "TRUE";
BA_ "SignalDescription" SG_ 76 LRRF1_CAN_DET_CONFID_AZIMUTH_16 "Signal to noise level 16";
BA_ "GenSigStartValue" SG_ 76 LRRF1_CAN_DET_AZIMUTH_21 8194.05320813772;
BA_ "SignalDescription" SG_ 76 LRRF1_CAN_DET_AZIMUTH_21 "Detected object azimuth position 21";
BA_ "GenSigStartValue" SG_ 76 LRRF1_CAN_DET_AZIMUTH_20 8194.05320813772;
BA_ "SignalDescription" SG_ 76 LRRF1_CAN_DET_AZIMUTH_20 "Detected object azimuth position 20";
BA_ "GenSigStartValue" SG_ 76 LRRF1_CAN_DET_AZIMUTH_19 8194.05320813772;
BA_ "SignalDescription" SG_ 76 LRRF1_CAN_DET_AZIMUTH_19 "Detected object azimuth position 19";
BA_ "GenSigStartValue" SG_ 76 LRRF1_CAN_DET_AZIMUTH_18 8194.05320813772;
BA_ "SignalDescription" SG_ 76 LRRF1_CAN_DET_AZIMUTH_18 "Detected object azimuth position 18";
BA_ "GenSigStartValue" SG_ 76 LRRF1_CAN_DET_AZIMUTH_17 8194.05320813772;
BA_ "SignalDescription" SG_ 76 LRRF1_CAN_DET_AZIMUTH_17 "Detected object azimuth position 17";
BA_ "GenSigStartValue" SG_ 76 LRRF1_CAN_DET_AZIMUTH_16 8194.05320813772;
BA_ "SignalDescription" SG_ 76 LRRF1_CAN_DET_AZIMUTH_16 "Detected object azimuth position 16";
BA_ "SignalDescription" SG_ 76 LRRF1_CAN_DET_AMPLITUDE_21 "Detected object amplitude 21";
BA_ "SignalDescription" SG_ 76 LRRF1_CAN_DET_AMPLITUDE_20 "Detected object amplitude 20";
BA_ "SignalDescription" SG_ 76 LRRF1_CAN_DET_AMPLITUDE_19 "Detected object amplitude 19";
BA_ "SignalDescription" SG_ 76 LRRF1_CAN_DET_AMPLITUDE_18 "Detected object amplitude 18";
BA_ "SignalDescription" SG_ 76 LRRF1_CAN_DET_AMPLITUDE_17 "Detected object amplitude 17";
BA_ "SignalDescription" SG_ 76 LRRF1_CAN_DET_AMPLITUDE_16 "Detected object amplitude 16";
BA_ "SignalDescription" SG_ 76 LRRF1_CAN_DET_VALID_LEVEL_21 "Detected object valid level 21";
BA_ "SignalDescription" SG_ 76 LRRF1_CAN_DET_VALID_LEVEL_20 "Detected object valid level 20";
BA_ "SignalDescription" SG_ 76 LRRF1_CAN_DET_VALID_LEVEL_19 "Detected object valid level 19";
BA_ "SignalDescription" SG_ 76 LRRF1_CAN_DET_VALID_LEVEL_18 "Detected object valid level 18";
BA_ "SignalDescription" SG_ 76 LRRF1_CAN_DET_VALID_LEVEL_17 "Detected object valid level 17";
BA_ "SignalDescription" SG_ 76 LRRF1_CAN_DET_VALID_LEVEL_16 "Detected object valid level 16";
VAL_ 84 LRRF1_CAN_DET_CONFID_AZIMUTH_71 3 "Low" 2 "Medium_Low" 1 "Medium_High" 0 "High" ;
VAL_ 84 LRRF1_CAN_DET_CONFID_AZIMUTH_77 3 "Low" 2 "Medium_Low" 1 "Medium_High" 0 "High" ;
VAL_ 84 LRRF1_CAN_DET_CONFID_AZIMUTH_76 3 "Low" 2 "Medium_Low" 1 "Medium_High" 0 "High" ;
VAL_ 84 LRRF1_CAN_DET_CONFID_AZIMUTH_75 3 "Low" 2 "Medium_Low" 1 "Medium_High" 0 "High" ;
VAL_ 84 LRRF1_CAN_DET_CONFID_AZIMUTH_74 3 "Low" 2 "Medium_Low" 1 "Medium_High" 0 "High" ;
VAL_ 84 LRRF1_CAN_DET_CONFID_AZIMUTH_73 3 "Low" 2 "Medium_Low" 1 "Medium_High" 0 "High" ;
VAL_ 84 LRRF1_CAN_DET_CONFID_AZIMUTH_72 3 "Low" 2 "Medium_Low" 1 "Medium_High" 0 "High" ;
VAL_ 83 LRRF1_CAN_DET_CONFID_AZIMUTH_64 3 "Low" 2 "Medium_Low" 1 "Medium_High" 0 "High" ;
VAL_ 83 LRRF1_CAN_DET_CONFID_AZIMUTH_70 3 "Low" 2 "Medium_Low" 1 "Medium_High" 0 "High" ;
VAL_ 83 LRRF1_CAN_DET_CONFID_AZIMUTH_69 3 "Low" 2 "Medium_Low" 1 "Medium_High" 0 "High" ;
VAL_ 83 LRRF1_CAN_DET_CONFID_AZIMUTH_68 3 "Low" 2 "Medium_Low" 1 "Medium_High" 0 "High" ;
VAL_ 83 LRRF1_CAN_DET_CONFID_AZIMUTH_67 3 "Low" 2 "Medium_Low" 1 "Medium_High" 0 "High" ;
VAL_ 83 LRRF1_CAN_DET_CONFID_AZIMUTH_66 3 "Low" 2 "Medium_Low" 1 "Medium_High" 0 "High" ;
VAL_ 83 LRRF1_CAN_DET_CONFID_AZIMUTH_65 3 "Low" 2 "Medium_Low" 1 "Medium_High" 0 "High" ;
VAL_ 82 LRRF1_CAN_DET_CONFID_AZIMUTH_57 3 "Low" 2 "Medium_Low" 1 "Medium_High" 0 "High" ;
VAL_ 82 LRRF1_CAN_DET_CONFID_AZIMUTH_63 3 "Low" 2 "Medium_Low" 1 "Medium_High" 0 "High" ;
VAL_ 82 LRRF1_CAN_DET_CONFID_AZIMUTH_62 3 "Low" 2 "Medium_Low" 1 "Medium_High" 0 "High" ;
VAL_ 82 LRRF1_CAN_DET_CONFID_AZIMUTH_61 3 "Low" 2 "Medium_Low" 1 "Medium_High" 0 "High" ;
VAL_ 82 LRRF1_CAN_DET_CONFID_AZIMUTH_60 3 "Low" 2 "Medium_Low" 1 "Medium_High" 0 "High" ;
VAL_ 82 LRRF1_CAN_DET_CONFID_AZIMUTH_58 3 "Low" 2 "Medium_Low" 1 "Medium_High" 0 "High" ;
VAL_ 80 LRRF1_CAN_DET_CONFID_AZIMUTH_43 3 "Low" 2 "Medium_Low" 1 "Medium_High" 0 "High" ;
VAL_ 80 LRRF1_CAN_DET_CONFID_AZIMUTH_49 3 "Low" 2 "Medium_Low" 1 "Medium_High" 0 "High" ;
VAL_ 80 LRRF1_CAN_DET_CONFID_AZIMUTH_48 3 "Low" 2 "Medium_Low" 1 "Medium_High" 0 "High" ;
VAL_ 80 LRRF1_CAN_DET_CONFID_AZIMUTH_47 3 "Low" 2 "Medium_Low" 1 "Medium_High" 0 "High" ;
VAL_ 80 LRRF1_CAN_DET_CONFID_AZIMUTH_46 3 "Low" 2 "Medium_Low" 1 "Medium_High" 0 "High" ;
VAL_ 80 LRRF1_CAN_DET_CONFID_AZIMUTH_45 3 "Low" 2 "Medium_Low" 1 "Medium_High" 0 "High" ;
VAL_ 80 LRRF1_CAN_DET_CONFID_AZIMUTH_44 3 "Low" 2 "Medium_Low" 1 "Medium_High" 0 "High" ;
VAL_ 79 LRRF1_CAN_DET_CONFID_AZIMUTH_36 3 "Low" 2 "Medium_Low" 1 "Medium_High" 0 "High" ;
VAL_ 79 LRRF1_CAN_DET_CONFID_AZIMUTH_42 3 "Low" 2 "Medium_Low" 1 "Medium_High" 0 "High" ;
VAL_ 79 LRRF1_CAN_DET_CONFID_AZIMUTH_41 3 "Low" 2 "Medium_Low" 1 "Medium_High" 0 "High" ;
VAL_ 79 LRRF1_CAN_DET_CONFID_AZIMUTH_40 3 "Low" 2 "Medium_Low" 1 "Medium_High" 0 "High" ;
VAL_ 79 LRRF1_CAN_DET_CONFID_AZIMUTH_39 3 "Low" 2 "Medium_Low" 1 "Medium_High" 0 "High" ;
VAL_ 79 LRRF1_CAN_DET_CONFID_AZIMUTH_38 3 "Low" 2 "Medium_Low" 1 "Medium_High" 0 "High" ;
VAL_ 79 LRRF1_CAN_DET_CONFID_AZIMUTH_37 3 "Low" 2 "Medium_Low" 1 "Medium_High" 0 "High" ;
VAL_ 78 LRRF1_CAN_DET_CONFID_AZIMUTH_29 3 "Low" 2 "Medium_Low" 1 "Medium_High" 0 "High" ;
VAL_ 78 LRRF1_CAN_DET_CONFID_AZIMUTH_35 3 "Low" 2 "Medium_Low" 1 "Medium_High" 0 "High" ;
VAL_ 78 LRRF1_CAN_DET_CONFID_AZIMUTH_34 3 "Low" 2 "Medium_Low" 1 "Medium_High" 0 "High" ;
VAL_ 78 LRRF1_CAN_DET_CONFID_AZIMUTH_33 3 "Low" 2 "Medium_Low" 1 "Medium_High" 0 "High" ;
VAL_ 78 LRRF1_CAN_DET_CONFID_AZIMUTH_32 3 "Low" 2 "Medium_Low" 1 "Medium_High" 0 "High" ;
VAL_ 78 LRRF1_CAN_DET_CONFID_AZIMUTH_31 3 "Low" 2 "Medium_Low" 1 "Medium_High" 0 "High" ;
VAL_ 78 LRRF1_CAN_DET_CONFID_AZIMUTH_30 3 "Low" 2 "Medium_Low" 1 "Medium_High" 0 "High" ;
VAL_ 77 LRRF1_CAN_DET_CONFID_AZIMUTH_22 3 "Low" 2 "Medium_Low" 1 "Medium_High" 0 "High" ;
VAL_ 77 LRRF1_CAN_DET_CONFID_AZIMUTH_28 3 "Low" 2 "Medium_Low" 1 "Medium_High" 0 "High" ;
VAL_ 77 LRRF1_CAN_DET_CONFID_AZIMUTH_27 3 "Low" 2 "Medium_Low" 1 "Medium_High" 0 "High" ;
VAL_ 77 LRRF1_CAN_DET_CONFID_AZIMUTH_26 3 "Low" 2 "Medium_Low" 1 "Medium_High" 0 "High" ;
VAL_ 77 LRRF1_CAN_DET_CONFID_AZIMUTH_25 3 "Low" 2 "Medium_Low" 1 "Medium_High" 0 "High" ;
VAL_ 77 LRRF1_CAN_DET_CONFID_AZIMUTH_24 3 "Low" 2 "Medium_Low" 1 "Medium_High" 0 "High" ;
VAL_ 77 LRRF1_CAN_DET_CONFID_AZIMUTH_23 3 "Low" 2 "Medium_Low" 1 "Medium_High" 0 "High" ;
VAL_ 76 LRRF1_CAN_DET_CONFID_AZIMUTH_15 3 "Low" 2 "Medium_Low" 1 "Medium_High" 0 "High" ;
VAL_ 76 LRRF1_CAN_DET_CONFID_AZIMUTH_21 3 "Low" 2 "Medium_Low" 1 "Medium_High" 0 "High" ;
VAL_ 76 LRRF1_CAN_DET_CONFID_AZIMUTH_20 3 "Low" 2 "Medium_Low" 1 "Medium_High" 0 "High" ;
VAL_ 76 LRRF1_CAN_DET_CONFID_AZIMUTH_19 3 "Low" 2 "Medium_Low" 1 "Medium_High" 0 "High" ;
VAL_ 76 LRRF1_CAN_DET_CONFID_AZIMUTH_18 3 "Low" 2 "Medium_Low" 1 "Medium_High" 0 "High" ;
VAL_ 76 LRRF1_CAN_DET_CONFID_AZIMUTH_17 3 "Low" 2 "Medium_Low" 1 "Medium_High" 0 "High" ;
VAL_ 76 LRRF1_CAN_DET_CONFID_AZIMUTH_16 3 "Low" 2 "Medium_Low" 1 "Medium_High" 0 "High" ;
SIG_GROUP_ 84 LRRF1_Detection_071_077 1 : LRRF1_CAN_DET_Near_TARGET_77 LRRF1_CAN_DET_Near_TARGET_76 LRRF1_CAN_DET_Near_TARGET_75 LRRF1_CAN_DET_Near_TARGET_74 LRRF1_CAN_DET_Near_TARGET_73 LRRF1_CAN_DET_Near_TARGET_72 LRRF1_CAN_DET_Near_TARGET_71 LRRF1_CAN_DET_ELEVATION_71 LRRF1_CAN_DET_CONFID_AZIMUTH_71 LRRF1_CAN_DET_SUPER_RES_TAR_0053 LRRF1_CAN_DET_VALID_LEVEL_71 LRRF1_CAN_DET_CONFID_ELEVAT_0053 LRRF1_CAN_DET_HOST_VEH_CLUT_0053 LRRF1_CAN_DET_AZIMUTH_71 LRRF1_CAN_DET_RANGE_RATE_71 LRRF1_CAN_DET_RANGE_71 LRRF1_CAN_SCAN_INDEX_2LSB_77 LRRF1_CAN_DET_SUPER_RES_TAR_0056 LRRF1_CAN_DET_AMPLITUDE_72 LRRF1_CAN_DET_VALID_LEVEL_75 LRRF1_Det_CRC_11 LRRF1_CAN_DET_VALID_LEVEL_74 LRRF1_Det_MC_11 LRRF1_CAN_DET_VALID_LEVEL_73 LRRF1_CAN_DET_VALID_LEVEL_72 LRRF1_CAN_DET_HOST_VEH_CLUT_0055 LRRF1_CAN_DET_AZIMUTH_74 LRRF1_CAN_DET_CONFID_AZIMUTH_74 LRRF1_CAN_DET_AZIMUTH_72 LRRF1_CAN_DET_AZIMUTH_73 LRRF1_CAN_DET_AMPLITUDE_77 LRRF1_CAN_DET_VALID_LEVEL_77 LRRF1_CAN_DET_AMPLITUDE_75 LRRF1_CAN_DET_AMPLITUDE_76 LRRF1_CAN_DET_AMPLITUDE_74 LRRF1_CAN_DET_CONFID_AZIMUTH_73 LRRF1_CAN_DET_ELEVATION_75 LRRF1_CAN_DET_CONFID_ELEVAT_0055 LRRF1_CAN_DET_ELEVATION_73 LRRF1_CAN_DET_HOST_VEH_CLUT_0056 LRRF1_CAN_DET_ELEVATION_74 LRRF1_CAN_DET_CONFID_AZIMUTH_75 LRRF1_CAN_DET_SUPER_RES_TAR_0059 LRRF1_CAN_DET_HOST_VEH_CLUT_0059 LRRF1_CAN_DET_HOST_VEH_CLUT_0058 LRRF1_CAN_DET_AMPLITUDE_73 LRRF1_CAN_DET_ELEVATION_72 LRRF1_CAN_DET_HOST_VEH_CLUT_0054 LRRF1_CAN_DET_AZIMUTH_76 LRRF1_CAN_DET_CONFID_ELEVAT_0056 LRRF1_CAN_DET_CONFID_ELEVAT_0058 LRRF1_CAN_DET_SUPER_RES_TAR_0057 LRRF1_CAN_DET_CONFID_ELEVAT_0059 LRRF1_CAN_DET_CONFID_ELEVAT_0057 LRRF1_CAN_DET_SUPER_RES_TAR_0055 LRRF1_CAN_DET_AZIMUTH_77 LRRF1_CAN_DET_SUPER_RES_TAR_0058 LRRF1_CAN_DET_RANGE_73 LRRF1_CAN_SCAN_INDEX_2LSB_71 LRRF1_CAN_DET_AMPLITUDE_71 LRRF1_CAN_DET_HOST_VEH_CLUT_0057 LRRF1_CAN_DET_AZIMUTH_75 LRRF1_CAN_DET_SUPER_RES_TAR_0054 LRRF1_CAN_DET_ELEVATION_76 LRRF1_CAN_DET_RANGE_77 LRRF1_CAN_SCAN_INDEX_2LSB_72 LRRF1_CAN_SCAN_INDEX_2LSB_76 LRRF1_CAN_DET_VALID_LEVEL_76 LRRF1_CAN_DET_RANGE_74 LRRF1_CAN_DET_CONFID_AZIMUTH_72 LRRF1_CAN_DET_RANGE_76 LRRF1_CAN_DET_CONFID_AZIMUTH_77 LRRF1_CAN_SCAN_INDEX_2LSB_74 LRRF1_CAN_DET_CONFID_AZIMUTH_76 LRRF1_CAN_SCAN_INDEX_2LSB_75 LRRF1_CAN_DET_ELEVATION_77 LRRF1_CAN_DET_RANGE_72 LRRF1_CAN_DET_CONFID_ELEVAT_0054 LRRF1_CAN_DET_RANGE_RATE_77 LRRF1_CAN_SCAN_INDEX_2LSB_73 LRRF1_CAN_DET_RANGE_RATE_75 LRRF1_CAN_DET_RANGE_RATE_76 LRRF1_CAN_DET_RANGE_RATE_74 LRRF1_CAN_DET_RANGE_RATE_73 LRRF1_CAN_DET_RANGE_RATE_72 LRRF1_CAN_DET_RANGE_75;
SIG_GROUP_ 83 LRRF1_Detection_064_070 1 : LRRF1_CAN_DET_Near_TARGET_70 LRRF1_CAN_DET_Near_TARGET_69 LRRF1_CAN_DET_Near_TARGET_68 LRRF1_CAN_DET_Near_TARGET_67 LRRF1_CAN_DET_Near_TARGET_66 LRRF1_CAN_DET_Near_TARGET_65 LRRF1_CAN_DET_Near_TARGET_64 LRRF1_CAN_DET_ELEVATION_64 LRRF1_CAN_DET_VALID_LEVEL_65 LRRF1_CAN_DET_CONFID_AZIMUTH_64 LRRF1_CAN_DET_SUPER_RES_TARGET_6 LRRF1_CAN_DET_HOST_VEH_CLUTTER_6 LRRF1_CAN_DET_VALID_LEVEL_68 LRRF1_CAN_DET_VALID_LEVEL_66 LRRF1_CAN_DET_VALID_LEVEL_64 LRRF1_CAN_DET_CONFID_ELEVATION_6 LRRF1_CAN_DET_AZIMUTH_64 LRRF1_CAN_DET_RANGE_RATE_64 LRRF1_CAN_DET_VALID_LEVEL_67 LRRF1_CAN_DET_RANGE_64 LRRF1_CAN_DET_AMPLITUDE_69 LRRF1_CAN_DET_AMPLITUDE_64 LRRF1_Det_CRC_10 LRRF1_CAN_DET_VALID_LEVEL_70 LRRF1_CAN_DET_ELEVATION_66 LRRF1_CAN_DET_RANGE_70 LRRF1_CAN_DET_AMPLITUDE_66 LRRF1_CAN_DET_AZIMUTH_67 LRRF1_CAN_DET_AMPLITUDE_68 LRRF1_CAN_DET_RANGE_68 LRRF1_CAN_SCAN_INDEX_2LSB_64 LRRF1_CAN_DET_AZIMUTH_65 LRRF1_CAN_DET_CONFID_AZIMUTH_68 LRRF1_CAN_DET_CONFID_AZIMUTH_66 LRRF1_CAN_DET_CONFID_ELEVAT_0062 LRRF1_CAN_DET_CONFID_ELEVAT_0063 LRRF1_CAN_DET_ELEVATION_70 LRRF1_CAN_DET_ELEVATION_68 LRRF1_CAN_DET_VALID_LEVEL_69 LRRF1_CAN_DET_CONFID_AZIMUTH_67 LRRF1_CAN_DET_AZIMUTH_68 LRRF1_CAN_DET_AZIMUTH_69 LRRF1_CAN_DET_AZIMUTH_70 LRRF1_CAN_DET_AMPLITUDE_67 LRRF1_CAN_DET_CONFID_ELEVAT_0061 LRRF1_CAN_DET_ELEVATION_65 LRRF1_CAN_DET_CONFID_AZIMUTH_70 LRRF1_CAN_DET_CONFID_AZIMUTH_69 LRRF1_CAN_DET_CONFID_ELEVAT_0064 LRRF1_CAN_DET_HOST_VEH_CLUT_0065 LRRF1_CAN_DET_ELEVATION_67 LRRF1_CAN_DET_AMPLITUDE_65 LRRF1_CAN_DET_SUPER_RES_TAR_0065 LRRF1_CAN_DET_HOST_VEH_CLUT_0064 LRRF1_CAN_DET_SUPER_RES_TAR_0063 LRRF1_CAN_DET_SUPER_RES_TAR_0064 LRRF1_CAN_DET_HOST_VEH_CLUT_0062 LRRF1_CAN_DET_HOST_VEH_CLUT_0061 LRRF1_CAN_DET_HOST_VEH_CLUT_0063 LRRF1_CAN_DET_CONFID_ELEVAT_0060 LRRF1_CAN_SCAN_INDEX_2LSB_70 LRRF1_CAN_DET_AMPLITUDE_70 LRRF1_CAN_DET_ELEVATION_69 LRRF1_Det_MC_10 LRRF1_CAN_SCAN_INDEX_2LSB_68 LRRF1_CAN_SCAN_INDEX_2LSB_66 LRRF1_CAN_DET_RANGE_69 LRRF1_CAN_DET_RANGE_67 LRRF1_CAN_DET_RANGE_65 LRRF1_CAN_DET_SUPER_RES_TAR_0060 LRRF1_CAN_DET_RANGE_66 LRRF1_CAN_DET_AZIMUTH_66 LRRF1_CAN_DET_CONFID_ELEVAT_0065 LRRF1_CAN_DET_SUPER_RES_TAR_0061 LRRF1_CAN_DET_CONFID_AZIMUTH_65 LRRF1_CAN_DET_SUPER_RES_TAR_0062 LRRF1_CAN_DET_HOST_VEH_CLUT_0060 LRRF1_CAN_DET_RANGE_RATE_65 LRRF1_CAN_DET_RANGE_RATE_66 LRRF1_CAN_DET_RANGE_RATE_67 LRRF1_CAN_DET_RANGE_RATE_68 LRRF1_CAN_DET_RANGE_RATE_69 LRRF1_CAN_DET_RANGE_RATE_70 LRRF1_CAN_SCAN_INDEX_2LSB_65 LRRF1_CAN_SCAN_INDEX_2LSB_67 LRRF1_CAN_SCAN_INDEX_2LSB_69;
SIG_GROUP_ 82 LRRF1_Detection_057_063 1 : LRRF1_CAN_DET_Near_TARGET_63 LRRF1_CAN_DET_Near_TARGET_62 LRRF1_CAN_DET_Near_TARGET_61 LRRF1_CAN_DET_Near_TARGET_60 LRRF1_CAN_DET_Near_TARGET_59 LRRF1_CAN_DET_Near_TARGET_58 LRRF1_CAN_DET_Near_TARGET_57 LRRF1_CAN_DET_ELEVATION_57 LRRF1_CAN_DET_SUPER_RES_TAR_0066 LRRF1_CAN_DET_CONFID_AZIMUTH_57 LRRF1_CAN_DET_VALID_LEVEL_58 LRRF1_CAN_DET_VALID_LEVEL_59 LRRF1_CAN_DET_CONFID_ELEVAT_0066 LRRF1_CAN_DET_VALID_LEVEL_60 LRRF1_CAN_DET_VALID_LEVEL_61 LRRF1_CAN_DET_HOST_VEH_CLUT_0066 LRRF1_CAN_DET_RANGE_RATE_57 LRRF1_CAN_DET_AZIMUTH_57 LRRF1_CAN_DET_VALID_LEVEL_57 LRRF1_CAN_DET_RANGE_57 LRRF1_CAN_DET_VALID_LEVEL_62 LRRF1_Det_CRC_09 LRRF1_CAN_DET_AMPLITUDE_58 LRRF1_Det_MC_09 LRRF1_CAN_DET_VALID_LEVEL_63 LRRF1_CAN_DET_AMPLITUDE_57 LRRF1_CAN_SCAN_INDEX_2LSB_57 LRRF1_CAN_DET_AMPLITUDE_60 LRRF1_CAN_DET_ELEVATION_62 LRRF1_CAN_DET_CONFID_AZIMUTH_62 LRRF1_CAN_DET_AMPLITUDE_62 LRRF1_CAN_DET_AZIMUTH_58 LRRF1_CAN_DET_AMPLITUDE_61 LRRF1_CAN_DET_AMPLITUDE_59 LRRF1_CAN_DET_AZIMUTH_59 LRRF1_CAN_DET_AZIMUTH_63 LRRF1_CAN_DET_AZIMUTH_61 LRRF1_CAN_DET_AMPLITUDE_63 LRRF1_CAN_DET_CONFID_AZIMUTH_60 LRRF1_CAN_DET_ELEVATION_59 LRRF1_CAN_DET_AZIMUTH_62 LRRF1_CAN_DET_CONFID_ELEVAT_0067 LRRF1_CAN_DET_ELEVATION_58 LRRF1_CAN_DET_AZIMUTH_60 LRRF1_CAN_DET_ELEVATION_63 LRRF1_CAN_DET_HOST_VEH_CLUT_0071 LRRF1_CAN_DET_ELEVATION_60 LRRF1_CAN_DET_HOST_VEH_CLUT_0072 LRRF1_CAN_DET_HOST_VEH_CLUT_0070 LRRF1_CAN_DET_HOST_VEH_CLUT_0069 LRRF1_CAN_DET_CONFID_ELEVAT_0072 LRRF1_CAN_DET_HOST_VEH_CLUT_0068 LRRF1_CAN_DET_CONFID_AZIMUTH_59 LRRF1_CAN_DET_HOST_VEH_CLUT_0067 LRRF1_CAN_DET_CONFID_AZIMUTH_61 LRRF1_CAN_DET_RANGE_63 LRRF1_CAN_DET_CONFID_ELEVAT_0071 LRRF1_CAN_SCAN_INDEX_2LSB_61 LRRF1_CAN_DET_CONFID_AZIMUTH_63 LRRF1_CAN_SCAN_INDEX_2LSB_62 LRRF1_CAN_DET_CONFID_ELEVAT_0069 LRRF1_CAN_SCAN_INDEX_2LSB_63 LRRF1_CAN_DET_CONFID_AZIMUTH_58 LRRF1_CAN_DET_SUPER_RES_TAR_0069 LRRF1_CAN_DET_SUPER_RES_TAR_0071 LRRF1_CAN_DET_CONFID_ELEVAT_0068 LRRF1_CAN_DET_SUPER_RES_TAR_0070 LRRF1_CAN_DET_SUPER_RES_TAR_0068 LRRF1_CAN_DET_RANGE_59 LRRF1_CAN_DET_RANGE_61 LRRF1_CAN_DET_RANGE_62 LRRF1_CAN_DET_CONFID_ELEVAT_0070 LRRF1_CAN_DET_SUPER_RES_TAR_0072 LRRF1_CAN_DET_SUPER_RES_TAR_0067 LRRF1_CAN_DET_RANGE_58 LRRF1_CAN_DET_RANGE_60 LRRF1_CAN_DET_ELEVATION_61 LRRF1_CAN_DET_RANGE_RATE_58 LRRF1_CAN_DET_RANGE_RATE_59 LRRF1_CAN_DET_RANGE_RATE_60 LRRF1_CAN_SCAN_INDEX_2LSB_60 LRRF1_CAN_DET_RANGE_RATE_61 LRRF1_CAN_DET_RANGE_RATE_62 LRRF1_CAN_DET_RANGE_RATE_63 LRRF1_CAN_SCAN_INDEX_2LSB_58 LRRF1_CAN_SCAN_INDEX_2LSB_59;
SIG_GROUP_ 80 LRRF1_Detection_043_049 1 : LRRF1_CAN_DET_Near_TARGET_49 LRRF1_CAN_DET_Near_TARGET_48 LRRF1_CAN_DET_Near_TARGET_47 LRRF1_CAN_DET_Near_TARGET_46 LRRF1_CAN_DET_Near_TARGET_45 LRRF1_CAN_DET_Near_TARGET_44 LRRF1_CAN_DET_Near_TARGET_43 LRRF1_CAN_DET_ELEVATION_43 LRRF1_CAN_DET_VALID_LEVEL_48 LRRF1_CAN_DET_VALID_LEVEL_45 LRRF1_CAN_DET_VALID_LEVEL_44 LRRF1_CAN_DET_VALID_LEVEL_49 LRRF1_CAN_DET_SUPER_RES_TARGET_4 LRRF1_CAN_DET_CONFID_ELEVATION_4 LRRF1_CAN_DET_VALID_LEVEL_43 LRRF1_CAN_DET_HOST_VEH_CLUTTER_4 LRRF1_CAN_DET_ELEVATION_47 LRRF1_CAN_DET_VALID_LEVEL_47 LRRF1_CAN_DET_RANGE_RATE_43 LRRF1_CAN_DET_AMPLITUDE_43 LRRF1_Det_CRC_07 LRRF1_Det_MC_07 LRRF1_CAN_DET_RANGE_45 LRRF1_CAN_DET_HOST_VEH_CLUT_0074 LRRF1_CAN_DET_HOST_VEH_CLUT_0077 LRRF1_CAN_DET_ELEVATION_45 LRRF1_CAN_DET_AMPLITUDE_44 LRRF1_CAN_DET_ELEVATION_46 LRRF1_CAN_DET_AMPLITUDE_48 LRRF1_CAN_DET_CONFID_ELEVAT_0078 LRRF1_CAN_DET_AZIMUTH_45 LRRF1_CAN_DET_AMPLITUDE_45 LRRF1_CAN_DET_AZIMUTH_47 LRRF1_CAN_DET_CONFID_AZIMUTH_46 LRRF1_CAN_DET_AZIMUTH_46 LRRF1_CAN_DET_AMPLITUDE_46 LRRF1_CAN_DET_AMPLITUDE_47 LRRF1_CAN_DET_AZIMUTH_49 LRRF1_CAN_DET_CONFID_AZIMUTH_49 LRRF1_CAN_DET_ELEVATION_44 LRRF1_CAN_DET_AZIMUTH_48 LRRF1_CAN_SCAN_INDEX_2LSB_45 LRRF1_CAN_DET_AZIMUTH_43 LRRF1_CAN_DET_CONFID_AZIMUTH_43 LRRF1_CAN_DET_VALID_LEVEL_46 LRRF1_CAN_DET_CONFID_AZIMUTH_45 LRRF1_CAN_DET_CONFID_AZIMUTH_48 LRRF1_CAN_DET_CONFID_ELEVAT_0073 LRRF1_CAN_DET_CONFID_ELEVAT_0077 LRRF1_CAN_DET_CONFID_ELEVAT_0075 LRRF1_CAN_DET_CONFID_AZIMUTH_47 LRRF1_CAN_DET_ELEVATION_48 LRRF1_CAN_DET_HOST_VEH_CLUT_0078 LRRF1_CAN_DET_CONFID_AZIMUTH_44 LRRF1_CAN_DET_ELEVATION_49 LRRF1_CAN_DET_CONFID_ELEVAT_0076 LRRF1_CAN_DET_HOST_VEH_CLUT_0075 LRRF1_CAN_DET_HOST_VEH_CLUT_0076 LRRF1_CAN_DET_HOST_VEH_CLUT_0073 LRRF1_CAN_DET_CONFID_ELEVAT_0074 LRRF1_CAN_DET_SUPER_RES_TAR_0078 LRRF1_CAN_SCAN_INDEX_2LSB_44 LRRF1_CAN_DET_SUPER_RES_TAR_0077 LRRF1_CAN_DET_RANGE_RATE_46 LRRF1_CAN_DET_SUPER_RES_TAR_0076 LRRF1_CAN_DET_AMPLITUDE_49 LRRF1_CAN_DET_RANGE_RATE_47 LRRF1_CAN_DET_RANGE_RATE_49 LRRF1_CAN_DET_RANGE_RATE_48 LRRF1_CAN_DET_AZIMUTH_44 LRRF1_CAN_DET_RANGE_43 LRRF1_CAN_SCAN_INDEX_2LSB_43 LRRF1_CAN_SCAN_INDEX_2LSB_48 LRRF1_CAN_SCAN_INDEX_2LSB_49 LRRF1_CAN_SCAN_INDEX_2LSB_47 LRRF1_CAN_SCAN_INDEX_2LSB_46 LRRF1_CAN_DET_SUPER_RES_TAR_0075 LRRF1_CAN_DET_SUPER_RES_TAR_0074 LRRF1_CAN_DET_SUPER_RES_TAR_0073 LRRF1_CAN_DET_RANGE_44 LRRF1_CAN_DET_RANGE_RATE_44 LRRF1_CAN_DET_RANGE_46 LRRF1_CAN_DET_RANGE_47 LRRF1_CAN_DET_RANGE_48 LRRF1_CAN_DET_RANGE_49 LRRF1_CAN_DET_RANGE_RATE_45;
SIG_GROUP_ 79 LRRF1_Detection_036_042 1 : LRRF1_CAN_DET_Near_TARGET_42 LRRF1_CAN_DET_Near_TARGET_41 LRRF1_CAN_DET_Near_TARGET_40 LRRF1_CAN_DET_Near_TARGET_39 LRRF1_CAN_DET_Near_TARGET_38 LRRF1_CAN_DET_Near_TARGET_37 LRRF1_CAN_DET_Near_TARGET_36 LRRF1_CAN_DET_ELEVATION_36 LRRF1_CAN_DET_HOST_VEH_CLUTTER_3 LRRF1_CAN_DET_SUPER_RES_TARGET_3 LRRF1_CAN_DET_CONFID_AZIMUTH_36 LRRF1_CAN_DET_CONFID_ELEVATION_3 LRRF1_CAN_DET_VALID_LEVEL_37 LRRF1_CAN_DET_AMPLITUDE_41 LRRF1_CAN_DET_VALID_LEVEL_40 LRRF1_CAN_DET_VALID_LEVEL_41 LRRF1_CAN_DET_RANGE_RATE_36 LRRF1_CAN_DET_VALID_LEVEL_38 LRRF1_CAN_DET_VALID_LEVEL_39 LRRF1_CAN_DET_AZIMUTH_41 LRRF1_CAN_DET_AZIMUTH_42 LRRF1_CAN_DET_ELEVATION_38 LRRF1_CAN_DET_VALID_LEVEL_36 LRRF1_CAN_DET_ELEVATION_39 LRRF1_CAN_DET_AZIMUTH_36 LRRF1_CAN_DET_RANGE_36 LRRF1_CAN_SCAN_INDEX_2LSB_36 LRRF1_Det_CRC_06 LRRF1_Det_MC_06 LRRF1_CAN_DET_ELEVATION_41 LRRF1_CAN_DET_AZIMUTH_38 LRRF1_CAN_DET_AZIMUTH_37 LRRF1_CAN_DET_AMPLITUDE_37 LRRF1_CAN_DET_AMPLITUDE_42 LRRF1_CAN_DET_AMPLITUDE_39 LRRF1_CAN_DET_AMPLITUDE_38 LRRF1_CAN_DET_VALID_LEVEL_42 LRRF1_CAN_DET_SUPER_RES_TAR_0082 LRRF1_CAN_DET_HOST_VEH_CLUT_0079 LRRF1_CAN_DET_HOST_VEH_CLUT_0080 LRRF1_CAN_DET_HOST_VEH_CLUT_0082 LRRF1_CAN_DET_HOST_VEH_CLUT_0084 LRRF1_CAN_DET_AZIMUTH_40 LRRF1_CAN_DET_ELEVATION_37 LRRF1_CAN_DET_CONFID_ELEVAT_0082 LRRF1_CAN_DET_CONFID_AZIMUTH_37 LRRF1_CAN_DET_CONFID_AZIMUTH_41 LRRF1_CAN_DET_CONFID_ELEVAT_0080 LRRF1_CAN_DET_CONFID_AZIMUTH_40 LRRF1_CAN_DET_ELEVATION_40 LRRF1_CAN_DET_HOST_VEH_CLUT_0081 LRRF1_CAN_DET_CONFID_AZIMUTH_39 LRRF1_CAN_DET_SUPER_RES_TAR_0083 LRRF1_CAN_DET_SUPER_RES_TAR_0084 LRRF1_CAN_DET_SUPER_RES_TAR_0081 LRRF1_CAN_DET_AMPLITUDE_36 LRRF1_CAN_DET_HOST_VEH_CLUT_0083 LRRF1_CAN_DET_CONFID_ELEVAT_0083 LRRF1_CAN_DET_RANGE_38 LRRF1_CAN_SCAN_INDEX_2LSB_40 LRRF1_CAN_SCAN_INDEX_2LSB_42 LRRF1_CAN_DET_AMPLITUDE_40 LRRF1_CAN_DET_RANGE_40 LRRF1_CAN_SCAN_INDEX_2LSB_41 LRRF1_CAN_DET_CONFID_ELEVAT_0079 LRRF1_CAN_DET_SUPER_RES_TAR_0080 LRRF1_CAN_DET_AZIMUTH_39 LRRF1_CAN_DET_RANGE_RATE_41 LRRF1_CAN_SCAN_INDEX_2LSB_39 LRRF1_CAN_SCAN_INDEX_2LSB_38 LRRF1_CAN_SCAN_INDEX_2LSB_37 LRRF1_CAN_DET_RANGE_41 LRRF1_CAN_DET_RANGE_RATE_42 LRRF1_CAN_DET_CONFID_AZIMUTH_38 LRRF1_CAN_DET_SUPER_RES_TAR_0079 LRRF1_CAN_DET_CONFID_ELEVAT_0084 LRRF1_CAN_DET_RANGE_RATE_39 LRRF1_CAN_DET_ELEVATION_42 LRRF1_CAN_DET_RANGE_39 LRRF1_CAN_DET_RANGE_42 LRRF1_CAN_DET_RANGE_RATE_38 LRRF1_CAN_DET_RANGE_RATE_40 LRRF1_CAN_DET_CONFID_AZIMUTH_42 LRRF1_CAN_DET_CONFID_ELEVAT_0081 LRRF1_CAN_DET_RANGE_RATE_37 LRRF1_CAN_DET_RANGE_37;
SIG_GROUP_ 78 LRRF1_Detection_029_035 1 : LRRF1_CAN_DET_Near_TARGET_35 LRRF1_CAN_DET_Near_TARGET_34 LRRF1_CAN_DET_Near_TARGET_33 LRRF1_CAN_DET_Near_TARGET_32 LRRF1_CAN_DET_Near_TARGET_31 LRRF1_CAN_DET_Near_TARGET_30 LRRF1_CAN_DET_Near_TARGET_29 LRRF1_CAN_DET_AZIMUTH_29 LRRF1_CAN_DET_ELEVATION_29 LRRF1_CAN_DET_SUPER_RES_TARGET_2 LRRF1_CAN_DET_CONFID_AZIMUTH_29 LRRF1_CAN_DET_VALID_LEVEL_29 LRRF1_CAN_DET_CONFID_ELEVATION_2 LRRF1_CAN_DET_AMPLITUDE_29 LRRF1_CAN_DET_VALID_LEVEL_32 LRRF1_CAN_DET_VALID_LEVEL_30 LRRF1_CAN_DET_AMPLITUDE_30 LRRF1_CAN_DET_VALID_LEVEL_31 LRRF1_CAN_SCAN_INDEX_2LSB_29 LRRF1_CAN_DET_AMPLITUDE_34 LRRF1_CAN_DET_RANGE_RATE_29 LRRF1_CAN_DET_RANGE_29 LRRF1_CAN_DET_HOST_VEH_CLUTTER_2 LRRF1_CAN_DET_AZIMUTH_32 LRRF1_Det_MC_05 LRRF1_Det_CRC_05 LRRF1_CAN_DET_ELEVATION_31 LRRF1_CAN_DET_HOST_VEH_CLUT_0090 LRRF1_CAN_DET_AZIMUTH_35 LRRF1_CAN_DET_ELEVATION_33 LRRF1_CAN_DET_VALID_LEVEL_33 LRRF1_CAN_DET_AMPLITUDE_35 LRRF1_CAN_DET_VALID_LEVEL_34 LRRF1_CAN_DET_AMPLITUDE_33 LRRF1_CAN_DET_AMPLITUDE_32 LRRF1_CAN_DET_AMPLITUDE_31 LRRF1_CAN_DET_VALID_LEVEL_35 LRRF1_CAN_DET_AZIMUTH_31 LRRF1_CAN_DET_AZIMUTH_34 LRRF1_CAN_DET_CONFID_AZIMUTH_30 LRRF1_CAN_DET_CONFID_AZIMUTH_32 LRRF1_CAN_DET_ELEVATION_32 LRRF1_CAN_DET_ELEVATION_30 LRRF1_CAN_DET_CONFID_AZIMUTH_34 LRRF1_CAN_DET_CONFID_ELEVAT_0089 LRRF1_CAN_DET_CONFID_AZIMUTH_35 LRRF1_CAN_DET_CONFID_ELEVAT_0088 LRRF1_CAN_DET_CONFID_ELEVAT_0086 LRRF1_CAN_DET_CONFID_ELEVAT_0087 LRRF1_CAN_DET_CONFID_ELEVAT_0085 LRRF1_CAN_DET_ELEVATION_34 LRRF1_CAN_DET_AZIMUTH_33 LRRF1_CAN_DET_CONFID_ELEVAT_0090 LRRF1_CAN_DET_HOST_VEH_CLUT_0089 LRRF1_CAN_DET_ELEVATION_35 LRRF1_CAN_DET_HOST_VEH_CLUT_0088 LRRF1_CAN_DET_RANGE_32 LRRF1_CAN_DET_RANGE_35 LRRF1_CAN_DET_RANGE_34 LRRF1_CAN_DET_CONFID_AZIMUTH_31 LRRF1_CAN_DET_RANGE_RATE_34 LRRF1_CAN_SCAN_INDEX_2LSB_31 LRRF1_CAN_DET_RANGE_RATE_30 LRRF1_CAN_DET_AZIMUTH_30 LRRF1_CAN_DET_SUPER_RES_TAR_0087 LRRF1_CAN_DET_HOST_VEH_CLUT_0087 LRRF1_CAN_DET_HOST_VEH_CLUT_0086 LRRF1_CAN_DET_SUPER_RES_TAR_0090 LRRF1_CAN_DET_SUPER_RES_TAR_0089 LRRF1_CAN_DET_SUPER_RES_TAR_0088 LRRF1_CAN_DET_HOST_VEH_CLUT_0085 LRRF1_CAN_DET_CONFID_AZIMUTH_33 LRRF1_CAN_SCAN_INDEX_2LSB_35 LRRF1_CAN_SCAN_INDEX_2LSB_34 LRRF1_CAN_SCAN_INDEX_2LSB_32 LRRF1_CAN_SCAN_INDEX_2LSB_33 LRRF1_CAN_SCAN_INDEX_2LSB_30 LRRF1_CAN_DET_RANGE_RATE_35 LRRF1_CAN_DET_RANGE_RATE_32 LRRF1_CAN_DET_RANGE_RATE_33 LRRF1_CAN_DET_RANGE_RATE_31 LRRF1_CAN_DET_SUPER_RES_TAR_0086 LRRF1_CAN_DET_SUPER_RES_TAR_0085 LRRF1_CAN_DET_RANGE_30 LRRF1_CAN_DET_RANGE_31 LRRF1_CAN_DET_RANGE_33;
SIG_GROUP_ 77 LRRF1_Detection_022_028 1 : LRRF1_CAN_DET_Near_TARGET_28 LRRF1_CAN_DET_Near_TARGET_27 LRRF1_CAN_DET_Near_TARGET_26 LRRF1_CAN_DET_Near_TARGET_25 LRRF1_CAN_DET_Near_TARGET_24 LRRF1_CAN_DET_Near_TARGET_23 LRRF1_CAN_DET_Near_TARGET_22 LRRF1_CAN_DET_VALID_LEVEL_23 LRRF1_CAN_DET_VALID_LEVEL_24 LRRF1_CAN_DET_ELEVATION_22 LRRF1_CAN_DET_VALID_LEVEL_25 LRRF1_CAN_DET_VALID_LEVEL_26 LRRF1_CAN_DET_CONFID_AZIMUTH_22 LRRF1_CAN_DET_SUPER_RES_TAR_0091 LRRF1_CAN_DET_RANGE_22 LRRF1_CAN_DET_CONFID_ELEVAT_0091 LRRF1_CAN_DET_HOST_VEH_CLUT_0091 LRRF1_CAN_DET_VALID_LEVEL_27 LRRF1_CAN_DET_VALID_LEVEL_22 LRRF1_CAN_DET_AZIMUTH_22 LRRF1_CAN_DET_AMPLITUDE_23 LRRF1_CAN_SCAN_INDEX_2LSB_28 LRRF1_CAN_DET_RANGE_RATE_22 LRRF1_CAN_DET_VALID_LEVEL_28 LRRF1_CAN_DET_AMPLITUDE_26 LRRF1_CAN_DET_AMPLITUDE_24 LRRF1_CAN_SCAN_INDEX_2LSB_26 LRRF1_CAN_DET_AMPLITUDE_22 LRRF1_Det_CRC_04 LRRF1_Det_MC_04 LRRF1_CAN_DET_CONFID_ELEVAT_0092 LRRF1_CAN_SCAN_INDEX_2LSB_22 LRRF1_CAN_DET_CONFID_ELEVAT_0093 LRRF1_CAN_DET_AMPLITUDE_25 LRRF1_CAN_DET_CONFID_AZIMUTH_28 LRRF1_CAN_DET_AZIMUTH_28 LRRF1_CAN_DET_CONFID_AZIMUTH_24 LRRF1_CAN_DET_CONFID_AZIMUTH_26 LRRF1_CAN_DET_CONFID_AZIMUTH_23 LRRF1_CAN_DET_AZIMUTH_27 LRRF1_CAN_DET_AMPLITUDE_28 LRRF1_CAN_DET_AZIMUTH_23 LRRF1_CAN_DET_AZIMUTH_24 LRRF1_CAN_DET_AMPLITUDE_27 LRRF1_CAN_DET_ELEVATION_24 LRRF1_CAN_DET_ELEVATION_23 LRRF1_CAN_DET_AZIMUTH_25 LRRF1_CAN_SCAN_INDEX_2LSB_24 LRRF1_CAN_DET_ELEVATION_26 LRRF1_CAN_DET_HOST_VEH_CLUT_0093 LRRF1_CAN_DET_ELEVATION_27 LRRF1_CAN_DET_ELEVATION_28 LRRF1_CAN_DET_SUPER_RES_TAR_0095 LRRF1_CAN_DET_AZIMUTH_26 LRRF1_CAN_DET_SUPER_RES_TAR_0097 LRRF1_CAN_DET_CONFID_AZIMUTH_25 LRRF1_CAN_DET_HOST_VEH_CLUT_0096 LRRF1_CAN_DET_HOST_VEH_CLUT_0092 LRRF1_CAN_DET_CONFID_ELEVAT_0097 LRRF1_CAN_DET_SUPER_RES_TAR_0096 LRRF1_CAN_DET_CONFID_AZIMUTH_27 LRRF1_CAN_DET_CONFID_ELEVAT_0094 LRRF1_CAN_DET_SUPER_RES_TAR_0094 LRRF1_CAN_DET_CONFID_ELEVAT_0095 LRRF1_CAN_SCAN_INDEX_2LSB_25 LRRF1_CAN_SCAN_INDEX_2LSB_27 LRRF1_CAN_DET_HOST_VEH_CLUT_0097 LRRF1_CAN_DET_SUPER_RES_TAR_0093 LRRF1_CAN_DET_SUPER_RES_TAR_0092 LRRF1_CAN_DET_RANGE_RATE_26 LRRF1_CAN_SCAN_INDEX_2LSB_23 LRRF1_CAN_DET_RANGE_RATE_28 LRRF1_CAN_DET_ELEVATION_25 LRRF1_CAN_DET_RANGE_24 LRRF1_CAN_DET_RANGE_25 LRRF1_CAN_DET_CONFID_ELEVAT_0096 LRRF1_CAN_DET_RANGE_RATE_24 LRRF1_CAN_DET_RANGE_RATE_25 LRRF1_CAN_DET_RANGE_RATE_27 LRRF1_CAN_DET_HOST_VEH_CLUT_0095 LRRF1_CAN_DET_RANGE_RATE_23 LRRF1_CAN_DET_HOST_VEH_CLUT_0094 LRRF1_CAN_DET_RANGE_28 LRRF1_CAN_DET_RANGE_26 LRRF1_CAN_DET_RANGE_27 LRRF1_CAN_DET_RANGE_23;
SIG_GROUP_ 76 LRRF1_Detection_015_021 1 : LRRF1_CAN_DET_Near_TARGET_21 LRRF1_CAN_DET_Near_TARGET_20 LRRF1_CAN_DET_Near_TARGET_19 LRRF1_CAN_DET_Near_TARGET_18 LRRF1_CAN_DET_Near_TARGET_17 LRRF1_CAN_DET_Near_TARGET_16 LRRF1_CAN_DET_Near_TARGET_15 LRRF1_CAN_DET_ELEVATION_15 LRRF1_CAN_DET_CONFID_AZIMUTH_15 LRRF1_CAN_DET_VALID_LEVEL_17 LRRF1_CAN_DET_SUPER_RES_TAR_0098 LRRF1_CAN_DET_VALID_LEVEL_16 LRRF1_CAN_DET_CONFID_ELEVAT_0098 LRRF1_CAN_DET_VALID_LEVEL_18 LRRF1_CAN_DET_HOST_VEH_CLUT_0098 LRRF1_CAN_DET_VALID_LEVEL_20 LRRF1_CAN_DET_VALID_LEVEL_19 LRRF1_CAN_DET_VALID_LEVEL_15 LRRF1_CAN_DET_VALID_LEVEL_21 LRRF1_CAN_DET_AMPLITUDE_16 LRRF1_CAN_DET_AZIMUTH_15 LRRF1_CAN_DET_RANGE_15 LRRF1_CAN_DET_AMPLITUDE_15 LRRF1_CAN_SCAN_INDEX_2LSB_15 LRRF1_CAN_DET_RANGE_RATE_15 LRRF1_CAN_DET_RANGE_18 LRRF1_CAN_DET_RANGE_21 LRRF1_CAN_DET_AMPLITUDE_17 LRRF1_CAN_DET_AZIMUTH_18 LRRF1_CAN_DET_AMPLITUDE_18 LRRF1_CAN_DET_ELEVATION_18 LRRF1_CAN_DET_RANGE_20 LRRF1_Det_MC_03 LRRF1_CAN_DET_AMPLITUDE_19 LRRF1_CAN_DET_ELEVATION_17 LRRF1_CAN_DET_AMPLITUDE_20 LRRF1_CAN_DET_AZIMUTH_17 LRRF1_CAN_DET_CONFID_AZIMUTH_18 LRRF1_CAN_DET_AZIMUTH_19 LRRF1_CAN_DET_CONFID_ELEVAT_0104 LRRF1_CAN_DET_ELEVATION_21 LRRF1_CAN_DET_HOST_VEH_CLUT_0103 LRRF1_CAN_DET_AMPLITUDE_21 LRRF1_CAN_DET_CONFID_ELEVAT_0102 LRRF1_CAN_DET_CONFID_AZIMUTH_19 LRRF1_CAN_DET_RANGE_19 LRRF1_CAN_DET_CONFID_ELEVAT_0099 LRRF1_CAN_DET_ELEVATION_20 LRRF1_CAN_DET_CONFID_ELEVAT_0100 LRRF1_CAN_DET_ELEVATION_19 LRRF1_CAN_DET_CONFID_AZIMUTH_16 LRRF1_CAN_DET_HOST_VEH_CLUT_0101 LRRF1_CAN_DET_CONFID_AZIMUTH_17 LRRF1_CAN_DET_HOST_VEH_CLUT_0104 LRRF1_CAN_DET_AZIMUTH_20 LRRF1_CAN_DET_HOST_VEH_CLUT_0100 LRRF1_CAN_DET_HOST_VEH_CLUT_0102 LRRF1_CAN_DET_ELEVATION_16 LRRF1_CAN_DET_CONFID_AZIMUTH_20 LRRF1_CAN_DET_CONFID_ELEVAT_0101 LRRF1_CAN_DET_SUPER_RES_TAR_0101 LRRF1_CAN_DET_CONFID_AZIMUTH_21 LRRF1_CAN_DET_CONFID_ELEVAT_0103 LRRF1_CAN_DET_SUPER_RES_TAR_0099 LRRF1_CAN_DET_RANGE_16 LRRF1_CAN_DET_RANGE_17 LRRF1_CAN_DET_AZIMUTH_16 LRRF1_CAN_DET_HOST_VEH_CLUT_0099 LRRF1_CAN_DET_SUPER_RES_TAR_0102 LRRF1_CAN_DET_AZIMUTH_21 LRRF1_CAN_DET_SUPER_RES_TAR_0104 LRRF1_CAN_DET_SUPER_RES_TAR_0103 LRRF1_CAN_DET_SUPER_RES_TAR_0100 LRRF1_CAN_DET_RANGE_RATE_19 LRRF1_Det_CRC_03 LRRF1_CAN_SCAN_INDEX_2LSB_16 LRRF1_CAN_SCAN_INDEX_2LSB_21 LRRF1_CAN_SCAN_INDEX_2LSB_17 LRRF1_CAN_SCAN_INDEX_2LSB_19 LRRF1_CAN_SCAN_INDEX_2LSB_20 LRRF1_CAN_DET_RANGE_RATE_16 LRRF1_CAN_DET_RANGE_RATE_17 LRRF1_CAN_DET_RANGE_RATE_18 LRRF1_CAN_DET_RANGE_RATE_20 LRRF1_CAN_DET_RANGE_RATE_21 LRRF1_CAN_SCAN_INDEX_2LSB_18;
