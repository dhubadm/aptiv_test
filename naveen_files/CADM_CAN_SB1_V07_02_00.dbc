VERSION ""

NS_ :

BS_:

BU_: External_Tool CADM LRRF MRRRL MRRRR

BO_ 324 MRR_RL_Active_Fault_Status: 20 MRRRL
 SG_ MRR_RL_TO_SystemTDBlockage_Flt : 87|1@0+ (1,0) [0|1] ""  CADM
 SG_ MRR_RL_TO_CADMSWVersion_Flt : 95|1@0+ (1,0) [0|1] ""  CADM
 SG_ MRR_RL_TO_RADARCfgParameter_Flt : 94|1@0+ (1,0) [0|1] ""  CADM
 SG_ MRR_RL_TO_SATCADMVIN_Flt : 93|1@0+ (1,0) [0|1] ""  CADM
 SG_ MRR_RL_TO_CADMTracksChange_Flt : 92|1@0+ (1,0) [0|1] ""  CADM
 SG_ MRR_RL_Active_Fault_Status_CRC : 151|16@0+ (1,0) [0|65535] ""  CADM
 SG_ MRR_RL_Active_Fault_Status_MC : 139|4@0+ (1,0) [0|15] ""  CADM
 SG_ MRR_RL_Dolphin_Flt : 71|1@0+ (1,0) [0|1] ""  CADM
 SG_ MRR_RL_RRUCore_Flt : 70|1@0+ (1,0) [0|1] ""  CADM
 SG_ MRR_RL_RRUBIST_Flt : 72|1@0+ (1,0) [0|1] ""  CADM
 SG_ MRR_RL_PINPosition_Flt : 69|1@0+ (1,0) [0|1] ""  CADM
 SG_ MRR_RL_PCANDataRangeChk_Flt : 68|1@0+ (1,0) [0|1] ""  CADM
 SG_ MRR_RL_TO_AngleAdjustmentTable_F : 88|1@0+ (1,0) [0|1] ""  CADM
 SG_ MRR_RL_TO_CADMSgnlActlVal_Flt : 86|1@0+ (1,0) [0|1] ""  CADM
 SG_ MRR_RL_TO_TrigControl_Flt : 85|1@0+ (1,0) [0|1] ""  CADM
 SG_ MRR_RL_TO_VehicleState_Flt : 84|1@0+ (1,0) [0|1] ""  CADM
 SG_ MRR_RL_MC_AngleAdjTable_Flt : 83|1@0+ (1,0) [0|1] ""  CADM
 SG_ MRR_RL_CRC_AngleAdjTable_Flt : 82|1@0+ (1,0) [0|1] ""  CADM
 SG_ MRR_RL_MC_VehicleState_Flt : 81|1@0+ (1,0) [0|1] ""  CADM
 SG_ MRR_RL_CRC_VehicleState_Flt : 80|1@0+ (1,0) [0|1] ""  CADM
 SG_ MRR_RL_MC_TrigControl_Flt : 79|1@0+ (1,0) [0|1] ""  CADM
 SG_ MRR_RL_CRC_TrigControl_Flt : 78|1@0+ (1,0) [0|1] ""  CADM
 SG_ MRR_RL_CRC_RadarCfgParameter_Flt : 75|1@0+ (1,0) [0|1] ""  CADM
 SG_ MRR_RL_MC_CADMSgnlActlVal_Flt : 74|1@0+ (1,0) [0|1] ""  CADM
 SG_ MRR_RL_CRC_CADMSgnlActlVal_Flt : 73|1@0+ (1,0) [0|1] ""  CADM
 SG_ MRR_RL_VINSignalCompare_Flt : 66|1@0+ (1,0) [0|1] ""  CADM
 SG_ MRR_RL_BatteryLow_Flt : 63|1@0+ (1,0) [0|1] ""  CADM
 SG_ MRR_RL_BatteryHigh_Flt : 62|1@0+ (1,0) [0|1] ""  CADM
 SG_ MRR_RL_Core0_To_Core1_IPC_Flt : 60|1@0+ (1,0) [0|1] ""  CADM
 SG_ MRR_RL_Core1_To_Core0_IPC_Flt : 61|1@0+ (1,0) [0|1] ""  CADM
 SG_ MRR_RL_Core1_To_Core2_IPC_Flt : 59|1@0+ (1,0) [0|1] ""  CADM
 SG_ MRR_RL_Core2_To_Core1_IPC_Flt : 58|1@0+ (1,0) [0|1] ""  CADM
 SG_ MRR_RL_Core2_To_Core0_IPC_Flt : 57|1@0+ (1,0) [0|1] ""  CADM
 SG_ MRR_RL_Core2Halted_Flt : 19|1@0+ (1,0) [0|1] ""  CADM
 SG_ MRR_RL_Core1Halted_Flt : 18|1@0+ (1,0) [0|1] ""  CADM
 SG_ MRR_RL_LocalOscPower_Flt : 50|1@0+ (1,0) [0|1] ""  CADM
 SG_ MRR_RL_DSPLoopOverrun_Flt : 54|1@0+ (1,0) [0|1] ""  CADM
 SG_ MRR_RL_TransmitterPower_Flt : 49|1@0+ (1,0) [0|1] ""  CADM
 SG_ MRR_RL_Core0_To_Core2_IPC_Flt : 56|1@0+ (1,0) [0|1] ""  CADM
 SG_ MRR_RL_XCVRDeviceSPI_Flt : 45|1@0+ (1,0) [0|1] ""  CADM
 SG_ MRR_RL_MNRBlockage_Flt : 40|1@0+ (1,0) [0|1] ""  CADM
 SG_ MRR_RL_TransmitterTempHigh_Flt : 38|1@0+ (1,0) [0|1] ""  CADM
 SG_ MRR_RL_AlignRoutineFailed_Flt : 37|1@0+ (1,0) [0|1] ""  CADM
 SG_ MRR_RL_MicroTempHigh_Flt : 35|1@0+ (1,0) [0|1] ""  CADM
 SG_ MRR_RL_HAlignOutofRange_Flt : 33|1@0+ (1,0) [0|1] ""  CADM
 SG_ MRR_RL_v1p1_SupplyOutOfRange_Flt : 30|1@0+ (1,0) [0|1] ""  CADM
 SG_ MRR_RL_v1p25_SupplyOutOfRange_Fl : 29|1@0+ (1,0) [0|1] ""  CADM
 SG_ MRR_RL_v1p8_SupplyOutOfRange_Flt : 28|1@0+ (1,0) [0|1] ""  CADM
 SG_ MRR_RL_v2p3_SupplyOutOfRange_Flt : 27|1@0+ (1,0) [0|1] ""  CADM
 SG_ MRR_RL_v_5_SupplyOutOfRange_Flt : 24|1@0+ (1,0) [0|1] ""  CADM
 SG_ MRR_RL_TransmitterID_Flt : 23|1@0+ (1,0) [0|1] ""  CADM
 SG_ MRR_RL_PCANBusOff_Flt : 16|1@0+ (1,0) [0|1] ""  CADM
 SG_ MRR_RL_InstructionSetCheck_Flt : 13|1@0+ (1,0) [0|1] ""  CADM
 SG_ MRR_RL_StackOverflow_Flt : 12|1@0+ (1,0) [0|1] ""  CADM
 SG_ MRR_RL_Watchdog_Flt : 11|1@0+ (1,0) [0|1] ""  CADM
 SG_ MRR_RL_PLLLock_Flt : 10|1@0+ (1,0) [0|1] ""  CADM
 SG_ MRR_RL_RAMMemoryTest_Flt : 8|1@0+ (1,0) [0|1] ""  CADM
 SG_ MRR_RL_USCValidation_Flt : 7|1@0+ (1,0) [0|1] ""  CADM
 SG_ MRR_RL_SMCChecksum_Flt : 4|1@0+ (1,0) [0|1] ""  CADM
 SG_ MRR_RL_KeepAliveChecksum_Flt : 2|1@0+ (1,0) [0|1] ""  CADM
 SG_ MRR_RL_ApplicationFlashChksum_Fl : 0|1@0+ (1,0) [0|1] ""  CADM

BO_ 325 MRR_RL_Error_Status: 32 MRRRL
 SG_ MRR_RL_RRU_Self_Test_Faults_reas : 239|8@0+ (1,0) [0|255] ""  External_Tool
 SG_ MRR_RL_XBAR_cfg_failure : 255|1@0+ (1,0) [0|1] ""  External_Tool
 SG_ MRR_RL_Stack_OVF_fault_reason : 247|3@0+ (1,0) [0|7] ""  External_Tool
 SG_ MRR_RL_App_flash_checksum_reason : 244|3@0+ (1,0) [0|7] ""  External_Tool
 SG_ MRR_RL_KAM_fault_reason : 241|2@0+ (1,0) [0|3] ""  External_Tool
 SG_ MRR_RL_RRU_Core_Faults_reason3 : 231|8@0+ (1,0) [0|255] ""  External_Tool
 SG_ MRR_RL_RRU_Core_Faults_reason2 : 167|64@0+ (1,0) [0|1.84467440737096E+019] ""  External_Tool
 SG_ MRR_RL_RRU_Core_Faults_reason1 : 103|64@0+ (1,0) [0|1.84467440737096E+019] ""  External_Tool
 SG_ MRR_RL_Rx_Radar_Mount_Msg_Fault : 88|1@0+ (1,0) [0|1] ""  External_Tool
 SG_ MRR_RL_Dolphin_Fault_Detection : 87|8@0+ (1,0) [0|63] ""  External_Tool
 SG_ MRR_RL_RRU_Self_Test_Faults_0000 : 79|8@0+ (1,0) [0|255] ""  External_Tool
 SG_ MRR_RL_RRU_Core_Faults_reason0 : 71|8@0+ (1,0) [0|255] ""  External_Tool
 SG_ MRR_RL_USC_Load_Error : 59|1@0+ (1,0) [0|1] ""  External_Tool
 SG_ MRR_RL_SMC_Load_Error : 58|1@0+ (1,0) [0|1] ""  External_Tool
 SG_ MRR_RL_TX_Temperature_Flt : 57|1@0+ (1,0) [0|1] ""  External_Tool
 SG_ MRR_RL_Dsp_Unit_Cal_Blk_Chcksm_E : 56|1@0+ (1,0) [0|1] ""  External_Tool
 SG_ MRR_RL_Dsp_Unit_Cal_Checksum_Err : 55|1@0+ (1,0) [0|1] ""  External_Tool
 SG_ MRR_RL_Vertical_Misalignment_err : 54|1@0+ (1,0) [0|1] ""  External_Tool
 SG_ MRR_RL_RTN_SPI_Transfer_Error : 53|1@0+ (1,0) [0|1] ""  External_Tool
 SG_ MRR_RL_RRN_SPI_Transfer_Error : 52|1@0+ (1,0) [0|1] ""  External_Tool
 SG_ MRR_RL_Linearizer_SPI_Transfer_E : 51|1@0+ (1,0) [0|1] ""  External_Tool
 SG_ MRR_RL_ADC_SPI_Transfer_Error : 50|1@0+ (1,0) [0|1] ""  External_Tool
 SG_ MRR_RL_Transmitter_ID_Error : 49|1@0+ (1,0) [0|1] ""  External_Tool
 SG_ MRR_RL_Dsp_Loop_Overrun_Error : 48|1@0+ (1,0) [0|1] ""  External_Tool
 SG_ MRR_RL_Saturated_Tuning_Freq_Err : 47|1@0+ (1,0) [0|1] ""  External_Tool
 SG_ MRR_RL_Radar_Data_sync_error : 46|1@0+ (1,0) [0|1] ""  External_Tool
 SG_ MRR_RL_Dsp_Tuning_Sensitivity_Er : 45|1@0+ (1,0) [0|1] ""  External_Tool
 SG_ MRR_RL_Radar_LO_Power_Error : 44|1@0+ (1,0) [0|1] ""  External_Tool
 SG_ MRR_RL_Radar_TX_Power_Error : 43|1@0+ (1,0) [0|1] ""  External_Tool
 SG_ MRR_RL_Timer_Create_Error : 6|1@0+ (1,0) [0|1] ""  External_Tool
 SG_ MRR_RL_Thread_Create_Error : 2|1@0+ (1,0) [0|1] ""  External_Tool
 SG_ MRR_RL_ARM_Calibration_Error : 9|1@0+ (1,0) [0|1] ""  External_Tool
 SG_ MRR_RL_SPI_FEE_Error : 14|1@0+ (1,0) [0|1] ""  External_Tool
 SG_ MRR_RL_SPI_Comm_Error : 13|1@0+ (1,0) [0|1] ""  External_Tool
 SG_ MRR_RL_Socket_Write_Error : 39|1@0+ (1,0) [0|1] ""  External_Tool
 SG_ MRR_RL_Socket_Read_error : 38|1@0+ (1,0) [0|1] ""  External_Tool
 SG_ MRR_RL_Socket_Init_Error : 37|1@0+ (1,0) [0|1] ""  External_Tool
 SG_ MRR_RL_Signal_Wait_Error : 4|1@0+ (1,0) [0|1] ""  External_Tool
 SG_ MRR_RL_Signal_Send_Error : 5|1@0+ (1,0) [0|1] ""  External_Tool
 SG_ MRR_RL_Signal_Create_Error : 3|1@0+ (1,0) [0|1] ""  External_Tool
 SG_ MRR_RL_Shared_Mem_Write_Error : 21|1@0+ (1,0) [0|1] ""  External_Tool
 SG_ MRR_RL_Shared_Mem_Read_Error : 20|1@0+ (1,0) [0|1] ""  External_Tool
 SG_ MRR_RL_Shared_Mem_Config_Error : 19|1@0+ (1,0) [0|1] ""  External_Tool
 SG_ MRR_RL_Share_Mem_Init_Error : 18|1@0+ (1,0) [0|1] ""  External_Tool
 SG_ MRR_RL_RAM_Test_Error : 1|1@0+ (1,0) [0|1] ""  External_Tool
 SG_ MRR_RL_Num_Errors : 63|1@0+ (1,0) [0|1] ""  External_Tool
 SG_ MRR_RL_MMAP_Memory_Error : 40|1@0+ (1,0) [0|1] ""  External_Tool
 SG_ MRR_RL_ISR_Attach_Error : 36|1@0+ (1,0) [0|1] ""  External_Tool
 SG_ MRR_RL_IPC_DRV_Write_Error : 29|1@0+ (1,0) [0|1] ""  External_Tool
 SG_ MRR_RL_IPC_DRV_Trigger_Error : 31|1@0+ (1,0) [0|1] ""  External_Tool
 SG_ MRR_RL_IPC_DRV_Sync_Error : 30|1@0+ (1,0) [0|1] ""  External_Tool
 SG_ MRR_RL_IPC_DRV_Read_Error : 28|1@0+ (1,0) [0|1] ""  External_Tool
 SG_ MRR_RL_IPC_DRV_Init_Error : 27|1@0+ (1,0) [0|1] ""  External_Tool
 SG_ MRR_RL_Interrupt_Enable_Error : 42|1@0+ (1,0) [0|1] ""  External_Tool
 SG_ MRR_RL_HIL_Format_Error : 41|1@0+ (1,0) [0|1] ""  External_Tool
 SG_ MRR_RL_Flash_Filesystem_Error : 7|1@0+ (1,0) [0|1] ""  External_Tool
 SG_ MRR_RL_Error_none : 0|1@0+ (1,0) [0|1] ""  External_Tool
 SG_ MRR_RL_Dsp_Load_Read_Error : 34|1@0+ (1,0) [0|1] ""  External_Tool
 SG_ MRR_RL_Dsp_Load_Open_Error : 33|1@0+ (1,0) [0|1] ""  External_Tool
 SG_ MRR_RL_Dsp_Load_Address_Error : 35|1@0+ (1,0) [0|1] ""  External_Tool
 SG_ MRR_RL_Dsp_ISP_Write_Error : 17|1@0+ (1,0) [0|1] ""  External_Tool
 SG_ MRR_RL_Dsp_IPC_Read_Error : 16|1@0+ (1,0) [0|1] ""  External_Tool
 SG_ MRR_RL_Dsp_IPC_Init : 15|1@0+ (1,0) [0|1] ""  External_Tool
 SG_ MRR_RL_Dsp_Init_Error : 32|1@0+ (1,0) [0|1] ""  External_Tool
 SG_ MRR_RL_Dsp_DRV_Start_Error : 26|1@0+ (1,0) [0|1] ""  External_Tool
 SG_ MRR_RL_Dsp_DRV_Load_Error : 25|1@0+ (1,0) [0|1] ""  External_Tool
 SG_ MRR_RL_Dsp_DRV_Init_Error : 22|1@0+ (1,0) [0|1] ""  External_Tool
 SG_ MRR_RL_Dsp_DRV_Init2_error : 24|1@0+ (1,0) [0|1] ""  External_Tool
 SG_ MRR_RL_Dsp_DRV_Init1_error : 23|1@0+ (1,0) [0|1] ""  External_Tool
 SG_ MRR_RL_CAN_XMT_Error : 10|1@0+ (1,0) [0|1] ""  External_Tool
 SG_ MRR_RL_CAN_RCV_Error : 11|1@0+ (1,0) [0|1] ""  External_Tool
 SG_ MRR_RL_CAN_Hardware_Error : 12|1@0+ (1,0) [0|1] ""  External_Tool
 SG_ MRR_RL_Always_True : 62|1@0+ (1,0) [0|1] ""  External_Tool

BO_ 1289 MRR_RL_Detection_064: 12 MRRRL
 SG_ MRR_RL_CAN_DET_MID_TARGET_064 : 65|1@0+ (1,0) [0|1] ""  CADM
 SG_ MRR_RL_CAN_DET_Near_TARGET_064 : 64|1@0+ (1,0) [0|1] ""  CADM
 SG_ MRR_RL_DET_CRC_010 : 87|16@0+ (1,0) [0|65535] ""  CADM
 SG_ MRR_RL_DET_MC_010 : 75|4@0+ (1,0) [0|15] ""  CADM
 SG_ MRR_RL_CAN_DET_SUPER_RES_TARGET_ : 56|1@0+ (1,0) [0|1] ""  CADM
 SG_ MRR_RL_CAN_DET_ELEVATION_064 : 63|7@0+ (0.002748,-0.1745) [-0.1745|0.174496] "rad"  CADM
 SG_ MRR_RL_CAN_DET_HOST_VEH_CLUTTER_ : 48|1@0+ (1,0) [0|1] ""  CADM
 SG_ MRR_RL_CAN_DET_CONFID_ELEVATION_ : 49|1@0+ (1,0) [0|1] ""  CADM
 SG_ MRR_RL_CAN_DET_AZIMUTH_064 : 47|14@0+ (0.0003834,-3.1416) [-3.1416|3.1396422] "rad"  CADM
 SG_ MRR_RL_CAN_DET_CONFID_AZIMUTH_06 : 33|2@0+ (1,0) [0|3] ""  CADM
 SG_ MRR_RL_CAN_DET_RANGE_064 : 31|14@0+ (0.015625,0) [0|255.984375] "m"  CADM
 SG_ MRR_RL_CAN_SCAN_INDEX_2LSB_064 : 17|2@0+ (1,0) [0|3] ""  CADM
 SG_ MRR_RL_CAN_DET_RANGE_RATE_064 : 15|14@0+ (0.015625,-128) [-128|127.984375] "m/s"  CADM
 SG_ MRR_RL_CAN_DET_VALID_LEVEL_064 : 0|1@0+ (1,0) [0|1] ""  CADM
 SG_ MRR_RL_CAN_DET_AMPLITUDE_064 : 7|7@0+ (1,-64) [-64|63] "dBsm"  CADM

BO_ 1288 MRR_RL_Detection_057_063: 64 MRRRL
 SG_ MRR_RL_CAN_DET_MID_TARGET_063 : 462|1@0+ (1,0) [0|1] ""  CADM
 SG_ MRR_RL_CAN_DET_MID_TARGET_062 : 461|1@0+ (1,0) [0|1] ""  CADM
 SG_ MRR_RL_CAN_DET_MID_TARGET_061 : 460|1@0+ (1,0) [0|1] ""  CADM
 SG_ MRR_RL_CAN_DET_MID_TARGET_060 : 459|1@0+ (1,0) [0|1] ""  CADM
 SG_ MRR_RL_CAN_DET_MID_TARGET_059 : 458|1@0+ (1,0) [0|1] ""  CADM
 SG_ MRR_RL_CAN_DET_MID_TARGET_058 : 457|1@0+ (1,0) [0|1] ""  CADM
 SG_ MRR_RL_CAN_DET_MID_TARGET_057 : 456|1@0+ (1,0) [0|1] ""  CADM
 SG_ MRR_RL_CAN_DET_Near_TARGET_057 : 448|1@0+ (1,0) [0|1] ""  CADM
 SG_ MRR_RL_CAN_DET_Near_TARGET_058 : 449|1@0+ (1,0) [0|1] ""  CADM
 SG_ MRR_RL_CAN_DET_Near_TARGET_059 : 450|1@0+ (1,0) [0|1] ""  CADM
 SG_ MRR_RL_CAN_DET_Near_TARGET_060 : 451|1@0+ (1,0) [0|1] ""  CADM
 SG_ MRR_RL_CAN_DET_Near_TARGET_061 : 452|1@0+ (1,0) [0|1] ""  CADM
 SG_ MRR_RL_CAN_DET_Near_TARGET_062 : 453|1@0+ (1,0) [0|1] ""  CADM
 SG_ MRR_RL_CAN_DET_Near_TARGET_063 : 454|1@0+ (1,0) [0|1] ""  CADM
 SG_ MRR_RL_DET_CRC_009 : 503|16@0+ (1,0) [0|65535] ""  CADM
 SG_ MRR_RL_DET_MC_009 : 491|4@0+ (1,0) [0|15] ""  CADM
 SG_ MRR_RL_CAN_DET_SUPER_RES_TA_0000 : 440|1@0+ (1,0) [0|1] ""  CADM
 SG_ MRR_RL_CAN_DET_ELEVATION_063 : 447|7@0+ (0.002748,-0.1745) [-0.1745|0.174496] "rad"  CADM
 SG_ MRR_RL_CAN_DET_HOST_VEH_CLU_0000 : 432|1@0+ (1,0) [0|1] ""  CADM
 SG_ MRR_RL_CAN_DET_CONFID_ELEVA_0000 : 433|1@0+ (1,0) [0|1] ""  CADM
 SG_ MRR_RL_CAN_DET_AZIMUTH_063 : 431|14@0+ (0.0003834,-3.1416) [-3.1416|3.1396422] "rad"  CADM
 SG_ MRR_RL_CAN_DET_CONFID_AZIMU_0000 : 417|2@0+ (1,0) [0|3] ""  CADM
 SG_ MRR_RL_CAN_DET_RANGE_063 : 415|14@0+ (0.015625,0) [0|255.984375] "m"  CADM
 SG_ MRR_RL_CAN_SCAN_INDEX_2LSB_063 : 401|2@0+ (1,0) [0|3] ""  CADM
 SG_ MRR_RL_CAN_DET_RANGE_RATE_063 : 399|14@0+ (0.015625,-128) [-128|127.984375] "m/s"  CADM
 SG_ MRR_RL_CAN_DET_VALID_LEVEL_063 : 384|1@0+ (1,0) [0|1] ""  CADM
 SG_ MRR_RL_CAN_DET_AMPLITUDE_063 : 391|7@0+ (1,-64) [-64|63] "dBsm"  CADM
 SG_ MRR_RL_CAN_DET_SUPER_RES_TA_0001 : 376|1@0+ (1,0) [0|1] ""  CADM
 SG_ MRR_RL_CAN_DET_ELEVATION_062 : 383|7@0+ (0.002748,-0.1745) [-0.1745|0.174496] "rad"  CADM
 SG_ MRR_RL_CAN_DET_HOST_VEH_CLU_0001 : 368|1@0+ (1,0) [0|1] ""  CADM
 SG_ MRR_RL_CAN_DET_CONFID_ELEVA_0001 : 369|1@0+ (1,0) [0|1] ""  CADM
 SG_ MRR_RL_CAN_DET_AZIMUTH_062 : 367|14@0+ (0.0003834,-3.1416) [-3.1416|3.1396422] "rad"  CADM
 SG_ MRR_RL_CAN_DET_CONFID_AZIMU_0001 : 353|2@0+ (1,0) [0|3] ""  CADM
 SG_ MRR_RL_CAN_DET_RANGE_062 : 351|14@0+ (0.015625,0) [0|255.984375] "m"  CADM
 SG_ MRR_RL_CAN_SCAN_INDEX_2LSB_062 : 337|2@0+ (1,0) [0|3] ""  CADM
 SG_ MRR_RL_CAN_DET_RANGE_RATE_062 : 335|14@0+ (0.015625,-128) [-128|127.984375] "m/s"  CADM
 SG_ MRR_RL_CAN_DET_VALID_LEVEL_062 : 320|1@0+ (1,0) [0|1] ""  CADM
 SG_ MRR_RL_CAN_DET_AMPLITUDE_062 : 327|7@0+ (1,-64) [-64|63] "dBsm"  CADM
 SG_ MRR_RL_CAN_DET_SUPER_RES_TA_0002 : 312|1@0+ (1,0) [0|1] ""  CADM
 SG_ MRR_RL_CAN_DET_ELEVATION_061 : 319|7@0+ (0.002748,-0.1745) [-0.1745|0.174496] "rad"  CADM
 SG_ MRR_RL_CAN_DET_HOST_VEH_CLU_0002 : 304|1@0+ (1,0) [0|1] ""  CADM
 SG_ MRR_RL_CAN_DET_CONFID_ELEVA_0002 : 305|1@0+ (1,0) [0|1] ""  CADM
 SG_ MRR_RL_CAN_DET_AZIMUTH_061 : 303|14@0+ (0.0003834,-3.1416) [-3.1416|3.1396422] "rad"  CADM
 SG_ MRR_RL_CAN_DET_CONFID_AZIMU_0002 : 289|2@0+ (1,0) [0|3] ""  CADM
 SG_ MRR_RL_CAN_DET_RANGE_061 : 287|14@0+ (0.015625,0) [0|255.984375] "m"  CADM
 SG_ MRR_RL_CAN_SCAN_INDEX_2LSB_061 : 273|2@0+ (1,0) [0|3] ""  CADM
 SG_ MRR_RL_CAN_DET_RANGE_RATE_061 : 271|14@0+ (0.015625,-128) [-128|127.984375] "m/s"  CADM
 SG_ MRR_RL_CAN_DET_VALID_LEVEL_061 : 256|1@0+ (1,0) [0|1] ""  CADM
 SG_ MRR_RL_CAN_DET_AMPLITUDE_061 : 263|7@0+ (1,-64) [-64|63] "dBsm"  CADM
 SG_ MRR_RL_CAN_DET_SUPER_RES_TA_0003 : 248|1@0+ (1,0) [0|1] ""  CADM
 SG_ MRR_RL_CAN_DET_ELEVATION_060 : 255|7@0+ (0.002748,-0.1745) [-0.1745|0.174496] "rad"  CADM
 SG_ MRR_RL_CAN_DET_HOST_VEH_CLU_0003 : 240|1@0+ (1,0) [0|1] ""  CADM
 SG_ MRR_RL_CAN_DET_CONFID_ELEVA_0003 : 241|1@0+ (1,0) [0|1] ""  CADM
 SG_ MRR_RL_CAN_DET_AZIMUTH_060 : 239|14@0+ (0.0003834,-3.1416) [-3.1416|3.1396422] "rad"  CADM
 SG_ MRR_RL_CAN_DET_CONFID_AZIMU_0003 : 225|2@0+ (1,0) [0|3] ""  CADM
 SG_ MRR_RL_CAN_DET_RANGE_060 : 223|14@0+ (0.015625,0) [0|255.984375] "m"  CADM
 SG_ MRR_RL_CAN_SCAN_INDEX_2LSB_060 : 209|2@0+ (1,0) [0|3] ""  CADM
 SG_ MRR_RL_CAN_DET_RANGE_RATE_060 : 207|14@0+ (0.015625,-128) [-128|127.984375] "m/s"  CADM
 SG_ MRR_RL_CAN_DET_VALID_LEVEL_060 : 192|1@0+ (1,0) [0|1] ""  CADM
 SG_ MRR_RL_CAN_DET_AMPLITUDE_060 : 199|7@0+ (1,-64) [-64|63] "dBsm"  CADM
 SG_ MRR_RL_CAN_DET_SUPER_RES_TA_0004 : 184|1@0+ (1,0) [0|1] ""  CADM
 SG_ MRR_RL_CAN_DET_ELEVATION_059 : 191|7@0+ (0.002748,-0.1745) [-0.1745|0.174496] "rad"  CADM
 SG_ MRR_RL_CAN_DET_HOST_VEH_CLU_0004 : 176|1@0+ (1,0) [0|1] ""  CADM
 SG_ MRR_RL_CAN_DET_CONFID_ELEVA_0004 : 177|1@0+ (1,0) [0|1] ""  CADM
 SG_ MRR_RL_CAN_DET_AZIMUTH_059 : 175|14@0+ (0.0003834,-3.1416) [-3.1416|3.1396422] "rad"  CADM
 SG_ MRR_RL_CAN_DET_CONFID_AZIMUTH_05 : 161|2@0+ (1,0) [0|3] ""  CADM
 SG_ MRR_RL_CAN_DET_RANGE_059 : 159|14@0+ (0.015625,0) [0|255.984375] "m"  CADM
 SG_ MRR_RL_CAN_SCAN_INDEX_2LSB_059 : 145|2@0+ (1,0) [0|3] ""  CADM
 SG_ MRR_RL_CAN_DET_RANGE_RATE_059 : 143|14@0+ (0.015625,-128) [-128|127.984375] "m/s"  CADM
 SG_ MRR_RL_CAN_DET_VALID_LEVEL_059 : 128|1@0+ (1,0) [0|1] ""  CADM
 SG_ MRR_RL_CAN_DET_AMPLITUDE_059 : 135|7@0+ (1,-64) [-64|63] "dBsm"  CADM
 SG_ MRR_RL_CAN_DET_SUPER_RES_TA_0005 : 120|1@0+ (1,0) [0|1] ""  CADM
 SG_ MRR_RL_CAN_DET_ELEVATION_058 : 127|7@0+ (0.002748,-0.1745) [-0.1745|0.174496] "rad"  CADM
 SG_ MRR_RL_CAN_DET_HOST_VEH_CLU_0005 : 112|1@0+ (1,0) [0|1] ""  CADM
 SG_ MRR_RL_CAN_DET_CONFID_ELEVA_0005 : 113|1@0+ (1,0) [0|1] ""  CADM
 SG_ MRR_RL_CAN_DET_AZIMUTH_058 : 111|14@0+ (0.0003834,-3.1416) [-3.1416|3.1396422] "rad"  CADM
 SG_ MRR_RL_CAN_DET_CONFID_AZIMU_0004 : 97|2@0+ (1,0) [0|3] ""  CADM
 SG_ MRR_RL_CAN_DET_RANGE_058 : 95|14@0+ (0.015625,0) [0|255.984375] "m"  CADM
 SG_ MRR_RL_CAN_SCAN_INDEX_2LSB_058 : 81|2@0+ (1,0) [0|3] ""  CADM
 SG_ MRR_RL_CAN_DET_RANGE_RATE_058 : 79|14@0+ (0.015625,-128) [-128|127.984375] "m/s"  CADM
 SG_ MRR_RL_CAN_DET_VALID_LEVEL_058 : 64|1@0+ (1,0) [0|1] ""  CADM
 SG_ MRR_RL_CAN_DET_AMPLITUDE_058 : 71|7@0+ (1,-64) [-64|63] "dBsm"  CADM
 SG_ MRR_RL_CAN_DET_SUPER_RES_TA_0006 : 56|1@0+ (1,0) [0|1] ""  CADM
 SG_ MRR_RL_CAN_DET_ELEVATION_057 : 63|7@0+ (0.002748,-0.1745) [-0.1745|0.174496] "rad"  CADM
 SG_ MRR_RL_CAN_DET_HOST_VEH_CLU_0006 : 48|1@0+ (1,0) [0|1] ""  CADM
 SG_ MRR_RL_CAN_DET_CONFID_ELEVA_0006 : 49|1@0+ (1,0) [0|1] ""  CADM
 SG_ MRR_RL_CAN_DET_AZIMUTH_057 : 47|14@0+ (0.0003834,-3.1416) [-3.1416|3.1396422] "rad"  CADM
 SG_ MRR_RL_CAN_DET_CONFID_AZIMU_0005 : 33|2@0+ (1,0) [0|3] ""  CADM
 SG_ MRR_RL_CAN_DET_RANGE_057 : 31|14@0+ (0.015625,0) [0|255.984375] "m"  CADM
 SG_ MRR_RL_CAN_SCAN_INDEX_2LSB_057 : 17|2@0+ (1,0) [0|3] ""  CADM
 SG_ MRR_RL_CAN_DET_RANGE_RATE_057 : 15|14@0+ (0.015625,-128) [-128|127.984375] "m/s"  CADM
 SG_ MRR_RL_CAN_DET_VALID_LEVEL_057 : 0|1@0+ (1,0) [0|1] ""  CADM
 SG_ MRR_RL_CAN_DET_AMPLITUDE_057 : 7|7@0+ (1,-64) [-64|63] "dBsm"  CADM

BO_ 1287 MRR_RL_Detection_050_056: 64 MRRRL
 SG_ MRR_RL_CAN_DET_MID_TARGET_056 : 462|1@0+ (1,0) [0|1] ""  CADM
 SG_ MRR_RL_CAN_DET_MID_TARGET_055 : 461|1@0+ (1,0) [0|1] ""  CADM
 SG_ MRR_RL_CAN_DET_MID_TARGET_054 : 460|1@0+ (1,0) [0|1] ""  CADM
 SG_ MRR_RL_CAN_DET_MID_TARGET_053 : 459|1@0+ (1,0) [0|1] ""  CADM
 SG_ MRR_RL_CAN_DET_MID_TARGET_052 : 458|1@0+ (1,0) [0|1] ""  CADM
 SG_ MRR_RL_CAN_DET_MID_TARGET_051 : 457|1@0+ (1,0) [0|1] ""  CADM
 SG_ MRR_RL_CAN_DET_MID_TARGET_050 : 456|1@0+ (1,0) [0|1] ""  CADM
 SG_ MRR_RL_CAN_DET_Near_TARGET_050 : 448|1@0+ (1,0) [0|1] ""  CADM
 SG_ MRR_RL_CAN_DET_Near_TARGET_051 : 449|1@0+ (1,0) [0|1] ""  CADM
 SG_ MRR_RL_CAN_DET_Near_TARGET_052 : 450|1@0+ (1,0) [0|1] ""  CADM
 SG_ MRR_RL_CAN_DET_Near_TARGET_053 : 451|1@0+ (1,0) [0|1] ""  CADM
 SG_ MRR_RL_CAN_DET_Near_TARGET_054 : 452|1@0+ (1,0) [0|1] ""  CADM
 SG_ MRR_RL_CAN_DET_Near_TARGET_055 : 453|1@0+ (1,0) [0|1] ""  CADM
 SG_ MRR_RL_CAN_DET_Near_TARGET_056 : 454|1@0+ (1,0) [0|1] ""  CADM
 SG_ MRR_RL_DET_CRC_008 : 503|16@0+ (1,0) [0|65535] ""  CADM
 SG_ MRR_RL_DET_MC_008 : 491|4@0+ (1,0) [0|15] ""  CADM
 SG_ MRR_RL_CAN_DET_SUPER_RES_TA_0007 : 440|1@0+ (1,0) [0|1] ""  CADM
 SG_ MRR_RL_CAN_DET_ELEVATION_056 : 447|7@0+ (0.002748,-0.1745) [-0.1745|0.174496] "rad"  CADM
 SG_ MRR_RL_CAN_DET_HOST_VEH_CLU_0007 : 432|1@0+ (1,0) [0|1] ""  CADM
 SG_ MRR_RL_CAN_DET_CONFID_ELEVA_0007 : 433|1@0+ (1,0) [0|1] ""  CADM
 SG_ MRR_RL_CAN_DET_AZIMUTH_056 : 431|14@0+ (0.0003834,-3.1416) [-3.1416|3.1396422] "rad"  CADM
 SG_ MRR_RL_CAN_DET_CONFID_AZIMU_0006 : 417|2@0+ (1,0) [0|3] ""  CADM
 SG_ MRR_RL_CAN_DET_RANGE_056 : 415|14@0+ (0.015625,0) [0|255.984375] "m"  CADM
 SG_ MRR_RL_CAN_SCAN_INDEX_2LSB_056 : 401|2@0+ (1,0) [0|3] ""  CADM
 SG_ MRR_RL_CAN_DET_RANGE_RATE_056 : 399|14@0+ (0.015625,-128) [-128|127.984375] "m/s"  CADM
 SG_ MRR_RL_CAN_DET_VALID_LEVEL_056 : 384|1@0+ (1,0) [0|1] ""  CADM
 SG_ MRR_RL_CAN_DET_AMPLITUDE_056 : 391|7@0+ (1,-64) [-64|63] "dBsm"  CADM
 SG_ MRR_RL_CAN_DET_SUPER_RES_TA_0008 : 376|1@0+ (1,0) [0|1] ""  CADM
 SG_ MRR_RL_CAN_DET_ELEVATION_055 : 383|7@0+ (0.002748,-0.1745) [-0.1745|0.174496] "rad"  CADM
 SG_ MRR_RL_CAN_DET_HOST_VEH_CLU_0008 : 368|1@0+ (1,0) [0|1] ""  CADM
 SG_ MRR_RL_CAN_DET_CONFID_ELEVA_0008 : 369|1@0+ (1,0) [0|1] ""  CADM
 SG_ MRR_RL_CAN_DET_AZIMUTH_055 : 367|14@0+ (0.0003834,-3.1416) [-3.1416|3.1396422] "rad"  CADM
 SG_ MRR_RL_CAN_DET_CONFID_AZIMU_0007 : 353|2@0+ (1,0) [0|3] ""  CADM
 SG_ MRR_RL_CAN_DET_RANGE_055 : 351|14@0+ (0.015625,0) [0|255.984375] "m"  CADM
 SG_ MRR_RL_CAN_SCAN_INDEX_2LSB_055 : 337|2@0+ (1,0) [0|3] ""  CADM
 SG_ MRR_RL_CAN_DET_RANGE_RATE_055 : 335|14@0+ (0.015625,-128) [-128|127.984375] "m/s"  CADM
 SG_ MRR_RL_CAN_DET_VALID_LEVEL_055 : 320|1@0+ (1,0) [0|1] ""  CADM
 SG_ MRR_RL_CAN_DET_AMPLITUDE_055 : 327|7@0+ (1,-64) [-64|63] "dBsm"  CADM
 SG_ MRR_RL_CAN_DET_SUPER_RES_TA_0009 : 312|1@0+ (1,0) [0|1] ""  CADM
 SG_ MRR_RL_CAN_DET_ELEVATION_054 : 319|7@0+ (0.002748,-0.1745) [-0.1745|0.174496] "rad"  CADM
 SG_ MRR_RL_CAN_DET_HOST_VEH_CLU_0009 : 304|1@0+ (1,0) [0|1] ""  CADM
 SG_ MRR_RL_CAN_DET_CONFID_ELEVA_0009 : 305|1@0+ (1,0) [0|1] ""  CADM
 SG_ MRR_RL_CAN_DET_AZIMUTH_054 : 303|14@0+ (0.0003834,-3.1416) [-3.1416|3.1396422] "rad"  CADM
 SG_ MRR_RL_CAN_DET_CONFID_AZIMU_0008 : 289|2@0+ (1,0) [0|3] ""  CADM
 SG_ MRR_RL_CAN_DET_RANGE_054 : 287|14@0+ (0.015625,0) [0|255.984375] "m"  CADM
 SG_ MRR_RL_CAN_SCAN_INDEX_2LSB_054 : 273|2@0+ (1,0) [0|3] ""  CADM
 SG_ MRR_RL_CAN_DET_RANGE_RATE_054 : 271|14@0+ (0.015625,-128) [-128|127.984375] "m/s"  CADM
 SG_ MRR_RL_CAN_DET_VALID_LEVEL_054 : 256|1@0+ (1,0) [0|1] ""  CADM
 SG_ MRR_RL_CAN_DET_AMPLITUDE_054 : 263|7@0+ (1,-64) [-64|63] "dBsm"  CADM
 SG_ MRR_RL_CAN_DET_SUPER_RES_TA_0010 : 248|1@0+ (1,0) [0|1] ""  CADM
 SG_ MRR_RL_CAN_DET_ELEVATION_053 : 255|7@0+ (0.002748,-0.1745) [-0.1745|0.174496] "rad"  CADM
 SG_ MRR_RL_CAN_DET_HOST_VEH_CLU_0010 : 240|1@0+ (1,0) [0|1] ""  CADM
 SG_ MRR_RL_CAN_DET_CONFID_ELEVA_0010 : 241|1@0+ (1,0) [0|1] ""  CADM
 SG_ MRR_RL_CAN_DET_AZIMUTH_053 : 239|14@0+ (0.0003834,-3.1416) [-3.1416|3.1396422] "rad"  CADM
 SG_ MRR_RL_CAN_DET_CONFID_AZIMU_0009 : 225|2@0+ (1,0) [0|3] ""  CADM
 SG_ MRR_RL_CAN_DET_RANGE_053 : 223|14@0+ (0.015625,0) [0|255.984375] "m"  CADM
 SG_ MRR_RL_CAN_SCAN_INDEX_2LSB_053 : 209|2@0+ (1,0) [0|3] ""  CADM
 SG_ MRR_RL_CAN_DET_RANGE_RATE_053 : 207|14@0+ (0.015625,-128) [-128|127.984375] "m/s"  CADM
 SG_ MRR_RL_CAN_DET_VALID_LEVEL_053 : 192|1@0+ (1,0) [0|1] ""  CADM
 SG_ MRR_RL_CAN_DET_AMPLITUDE_053 : 199|7@0+ (1,-64) [-64|63] "dBsm"  CADM
 SG_ MRR_RL_CAN_DET_SUPER_RES_TA_0011 : 184|1@0+ (1,0) [0|1] ""  CADM
 SG_ MRR_RL_CAN_DET_ELEVATION_052 : 191|7@0+ (0.002748,-0.1745) [-0.1745|0.174496] "rad"  CADM
 SG_ MRR_RL_CAN_DET_HOST_VEH_CLU_0011 : 176|1@0+ (1,0) [0|1] ""  CADM
 SG_ MRR_RL_CAN_DET_CONFID_ELEVA_0011 : 177|1@0+ (1,0) [0|1] ""  CADM
 SG_ MRR_RL_CAN_DET_AZIMUTH_052 : 175|14@0+ (0.0003834,-3.1416) [-3.1416|3.1396422] "rad"  CADM
 SG_ MRR_RL_CAN_DET_CONFID_AZIMU_0010 : 161|2@0+ (1,0) [0|3] ""  CADM
 SG_ MRR_RL_CAN_DET_RANGE_052 : 159|14@0+ (0.015625,0) [0|255.984375] "m"  CADM
 SG_ MRR_RL_CAN_SCAN_INDEX_2LSB_052 : 145|2@0+ (1,0) [0|3] ""  CADM
 SG_ MRR_RL_CAN_DET_RANGE_RATE_052 : 143|14@0+ (0.015625,-128) [-128|127.984375] "m/s"  CADM
 SG_ MRR_RL_CAN_DET_VALID_LEVEL_052 : 128|1@0+ (1,0) [0|1] ""  CADM
 SG_ MRR_RL_CAN_DET_AMPLITUDE_052 : 135|7@0+ (1,-64) [-64|63] "dBsm"  CADM
 SG_ MRR_RL_CAN_DET_SUPER_RES_TA_0012 : 120|1@0+ (1,0) [0|1] ""  CADM
 SG_ MRR_RL_CAN_DET_ELEVATION_051 : 127|7@0+ (0.002748,-0.1745) [-0.1745|0.174496] "rad"  CADM
 SG_ MRR_RL_CAN_DET_HOST_VEH_CLU_0012 : 112|1@0+ (1,0) [0|1] ""  CADM
 SG_ MRR_RL_CAN_DET_CONFID_ELEVA_0012 : 113|1@0+ (1,0) [0|1] ""  CADM
 SG_ MRR_RL_CAN_DET_AZIMUTH_051 : 111|14@0+ (0.0003834,-3.1416) [-3.1416|3.1396422] "rad"  CADM
 SG_ MRR_RL_CAN_DET_CONFID_AZIMU_0011 : 97|2@0+ (1,0) [0|3] ""  CADM
 SG_ MRR_RL_CAN_DET_RANGE_051 : 95|14@0+ (0.015625,0) [0|255.984375] "m"  CADM
 SG_ MRR_RL_CAN_SCAN_INDEX_2LSB_051 : 81|2@0+ (1,0) [0|3] ""  CADM
 SG_ MRR_RL_CAN_DET_RANGE_RATE_051 : 79|14@0+ (0.015625,-128) [-128|127.984375] "m/s"  CADM
 SG_ MRR_RL_CAN_DET_VALID_LEVEL_051 : 64|1@0+ (1,0) [0|1] ""  CADM
 SG_ MRR_RL_CAN_DET_AMPLITUDE_051 : 71|7@0+ (1,-64) [-64|63] "dBsm"  CADM
 SG_ MRR_RL_CAN_DET_SUPER_RES_TA_0013 : 56|1@0+ (1,0) [0|1] ""  CADM
 SG_ MRR_RL_CAN_DET_ELEVATION_050 : 63|7@0+ (0.002748,-0.1745) [-0.1745|0.174496] "rad"  CADM
 SG_ MRR_RL_CAN_DET_HOST_VEH_CLU_0013 : 48|1@0+ (1,0) [0|1] ""  CADM
 SG_ MRR_RL_CAN_DET_CONFID_ELEVA_0013 : 49|1@0+ (1,0) [0|1] ""  CADM
 SG_ MRR_RL_CAN_DET_AZIMUTH_050 : 47|14@0+ (0.0003834,-3.1416) [-3.1416|3.1396422] "rad"  CADM
 SG_ MRR_RL_CAN_DET_CONFID_AZIMU_0012 : 33|2@0+ (1,0) [0|3] ""  CADM
 SG_ MRR_RL_CAN_DET_RANGE_050 : 31|14@0+ (0.015625,0) [0|255.984375] "m"  CADM
 SG_ MRR_RL_CAN_SCAN_INDEX_2LSB_050 : 17|2@0+ (1,0) [0|3] ""  CADM
 SG_ MRR_RL_CAN_DET_RANGE_RATE_050 : 15|14@0+ (0.015625,-128) [-128|127.984375] "m/s"  CADM
 SG_ MRR_RL_CAN_DET_VALID_LEVEL_050 : 0|1@0+ (1,0) [0|1] ""  CADM
 SG_ MRR_RL_CAN_DET_AMPLITUDE_050 : 7|7@0+ (1,-64) [-64|63] "dBsm"  CADM

BO_ 1286 MRR_RL_Detection_043_049: 64 MRRRL
 SG_ MRR_RL_CAN_DET_MID_TARGET_049 : 462|1@0+ (1,0) [0|1] ""  CADM
 SG_ MRR_RL_CAN_DET_MID_TARGET_048 : 461|1@0+ (1,0) [0|1] ""  CADM
 SG_ MRR_RL_CAN_DET_MID_TARGET_047 : 460|1@0+ (1,0) [0|1] ""  CADM
 SG_ MRR_RL_CAN_DET_MID_TARGET_046 : 459|1@0+ (1,0) [0|1] ""  CADM
 SG_ MRR_RL_CAN_DET_MID_TARGET_045 : 458|1@0+ (1,0) [0|1] ""  CADM
 SG_ MRR_RL_CAN_DET_MID_TARGET_044 : 457|1@0+ (1,0) [0|1] ""  CADM
 SG_ MRR_RL_CAN_DET_MID_TARGET_043 : 456|1@0+ (1,0) [0|1] ""  CADM
 SG_ MRR_RL_CAN_DET_Near_TARGET_043 : 448|1@0+ (1,0) [0|1] ""  CADM
 SG_ MRR_RL_CAN_DET_Near_TARGET_044 : 449|1@0+ (1,0) [0|1] ""  CADM
 SG_ MRR_RL_CAN_DET_Near_TARGET_045 : 450|1@0+ (1,0) [0|1] ""  CADM
 SG_ MRR_RL_CAN_DET_Near_TARGET_046 : 451|1@0+ (1,0) [0|1] ""  CADM
 SG_ MRR_RL_CAN_DET_Near_TARGET_047 : 452|1@0+ (1,0) [0|1] ""  CADM
 SG_ MRR_RL_CAN_DET_Near_TARGET_048 : 453|1@0+ (1,0) [0|1] ""  CADM
 SG_ MRR_RL_CAN_DET_Near_TARGET_049 : 454|1@0+ (1,0) [0|1] ""  CADM
 SG_ MRR_RL_DET_CRC_007 : 503|16@0+ (1,0) [0|65535] ""  CADM
 SG_ MRR_RL_DET_MC_007 : 491|4@0+ (1,0) [0|15] ""  CADM
 SG_ MRR_RL_CAN_DET_SUPER_RES_TA_0014 : 440|1@0+ (1,0) [0|1] ""  CADM
 SG_ MRR_RL_CAN_DET_ELEVATION_049 : 447|7@0+ (0.002748,-0.1745) [-0.1745|0.174496] "rad"  CADM
 SG_ MRR_RL_CAN_DET_HOST_VEH_CLU_0014 : 432|1@0+ (1,0) [0|1] ""  CADM
 SG_ MRR_RL_CAN_DET_CONFID_ELEVA_0014 : 433|1@0+ (1,0) [0|1] ""  CADM
 SG_ MRR_RL_CAN_DET_AZIMUTH_049 : 431|14@0+ (0.0003834,-3.1416) [-3.1416|3.1396422] "rad"  CADM
 SG_ MRR_RL_CAN_DET_CONFID_AZIMUTH_04 : 417|2@0+ (1,0) [0|3] ""  CADM
 SG_ MRR_RL_CAN_DET_RANGE_049 : 415|14@0+ (0.015625,0) [0|255.984375] "m"  CADM
 SG_ MRR_RL_CAN_SCAN_INDEX_2LSB_049 : 401|2@0+ (1,0) [0|3] ""  CADM
 SG_ MRR_RL_CAN_DET_RANGE_RATE_049 : 399|14@0+ (0.015625,-128) [-128|127.984375] "m/s"  CADM
 SG_ MRR_RL_CAN_DET_VALID_LEVEL_049 : 384|1@0+ (1,0) [0|1] ""  CADM
 SG_ MRR_RL_CAN_DET_AMPLITUDE_049 : 391|7@0+ (1,-64) [-64|63] "dBsm"  CADM
 SG_ MRR_RL_CAN_DET_SUPER_RES_TA_0015 : 376|1@0+ (1,0) [0|1] ""  CADM
 SG_ MRR_RL_CAN_DET_ELEVATION_048 : 383|7@0+ (0.002748,-0.1745) [-0.1745|0.174496] "rad"  CADM
 SG_ MRR_RL_CAN_DET_HOST_VEH_CLU_0015 : 368|1@0+ (1,0) [0|1] ""  CADM
 SG_ MRR_RL_CAN_DET_CONFID_ELEVA_0015 : 369|1@0+ (1,0) [0|1] ""  CADM
 SG_ MRR_RL_CAN_DET_AZIMUTH_048 : 367|14@0+ (0.0003834,-3.1416) [-3.1416|3.1396422] "rad"  CADM
 SG_ MRR_RL_CAN_DET_CONFID_AZIMU_0013 : 353|2@0+ (1,0) [0|3] ""  CADM
 SG_ MRR_RL_CAN_DET_RANGE_048 : 351|14@0+ (0.015625,0) [0|255.984375] "m"  CADM
 SG_ MRR_RL_CAN_SCAN_INDEX_2LSB_048 : 337|2@0+ (1,0) [0|3] ""  CADM
 SG_ MRR_RL_CAN_DET_RANGE_RATE_048 : 335|14@0+ (0.015625,-128) [-128|127.984375] "m/s"  CADM
 SG_ MRR_RL_CAN_DET_VALID_LEVEL_048 : 320|1@0+ (1,0) [0|1] ""  CADM
 SG_ MRR_RL_CAN_DET_AMPLITUDE_048 : 327|7@0+ (1,-64) [-64|63] "dBsm"  CADM
 SG_ MRR_RL_CAN_DET_SUPER_RES_TA_0016 : 312|1@0+ (1,0) [0|1] ""  CADM
 SG_ MRR_RL_CAN_DET_ELEVATION_047 : 319|7@0+ (0.002748,-0.1745) [-0.1745|0.174496] "rad"  CADM
 SG_ MRR_RL_CAN_DET_HOST_VEH_CLU_0016 : 304|1@0+ (1,0) [0|1] ""  CADM
 SG_ MRR_RL_CAN_DET_CONFID_ELEVA_0016 : 305|1@0+ (1,0) [0|1] ""  CADM
 SG_ MRR_RL_CAN_DET_AZIMUTH_047 : 303|14@0+ (0.0003834,-3.1416) [-3.1416|3.1396422] "rad"  CADM
 SG_ MRR_RL_CAN_DET_CONFID_AZIMU_0014 : 289|2@0+ (1,0) [0|3] ""  CADM
 SG_ MRR_RL_CAN_DET_RANGE_047 : 287|14@0+ (0.015625,0) [0|255.984375] "m"  CADM
 SG_ MRR_RL_CAN_SCAN_INDEX_2LSB_047 : 273|2@0+ (1,0) [0|3] ""  CADM
 SG_ MRR_RL_CAN_DET_RANGE_RATE_047 : 271|14@0+ (0.015625,-128) [-128|127.984375] "m/s"  CADM
 SG_ MRR_RL_CAN_DET_VALID_LEVEL_047 : 256|1@0+ (1,0) [0|1] ""  CADM
 SG_ MRR_RL_CAN_DET_AMPLITUDE_047 : 263|7@0+ (1,-64) [-64|63] "dBsm"  CADM
 SG_ MRR_RL_CAN_DET_SUPER_RES_TA_0017 : 248|1@0+ (1,0) [0|1] ""  CADM
 SG_ MRR_RL_CAN_DET_ELEVATION_046 : 255|7@0+ (0.002748,-0.1745) [-0.1745|0.174496] "rad"  CADM
 SG_ MRR_RL_CAN_DET_HOST_VEH_CLU_0017 : 240|1@0+ (1,0) [0|1] ""  CADM
 SG_ MRR_RL_CAN_DET_CONFID_ELEVA_0017 : 241|1@0+ (1,0) [0|1] ""  CADM
 SG_ MRR_RL_CAN_DET_AZIMUTH_046 : 239|14@0+ (0.0003834,-3.1416) [-3.1416|3.1396422] "rad"  CADM
 SG_ MRR_RL_CAN_DET_CONFID_AZIMU_0015 : 225|2@0+ (1,0) [0|3] ""  CADM
 SG_ MRR_RL_CAN_DET_RANGE_046 : 223|14@0+ (0.015625,0) [0|255.984375] "m"  CADM
 SG_ MRR_RL_CAN_SCAN_INDEX_2LSB_046 : 209|2@0+ (1,0) [0|3] ""  CADM
 SG_ MRR_RL_CAN_DET_RANGE_RATE_046 : 207|14@0+ (0.015625,-128) [-128|127.984375] "m/s"  CADM
 SG_ MRR_RL_CAN_DET_VALID_LEVEL_046 : 192|1@0+ (1,0) [0|1] ""  CADM
 SG_ MRR_RL_CAN_DET_AMPLITUDE_046 : 199|7@0+ (1,-64) [-64|63] "dBsm"  CADM
 SG_ MRR_RL_CAN_DET_SUPER_RES_TA_0018 : 184|1@0+ (1,0) [0|1] ""  CADM
 SG_ MRR_RL_CAN_DET_ELEVATION_045 : 191|7@0+ (0.002748,-0.1745) [-0.1745|0.174496] "rad"  CADM
 SG_ MRR_RL_CAN_DET_HOST_VEH_CLU_0018 : 176|1@0+ (1,0) [0|1] ""  CADM
 SG_ MRR_RL_CAN_DET_CONFID_ELEVA_0018 : 177|1@0+ (1,0) [0|1] ""  CADM
 SG_ MRR_RL_CAN_DET_AZIMUTH_045 : 175|14@0+ (0.0003834,-3.1416) [-3.1416|3.1396422] "rad"  CADM
 SG_ MRR_RL_CAN_DET_CONFID_AZIMU_0016 : 161|2@0+ (1,0) [0|3] ""  CADM
 SG_ MRR_RL_CAN_DET_RANGE_045 : 159|14@0+ (0.015625,0) [0|255.984375] "m"  CADM
 SG_ MRR_RL_CAN_SCAN_INDEX_2LSB_045 : 145|2@0+ (1,0) [0|3] ""  CADM
 SG_ MRR_RL_CAN_DET_RANGE_RATE_045 : 143|14@0+ (0.015625,-128) [-128|127.984375] "m/s"  CADM
 SG_ MRR_RL_CAN_DET_VALID_LEVEL_045 : 128|1@0+ (1,0) [0|1] ""  CADM
 SG_ MRR_RL_CAN_DET_AMPLITUDE_045 : 135|7@0+ (1,-64) [-64|63] "dBsm"  CADM
 SG_ MRR_RL_CAN_DET_SUPER_RES_TA_0019 : 120|1@0+ (1,0) [0|1] ""  CADM
 SG_ MRR_RL_CAN_DET_ELEVATION_044 : 127|7@0+ (0.002748,-0.1745) [-0.1745|0.174496] "rad"  CADM
 SG_ MRR_RL_CAN_DET_HOST_VEH_CLU_0019 : 112|1@0+ (1,0) [0|1] ""  CADM
 SG_ MRR_RL_CAN_DET_CONFID_ELEVA_0019 : 113|1@0+ (1,0) [0|1] ""  CADM
 SG_ MRR_RL_CAN_DET_AZIMUTH_044 : 111|14@0+ (0.0003834,-3.1416) [-3.1416|3.1396422] "rad"  CADM
 SG_ MRR_RL_CAN_DET_CONFID_AZIMU_0017 : 97|2@0+ (1,0) [0|3] ""  CADM
 SG_ MRR_RL_CAN_DET_RANGE_044 : 95|14@0+ (0.015625,0) [0|255.984375] "m"  CADM
 SG_ MRR_RL_CAN_SCAN_INDEX_2LSB_044 : 81|2@0+ (1,0) [0|3] ""  CADM
 SG_ MRR_RL_CAN_DET_RANGE_RATE_044 : 79|14@0+ (0.015625,-128) [-128|127.984375] "m/s"  CADM
 SG_ MRR_RL_CAN_DET_VALID_LEVEL_044 : 64|1@0+ (1,0) [0|1] ""  CADM
 SG_ MRR_RL_CAN_DET_AMPLITUDE_044 : 71|7@0+ (1,-64) [-64|63] "dBsm"  CADM
 SG_ MRR_RL_CAN_DET_SUPER_RES_TA_0020 : 56|1@0+ (1,0) [0|1] ""  CADM
 SG_ MRR_RL_CAN_DET_ELEVATION_043 : 63|7@0+ (0.002748,-0.1745) [-0.1745|0.174496] "rad"  CADM
 SG_ MRR_RL_CAN_DET_HOST_VEH_CLU_0020 : 48|1@0+ (1,0) [0|1] ""  CADM
 SG_ MRR_RL_CAN_DET_CONFID_ELEVA_0020 : 49|1@0+ (1,0) [0|1] ""  CADM
 SG_ MRR_RL_CAN_DET_AZIMUTH_043 : 47|14@0+ (0.0003834,-3.1416) [-3.1416|3.1396422] "rad"  CADM
 SG_ MRR_RL_CAN_DET_CONFID_AZIMU_0018 : 33|2@0+ (1,0) [0|3] ""  CADM
 SG_ MRR_RL_CAN_DET_RANGE_043 : 31|14@0+ (0.015625,0) [0|255.984375] "m"  CADM
 SG_ MRR_RL_CAN_SCAN_INDEX_2LSB_043 : 17|2@0+ (1,0) [0|3] ""  CADM
 SG_ MRR_RL_CAN_DET_RANGE_RATE_043 : 15|14@0+ (0.015625,-128) [-128|127.984375] "m/s"  CADM
 SG_ MRR_RL_CAN_DET_VALID_LEVEL_043 : 0|1@0+ (1,0) [0|1] ""  CADM
 SG_ MRR_RL_CAN_DET_AMPLITUDE_043 : 7|7@0+ (1,-64) [-64|63] "dBsm"  CADM

BO_ 1285 MRR_RL_Detection_036_042: 64 MRRRL
 SG_ MRR_RL_CAN_DET_MID_TARGET_042 : 462|1@0+ (1,0) [0|1] ""  CADM
 SG_ MRR_RL_CAN_DET_MID_TARGET_041 : 461|1@0+ (1,0) [0|1] ""  CADM
 SG_ MRR_RL_CAN_DET_MID_TARGET_040 : 460|1@0+ (1,0) [0|1] ""  CADM
 SG_ MRR_RL_CAN_DET_MID_TARGET_039 : 459|1@0+ (1,0) [0|1] ""  CADM
 SG_ MRR_RL_CAN_DET_MID_TARGET_038 : 458|1@0+ (1,0) [0|1] ""  CADM
 SG_ MRR_RL_CAN_DET_MID_TARGET_037 : 457|1@0+ (1,0) [0|1] ""  CADM
 SG_ MRR_RL_CAN_DET_MID_TARGET_036 : 456|1@0+ (1,0) [0|1] ""  CADM
 SG_ MRR_RL_CAN_DET_Near_TARGET_036 : 448|1@0+ (1,0) [0|1] ""  CADM
 SG_ MRR_RL_CAN_DET_Near_TARGET_037 : 449|1@0+ (1,0) [0|1] ""  CADM
 SG_ MRR_RL_CAN_DET_Near_TARGET_038 : 450|1@0+ (1,0) [0|1] ""  CADM
 SG_ MRR_RL_CAN_DET_Near_TARGET_039 : 451|1@0+ (1,0) [0|1] ""  CADM
 SG_ MRR_RL_CAN_DET_Near_TARGET_040 : 452|1@0+ (1,0) [0|1] ""  CADM
 SG_ MRR_RL_CAN_DET_Near_TARGET_041 : 453|1@0+ (1,0) [0|1] ""  CADM
 SG_ MRR_RL_CAN_DET_Near_TARGET_042 : 454|1@0+ (1,0) [0|1] ""  CADM
 SG_ MRR_RL_DET_CRC_006 : 503|16@0+ (1,0) [0|65535] ""  CADM
 SG_ MRR_RL_DET_MC_006 : 491|4@0+ (1,0) [0|15] ""  CADM
 SG_ MRR_RL_CAN_DET_SUPER_RES_TA_0021 : 440|1@0+ (1,0) [0|1] ""  CADM
 SG_ MRR_RL_CAN_DET_ELEVATION_042 : 447|7@0+ (0.002748,-0.1745) [-0.1745|0.174496] "rad"  CADM
 SG_ MRR_RL_CAN_DET_HOST_VEH_CLU_0021 : 432|1@0+ (1,0) [0|1] ""  CADM
 SG_ MRR_RL_CAN_DET_CONFID_ELEVA_0021 : 433|1@0+ (1,0) [0|1] ""  CADM
 SG_ MRR_RL_CAN_DET_AZIMUTH_042 : 431|14@0+ (0.0003834,-3.1416) [-3.1416|3.1396422] "rad"  CADM
 SG_ MRR_RL_CAN_DET_CONFID_AZIMU_0019 : 417|2@0+ (1,0) [0|3] ""  CADM
 SG_ MRR_RL_CAN_DET_RANGE_042 : 415|14@0+ (0.015625,0) [0|255.984375] "m"  CADM
 SG_ MRR_RL_CAN_SCAN_INDEX_2LSB_042 : 401|2@0+ (1,0) [0|3] ""  CADM
 SG_ MRR_RL_CAN_DET_RANGE_RATE_042 : 399|14@0+ (0.015625,-128) [-128|127.984375] "m/s"  CADM
 SG_ MRR_RL_CAN_DET_VALID_LEVEL_042 : 384|1@0+ (1,0) [0|1] ""  CADM
 SG_ MRR_RL_CAN_DET_AMPLITUDE_042 : 391|7@0+ (1,-64) [-64|63] "dBsm"  CADM
 SG_ MRR_RL_CAN_DET_SUPER_RES_TA_0022 : 376|1@0+ (1,0) [0|1] ""  CADM
 SG_ MRR_RL_CAN_DET_ELEVATION_041 : 383|7@0+ (0.002748,-0.1745) [-0.1745|0.174496] "rad"  CADM
 SG_ MRR_RL_CAN_DET_HOST_VEH_CLU_0022 : 368|1@0+ (1,0) [0|1] ""  CADM
 SG_ MRR_RL_CAN_DET_CONFID_ELEVA_0022 : 369|1@0+ (1,0) [0|1] ""  CADM
 SG_ MRR_RL_CAN_DET_AZIMUTH_041 : 367|14@0+ (0.0003834,-3.1416) [-3.1416|3.1396422] "rad"  CADM
 SG_ MRR_RL_CAN_DET_CONFID_AZIMU_0020 : 353|2@0+ (1,0) [0|3] ""  CADM
 SG_ MRR_RL_CAN_DET_RANGE_041 : 351|14@0+ (0.015625,0) [0|255.984375] "m"  CADM
 SG_ MRR_RL_CAN_SCAN_INDEX_2LSB_041 : 337|2@0+ (1,0) [0|3] ""  CADM
 SG_ MRR_RL_CAN_DET_RANGE_RATE_041 : 335|14@0+ (0.015625,-128) [-128|127.984375] "m/s"  CADM
 SG_ MRR_RL_CAN_DET_VALID_LEVEL_041 : 320|1@0+ (1,0) [0|1] ""  CADM
 SG_ MRR_RL_CAN_DET_AMPLITUDE_041 : 327|7@0+ (1,-64) [-64|63] "dBsm"  CADM
 SG_ MRR_RL_CAN_DET_SUPER_RES_TA_0023 : 312|1@0+ (1,0) [0|1] ""  CADM
 SG_ MRR_RL_CAN_DET_ELEVATION_040 : 319|7@0+ (0.002748,-0.1745) [-0.1745|0.174496] "rad"  CADM
 SG_ MRR_RL_CAN_DET_HOST_VEH_CLU_0023 : 304|1@0+ (1,0) [0|1] ""  CADM
 SG_ MRR_RL_CAN_DET_CONFID_ELEVA_0023 : 305|1@0+ (1,0) [0|1] ""  CADM
 SG_ MRR_RL_CAN_DET_AZIMUTH_040 : 303|14@0+ (0.0003834,-3.1416) [-3.1416|3.1396422] "rad"  CADM
 SG_ MRR_RL_CAN_DET_CONFID_AZIMU_0021 : 289|2@0+ (1,0) [0|3] ""  CADM
 SG_ MRR_RL_CAN_DET_RANGE_040 : 287|14@0+ (0.015625,0) [0|255.984375] "m"  CADM
 SG_ MRR_RL_CAN_SCAN_INDEX_2LSB_040 : 273|2@0+ (1,0) [0|3] ""  CADM
 SG_ MRR_RL_CAN_DET_RANGE_RATE_040 : 271|14@0+ (0.015625,-128) [-128|127.984375] "m/s"  CADM
 SG_ MRR_RL_CAN_DET_VALID_LEVEL_040 : 256|1@0+ (1,0) [0|1] ""  CADM
 SG_ MRR_RL_CAN_DET_AMPLITUDE_040 : 263|7@0+ (1,-64) [-64|63] "dBsm"  CADM
 SG_ MRR_RL_CAN_DET_SUPER_RES_TA_0024 : 248|1@0+ (1,0) [0|1] ""  CADM
 SG_ MRR_RL_CAN_DET_ELEVATION_039 : 255|7@0+ (0.002748,-0.1745) [-0.1745|0.174496] "rad"  CADM
 SG_ MRR_RL_CAN_DET_HOST_VEH_CLU_0024 : 240|1@0+ (1,0) [0|1] ""  CADM
 SG_ MRR_RL_CAN_DET_CONFID_ELEVA_0024 : 241|1@0+ (1,0) [0|1] ""  CADM
 SG_ MRR_RL_CAN_DET_AZIMUTH_039 : 239|14@0+ (0.0003834,-3.1416) [-3.1416|3.1396422] "rad"  CADM
 SG_ MRR_RL_CAN_DET_CONFID_AZIMUTH_03 : 225|2@0+ (1,0) [0|3] ""  CADM
 SG_ MRR_RL_CAN_DET_RANGE_039 : 223|14@0+ (0.015625,0) [0|255.984375] "m"  CADM
 SG_ MRR_RL_CAN_SCAN_INDEX_2LSB_039 : 209|2@0+ (1,0) [0|3] ""  CADM
 SG_ MRR_RL_CAN_DET_RANGE_RATE_039 : 207|14@0+ (0.015625,-128) [-128|127.984375] "m/s"  CADM
 SG_ MRR_RL_CAN_DET_VALID_LEVEL_039 : 192|1@0+ (1,0) [0|1] ""  CADM
 SG_ MRR_RL_CAN_DET_AMPLITUDE_039 : 199|7@0+ (1,-64) [-64|63] "dBsm"  CADM
 SG_ MRR_RL_CAN_DET_SUPER_RES_TA_0025 : 184|1@0+ (1,0) [0|1] ""  CADM
 SG_ MRR_RL_CAN_DET_ELEVATION_038 : 191|7@0+ (0.002748,-0.1745) [-0.1745|0.174496] "rad"  CADM
 SG_ MRR_RL_CAN_DET_HOST_VEH_CLU_0025 : 176|1@0+ (1,0) [0|1] ""  CADM
 SG_ MRR_RL_CAN_DET_CONFID_ELEVA_0025 : 177|1@0+ (1,0) [0|1] ""  CADM
 SG_ MRR_RL_CAN_DET_AZIMUTH_038 : 175|14@0+ (0.0003834,-3.1416) [-3.1416|3.1396422] "rad"  CADM
 SG_ MRR_RL_CAN_DET_CONFID_AZIMU_0022 : 161|2@0+ (1,0) [0|3] ""  CADM
 SG_ MRR_RL_CAN_DET_RANGE_038 : 159|14@0+ (0.015625,0) [0|255.984375] "m"  CADM
 SG_ MRR_RL_CAN_SCAN_INDEX_2LSB_038 : 145|2@0+ (1,0) [0|3] ""  CADM
 SG_ MRR_RL_CAN_DET_RANGE_RATE_038 : 143|14@0+ (0.015625,-128) [-128|127.984375] "m/s"  CADM
 SG_ MRR_RL_CAN_DET_VALID_LEVEL_038 : 128|1@0+ (1,0) [0|1] ""  CADM
 SG_ MRR_RL_CAN_DET_AMPLITUDE_038 : 135|7@0+ (1,-64) [-64|63] "dBsm"  CADM
 SG_ MRR_RL_CAN_DET_SUPER_RES_TA_0026 : 120|1@0+ (1,0) [0|1] ""  CADM
 SG_ MRR_RL_CAN_DET_ELEVATION_037 : 127|7@0+ (0.002748,-0.1745) [-0.1745|0.174496] "rad"  CADM
 SG_ MRR_RL_CAN_DET_HOST_VEH_CLU_0026 : 112|1@0+ (1,0) [0|1] ""  CADM
 SG_ MRR_RL_CAN_DET_CONFID_ELEVA_0026 : 113|1@0+ (1,0) [0|1] ""  CADM
 SG_ MRR_RL_CAN_DET_AZIMUTH_037 : 111|14@0+ (0.0003834,-3.1416) [-3.1416|3.1396422] "rad"  CADM
 SG_ MRR_RL_CAN_DET_CONFID_AZIMU_0023 : 97|2@0+ (1,0) [0|3] ""  CADM
 SG_ MRR_RL_CAN_DET_RANGE_037 : 95|14@0+ (0.015625,0) [0|255.984375] "m"  CADM
 SG_ MRR_RL_CAN_SCAN_INDEX_2LSB_037 : 81|2@0+ (1,0) [0|3] ""  CADM
 SG_ MRR_RL_CAN_DET_RANGE_RATE_037 : 79|14@0+ (0.015625,-128) [-128|127.984375] "m/s"  CADM
 SG_ MRR_RL_CAN_DET_VALID_LEVEL_037 : 64|1@0+ (1,0) [0|1] ""  CADM
 SG_ MRR_RL_CAN_DET_AMPLITUDE_037 : 71|7@0+ (1,-64) [-64|63] "dBsm"  CADM
 SG_ MRR_RL_CAN_DET_SUPER_RES_TA_0027 : 56|1@0+ (1,0) [0|1] ""  CADM
 SG_ MRR_RL_CAN_DET_ELEVATION_036 : 63|7@0+ (0.002748,-0.1745) [-0.1745|0.174496] "rad"  CADM
 SG_ MRR_RL_CAN_DET_HOST_VEH_CLU_0027 : 48|1@0+ (1,0) [0|1] ""  CADM
 SG_ MRR_RL_CAN_DET_CONFID_ELEVA_0027 : 49|1@0+ (1,0) [0|1] ""  CADM
 SG_ MRR_RL_CAN_DET_AZIMUTH_036 : 47|14@0+ (0.0003834,-3.1416) [-3.1416|3.1396422] "rad"  CADM
 SG_ MRR_RL_CAN_DET_CONFID_AZIMU_0024 : 33|2@0+ (1,0) [0|3] ""  CADM
 SG_ MRR_RL_CAN_DET_RANGE_036 : 31|14@0+ (0.015625,0) [0|255.984375] "m"  CADM
 SG_ MRR_RL_CAN_SCAN_INDEX_2LSB_036 : 17|2@0+ (1,0) [0|3] ""  CADM
 SG_ MRR_RL_CAN_DET_RANGE_RATE_036 : 15|14@0+ (0.015625,-128) [-128|127.984375] "m/s"  CADM
 SG_ MRR_RL_CAN_DET_VALID_LEVEL_036 : 0|1@0+ (1,0) [0|1] ""  CADM
 SG_ MRR_RL_CAN_DET_AMPLITUDE_036 : 7|7@0+ (1,-64) [-64|63] "dBsm"  CADM

BO_ 1284 MRR_RL_Detection_029_035: 64 MRRRL
 SG_ MRR_RL_CAN_DET_MID_TARGET_035 : 462|1@0+ (1,0) [0|1] ""  CADM
 SG_ MRR_RL_CAN_DET_MID_TARGET_034 : 461|1@0+ (1,0) [0|1] ""  CADM
 SG_ MRR_RL_CAN_DET_MID_TARGET_033 : 460|1@0+ (1,0) [0|1] ""  CADM
 SG_ MRR_RL_CAN_DET_MID_TARGET_032 : 459|1@0+ (1,0) [0|1] ""  CADM
 SG_ MRR_RL_CAN_DET_MID_TARGET_031 : 458|1@0+ (1,0) [0|1] ""  CADM
 SG_ MRR_RL_CAN_DET_MID_TARGET_030 : 457|1@0+ (1,0) [0|1] ""  CADM
 SG_ MRR_RL_CAN_DET_MID_TARGET_029 : 456|1@0+ (1,0) [0|1] ""  CADM
 SG_ MRR_RL_CAN_DET_Near_TARGET_029 : 448|1@0+ (1,0) [0|1] ""  CADM
 SG_ MRR_RL_CAN_DET_Near_TARGET_030 : 449|1@0+ (1,0) [0|1] ""  CADM
 SG_ MRR_RL_CAN_DET_Near_TARGET_031 : 450|1@0+ (1,0) [0|1] ""  CADM
 SG_ MRR_RL_CAN_DET_Near_TARGET_032 : 451|1@0+ (1,0) [0|1] ""  CADM
 SG_ MRR_RL_CAN_DET_Near_TARGET_033 : 452|1@0+ (1,0) [0|1] ""  CADM
 SG_ MRR_RL_CAN_DET_Near_TARGET_034 : 453|1@0+ (1,0) [0|1] ""  CADM
 SG_ MRR_RL_CAN_DET_Near_TARGET_035 : 454|1@0+ (1,0) [0|1] ""  CADM
 SG_ MRR_RL_DET_CRC_005 : 503|16@0+ (1,0) [0|65535] ""  CADM
 SG_ MRR_RL_DET_MC_005 : 491|4@0+ (1,0) [0|15] ""  CADM
 SG_ MRR_RL_CAN_DET_SUPER_RES_TA_0028 : 440|1@0+ (1,0) [0|1] ""  CADM
 SG_ MRR_RL_CAN_DET_ELEVATION_035 : 447|7@0+ (0.002748,-0.1745) [-0.1745|0.174496] "rad"  CADM
 SG_ MRR_RL_CAN_DET_HOST_VEH_CLU_0028 : 432|1@0+ (1,0) [0|1] ""  CADM
 SG_ MRR_RL_CAN_DET_CONFID_ELEVA_0028 : 433|1@0+ (1,0) [0|1] ""  CADM
 SG_ MRR_RL_CAN_DET_AZIMUTH_035 : 431|14@0+ (0.0003834,-3.1416) [-3.1416|3.1396422] "rad"  CADM
 SG_ MRR_RL_CAN_DET_CONFID_AZIMU_0025 : 417|2@0+ (1,0) [0|3] ""  CADM
 SG_ MRR_RL_CAN_DET_RANGE_035 : 415|14@0+ (0.015625,0) [0|255.984375] "m"  CADM
 SG_ MRR_RL_CAN_SCAN_INDEX_2LSB_035 : 401|2@0+ (1,0) [0|3] ""  CADM
 SG_ MRR_RL_CAN_DET_RANGE_RATE_035 : 399|14@0+ (0.015625,-128) [-128|127.984375] "m/s"  CADM
 SG_ MRR_RL_CAN_DET_VALID_LEVEL_035 : 384|1@0+ (1,0) [0|1] ""  CADM
 SG_ MRR_RL_CAN_DET_AMPLITUDE_035 : 391|7@0+ (1,-64) [-64|63] "dBsm"  CADM
 SG_ MRR_RL_CAN_DET_SUPER_RES_TA_0029 : 376|1@0+ (1,0) [0|1] ""  CADM
 SG_ MRR_RL_CAN_DET_ELEVATION_034 : 383|7@0+ (0.002748,-0.1745) [-0.1745|0.174496] "rad"  CADM
 SG_ MRR_RL_CAN_DET_HOST_VEH_CLU_0029 : 368|1@0+ (1,0) [0|1] ""  CADM
 SG_ MRR_RL_CAN_DET_CONFID_ELEVA_0029 : 369|1@0+ (1,0) [0|1] ""  CADM
 SG_ MRR_RL_CAN_DET_AZIMUTH_034 : 367|14@0+ (0.0003834,-3.1416) [-3.1416|3.1396422] "rad"  CADM
 SG_ MRR_RL_CAN_DET_CONFID_AZIMU_0026 : 353|2@0+ (1,0) [0|3] ""  CADM
 SG_ MRR_RL_CAN_DET_RANGE_034 : 351|14@0+ (0.015625,0) [0|255.984375] "m"  CADM
 SG_ MRR_RL_CAN_SCAN_INDEX_2LSB_034 : 337|2@0+ (1,0) [0|3] ""  CADM
 SG_ MRR_RL_CAN_DET_RANGE_RATE_034 : 335|14@0+ (0.015625,-128) [-128|127.984375] "m/s"  CADM
 SG_ MRR_RL_CAN_DET_VALID_LEVEL_034 : 320|1@0+ (1,0) [0|1] ""  CADM
 SG_ MRR_RL_CAN_DET_AMPLITUDE_034 : 327|7@0+ (1,-64) [-64|63] "dBsm"  CADM
 SG_ MRR_RL_CAN_DET_SUPER_RES_TA_0030 : 312|1@0+ (1,0) [0|1] ""  CADM
 SG_ MRR_RL_CAN_DET_ELEVATION_033 : 319|7@0+ (0.002748,-0.1745) [-0.1745|0.174496] "rad"  CADM
 SG_ MRR_RL_CAN_DET_HOST_VEH_CLU_0030 : 304|1@0+ (1,0) [0|1] ""  CADM
 SG_ MRR_RL_CAN_DET_CONFID_ELEVA_0030 : 305|1@0+ (1,0) [0|1] ""  CADM
 SG_ MRR_RL_CAN_DET_AZIMUTH_033 : 303|14@0+ (0.0003834,-3.1416) [-3.1416|3.1396422] "rad"  CADM
 SG_ MRR_RL_CAN_DET_CONFID_AZIMU_0027 : 289|2@0+ (1,0) [0|3] ""  CADM
 SG_ MRR_RL_CAN_DET_RANGE_033 : 287|14@0+ (0.015625,0) [0|255.984375] "m"  CADM
 SG_ MRR_RL_CAN_SCAN_INDEX_2LSB_033 : 273|2@0+ (1,0) [0|3] ""  CADM
 SG_ MRR_RL_CAN_DET_RANGE_RATE_033 : 271|14@0+ (0.015625,-128) [-128|127.984375] "m/s"  CADM
 SG_ MRR_RL_CAN_DET_VALID_LEVEL_033 : 256|1@0+ (1,0) [0|1] ""  CADM
 SG_ MRR_RL_CAN_DET_AMPLITUDE_033 : 263|7@0+ (1,-64) [-64|63] "dBsm"  CADM
 SG_ MRR_RL_CAN_DET_SUPER_RES_TA_0031 : 248|1@0+ (1,0) [0|1] ""  CADM
 SG_ MRR_RL_CAN_DET_ELEVATION_032 : 255|7@0+ (0.002748,-0.1745) [-0.1745|0.174496] "rad"  CADM
 SG_ MRR_RL_CAN_DET_HOST_VEH_CLU_0031 : 240|1@0+ (1,0) [0|1] ""  CADM
 SG_ MRR_RL_CAN_DET_CONFID_ELEVA_0031 : 241|1@0+ (1,0) [0|1] ""  CADM
 SG_ MRR_RL_CAN_DET_AZIMUTH_032 : 239|14@0+ (0.0003834,-3.1416) [-3.1416|3.1396422] "rad"  CADM
 SG_ MRR_RL_CAN_DET_CONFID_AZIMU_0028 : 225|2@0+ (1,0) [0|3] ""  CADM
 SG_ MRR_RL_CAN_DET_RANGE_032 : 223|14@0+ (0.015625,0) [0|255.984375] "m"  CADM
 SG_ MRR_RL_CAN_SCAN_INDEX_2LSB_032 : 209|2@0+ (1,0) [0|3] ""  CADM
 SG_ MRR_RL_CAN_DET_RANGE_RATE_032 : 207|14@0+ (0.015625,-128) [-128|127.984375] "m/s"  CADM
 SG_ MRR_RL_CAN_DET_VALID_LEVEL_032 : 192|1@0+ (1,0) [0|1] ""  CADM
 SG_ MRR_RL_CAN_DET_AMPLITUDE_032 : 199|7@0+ (1,-64) [-64|63] "dBsm"  CADM
 SG_ MRR_RL_CAN_DET_SUPER_RES_TA_0032 : 184|1@0+ (1,0) [0|1] ""  CADM
 SG_ MRR_RL_CAN_DET_ELEVATION_031 : 191|7@0+ (0.002748,-0.1745) [-0.1745|0.174496] "rad"  CADM
 SG_ MRR_RL_CAN_DET_HOST_VEH_CLU_0032 : 176|1@0+ (1,0) [0|1] ""  CADM
 SG_ MRR_RL_CAN_DET_CONFID_ELEVA_0032 : 177|1@0+ (1,0) [0|1] ""  CADM
 SG_ MRR_RL_CAN_DET_AZIMUTH_031 : 175|14@0+ (0.0003834,-3.1416) [-3.1416|3.1396422] "rad"  CADM
 SG_ MRR_RL_CAN_DET_CONFID_AZIMU_0029 : 161|2@0+ (1,0) [0|3] ""  CADM
 SG_ MRR_RL_CAN_DET_RANGE_031 : 159|14@0+ (0.015625,0) [0|255.984375] "m"  CADM
 SG_ MRR_RL_CAN_SCAN_INDEX_2LSB_031 : 145|2@0+ (1,0) [0|3] ""  CADM
 SG_ MRR_RL_CAN_DET_RANGE_RATE_031 : 143|14@0+ (0.015625,-128) [-128|127.984375] "m/s"  CADM
 SG_ MRR_RL_CAN_DET_VALID_LEVEL_031 : 128|1@0+ (1,0) [0|1] ""  CADM
 SG_ MRR_RL_CAN_DET_AMPLITUDE_031 : 135|7@0+ (1,-64) [-64|63] "dBsm"  CADM
 SG_ MRR_RL_CAN_DET_SUPER_RES_TA_0033 : 120|1@0+ (1,0) [0|1] ""  CADM
 SG_ MRR_RL_CAN_DET_ELEVATION_030 : 127|7@0+ (0.002748,-0.1745) [-0.1745|0.174496] "rad"  CADM
 SG_ MRR_RL_CAN_DET_HOST_VEH_CLU_0033 : 112|1@0+ (1,0) [0|1] ""  CADM
 SG_ MRR_RL_CAN_DET_CONFID_ELEVA_0033 : 113|1@0+ (1,0) [0|1] ""  CADM
 SG_ MRR_RL_CAN_DET_AZIMUTH_030 : 111|14@0+ (0.0003834,-3.1416) [-3.1416|3.1396422] "rad"  CADM
 SG_ MRR_RL_CAN_DET_CONFID_AZIMU_0030 : 97|2@0+ (1,0) [0|3] ""  CADM
 SG_ MRR_RL_CAN_DET_RANGE_030 : 95|14@0+ (0.015625,0) [0|255.984375] "m"  CADM
 SG_ MRR_RL_CAN_SCAN_INDEX_2LSB_030 : 81|2@0+ (1,0) [0|3] ""  CADM
 SG_ MRR_RL_CAN_DET_RANGE_RATE_030 : 79|14@0+ (0.015625,-128) [-128|127.984375] "m/s"  CADM
 SG_ MRR_RL_CAN_DET_VALID_LEVEL_030 : 64|1@0+ (1,0) [0|1] ""  CADM
 SG_ MRR_RL_CAN_DET_AMPLITUDE_030 : 71|7@0+ (1,-64) [-64|63] "dBsm"  CADM
 SG_ MRR_RL_CAN_DET_SUPER_RES_TA_0034 : 56|1@0+ (1,0) [0|1] ""  CADM
 SG_ MRR_RL_CAN_DET_ELEVATION_029 : 63|7@0+ (0.002748,-0.1745) [-0.1745|0.174496] "rad"  CADM
 SG_ MRR_RL_CAN_DET_HOST_VEH_CLU_0034 : 48|1@0+ (1,0) [0|1] ""  CADM
 SG_ MRR_RL_CAN_DET_CONFID_ELEVA_0034 : 49|1@0+ (1,0) [0|1] ""  CADM
 SG_ MRR_RL_CAN_DET_AZIMUTH_029 : 47|14@0+ (0.0003834,-3.1416) [-3.1416|3.1396422] "rad"  CADM
 SG_ MRR_RL_CAN_DET_CONFID_AZIMUTH_02 : 33|2@0+ (1,0) [0|3] ""  CADM
 SG_ MRR_RL_CAN_DET_RANGE_029 : 31|14@0+ (0.015625,0) [0|255.984375] "m"  CADM
 SG_ MRR_RL_CAN_SCAN_INDEX_2LSB_029 : 17|2@0+ (1,0) [0|3] ""  CADM
 SG_ MRR_RL_CAN_DET_RANGE_RATE_029 : 15|14@0+ (0.015625,-128) [-128|127.984375] "m/s"  CADM
 SG_ MRR_RL_CAN_DET_VALID_LEVEL_029 : 0|1@0+ (1,0) [0|1] ""  CADM
 SG_ MRR_RL_CAN_DET_AMPLITUDE_029 : 7|7@0+ (1,-64) [-64|63] "dBsm"  CADM

BA_DEF_ SG_  "NWM_WakeupAllowed" ENUM  "0 No","1 Yes";
BA_DEF_ BO_  "GenMsgTimeoutTime" INT 0 2500;
BA_DEF_ BO_  "WakeupMessage" ENUM  "0 No","1 Yes";
BA_DEF_ SG_  "SignalDescription" STRING ;
BA_DEF_ SG_  "GenSigTimeoutTime_ABS_ESC" INT 0 100000;
BA_DEF_ SG_  "UsedOnPgmDBC" ENUM  "No","Yes";
BA_DEF_ BO_  "VFrameFormat" ENUM  "StandardCAN","ExtendedCAN","reserved","reserved","reserved","reserved","reserved","reserved","reserved","reserved","reserved","reserved","reserved","reserved","StandardCAN_FD","ExtendedCAN_FD";
BA_DEF_ BO_  "DiagConnection" INT 0 65535;
BA_DEF_ BO_  "CanTpBs" INT 0 255;
BA_DEF_ BO_  "EventRateOfChange" INT 10 10000;
BA_DEF_ BO_  "DiagState" ENUM  "No","Yes";
BA_DEF_ BO_  "DiagRequest" ENUM  "No","Yes";
BA_DEF_ BO_  "DiagResponse" ENUM  "No","Yes";
BA_DEF_ SG_  "GenSigCycleTime" INT 0 0;
BA_DEF_ SG_  "GenSigMarked" STRING ;
BA_DEF_ SG_  "GenSigVtName" STRING ;
BA_DEF_ SG_  "GenSigVtEn" STRING ;
BA_DEF_ SG_  "GenSigCmt" STRING ;
BA_DEF_ SG_  "GenSigSendType" ENUM  "Cyclic","OnWrite","vector_leerstring","OnChange","vector_leerstring","IfActive","vector_leerstring","NoSigSendType";
BA_DEF_ SG_  "GenSigInactiveValue" INT 0 100000;
BA_DEF_ SG_  "GenSigMissingSourceValue" INT 0 1000000000;
BA_DEF_ SG_  "GenSigStartValue" INT 0 1000000000;
BA_DEF_ BO_  "GenMsgILSupport" ENUM  "No","Yes";
BA_DEF_ BO_  "GenMsgSendType" ENUM  "FixedPeriodic","Event","EnabledPeriodic","NotUsed","NotUsed","EventPeriodic","NotUsed","NotUsed","NoMsgSendType";
BA_DEF_ BO_  "GenMsgCycleTime" INT 0 100000;
BA_DEF_ BO_  "GenMsgDelayTime" INT 0 10000;
BA_DEF_ BO_  "GenMsgNrOfRepetition" INT 0 100;
BA_DEF_ BO_  "GenMsgStartDelayTime" INT 0 10000;
BA_DEF_ BO_  "NetworkInitialization" ENUM  "No","Yes";
BA_DEF_ SG_  "SystemSignalLongSymbol" STRING ;
BA_DEF_DEF_  "NWM_WakeupAllowed" "0 No";
BA_DEF_DEF_  "GenMsgTimeoutTime" 2500;
BA_DEF_DEF_  "WakeupMessage" "0 No";
BA_DEF_DEF_  "SignalDescription" "";
BA_DEF_DEF_  "GenSigTimeoutTime_ABS_ESC" 0;
BA_DEF_DEF_  "UsedOnPgmDBC" "Yes";
BA_DEF_DEF_  "VFrameFormat" "StandardCAN_FD";
BA_DEF_DEF_  "DiagConnection" 0;
BA_DEF_DEF_  "CanTpBs" 255;
BA_DEF_DEF_  "EventRateOfChange" 10000;
BA_DEF_DEF_  "DiagState" "No";
BA_DEF_DEF_  "DiagRequest" "No";
BA_DEF_DEF_  "DiagResponse" "No";
BA_DEF_DEF_  "GenSigCycleTime" 0;
BA_DEF_DEF_  "GenSigMarked" "";
BA_DEF_DEF_  "GenSigVtName" "";
BA_DEF_DEF_  "GenSigVtEn" "";
BA_DEF_DEF_  "GenSigCmt" "";
BA_DEF_DEF_  "GenSigSendType" "NoSigSendType";
BA_DEF_DEF_  "GenSigInactiveValue" 0;
BA_DEF_DEF_  "GenSigMissingSourceValue" 0;
BA_DEF_DEF_  "GenSigStartValue" 0;
BA_DEF_DEF_  "GenMsgILSupport" "Yes";
BA_DEF_DEF_  "GenMsgSendType" "NoMsgSendType";
BA_DEF_DEF_  "GenMsgCycleTime" 0;
BA_DEF_DEF_  "GenMsgDelayTime" 0;
BA_DEF_DEF_  "GenMsgNrOfRepetition" 0;
BA_DEF_DEF_  "GenMsgStartDelayTime" 0;
BA_DEF_DEF_  "NetworkInitialization" "No";
BA_DEF_DEF_  "SystemSignalLongSymbol" "";
BA_ "GenMsgTimeoutTime" BO_ 324 0;
BA_ "GenMsgSendType" BO_ 324 0;
BA_ "GenMsgCycleTime" BO_ 324 20;
BA_ "GenMsgCycleTime" BO_ 325 20;
BA_ "GenMsgSendType" BO_ 325 0;
BA_ "GenMsgTimeoutTime" BO_ 325 0;
BA_ "GenMsgTimeoutTime" BO_ 1289 0;
BA_ "GenMsgSendType" BO_ 1289 1;
BA_ "GenMsgTimeoutTime" BO_ 1288 0;
BA_ "GenMsgSendType" BO_ 1288 1;
BA_ "GenMsgTimeoutTime" BO_ 1287 0;
BA_ "GenMsgSendType" BO_ 1287 1;
BA_ "GenMsgTimeoutTime" BO_ 1286 0;
BA_ "GenMsgSendType" BO_ 1286 1;
BA_ "GenMsgSendType" BO_ 1285 1;
BA_ "GenMsgTimeoutTime" BO_ 1285 0;
BA_ "GenMsgTimeoutTime" BO_ 1284 0;
BA_ "GenMsgSendType" BO_ 1284 1;
BA_ "GenSigCycleTime" SG_ 324 MRR_RL_TO_SystemTDBlockage_Flt 20;
BA_ "GenSigSendType" SG_ 324 MRR_RL_TO_SystemTDBlockage_Flt 0;
BA_ "GenSigSendType" SG_ 324 MRR_RL_TO_CADMSWVersion_Flt 0;
BA_ "GenSigCycleTime" SG_ 324 MRR_RL_TO_CADMSWVersion_Flt 20;
BA_ "GenSigSendType" SG_ 324 MRR_RL_TO_RADARCfgParameter_Flt 0;
BA_ "GenSigCycleTime" SG_ 324 MRR_RL_TO_RADARCfgParameter_Flt 20;
BA_ "GenSigSendType" SG_ 324 MRR_RL_TO_SATCADMVIN_Flt 0;
BA_ "GenSigCycleTime" SG_ 324 MRR_RL_TO_SATCADMVIN_Flt 20;
BA_ "GenSigSendType" SG_ 324 MRR_RL_TO_CADMTracksChange_Flt 0;
BA_ "GenSigCycleTime" SG_ 324 MRR_RL_TO_CADMTracksChange_Flt 20;
BA_ "GenSigSendType" SG_ 324 MRR_RL_Active_Fault_Status_CRC 0;
BA_ "GenSigCycleTime" SG_ 324 MRR_RL_Active_Fault_Status_CRC 20;
BA_ "GenSigSendType" SG_ 324 MRR_RL_Active_Fault_Status_MC 0;
BA_ "GenSigCycleTime" SG_ 324 MRR_RL_Active_Fault_Status_MC 20;
BA_ "GenSigSendType" SG_ 324 MRR_RL_Dolphin_Flt 0;
BA_ "GenSigCycleTime" SG_ 324 MRR_RL_Dolphin_Flt 20;
BA_ "GenSigSendType" SG_ 324 MRR_RL_RRUCore_Flt 0;
BA_ "GenSigCycleTime" SG_ 324 MRR_RL_RRUCore_Flt 20;
BA_ "GenSigSendType" SG_ 324 MRR_RL_RRUBIST_Flt 0;
BA_ "GenSigCycleTime" SG_ 324 MRR_RL_RRUBIST_Flt 20;
BA_ "GenSigSendType" SG_ 324 MRR_RL_PINPosition_Flt 0;
BA_ "GenSigCycleTime" SG_ 324 MRR_RL_PINPosition_Flt 20;
BA_ "GenSigSendType" SG_ 324 MRR_RL_PCANDataRangeChk_Flt 0;
BA_ "GenSigCycleTime" SG_ 324 MRR_RL_PCANDataRangeChk_Flt 20;
BA_ "GenSigCycleTime" SG_ 324 MRR_RL_TO_AngleAdjustmentTable_F 20;
BA_ "GenSigSendType" SG_ 324 MRR_RL_TO_AngleAdjustmentTable_F 0;
BA_ "SystemSignalLongSymbol" SG_ 324 MRR_RL_TO_AngleAdjustmentTable_F "MRR_RL_TO_AngleAdjustmentTable_Flt";
BA_ "GenSigCycleTime" SG_ 324 MRR_RL_TO_CADMSgnlActlVal_Flt 20;
BA_ "GenSigSendType" SG_ 324 MRR_RL_TO_CADMSgnlActlVal_Flt 0;
BA_ "GenSigCycleTime" SG_ 324 MRR_RL_TO_TrigControl_Flt 20;
BA_ "GenSigSendType" SG_ 324 MRR_RL_TO_TrigControl_Flt 0;
BA_ "GenSigCycleTime" SG_ 324 MRR_RL_TO_VehicleState_Flt 20;
BA_ "GenSigSendType" SG_ 324 MRR_RL_TO_VehicleState_Flt 0;
BA_ "GenSigCycleTime" SG_ 324 MRR_RL_MC_AngleAdjTable_Flt 20;
BA_ "GenSigSendType" SG_ 324 MRR_RL_MC_AngleAdjTable_Flt 0;
BA_ "GenSigCycleTime" SG_ 324 MRR_RL_CRC_AngleAdjTable_Flt 20;
BA_ "GenSigSendType" SG_ 324 MRR_RL_CRC_AngleAdjTable_Flt 0;
BA_ "GenSigCycleTime" SG_ 324 MRR_RL_MC_VehicleState_Flt 20;
BA_ "GenSigSendType" SG_ 324 MRR_RL_MC_VehicleState_Flt 0;
BA_ "GenSigCycleTime" SG_ 324 MRR_RL_CRC_VehicleState_Flt 20;
BA_ "GenSigSendType" SG_ 324 MRR_RL_CRC_VehicleState_Flt 0;
BA_ "GenSigCycleTime" SG_ 324 MRR_RL_MC_TrigControl_Flt 20;
BA_ "GenSigSendType" SG_ 324 MRR_RL_MC_TrigControl_Flt 0;
BA_ "GenSigCycleTime" SG_ 324 MRR_RL_CRC_TrigControl_Flt 20;
BA_ "GenSigSendType" SG_ 324 MRR_RL_CRC_TrigControl_Flt 0;
BA_ "GenSigCycleTime" SG_ 324 MRR_RL_CRC_RadarCfgParameter_Flt 20;
BA_ "GenSigSendType" SG_ 324 MRR_RL_CRC_RadarCfgParameter_Flt 0;
BA_ "GenSigCycleTime" SG_ 324 MRR_RL_MC_CADMSgnlActlVal_Flt 20;
BA_ "GenSigSendType" SG_ 324 MRR_RL_MC_CADMSgnlActlVal_Flt 0;
BA_ "GenSigCycleTime" SG_ 324 MRR_RL_CRC_CADMSgnlActlVal_Flt 20;
BA_ "GenSigSendType" SG_ 324 MRR_RL_CRC_CADMSgnlActlVal_Flt 0;
BA_ "GenSigCycleTime" SG_ 324 MRR_RL_VINSignalCompare_Flt 20;
BA_ "GenSigSendType" SG_ 324 MRR_RL_VINSignalCompare_Flt 0;
BA_ "GenSigCycleTime" SG_ 324 MRR_RL_BatteryLow_Flt 20;
BA_ "GenSigSendType" SG_ 324 MRR_RL_BatteryLow_Flt 0;
BA_ "GenSigCycleTime" SG_ 324 MRR_RL_BatteryHigh_Flt 20;
BA_ "GenSigSendType" SG_ 324 MRR_RL_BatteryHigh_Flt 0;
BA_ "GenSigCycleTime" SG_ 324 MRR_RL_Core0_To_Core1_IPC_Flt 20;
BA_ "GenSigSendType" SG_ 324 MRR_RL_Core0_To_Core1_IPC_Flt 0;
BA_ "GenSigSendType" SG_ 324 MRR_RL_Core1_To_Core0_IPC_Flt 0;
BA_ "GenSigCycleTime" SG_ 324 MRR_RL_Core1_To_Core0_IPC_Flt 20;
BA_ "GenSigSendType" SG_ 324 MRR_RL_Core1_To_Core2_IPC_Flt 0;
BA_ "GenSigCycleTime" SG_ 324 MRR_RL_Core1_To_Core2_IPC_Flt 20;
BA_ "GenSigSendType" SG_ 324 MRR_RL_Core2_To_Core1_IPC_Flt 0;
BA_ "GenSigCycleTime" SG_ 324 MRR_RL_Core2_To_Core1_IPC_Flt 20;
BA_ "GenSigSendType" SG_ 324 MRR_RL_Core2_To_Core0_IPC_Flt 0;
BA_ "GenSigCycleTime" SG_ 324 MRR_RL_Core2_To_Core0_IPC_Flt 20;
BA_ "GenSigSendType" SG_ 324 MRR_RL_Core2Halted_Flt 0;
BA_ "GenSigCycleTime" SG_ 324 MRR_RL_Core2Halted_Flt 20;
BA_ "GenSigSendType" SG_ 324 MRR_RL_Core1Halted_Flt 0;
BA_ "GenSigCycleTime" SG_ 324 MRR_RL_Core1Halted_Flt 20;
BA_ "GenSigSendType" SG_ 324 MRR_RL_LocalOscPower_Flt 0;
BA_ "GenSigCycleTime" SG_ 324 MRR_RL_LocalOscPower_Flt 20;
BA_ "GenSigSendType" SG_ 324 MRR_RL_DSPLoopOverrun_Flt 0;
BA_ "GenSigCycleTime" SG_ 324 MRR_RL_DSPLoopOverrun_Flt 20;
BA_ "GenSigSendType" SG_ 324 MRR_RL_TransmitterPower_Flt 0;
BA_ "GenSigCycleTime" SG_ 324 MRR_RL_TransmitterPower_Flt 20;
BA_ "GenSigSendType" SG_ 324 MRR_RL_Core0_To_Core2_IPC_Flt 0;
BA_ "GenSigCycleTime" SG_ 324 MRR_RL_Core0_To_Core2_IPC_Flt 20;
BA_ "GenSigSendType" SG_ 324 MRR_RL_XCVRDeviceSPI_Flt 0;
BA_ "GenSigCycleTime" SG_ 324 MRR_RL_XCVRDeviceSPI_Flt 20;
BA_ "GenSigSendType" SG_ 324 MRR_RL_MNRBlockage_Flt 0;
BA_ "GenSigCycleTime" SG_ 324 MRR_RL_MNRBlockage_Flt 20;
BA_ "GenSigSendType" SG_ 324 MRR_RL_TransmitterTempHigh_Flt 0;
BA_ "GenSigCycleTime" SG_ 324 MRR_RL_TransmitterTempHigh_Flt 20;
BA_ "GenSigSendType" SG_ 324 MRR_RL_AlignRoutineFailed_Flt 0;
BA_ "GenSigCycleTime" SG_ 324 MRR_RL_AlignRoutineFailed_Flt 20;
BA_ "GenSigSendType" SG_ 324 MRR_RL_MicroTempHigh_Flt 0;
BA_ "GenSigCycleTime" SG_ 324 MRR_RL_MicroTempHigh_Flt 20;
BA_ "GenSigSendType" SG_ 324 MRR_RL_HAlignOutofRange_Flt 0;
BA_ "GenSigCycleTime" SG_ 324 MRR_RL_HAlignOutofRange_Flt 20;
BA_ "GenSigSendType" SG_ 324 MRR_RL_v1p1_SupplyOutOfRange_Flt 0;
BA_ "GenSigCycleTime" SG_ 324 MRR_RL_v1p1_SupplyOutOfRange_Flt 20;
BA_ "GenSigSendType" SG_ 324 MRR_RL_v1p25_SupplyOutOfRange_Fl 0;
BA_ "GenSigCycleTime" SG_ 324 MRR_RL_v1p25_SupplyOutOfRange_Fl 20;
BA_ "SystemSignalLongSymbol" SG_ 324 MRR_RL_v1p25_SupplyOutOfRange_Fl "MRR_RL_v1p25_SupplyOutOfRange_Flt";
BA_ "GenSigSendType" SG_ 324 MRR_RL_v1p8_SupplyOutOfRange_Flt 0;
BA_ "GenSigCycleTime" SG_ 324 MRR_RL_v1p8_SupplyOutOfRange_Flt 20;
BA_ "GenSigSendType" SG_ 324 MRR_RL_v2p3_SupplyOutOfRange_Flt 0;
BA_ "GenSigCycleTime" SG_ 324 MRR_RL_v2p3_SupplyOutOfRange_Flt 20;
BA_ "GenSigSendType" SG_ 324 MRR_RL_v_5_SupplyOutOfRange_Flt 0;
BA_ "GenSigCycleTime" SG_ 324 MRR_RL_v_5_SupplyOutOfRange_Flt 20;
BA_ "GenSigSendType" SG_ 324 MRR_RL_TransmitterID_Flt 0;
BA_ "GenSigCycleTime" SG_ 324 MRR_RL_TransmitterID_Flt 20;
BA_ "GenSigSendType" SG_ 324 MRR_RL_PCANBusOff_Flt 0;
BA_ "GenSigCycleTime" SG_ 324 MRR_RL_PCANBusOff_Flt 20;
BA_ "GenSigSendType" SG_ 324 MRR_RL_InstructionSetCheck_Flt 0;
BA_ "GenSigCycleTime" SG_ 324 MRR_RL_InstructionSetCheck_Flt 20;
BA_ "GenSigSendType" SG_ 324 MRR_RL_StackOverflow_Flt 0;
BA_ "GenSigCycleTime" SG_ 324 MRR_RL_StackOverflow_Flt 20;
BA_ "GenSigSendType" SG_ 324 MRR_RL_Watchdog_Flt 0;
BA_ "GenSigCycleTime" SG_ 324 MRR_RL_Watchdog_Flt 20;
BA_ "GenSigSendType" SG_ 324 MRR_RL_PLLLock_Flt 0;
BA_ "GenSigCycleTime" SG_ 324 MRR_RL_PLLLock_Flt 20;
BA_ "GenSigSendType" SG_ 324 MRR_RL_RAMMemoryTest_Flt 0;
BA_ "GenSigCycleTime" SG_ 324 MRR_RL_RAMMemoryTest_Flt 20;
BA_ "GenSigSendType" SG_ 324 MRR_RL_USCValidation_Flt 0;
BA_ "GenSigCycleTime" SG_ 324 MRR_RL_USCValidation_Flt 20;
BA_ "GenSigVtEn" SG_ 324 MRR_RL_USCValidation_Flt "*";
BA_ "GenSigSendType" SG_ 324 MRR_RL_SMCChecksum_Flt 0;
BA_ "GenSigCycleTime" SG_ 324 MRR_RL_SMCChecksum_Flt 20;
BA_ "GenSigSendType" SG_ 324 MRR_RL_KeepAliveChecksum_Flt 0;
BA_ "GenSigCycleTime" SG_ 324 MRR_RL_KeepAliveChecksum_Flt 20;
BA_ "GenSigSendType" SG_ 324 MRR_RL_ApplicationFlashChksum_Fl 0;
BA_ "GenSigCycleTime" SG_ 324 MRR_RL_ApplicationFlashChksum_Fl 20;
BA_ "SystemSignalLongSymbol" SG_ 324 MRR_RL_ApplicationFlashChksum_Fl "MRR_RL_ApplicationFlashChksum_Flt";
BA_ "GenSigCycleTime" SG_ 325 MRR_RL_RRU_Self_Test_Faults_reas 20;
BA_ "GenSigSendType" SG_ 325 MRR_RL_RRU_Self_Test_Faults_reas 0;
BA_ "SystemSignalLongSymbol" SG_ 325 MRR_RL_RRU_Self_Test_Faults_reas "MRR_RL_RRU_Self_Test_Faults_reason1";
BA_ "GenSigCycleTime" SG_ 325 MRR_RL_XBAR_cfg_failure 20;
BA_ "GenSigSendType" SG_ 325 MRR_RL_XBAR_cfg_failure 0;
BA_ "GenSigCycleTime" SG_ 325 MRR_RL_Stack_OVF_fault_reason 20;
BA_ "GenSigSendType" SG_ 325 MRR_RL_Stack_OVF_fault_reason 0;
BA_ "GenSigCycleTime" SG_ 325 MRR_RL_App_flash_checksum_reason 20;
BA_ "GenSigSendType" SG_ 325 MRR_RL_App_flash_checksum_reason 0;
BA_ "GenSigCycleTime" SG_ 325 MRR_RL_KAM_fault_reason 20;
BA_ "GenSigSendType" SG_ 325 MRR_RL_KAM_fault_reason 0;
BA_ "GenSigCycleTime" SG_ 325 MRR_RL_RRU_Core_Faults_reason3 20;
BA_ "GenSigSendType" SG_ 325 MRR_RL_RRU_Core_Faults_reason3 0;
BA_ "GenSigCycleTime" SG_ 325 MRR_RL_RRU_Core_Faults_reason2 20;
BA_ "GenSigSendType" SG_ 325 MRR_RL_RRU_Core_Faults_reason2 0;
BA_ "GenSigCycleTime" SG_ 325 MRR_RL_RRU_Core_Faults_reason1 20;
BA_ "GenSigSendType" SG_ 325 MRR_RL_RRU_Core_Faults_reason1 0;
BA_ "GenSigCycleTime" SG_ 325 MRR_RL_Rx_Radar_Mount_Msg_Fault 20;
BA_ "GenSigSendType" SG_ 325 MRR_RL_Rx_Radar_Mount_Msg_Fault 0;
BA_ "GenSigSendType" SG_ 325 MRR_RL_Dolphin_Fault_Detection 0;
BA_ "GenSigCycleTime" SG_ 325 MRR_RL_Dolphin_Fault_Detection 20;
BA_ "GenSigSendType" SG_ 325 MRR_RL_RRU_Self_Test_Faults_0000 0;
BA_ "GenSigCycleTime" SG_ 325 MRR_RL_RRU_Self_Test_Faults_0000 20;
BA_ "SystemSignalLongSymbol" SG_ 325 MRR_RL_RRU_Self_Test_Faults_0000 "MRR_RL_RRU_Self_Test_Faults_reason0";
BA_ "GenSigSendType" SG_ 325 MRR_RL_RRU_Core_Faults_reason0 0;
BA_ "GenSigCycleTime" SG_ 325 MRR_RL_RRU_Core_Faults_reason0 20;
BA_ "GenSigSendType" SG_ 325 MRR_RL_USC_Load_Error 0;
BA_ "GenSigCycleTime" SG_ 325 MRR_RL_USC_Load_Error 20;
BA_ "GenSigSendType" SG_ 325 MRR_RL_SMC_Load_Error 0;
BA_ "GenSigCycleTime" SG_ 325 MRR_RL_SMC_Load_Error 20;
BA_ "GenSigSendType" SG_ 325 MRR_RL_TX_Temperature_Flt 0;
BA_ "GenSigCycleTime" SG_ 325 MRR_RL_TX_Temperature_Flt 20;
BA_ "GenSigSendType" SG_ 325 MRR_RL_Dsp_Unit_Cal_Blk_Chcksm_E 0;
BA_ "GenSigCycleTime" SG_ 325 MRR_RL_Dsp_Unit_Cal_Blk_Chcksm_E 20;
BA_ "SystemSignalLongSymbol" SG_ 325 MRR_RL_Dsp_Unit_Cal_Blk_Chcksm_E "MRR_RL_Dsp_Unit_Cal_Blk_Chcksm_Error";
BA_ "GenSigSendType" SG_ 325 MRR_RL_Dsp_Unit_Cal_Checksum_Err 0;
BA_ "GenSigCycleTime" SG_ 325 MRR_RL_Dsp_Unit_Cal_Checksum_Err 20;
BA_ "SystemSignalLongSymbol" SG_ 325 MRR_RL_Dsp_Unit_Cal_Checksum_Err "MRR_RL_Dsp_Unit_Cal_Checksum_Error";
BA_ "GenSigSendType" SG_ 325 MRR_RL_Vertical_Misalignment_err 0;
BA_ "GenSigCycleTime" SG_ 325 MRR_RL_Vertical_Misalignment_err 20;
BA_ "SystemSignalLongSymbol" SG_ 325 MRR_RL_Vertical_Misalignment_err "MRR_RL_Vertical_Misalignment_error";
BA_ "GenSigSendType" SG_ 325 MRR_RL_RTN_SPI_Transfer_Error 0;
BA_ "GenSigCycleTime" SG_ 325 MRR_RL_RTN_SPI_Transfer_Error 20;
BA_ "GenSigSendType" SG_ 325 MRR_RL_RRN_SPI_Transfer_Error 0;
BA_ "GenSigCycleTime" SG_ 325 MRR_RL_RRN_SPI_Transfer_Error 20;
BA_ "GenSigSendType" SG_ 325 MRR_RL_Linearizer_SPI_Transfer_E 0;
BA_ "GenSigCycleTime" SG_ 325 MRR_RL_Linearizer_SPI_Transfer_E 20;
BA_ "SystemSignalLongSymbol" SG_ 325 MRR_RL_Linearizer_SPI_Transfer_E "MRR_RL_Linearizer_SPI_Transfer_Error";
BA_ "GenSigSendType" SG_ 325 MRR_RL_ADC_SPI_Transfer_Error 0;
BA_ "GenSigCycleTime" SG_ 325 MRR_RL_ADC_SPI_Transfer_Error 20;
BA_ "GenSigSendType" SG_ 325 MRR_RL_Transmitter_ID_Error 0;
BA_ "GenSigCycleTime" SG_ 325 MRR_RL_Transmitter_ID_Error 20;
BA_ "GenSigSendType" SG_ 325 MRR_RL_Dsp_Loop_Overrun_Error 0;
BA_ "GenSigCycleTime" SG_ 325 MRR_RL_Dsp_Loop_Overrun_Error 20;
BA_ "GenSigSendType" SG_ 325 MRR_RL_Saturated_Tuning_Freq_Err 0;
BA_ "GenSigCycleTime" SG_ 325 MRR_RL_Saturated_Tuning_Freq_Err 20;
BA_ "SystemSignalLongSymbol" SG_ 325 MRR_RL_Saturated_Tuning_Freq_Err "MRR_RL_Saturated_Tuning_Freq_Error";
BA_ "GenSigSendType" SG_ 325 MRR_RL_Radar_Data_sync_error 0;
BA_ "GenSigCycleTime" SG_ 325 MRR_RL_Radar_Data_sync_error 20;
BA_ "GenSigSendType" SG_ 325 MRR_RL_Dsp_Tuning_Sensitivity_Er 0;
BA_ "GenSigCycleTime" SG_ 325 MRR_RL_Dsp_Tuning_Sensitivity_Er 20;
BA_ "SystemSignalLongSymbol" SG_ 325 MRR_RL_Dsp_Tuning_Sensitivity_Er "MRR_RL_Dsp_Tuning_Sensitivity_Error";
BA_ "GenSigSendType" SG_ 325 MRR_RL_Radar_LO_Power_Error 0;
BA_ "GenSigCycleTime" SG_ 325 MRR_RL_Radar_LO_Power_Error 20;
BA_ "GenSigSendType" SG_ 325 MRR_RL_Radar_TX_Power_Error 0;
BA_ "GenSigCycleTime" SG_ 325 MRR_RL_Radar_TX_Power_Error 20;
BA_ "GenSigSendType" SG_ 325 MRR_RL_Timer_Create_Error 0;
BA_ "GenSigCycleTime" SG_ 325 MRR_RL_Timer_Create_Error 20;
BA_ "GenSigSendType" SG_ 325 MRR_RL_Thread_Create_Error 0;
BA_ "GenSigCycleTime" SG_ 325 MRR_RL_Thread_Create_Error 20;
BA_ "GenSigCycleTime" SG_ 325 MRR_RL_ARM_Calibration_Error 20;
BA_ "GenSigSendType" SG_ 325 MRR_RL_ARM_Calibration_Error 0;
BA_ "GenSigSendType" SG_ 325 MRR_RL_SPI_FEE_Error 0;
BA_ "GenSigCycleTime" SG_ 325 MRR_RL_SPI_FEE_Error 20;
BA_ "GenSigSendType" SG_ 325 MRR_RL_SPI_Comm_Error 0;
BA_ "GenSigCycleTime" SG_ 325 MRR_RL_SPI_Comm_Error 20;
BA_ "GenSigSendType" SG_ 325 MRR_RL_Socket_Write_Error 0;
BA_ "GenSigCycleTime" SG_ 325 MRR_RL_Socket_Write_Error 20;
BA_ "GenSigSendType" SG_ 325 MRR_RL_Socket_Read_error 0;
BA_ "GenSigCycleTime" SG_ 325 MRR_RL_Socket_Read_error 20;
BA_ "GenSigSendType" SG_ 325 MRR_RL_Socket_Init_Error 0;
BA_ "GenSigCycleTime" SG_ 325 MRR_RL_Socket_Init_Error 20;
BA_ "GenSigSendType" SG_ 325 MRR_RL_Signal_Wait_Error 0;
BA_ "GenSigCycleTime" SG_ 325 MRR_RL_Signal_Wait_Error 20;
BA_ "GenSigSendType" SG_ 325 MRR_RL_Signal_Send_Error 0;
BA_ "GenSigCycleTime" SG_ 325 MRR_RL_Signal_Send_Error 20;
BA_ "GenSigSendType" SG_ 325 MRR_RL_Signal_Create_Error 0;
BA_ "GenSigCycleTime" SG_ 325 MRR_RL_Signal_Create_Error 20;
BA_ "GenSigSendType" SG_ 325 MRR_RL_Shared_Mem_Write_Error 0;
BA_ "GenSigCycleTime" SG_ 325 MRR_RL_Shared_Mem_Write_Error 20;
BA_ "GenSigSendType" SG_ 325 MRR_RL_Shared_Mem_Read_Error 0;
BA_ "GenSigCycleTime" SG_ 325 MRR_RL_Shared_Mem_Read_Error 20;
BA_ "GenSigSendType" SG_ 325 MRR_RL_Shared_Mem_Config_Error 0;
BA_ "GenSigCycleTime" SG_ 325 MRR_RL_Shared_Mem_Config_Error 20;
BA_ "GenSigSendType" SG_ 325 MRR_RL_Share_Mem_Init_Error 0;
BA_ "GenSigCycleTime" SG_ 325 MRR_RL_Share_Mem_Init_Error 20;
BA_ "GenSigSendType" SG_ 325 MRR_RL_RAM_Test_Error 0;
BA_ "GenSigCycleTime" SG_ 325 MRR_RL_RAM_Test_Error 20;
BA_ "GenSigSendType" SG_ 325 MRR_RL_Num_Errors 0;
BA_ "GenSigCycleTime" SG_ 325 MRR_RL_Num_Errors 20;
BA_ "GenSigSendType" SG_ 325 MRR_RL_MMAP_Memory_Error 0;
BA_ "GenSigCycleTime" SG_ 325 MRR_RL_MMAP_Memory_Error 20;
BA_ "GenSigSendType" SG_ 325 MRR_RL_ISR_Attach_Error 0;
BA_ "GenSigCycleTime" SG_ 325 MRR_RL_ISR_Attach_Error 20;
BA_ "GenSigSendType" SG_ 325 MRR_RL_IPC_DRV_Write_Error 0;
BA_ "GenSigCycleTime" SG_ 325 MRR_RL_IPC_DRV_Write_Error 20;
BA_ "GenSigSendType" SG_ 325 MRR_RL_IPC_DRV_Trigger_Error 0;
BA_ "GenSigCycleTime" SG_ 325 MRR_RL_IPC_DRV_Trigger_Error 20;
BA_ "GenSigSendType" SG_ 325 MRR_RL_IPC_DRV_Sync_Error 0;
BA_ "GenSigCycleTime" SG_ 325 MRR_RL_IPC_DRV_Sync_Error 20;
BA_ "GenSigSendType" SG_ 325 MRR_RL_IPC_DRV_Read_Error 0;
BA_ "GenSigCycleTime" SG_ 325 MRR_RL_IPC_DRV_Read_Error 20;
BA_ "GenSigSendType" SG_ 325 MRR_RL_IPC_DRV_Init_Error 0;
BA_ "GenSigCycleTime" SG_ 325 MRR_RL_IPC_DRV_Init_Error 20;
BA_ "GenSigSendType" SG_ 325 MRR_RL_Interrupt_Enable_Error 0;
BA_ "GenSigCycleTime" SG_ 325 MRR_RL_Interrupt_Enable_Error 20;
BA_ "GenSigSendType" SG_ 325 MRR_RL_HIL_Format_Error 0;
BA_ "GenSigCycleTime" SG_ 325 MRR_RL_HIL_Format_Error 20;
BA_ "GenSigSendType" SG_ 325 MRR_RL_Flash_Filesystem_Error 0;
BA_ "GenSigCycleTime" SG_ 325 MRR_RL_Flash_Filesystem_Error 20;
BA_ "GenSigSendType" SG_ 325 MRR_RL_Error_none 0;
BA_ "GenSigCycleTime" SG_ 325 MRR_RL_Error_none 20;
BA_ "GenSigSendType" SG_ 325 MRR_RL_Dsp_Load_Read_Error 0;
BA_ "GenSigCycleTime" SG_ 325 MRR_RL_Dsp_Load_Read_Error 20;
BA_ "GenSigSendType" SG_ 325 MRR_RL_Dsp_Load_Open_Error 0;
BA_ "GenSigCycleTime" SG_ 325 MRR_RL_Dsp_Load_Open_Error 20;
BA_ "GenSigSendType" SG_ 325 MRR_RL_Dsp_Load_Address_Error 0;
BA_ "GenSigCycleTime" SG_ 325 MRR_RL_Dsp_Load_Address_Error 20;
BA_ "GenSigCycleTime" SG_ 325 MRR_RL_Dsp_ISP_Write_Error 20;
BA_ "GenSigSendType" SG_ 325 MRR_RL_Dsp_ISP_Write_Error 0;
BA_ "GenSigSendType" SG_ 325 MRR_RL_Dsp_IPC_Read_Error 0;
BA_ "GenSigCycleTime" SG_ 325 MRR_RL_Dsp_IPC_Read_Error 20;
BA_ "GenSigSendType" SG_ 325 MRR_RL_Dsp_IPC_Init 0;
BA_ "GenSigCycleTime" SG_ 325 MRR_RL_Dsp_IPC_Init 20;
BA_ "GenSigSendType" SG_ 325 MRR_RL_Dsp_Init_Error 0;
BA_ "GenSigCycleTime" SG_ 325 MRR_RL_Dsp_Init_Error 20;
BA_ "GenSigSendType" SG_ 325 MRR_RL_Dsp_DRV_Start_Error 0;
BA_ "GenSigCycleTime" SG_ 325 MRR_RL_Dsp_DRV_Start_Error 20;
BA_ "GenSigSendType" SG_ 325 MRR_RL_Dsp_DRV_Load_Error 0;
BA_ "GenSigCycleTime" SG_ 325 MRR_RL_Dsp_DRV_Load_Error 20;
BA_ "GenSigSendType" SG_ 325 MRR_RL_Dsp_DRV_Init_Error 0;
BA_ "GenSigCycleTime" SG_ 325 MRR_RL_Dsp_DRV_Init_Error 20;
BA_ "GenSigSendType" SG_ 325 MRR_RL_Dsp_DRV_Init2_error 0;
BA_ "GenSigCycleTime" SG_ 325 MRR_RL_Dsp_DRV_Init2_error 20;
BA_ "GenSigSendType" SG_ 325 MRR_RL_Dsp_DRV_Init1_error 0;
BA_ "GenSigCycleTime" SG_ 325 MRR_RL_Dsp_DRV_Init1_error 20;
BA_ "GenSigCycleTime" SG_ 325 MRR_RL_CAN_XMT_Error 20;
BA_ "GenSigSendType" SG_ 325 MRR_RL_CAN_XMT_Error 0;
BA_ "GenSigSendType" SG_ 325 MRR_RL_CAN_RCV_Error 0;
BA_ "GenSigCycleTime" SG_ 325 MRR_RL_CAN_RCV_Error 20;
BA_ "GenSigSendType" SG_ 325 MRR_RL_CAN_Hardware_Error 0;
BA_ "GenSigCycleTime" SG_ 325 MRR_RL_CAN_Hardware_Error 20;
BA_ "GenSigSendType" SG_ 325 MRR_RL_Always_True 0;
BA_ "GenSigCycleTime" SG_ 325 MRR_RL_Always_True 20;
BA_ "GenSigSendType" SG_ 1289 MRR_RL_CAN_DET_MID_TARGET_064 1;
BA_ "SignalDescription" SG_ 1289 MRR_RL_CAN_DET_MID_TARGET_064 "MID_Target_Discrimination";
BA_ "SignalDescription" SG_ 1289 MRR_RL_CAN_DET_Near_TARGET_064 "Near_Target_Discrimination";
BA_ "GenSigCmt" SG_ 1289 MRR_RL_CAN_DET_SUPER_RES_TARGET_ "Super resolution target ";
BA_ "SystemSignalLongSymbol" SG_ 1289 MRR_RL_CAN_DET_SUPER_RES_TARGET_ "MRR_RL_CAN_DET_SUPER_RES_TARGET_064";
BA_ "GenSigStartValue" SG_ 1289 MRR_RL_CAN_DET_ELEVATION_064 63.8646288209607;
BA_ "GenSigCmt" SG_ 1289 MRR_RL_CAN_DET_ELEVATION_064 "Detected object elevation position";
BA_ "GenSigCmt" SG_ 1289 MRR_RL_CAN_DET_HOST_VEH_CLUTTER_ "Host vehicle clutter";
BA_ "SystemSignalLongSymbol" SG_ 1289 MRR_RL_CAN_DET_HOST_VEH_CLUTTER_ "MRR_RL_CAN_DET_HOST_VEH_CLUTTER_064";
BA_ "GenSigCmt" SG_ 1289 MRR_RL_CAN_DET_CONFID_ELEVATION_ "Elevation Angle Confidence";
BA_ "SystemSignalLongSymbol" SG_ 1289 MRR_RL_CAN_DET_CONFID_ELEVATION_ "MRR_RL_CAN_DET_CONFID_ELEVATION_064";
BA_ "GenSigStartValue" SG_ 1289 MRR_RL_CAN_DET_AZIMUTH_064 8194.05320813772;
BA_ "GenSigCmt" SG_ 1289 MRR_RL_CAN_DET_AZIMUTH_064 "Detected object azimuth position";
BA_ "GenSigCmt" SG_ 1289 MRR_RL_CAN_DET_CONFID_AZIMUTH_06 "Signal to noise level";
BA_ "GenSigVtEn" SG_ 1289 MRR_RL_CAN_DET_CONFID_AZIMUTH_06 "TRUE";
BA_ "SystemSignalLongSymbol" SG_ 1289 MRR_RL_CAN_DET_CONFID_AZIMUTH_06 "MRR_RL_CAN_DET_CONFID_AZIMUTH_064";
BA_ "GenSigCmt" SG_ 1289 MRR_RL_CAN_DET_RANGE_064 "Detected object range";
BA_ "GenSigCmt" SG_ 1289 MRR_RL_CAN_SCAN_INDEX_2LSB_064 "The two LSB of scan index";
BA_ "GenSigStartValue" SG_ 1289 MRR_RL_CAN_DET_RANGE_RATE_064 8192;
BA_ "GenSigCmt" SG_ 1289 MRR_RL_CAN_DET_RANGE_RATE_064 "Detected object range rate";
BA_ "GenSigCmt" SG_ 1289 MRR_RL_CAN_DET_VALID_LEVEL_064 "Detected object valid level";
BA_ "GenSigStartValue" SG_ 1289 MRR_RL_CAN_DET_AMPLITUDE_064 64;
BA_ "GenSigCmt" SG_ 1289 MRR_RL_CAN_DET_AMPLITUDE_064 "Detected object amplitude";
BA_ "GenSigSendType" SG_ 1288 MRR_RL_CAN_DET_MID_TARGET_063 1;
BA_ "SignalDescription" SG_ 1288 MRR_RL_CAN_DET_MID_TARGET_063 "MID_Target_Discrimination";
BA_ "SignalDescription" SG_ 1288 MRR_RL_CAN_DET_MID_TARGET_062 "MID_Target_Discrimination";
BA_ "SignalDescription" SG_ 1288 MRR_RL_CAN_DET_MID_TARGET_061 "MID_Target_Discrimination";
BA_ "SignalDescription" SG_ 1288 MRR_RL_CAN_DET_MID_TARGET_060 "MID_Target_Discrimination";
BA_ "SignalDescription" SG_ 1288 MRR_RL_CAN_DET_MID_TARGET_059 "MID_Target_Discrimination";
BA_ "SignalDescription" SG_ 1288 MRR_RL_CAN_DET_MID_TARGET_058 "MID_Target_Discrimination";
BA_ "SignalDescription" SG_ 1288 MRR_RL_CAN_DET_MID_TARGET_057 "MID_Target_Discrimination";
BA_ "SignalDescription" SG_ 1288 MRR_RL_CAN_DET_Near_TARGET_057 "Near_Target_Discrimination";
BA_ "SignalDescription" SG_ 1288 MRR_RL_CAN_DET_Near_TARGET_058 "Near_Target_Discrimination";
BA_ "SignalDescription" SG_ 1288 MRR_RL_CAN_DET_Near_TARGET_059 "Near_Target_Discrimination";
BA_ "SignalDescription" SG_ 1288 MRR_RL_CAN_DET_Near_TARGET_060 "Near_Target_Discrimination";
BA_ "SignalDescription" SG_ 1288 MRR_RL_CAN_DET_Near_TARGET_061 "Near_Target_Discrimination";
BA_ "SignalDescription" SG_ 1288 MRR_RL_CAN_DET_Near_TARGET_062 "Near_Target_Discrimination";
BA_ "SignalDescription" SG_ 1288 MRR_RL_CAN_DET_Near_TARGET_063 "Near_Target_Discrimination";
BA_ "GenSigCmt" SG_ 1288 MRR_RL_CAN_DET_SUPER_RES_TA_0000 "Super resolution target ";
BA_ "SystemSignalLongSymbol" SG_ 1288 MRR_RL_CAN_DET_SUPER_RES_TA_0000 "MRR_RL_CAN_DET_SUPER_RES_TARGET_063";
BA_ "GenSigStartValue" SG_ 1288 MRR_RL_CAN_DET_ELEVATION_063 63.8646288209607;
BA_ "GenSigCmt" SG_ 1288 MRR_RL_CAN_DET_ELEVATION_063 "Detected object elevation position";
BA_ "GenSigCmt" SG_ 1288 MRR_RL_CAN_DET_HOST_VEH_CLU_0000 "Host vehicle clutter";
BA_ "SystemSignalLongSymbol" SG_ 1288 MRR_RL_CAN_DET_HOST_VEH_CLU_0000 "MRR_RL_CAN_DET_HOST_VEH_CLUTTER_063";
BA_ "GenSigCmt" SG_ 1288 MRR_RL_CAN_DET_CONFID_ELEVA_0000 "Elevation Angle Confidence";
BA_ "SystemSignalLongSymbol" SG_ 1288 MRR_RL_CAN_DET_CONFID_ELEVA_0000 "MRR_RL_CAN_DET_CONFID_ELEVATION_063";
BA_ "GenSigCmt" SG_ 1288 MRR_RL_CAN_DET_AZIMUTH_063 "Detected object azimuth position";
BA_ "GenSigStartValue" SG_ 1288 MRR_RL_CAN_DET_AZIMUTH_063 8194.05320813772;
BA_ "GenSigVtEn" SG_ 1288 MRR_RL_CAN_DET_CONFID_AZIMU_0000 "TRUE";
BA_ "GenSigCmt" SG_ 1288 MRR_RL_CAN_DET_CONFID_AZIMU_0000 "Signal to noise level";
BA_ "SystemSignalLongSymbol" SG_ 1288 MRR_RL_CAN_DET_CONFID_AZIMU_0000 "MRR_RL_CAN_DET_CONFID_AZIMUTH_063";
BA_ "GenSigCmt" SG_ 1288 MRR_RL_CAN_DET_RANGE_063 "Detected object range";
BA_ "GenSigCmt" SG_ 1288 MRR_RL_CAN_SCAN_INDEX_2LSB_063 "The two LSB of scan index";
BA_ "GenSigCmt" SG_ 1288 MRR_RL_CAN_DET_RANGE_RATE_063 "Detected object range rate";
BA_ "GenSigStartValue" SG_ 1288 MRR_RL_CAN_DET_RANGE_RATE_063 8192;
BA_ "GenSigCmt" SG_ 1288 MRR_RL_CAN_DET_VALID_LEVEL_063 "Detected object valid level";
BA_ "GenSigCmt" SG_ 1288 MRR_RL_CAN_DET_AMPLITUDE_063 "Detected object amplitude";
BA_ "GenSigStartValue" SG_ 1288 MRR_RL_CAN_DET_AMPLITUDE_063 64;
BA_ "GenSigCmt" SG_ 1288 MRR_RL_CAN_DET_SUPER_RES_TA_0001 "Super resolution target ";
BA_ "SystemSignalLongSymbol" SG_ 1288 MRR_RL_CAN_DET_SUPER_RES_TA_0001 "MRR_RL_CAN_DET_SUPER_RES_TARGET_062";
BA_ "GenSigCmt" SG_ 1288 MRR_RL_CAN_DET_ELEVATION_062 "Detected object elevation position";
BA_ "GenSigStartValue" SG_ 1288 MRR_RL_CAN_DET_ELEVATION_062 63.8646288209607;
BA_ "GenSigCmt" SG_ 1288 MRR_RL_CAN_DET_HOST_VEH_CLU_0001 "Host vehicle clutter";
BA_ "SystemSignalLongSymbol" SG_ 1288 MRR_RL_CAN_DET_HOST_VEH_CLU_0001 "MRR_RL_CAN_DET_HOST_VEH_CLUTTER_062";
BA_ "GenSigCmt" SG_ 1288 MRR_RL_CAN_DET_CONFID_ELEVA_0001 "Elevation Angle Confidence";
BA_ "SystemSignalLongSymbol" SG_ 1288 MRR_RL_CAN_DET_CONFID_ELEVA_0001 "MRR_RL_CAN_DET_CONFID_ELEVATION_062";
BA_ "GenSigCmt" SG_ 1288 MRR_RL_CAN_DET_AZIMUTH_062 "Detected object azimuth position";
BA_ "GenSigStartValue" SG_ 1288 MRR_RL_CAN_DET_AZIMUTH_062 8194.05320813772;
BA_ "GenSigVtEn" SG_ 1288 MRR_RL_CAN_DET_CONFID_AZIMU_0001 "TRUE";
BA_ "GenSigCmt" SG_ 1288 MRR_RL_CAN_DET_CONFID_AZIMU_0001 "Signal to noise level";
BA_ "SystemSignalLongSymbol" SG_ 1288 MRR_RL_CAN_DET_CONFID_AZIMU_0001 "MRR_RL_CAN_DET_CONFID_AZIMUTH_062";
BA_ "GenSigCmt" SG_ 1288 MRR_RL_CAN_DET_RANGE_062 "Detected object range";
BA_ "GenSigCmt" SG_ 1288 MRR_RL_CAN_SCAN_INDEX_2LSB_062 "The two LSB of scan index";
BA_ "GenSigCmt" SG_ 1288 MRR_RL_CAN_DET_RANGE_RATE_062 "Detected object range rate";
BA_ "GenSigStartValue" SG_ 1288 MRR_RL_CAN_DET_RANGE_RATE_062 8192;
BA_ "GenSigCmt" SG_ 1288 MRR_RL_CAN_DET_VALID_LEVEL_062 "Detected object valid level";
BA_ "GenSigCmt" SG_ 1288 MRR_RL_CAN_DET_AMPLITUDE_062 "Detected object amplitude";
BA_ "GenSigStartValue" SG_ 1288 MRR_RL_CAN_DET_AMPLITUDE_062 64;
BA_ "GenSigCmt" SG_ 1288 MRR_RL_CAN_DET_SUPER_RES_TA_0002 "Super resolution target ";
BA_ "SystemSignalLongSymbol" SG_ 1288 MRR_RL_CAN_DET_SUPER_RES_TA_0002 "MRR_RL_CAN_DET_SUPER_RES_TARGET_061";
BA_ "GenSigCmt" SG_ 1288 MRR_RL_CAN_DET_ELEVATION_061 "Detected object elevation position";
BA_ "GenSigStartValue" SG_ 1288 MRR_RL_CAN_DET_ELEVATION_061 63.8646288209607;
BA_ "GenSigCmt" SG_ 1288 MRR_RL_CAN_DET_HOST_VEH_CLU_0002 "Host vehicle clutter";
BA_ "SystemSignalLongSymbol" SG_ 1288 MRR_RL_CAN_DET_HOST_VEH_CLU_0002 "MRR_RL_CAN_DET_HOST_VEH_CLUTTER_061";
BA_ "GenSigCmt" SG_ 1288 MRR_RL_CAN_DET_CONFID_ELEVA_0002 "Elevation Angle Confidence";
BA_ "SystemSignalLongSymbol" SG_ 1288 MRR_RL_CAN_DET_CONFID_ELEVA_0002 "MRR_RL_CAN_DET_CONFID_ELEVATION_061";
BA_ "GenSigCmt" SG_ 1288 MRR_RL_CAN_DET_AZIMUTH_061 "Detected object azimuth position";
BA_ "GenSigStartValue" SG_ 1288 MRR_RL_CAN_DET_AZIMUTH_061 8194.05320813772;
BA_ "GenSigVtEn" SG_ 1288 MRR_RL_CAN_DET_CONFID_AZIMU_0002 "TRUE";
BA_ "GenSigCmt" SG_ 1288 MRR_RL_CAN_DET_CONFID_AZIMU_0002 "Signal to noise level";
BA_ "SystemSignalLongSymbol" SG_ 1288 MRR_RL_CAN_DET_CONFID_AZIMU_0002 "MRR_RL_CAN_DET_CONFID_AZIMUTH_061";
BA_ "GenSigCmt" SG_ 1288 MRR_RL_CAN_DET_RANGE_061 "Detected object range";
BA_ "GenSigCmt" SG_ 1288 MRR_RL_CAN_SCAN_INDEX_2LSB_061 "The two LSB of scan index";
BA_ "GenSigCmt" SG_ 1288 MRR_RL_CAN_DET_RANGE_RATE_061 "Detected object range rate";
BA_ "GenSigStartValue" SG_ 1288 MRR_RL_CAN_DET_RANGE_RATE_061 8192;
BA_ "GenSigCmt" SG_ 1288 MRR_RL_CAN_DET_VALID_LEVEL_061 "Detected object valid level";
BA_ "GenSigCmt" SG_ 1288 MRR_RL_CAN_DET_AMPLITUDE_061 "Detected object amplitude";
BA_ "GenSigStartValue" SG_ 1288 MRR_RL_CAN_DET_AMPLITUDE_061 64;
BA_ "GenSigCmt" SG_ 1288 MRR_RL_CAN_DET_SUPER_RES_TA_0003 "Super resolution target ";
BA_ "SystemSignalLongSymbol" SG_ 1288 MRR_RL_CAN_DET_SUPER_RES_TA_0003 "MRR_RL_CAN_DET_SUPER_RES_TARGET_060";
BA_ "GenSigCmt" SG_ 1288 MRR_RL_CAN_DET_ELEVATION_060 "Detected object elevation position";
BA_ "GenSigStartValue" SG_ 1288 MRR_RL_CAN_DET_ELEVATION_060 63.8646288209607;
BA_ "GenSigCmt" SG_ 1288 MRR_RL_CAN_DET_HOST_VEH_CLU_0003 "Host vehicle clutter";
BA_ "SystemSignalLongSymbol" SG_ 1288 MRR_RL_CAN_DET_HOST_VEH_CLU_0003 "MRR_RL_CAN_DET_HOST_VEH_CLUTTER_060";
BA_ "GenSigCmt" SG_ 1288 MRR_RL_CAN_DET_CONFID_ELEVA_0003 "Elevation Angle Confidence";
BA_ "SystemSignalLongSymbol" SG_ 1288 MRR_RL_CAN_DET_CONFID_ELEVA_0003 "MRR_RL_CAN_DET_CONFID_ELEVATION_060";
BA_ "GenSigCmt" SG_ 1288 MRR_RL_CAN_DET_AZIMUTH_060 "Detected object azimuth position";
BA_ "GenSigStartValue" SG_ 1288 MRR_RL_CAN_DET_AZIMUTH_060 8194.05320813772;
BA_ "GenSigVtEn" SG_ 1288 MRR_RL_CAN_DET_CONFID_AZIMU_0003 "TRUE";
BA_ "GenSigCmt" SG_ 1288 MRR_RL_CAN_DET_CONFID_AZIMU_0003 "Signal to noise level";
BA_ "SystemSignalLongSymbol" SG_ 1288 MRR_RL_CAN_DET_CONFID_AZIMU_0003 "MRR_RL_CAN_DET_CONFID_AZIMUTH_060";
BA_ "GenSigCmt" SG_ 1288 MRR_RL_CAN_DET_RANGE_060 "Detected object range";
BA_ "GenSigCmt" SG_ 1288 MRR_RL_CAN_SCAN_INDEX_2LSB_060 "The two LSB of scan index";
BA_ "GenSigCmt" SG_ 1288 MRR_RL_CAN_DET_RANGE_RATE_060 "Detected object range rate";
BA_ "GenSigStartValue" SG_ 1288 MRR_RL_CAN_DET_RANGE_RATE_060 8192;
BA_ "GenSigCmt" SG_ 1288 MRR_RL_CAN_DET_VALID_LEVEL_060 "Detected object valid level";
BA_ "GenSigCmt" SG_ 1288 MRR_RL_CAN_DET_AMPLITUDE_060 "Detected object amplitude";
BA_ "GenSigStartValue" SG_ 1288 MRR_RL_CAN_DET_AMPLITUDE_060 64;
BA_ "GenSigCmt" SG_ 1288 MRR_RL_CAN_DET_SUPER_RES_TA_0004 "Super resolution target ";
BA_ "SystemSignalLongSymbol" SG_ 1288 MRR_RL_CAN_DET_SUPER_RES_TA_0004 "MRR_RL_CAN_DET_SUPER_RES_TARGET_059";
BA_ "GenSigCmt" SG_ 1288 MRR_RL_CAN_DET_ELEVATION_059 "Detected object elevation position";
BA_ "GenSigStartValue" SG_ 1288 MRR_RL_CAN_DET_ELEVATION_059 63.8646288209607;
BA_ "GenSigCmt" SG_ 1288 MRR_RL_CAN_DET_HOST_VEH_CLU_0004 "Host vehicle clutter";
BA_ "SystemSignalLongSymbol" SG_ 1288 MRR_RL_CAN_DET_HOST_VEH_CLU_0004 "MRR_RL_CAN_DET_HOST_VEH_CLUTTER_059";
BA_ "GenSigCmt" SG_ 1288 MRR_RL_CAN_DET_CONFID_ELEVA_0004 "Elevation Angle Confidence";
BA_ "SystemSignalLongSymbol" SG_ 1288 MRR_RL_CAN_DET_CONFID_ELEVA_0004 "MRR_RL_CAN_DET_CONFID_ELEVATION_059";
BA_ "GenSigCmt" SG_ 1288 MRR_RL_CAN_DET_AZIMUTH_059 "Detected object azimuth position";
BA_ "GenSigStartValue" SG_ 1288 MRR_RL_CAN_DET_AZIMUTH_059 8194.05320813772;
BA_ "GenSigVtEn" SG_ 1288 MRR_RL_CAN_DET_CONFID_AZIMUTH_05 "TRUE";
BA_ "GenSigCmt" SG_ 1288 MRR_RL_CAN_DET_CONFID_AZIMUTH_05 "Signal to noise level";
BA_ "SystemSignalLongSymbol" SG_ 1288 MRR_RL_CAN_DET_CONFID_AZIMUTH_05 "MRR_RL_CAN_DET_CONFID_AZIMUTH_059";
BA_ "GenSigCmt" SG_ 1288 MRR_RL_CAN_DET_RANGE_059 "Detected object range";
BA_ "GenSigCmt" SG_ 1288 MRR_RL_CAN_SCAN_INDEX_2LSB_059 "The two LSB of scan index";
BA_ "GenSigCmt" SG_ 1288 MRR_RL_CAN_DET_RANGE_RATE_059 "Detected object range rate";
BA_ "GenSigStartValue" SG_ 1288 MRR_RL_CAN_DET_RANGE_RATE_059 8192;
BA_ "GenSigCmt" SG_ 1288 MRR_RL_CAN_DET_VALID_LEVEL_059 "Detected object valid level";
BA_ "GenSigCmt" SG_ 1288 MRR_RL_CAN_DET_AMPLITUDE_059 "Detected object amplitude";
BA_ "GenSigStartValue" SG_ 1288 MRR_RL_CAN_DET_AMPLITUDE_059 64;
BA_ "GenSigCmt" SG_ 1288 MRR_RL_CAN_DET_SUPER_RES_TA_0005 "Super resolution target ";
BA_ "SystemSignalLongSymbol" SG_ 1288 MRR_RL_CAN_DET_SUPER_RES_TA_0005 "MRR_RL_CAN_DET_SUPER_RES_TARGET_058";
BA_ "GenSigCmt" SG_ 1288 MRR_RL_CAN_DET_ELEVATION_058 "Detected object elevation position";
BA_ "GenSigStartValue" SG_ 1288 MRR_RL_CAN_DET_ELEVATION_058 63.8646288209607;
BA_ "GenSigCmt" SG_ 1288 MRR_RL_CAN_DET_HOST_VEH_CLU_0005 "Host vehicle clutter";
BA_ "SystemSignalLongSymbol" SG_ 1288 MRR_RL_CAN_DET_HOST_VEH_CLU_0005 "MRR_RL_CAN_DET_HOST_VEH_CLUTTER_058";
BA_ "GenSigCmt" SG_ 1288 MRR_RL_CAN_DET_CONFID_ELEVA_0005 "Elevation Angle Confidence";
BA_ "SystemSignalLongSymbol" SG_ 1288 MRR_RL_CAN_DET_CONFID_ELEVA_0005 "MRR_RL_CAN_DET_CONFID_ELEVATION_058";
BA_ "GenSigCmt" SG_ 1288 MRR_RL_CAN_DET_AZIMUTH_058 "Detected object azimuth position";
BA_ "GenSigStartValue" SG_ 1288 MRR_RL_CAN_DET_AZIMUTH_058 8194.05320813772;
BA_ "GenSigVtEn" SG_ 1288 MRR_RL_CAN_DET_CONFID_AZIMU_0004 "TRUE";
BA_ "GenSigCmt" SG_ 1288 MRR_RL_CAN_DET_CONFID_AZIMU_0004 "Signal to noise level";
BA_ "SystemSignalLongSymbol" SG_ 1288 MRR_RL_CAN_DET_CONFID_AZIMU_0004 "MRR_RL_CAN_DET_CONFID_AZIMUTH_058";
BA_ "GenSigCmt" SG_ 1288 MRR_RL_CAN_DET_RANGE_058 "Detected object range";
BA_ "GenSigCmt" SG_ 1288 MRR_RL_CAN_SCAN_INDEX_2LSB_058 "The two LSB of scan index";
BA_ "GenSigCmt" SG_ 1288 MRR_RL_CAN_DET_RANGE_RATE_058 "Detected object range rate";
BA_ "GenSigStartValue" SG_ 1288 MRR_RL_CAN_DET_RANGE_RATE_058 8192;
BA_ "GenSigCmt" SG_ 1288 MRR_RL_CAN_DET_VALID_LEVEL_058 "Detected object valid level";
BA_ "GenSigCmt" SG_ 1288 MRR_RL_CAN_DET_AMPLITUDE_058 "Detected object amplitude";
BA_ "GenSigStartValue" SG_ 1288 MRR_RL_CAN_DET_AMPLITUDE_058 64;
BA_ "GenSigCmt" SG_ 1288 MRR_RL_CAN_DET_SUPER_RES_TA_0006 "Super resolution target ";
BA_ "SystemSignalLongSymbol" SG_ 1288 MRR_RL_CAN_DET_SUPER_RES_TA_0006 "MRR_RL_CAN_DET_SUPER_RES_TARGET_057";
BA_ "GenSigCmt" SG_ 1288 MRR_RL_CAN_DET_ELEVATION_057 "Detected object elevation position";
BA_ "GenSigStartValue" SG_ 1288 MRR_RL_CAN_DET_ELEVATION_057 63.8646288209607;
BA_ "GenSigCmt" SG_ 1288 MRR_RL_CAN_DET_HOST_VEH_CLU_0006 "Host vehicle clutter";
BA_ "SystemSignalLongSymbol" SG_ 1288 MRR_RL_CAN_DET_HOST_VEH_CLU_0006 "MRR_RL_CAN_DET_HOST_VEH_CLUTTER_057";
BA_ "GenSigCmt" SG_ 1288 MRR_RL_CAN_DET_CONFID_ELEVA_0006 "Elevation Angle Confidence";
BA_ "SystemSignalLongSymbol" SG_ 1288 MRR_RL_CAN_DET_CONFID_ELEVA_0006 "MRR_RL_CAN_DET_CONFID_ELEVATION_057";
BA_ "GenSigCmt" SG_ 1288 MRR_RL_CAN_DET_AZIMUTH_057 "Detected object azimuth position";
BA_ "GenSigStartValue" SG_ 1288 MRR_RL_CAN_DET_AZIMUTH_057 8194.05320813772;
BA_ "GenSigVtEn" SG_ 1288 MRR_RL_CAN_DET_CONFID_AZIMU_0005 "TRUE";
BA_ "GenSigCmt" SG_ 1288 MRR_RL_CAN_DET_CONFID_AZIMU_0005 "Signal to noise level";
BA_ "SystemSignalLongSymbol" SG_ 1288 MRR_RL_CAN_DET_CONFID_AZIMU_0005 "MRR_RL_CAN_DET_CONFID_AZIMUTH_057";
BA_ "GenSigCmt" SG_ 1288 MRR_RL_CAN_DET_RANGE_057 "Detected object range";
BA_ "GenSigCmt" SG_ 1288 MRR_RL_CAN_SCAN_INDEX_2LSB_057 "The two LSB of scan index";
BA_ "GenSigCmt" SG_ 1288 MRR_RL_CAN_DET_RANGE_RATE_057 "Detected object range rate";
BA_ "GenSigStartValue" SG_ 1288 MRR_RL_CAN_DET_RANGE_RATE_057 8192;
BA_ "GenSigCmt" SG_ 1288 MRR_RL_CAN_DET_VALID_LEVEL_057 "Detected object valid level";
BA_ "GenSigCmt" SG_ 1288 MRR_RL_CAN_DET_AMPLITUDE_057 "Detected object amplitude";
BA_ "GenSigStartValue" SG_ 1288 MRR_RL_CAN_DET_AMPLITUDE_057 64;
BA_ "GenSigSendType" SG_ 1287 MRR_RL_CAN_DET_MID_TARGET_056 1;
BA_ "SignalDescription" SG_ 1287 MRR_RL_CAN_DET_MID_TARGET_056 "MID_Target_Discrimination";
BA_ "SignalDescription" SG_ 1287 MRR_RL_CAN_DET_MID_TARGET_055 "MID_Target_Discrimination";
BA_ "SignalDescription" SG_ 1287 MRR_RL_CAN_DET_MID_TARGET_054 "MID_Target_Discrimination";
BA_ "SignalDescription" SG_ 1287 MRR_RL_CAN_DET_MID_TARGET_053 "MID_Target_Discrimination";
BA_ "SignalDescription" SG_ 1287 MRR_RL_CAN_DET_MID_TARGET_052 "MID_Target_Discrimination";
BA_ "SignalDescription" SG_ 1287 MRR_RL_CAN_DET_MID_TARGET_051 "MID_Target_Discrimination";
BA_ "SignalDescription" SG_ 1287 MRR_RL_CAN_DET_MID_TARGET_050 "MID_Target_Discrimination";
BA_ "SignalDescription" SG_ 1287 MRR_RL_CAN_DET_Near_TARGET_050 "Near_Target_Discrimination";
BA_ "SignalDescription" SG_ 1287 MRR_RL_CAN_DET_Near_TARGET_051 "Near_Target_Discrimination";
BA_ "SignalDescription" SG_ 1287 MRR_RL_CAN_DET_Near_TARGET_052 "Near_Target_Discrimination";
BA_ "SignalDescription" SG_ 1287 MRR_RL_CAN_DET_Near_TARGET_053 "Near_Target_Discrimination";
BA_ "SignalDescription" SG_ 1287 MRR_RL_CAN_DET_Near_TARGET_054 "Near_Target_Discrimination";
BA_ "SignalDescription" SG_ 1287 MRR_RL_CAN_DET_Near_TARGET_055 "Near_Target_Discrimination";
BA_ "SignalDescription" SG_ 1287 MRR_RL_CAN_DET_Near_TARGET_056 "Near_Target_Discrimination";
BA_ "GenSigCmt" SG_ 1287 MRR_RL_CAN_DET_SUPER_RES_TA_0007 "Super resolution target ";
BA_ "SystemSignalLongSymbol" SG_ 1287 MRR_RL_CAN_DET_SUPER_RES_TA_0007 "MRR_RL_CAN_DET_SUPER_RES_TARGET_056";
BA_ "GenSigStartValue" SG_ 1287 MRR_RL_CAN_DET_ELEVATION_056 63.8646288209607;
BA_ "GenSigCmt" SG_ 1287 MRR_RL_CAN_DET_ELEVATION_056 "Detected object elevation position";
BA_ "GenSigCmt" SG_ 1287 MRR_RL_CAN_DET_HOST_VEH_CLU_0007 "Host vehicle clutter";
BA_ "SystemSignalLongSymbol" SG_ 1287 MRR_RL_CAN_DET_HOST_VEH_CLU_0007 "MRR_RL_CAN_DET_HOST_VEH_CLUTTER_056";
BA_ "GenSigCmt" SG_ 1287 MRR_RL_CAN_DET_CONFID_ELEVA_0007 "Elevation Angle Confidence";
BA_ "SystemSignalLongSymbol" SG_ 1287 MRR_RL_CAN_DET_CONFID_ELEVA_0007 "MRR_RL_CAN_DET_CONFID_ELEVATION_056";
BA_ "GenSigCmt" SG_ 1287 MRR_RL_CAN_DET_AZIMUTH_056 "Detected object azimuth position";
BA_ "GenSigStartValue" SG_ 1287 MRR_RL_CAN_DET_AZIMUTH_056 8194.05320813772;
BA_ "GenSigVtEn" SG_ 1287 MRR_RL_CAN_DET_CONFID_AZIMU_0006 "TRUE";
BA_ "GenSigCmt" SG_ 1287 MRR_RL_CAN_DET_CONFID_AZIMU_0006 "Signal to noise level";
BA_ "SystemSignalLongSymbol" SG_ 1287 MRR_RL_CAN_DET_CONFID_AZIMU_0006 "MRR_RL_CAN_DET_CONFID_AZIMUTH_056";
BA_ "GenSigCmt" SG_ 1287 MRR_RL_CAN_DET_RANGE_056 "Detected object range";
BA_ "GenSigCmt" SG_ 1287 MRR_RL_CAN_SCAN_INDEX_2LSB_056 "The two LSB of scan index";
BA_ "GenSigCmt" SG_ 1287 MRR_RL_CAN_DET_RANGE_RATE_056 "Detected object range rate";
BA_ "GenSigStartValue" SG_ 1287 MRR_RL_CAN_DET_RANGE_RATE_056 8192;
BA_ "GenSigCmt" SG_ 1287 MRR_RL_CAN_DET_VALID_LEVEL_056 "Detected object valid level";
BA_ "GenSigCmt" SG_ 1287 MRR_RL_CAN_DET_AMPLITUDE_056 "Detected object amplitude";
BA_ "GenSigStartValue" SG_ 1287 MRR_RL_CAN_DET_AMPLITUDE_056 64;
BA_ "GenSigCmt" SG_ 1287 MRR_RL_CAN_DET_SUPER_RES_TA_0008 "Super resolution target ";
BA_ "SystemSignalLongSymbol" SG_ 1287 MRR_RL_CAN_DET_SUPER_RES_TA_0008 "MRR_RL_CAN_DET_SUPER_RES_TARGET_055";
BA_ "GenSigCmt" SG_ 1287 MRR_RL_CAN_DET_ELEVATION_055 "Detected object elevation position";
BA_ "GenSigStartValue" SG_ 1287 MRR_RL_CAN_DET_ELEVATION_055 63.8646288209607;
BA_ "GenSigCmt" SG_ 1287 MRR_RL_CAN_DET_HOST_VEH_CLU_0008 "Host vehicle clutter";
BA_ "SystemSignalLongSymbol" SG_ 1287 MRR_RL_CAN_DET_HOST_VEH_CLU_0008 "MRR_RL_CAN_DET_HOST_VEH_CLUTTER_055";
BA_ "GenSigCmt" SG_ 1287 MRR_RL_CAN_DET_CONFID_ELEVA_0008 "Elevation Angle Confidence";
BA_ "SystemSignalLongSymbol" SG_ 1287 MRR_RL_CAN_DET_CONFID_ELEVA_0008 "MRR_RL_CAN_DET_CONFID_ELEVATION_055";
BA_ "GenSigCmt" SG_ 1287 MRR_RL_CAN_DET_AZIMUTH_055 "Detected object azimuth position";
BA_ "GenSigStartValue" SG_ 1287 MRR_RL_CAN_DET_AZIMUTH_055 8194.05320813772;
BA_ "GenSigVtEn" SG_ 1287 MRR_RL_CAN_DET_CONFID_AZIMU_0007 "TRUE";
BA_ "GenSigCmt" SG_ 1287 MRR_RL_CAN_DET_CONFID_AZIMU_0007 "Signal to noise level";
BA_ "SystemSignalLongSymbol" SG_ 1287 MRR_RL_CAN_DET_CONFID_AZIMU_0007 "MRR_RL_CAN_DET_CONFID_AZIMUTH_055";
BA_ "GenSigCmt" SG_ 1287 MRR_RL_CAN_DET_RANGE_055 "Detected object range";
BA_ "GenSigCmt" SG_ 1287 MRR_RL_CAN_SCAN_INDEX_2LSB_055 "The two LSB of scan index";
BA_ "GenSigCmt" SG_ 1287 MRR_RL_CAN_DET_RANGE_RATE_055 "Detected object range rate";
BA_ "GenSigStartValue" SG_ 1287 MRR_RL_CAN_DET_RANGE_RATE_055 8192;
BA_ "GenSigCmt" SG_ 1287 MRR_RL_CAN_DET_VALID_LEVEL_055 "Detected object valid level";
BA_ "GenSigCmt" SG_ 1287 MRR_RL_CAN_DET_AMPLITUDE_055 "Detected object amplitude";
BA_ "GenSigStartValue" SG_ 1287 MRR_RL_CAN_DET_AMPLITUDE_055 64;
BA_ "GenSigCmt" SG_ 1287 MRR_RL_CAN_DET_SUPER_RES_TA_0009 "Super resolution target ";
BA_ "SystemSignalLongSymbol" SG_ 1287 MRR_RL_CAN_DET_SUPER_RES_TA_0009 "MRR_RL_CAN_DET_SUPER_RES_TARGET_054";
BA_ "GenSigCmt" SG_ 1287 MRR_RL_CAN_DET_ELEVATION_054 "Detected object elevation position";
BA_ "GenSigStartValue" SG_ 1287 MRR_RL_CAN_DET_ELEVATION_054 63.8646288209607;
BA_ "GenSigCmt" SG_ 1287 MRR_RL_CAN_DET_HOST_VEH_CLU_0009 "Host vehicle clutter";
BA_ "SystemSignalLongSymbol" SG_ 1287 MRR_RL_CAN_DET_HOST_VEH_CLU_0009 "MRR_RL_CAN_DET_HOST_VEH_CLUTTER_054";
BA_ "GenSigCmt" SG_ 1287 MRR_RL_CAN_DET_CONFID_ELEVA_0009 "Elevation Angle Confidence";
BA_ "SystemSignalLongSymbol" SG_ 1287 MRR_RL_CAN_DET_CONFID_ELEVA_0009 "MRR_RL_CAN_DET_CONFID_ELEVATION_054";
BA_ "GenSigCmt" SG_ 1287 MRR_RL_CAN_DET_AZIMUTH_054 "Detected object azimuth position";
BA_ "GenSigStartValue" SG_ 1287 MRR_RL_CAN_DET_AZIMUTH_054 8194.05320813772;
BA_ "GenSigVtEn" SG_ 1287 MRR_RL_CAN_DET_CONFID_AZIMU_0008 "TRUE";
BA_ "GenSigCmt" SG_ 1287 MRR_RL_CAN_DET_CONFID_AZIMU_0008 "Signal to noise level";
BA_ "SystemSignalLongSymbol" SG_ 1287 MRR_RL_CAN_DET_CONFID_AZIMU_0008 "MRR_RL_CAN_DET_CONFID_AZIMUTH_054";
BA_ "GenSigCmt" SG_ 1287 MRR_RL_CAN_DET_RANGE_054 "Detected object range";
BA_ "GenSigCmt" SG_ 1287 MRR_RL_CAN_SCAN_INDEX_2LSB_054 "The two LSB of scan index";
BA_ "GenSigCmt" SG_ 1287 MRR_RL_CAN_DET_RANGE_RATE_054 "Detected object range rate";
BA_ "GenSigStartValue" SG_ 1287 MRR_RL_CAN_DET_RANGE_RATE_054 8192;
BA_ "GenSigCmt" SG_ 1287 MRR_RL_CAN_DET_VALID_LEVEL_054 "Detected object valid level";
BA_ "GenSigCmt" SG_ 1287 MRR_RL_CAN_DET_AMPLITUDE_054 "Detected object amplitude";
BA_ "GenSigStartValue" SG_ 1287 MRR_RL_CAN_DET_AMPLITUDE_054 64;
BA_ "GenSigCmt" SG_ 1287 MRR_RL_CAN_DET_SUPER_RES_TA_0010 "Super resolution target ";
BA_ "SystemSignalLongSymbol" SG_ 1287 MRR_RL_CAN_DET_SUPER_RES_TA_0010 "MRR_RL_CAN_DET_SUPER_RES_TARGET_053";
BA_ "GenSigCmt" SG_ 1287 MRR_RL_CAN_DET_ELEVATION_053 "Detected object elevation position";
BA_ "GenSigStartValue" SG_ 1287 MRR_RL_CAN_DET_ELEVATION_053 63.8646288209607;
BA_ "GenSigCmt" SG_ 1287 MRR_RL_CAN_DET_HOST_VEH_CLU_0010 "Host vehicle clutter";
BA_ "SystemSignalLongSymbol" SG_ 1287 MRR_RL_CAN_DET_HOST_VEH_CLU_0010 "MRR_RL_CAN_DET_HOST_VEH_CLUTTER_053";
BA_ "GenSigCmt" SG_ 1287 MRR_RL_CAN_DET_CONFID_ELEVA_0010 "Elevation Angle Confidence";
BA_ "SystemSignalLongSymbol" SG_ 1287 MRR_RL_CAN_DET_CONFID_ELEVA_0010 "MRR_RL_CAN_DET_CONFID_ELEVATION_053";
BA_ "GenSigCmt" SG_ 1287 MRR_RL_CAN_DET_AZIMUTH_053 "Detected object azimuth position";
BA_ "GenSigStartValue" SG_ 1287 MRR_RL_CAN_DET_AZIMUTH_053 8194.05320813772;
BA_ "GenSigVtEn" SG_ 1287 MRR_RL_CAN_DET_CONFID_AZIMU_0009 "TRUE";
BA_ "GenSigCmt" SG_ 1287 MRR_RL_CAN_DET_CONFID_AZIMU_0009 "Signal to noise level";
BA_ "SystemSignalLongSymbol" SG_ 1287 MRR_RL_CAN_DET_CONFID_AZIMU_0009 "MRR_RL_CAN_DET_CONFID_AZIMUTH_053";
BA_ "GenSigCmt" SG_ 1287 MRR_RL_CAN_DET_RANGE_053 "Detected object range";
BA_ "GenSigCmt" SG_ 1287 MRR_RL_CAN_SCAN_INDEX_2LSB_053 "The two LSB of scan index";
BA_ "GenSigCmt" SG_ 1287 MRR_RL_CAN_DET_RANGE_RATE_053 "Detected object range rate";
BA_ "GenSigStartValue" SG_ 1287 MRR_RL_CAN_DET_RANGE_RATE_053 8192;
BA_ "GenSigCmt" SG_ 1287 MRR_RL_CAN_DET_VALID_LEVEL_053 "Detected object valid level";
BA_ "GenSigCmt" SG_ 1287 MRR_RL_CAN_DET_AMPLITUDE_053 "Detected object amplitude";
BA_ "GenSigStartValue" SG_ 1287 MRR_RL_CAN_DET_AMPLITUDE_053 64;
BA_ "GenSigCmt" SG_ 1287 MRR_RL_CAN_DET_SUPER_RES_TA_0011 "Super resolution target ";
BA_ "SystemSignalLongSymbol" SG_ 1287 MRR_RL_CAN_DET_SUPER_RES_TA_0011 "MRR_RL_CAN_DET_SUPER_RES_TARGET_052";
BA_ "GenSigCmt" SG_ 1287 MRR_RL_CAN_DET_ELEVATION_052 "Detected object elevation position";
BA_ "GenSigStartValue" SG_ 1287 MRR_RL_CAN_DET_ELEVATION_052 63.8646288209607;
BA_ "GenSigCmt" SG_ 1287 MRR_RL_CAN_DET_HOST_VEH_CLU_0011 "Host vehicle clutter";
BA_ "SystemSignalLongSymbol" SG_ 1287 MRR_RL_CAN_DET_HOST_VEH_CLU_0011 "MRR_RL_CAN_DET_HOST_VEH_CLUTTER_052";
BA_ "GenSigCmt" SG_ 1287 MRR_RL_CAN_DET_CONFID_ELEVA_0011 "Elevation Angle Confidence";
BA_ "SystemSignalLongSymbol" SG_ 1287 MRR_RL_CAN_DET_CONFID_ELEVA_0011 "MRR_RL_CAN_DET_CONFID_ELEVATION_052";
BA_ "GenSigCmt" SG_ 1287 MRR_RL_CAN_DET_AZIMUTH_052 "Detected object azimuth position";
BA_ "GenSigStartValue" SG_ 1287 MRR_RL_CAN_DET_AZIMUTH_052 8194.05320813772;
BA_ "GenSigVtEn" SG_ 1287 MRR_RL_CAN_DET_CONFID_AZIMU_0010 "TRUE";
BA_ "GenSigCmt" SG_ 1287 MRR_RL_CAN_DET_CONFID_AZIMU_0010 "Signal to noise level";
BA_ "SystemSignalLongSymbol" SG_ 1287 MRR_RL_CAN_DET_CONFID_AZIMU_0010 "MRR_RL_CAN_DET_CONFID_AZIMUTH_052";
BA_ "GenSigCmt" SG_ 1287 MRR_RL_CAN_DET_RANGE_052 "Detected object range";
BA_ "GenSigCmt" SG_ 1287 MRR_RL_CAN_SCAN_INDEX_2LSB_052 "The two LSB of scan index";
BA_ "GenSigCmt" SG_ 1287 MRR_RL_CAN_DET_RANGE_RATE_052 "Detected object range rate";
BA_ "GenSigStartValue" SG_ 1287 MRR_RL_CAN_DET_RANGE_RATE_052 8192;
BA_ "GenSigCmt" SG_ 1287 MRR_RL_CAN_DET_VALID_LEVEL_052 "Detected object valid level";
BA_ "GenSigCmt" SG_ 1287 MRR_RL_CAN_DET_AMPLITUDE_052 "Detected object amplitude";
BA_ "GenSigStartValue" SG_ 1287 MRR_RL_CAN_DET_AMPLITUDE_052 64;
BA_ "GenSigCmt" SG_ 1287 MRR_RL_CAN_DET_SUPER_RES_TA_0012 "Super resolution target ";
BA_ "SystemSignalLongSymbol" SG_ 1287 MRR_RL_CAN_DET_SUPER_RES_TA_0012 "MRR_RL_CAN_DET_SUPER_RES_TARGET_051";
BA_ "GenSigCmt" SG_ 1287 MRR_RL_CAN_DET_ELEVATION_051 "Detected object elevation position";
BA_ "GenSigStartValue" SG_ 1287 MRR_RL_CAN_DET_ELEVATION_051 63.8646288209607;
BA_ "GenSigCmt" SG_ 1287 MRR_RL_CAN_DET_HOST_VEH_CLU_0012 "Host vehicle clutter";
BA_ "SystemSignalLongSymbol" SG_ 1287 MRR_RL_CAN_DET_HOST_VEH_CLU_0012 "MRR_RL_CAN_DET_HOST_VEH_CLUTTER_051";
BA_ "GenSigCmt" SG_ 1287 MRR_RL_CAN_DET_CONFID_ELEVA_0012 "Elevation Angle Confidence";
BA_ "SystemSignalLongSymbol" SG_ 1287 MRR_RL_CAN_DET_CONFID_ELEVA_0012 "MRR_RL_CAN_DET_CONFID_ELEVATION_051";
BA_ "GenSigCmt" SG_ 1287 MRR_RL_CAN_DET_AZIMUTH_051 "Detected object azimuth position";
BA_ "GenSigStartValue" SG_ 1287 MRR_RL_CAN_DET_AZIMUTH_051 8194.05320813772;
BA_ "GenSigVtEn" SG_ 1287 MRR_RL_CAN_DET_CONFID_AZIMU_0011 "TRUE";
BA_ "GenSigCmt" SG_ 1287 MRR_RL_CAN_DET_CONFID_AZIMU_0011 "Signal to noise level";
BA_ "SystemSignalLongSymbol" SG_ 1287 MRR_RL_CAN_DET_CONFID_AZIMU_0011 "MRR_RL_CAN_DET_CONFID_AZIMUTH_051";
BA_ "GenSigCmt" SG_ 1287 MRR_RL_CAN_DET_RANGE_051 "Detected object range";
BA_ "GenSigCmt" SG_ 1287 MRR_RL_CAN_SCAN_INDEX_2LSB_051 "The two LSB of scan index";
BA_ "GenSigCmt" SG_ 1287 MRR_RL_CAN_DET_RANGE_RATE_051 "Detected object range rate";
BA_ "GenSigStartValue" SG_ 1287 MRR_RL_CAN_DET_RANGE_RATE_051 8192;
BA_ "GenSigCmt" SG_ 1287 MRR_RL_CAN_DET_VALID_LEVEL_051 "Detected object valid level";
BA_ "GenSigCmt" SG_ 1287 MRR_RL_CAN_DET_AMPLITUDE_051 "Detected object amplitude";
BA_ "GenSigStartValue" SG_ 1287 MRR_RL_CAN_DET_AMPLITUDE_051 64;
BA_ "GenSigCmt" SG_ 1287 MRR_RL_CAN_DET_SUPER_RES_TA_0013 "Super resolution target ";
BA_ "SystemSignalLongSymbol" SG_ 1287 MRR_RL_CAN_DET_SUPER_RES_TA_0013 "MRR_RL_CAN_DET_SUPER_RES_TARGET_050";
BA_ "GenSigCmt" SG_ 1287 MRR_RL_CAN_DET_ELEVATION_050 "Detected object elevation position";
BA_ "GenSigStartValue" SG_ 1287 MRR_RL_CAN_DET_ELEVATION_050 63.8646288209607;
BA_ "GenSigCmt" SG_ 1287 MRR_RL_CAN_DET_HOST_VEH_CLU_0013 "Host vehicle clutter";
BA_ "SystemSignalLongSymbol" SG_ 1287 MRR_RL_CAN_DET_HOST_VEH_CLU_0013 "MRR_RL_CAN_DET_HOST_VEH_CLUTTER_050";
BA_ "GenSigCmt" SG_ 1287 MRR_RL_CAN_DET_CONFID_ELEVA_0013 "Elevation Angle Confidence";
BA_ "SystemSignalLongSymbol" SG_ 1287 MRR_RL_CAN_DET_CONFID_ELEVA_0013 "MRR_RL_CAN_DET_CONFID_ELEVATION_050";
BA_ "GenSigCmt" SG_ 1287 MRR_RL_CAN_DET_AZIMUTH_050 "Detected object azimuth position";
BA_ "GenSigStartValue" SG_ 1287 MRR_RL_CAN_DET_AZIMUTH_050 8194.05320813772;
BA_ "GenSigVtEn" SG_ 1287 MRR_RL_CAN_DET_CONFID_AZIMU_0012 "TRUE";
BA_ "GenSigCmt" SG_ 1287 MRR_RL_CAN_DET_CONFID_AZIMU_0012 "Signal to noise level";
BA_ "SystemSignalLongSymbol" SG_ 1287 MRR_RL_CAN_DET_CONFID_AZIMU_0012 "MRR_RL_CAN_DET_CONFID_AZIMUTH_050";
BA_ "GenSigCmt" SG_ 1287 MRR_RL_CAN_DET_RANGE_050 "Detected object range";
BA_ "GenSigCmt" SG_ 1287 MRR_RL_CAN_SCAN_INDEX_2LSB_050 "The two LSB of scan index";
BA_ "GenSigCmt" SG_ 1287 MRR_RL_CAN_DET_RANGE_RATE_050 "Detected object range rate";
BA_ "GenSigStartValue" SG_ 1287 MRR_RL_CAN_DET_RANGE_RATE_050 8192;
BA_ "GenSigCmt" SG_ 1287 MRR_RL_CAN_DET_VALID_LEVEL_050 "Detected object valid level";
BA_ "GenSigCmt" SG_ 1287 MRR_RL_CAN_DET_AMPLITUDE_050 "Detected object amplitude";
BA_ "GenSigStartValue" SG_ 1287 MRR_RL_CAN_DET_AMPLITUDE_050 64;
BA_ "GenSigSendType" SG_ 1286 MRR_RL_CAN_DET_MID_TARGET_049 1;
BA_ "SignalDescription" SG_ 1286 MRR_RL_CAN_DET_MID_TARGET_049 "MID_Target_Discrimination";
BA_ "SignalDescription" SG_ 1286 MRR_RL_CAN_DET_MID_TARGET_048 "MID_Target_Discrimination";
BA_ "SignalDescription" SG_ 1286 MRR_RL_CAN_DET_MID_TARGET_047 "MID_Target_Discrimination";
BA_ "SignalDescription" SG_ 1286 MRR_RL_CAN_DET_MID_TARGET_046 "MID_Target_Discrimination";
BA_ "SignalDescription" SG_ 1286 MRR_RL_CAN_DET_MID_TARGET_045 "MID_Target_Discrimination";
BA_ "SignalDescription" SG_ 1286 MRR_RL_CAN_DET_MID_TARGET_044 "MID_Target_Discrimination";
BA_ "SignalDescription" SG_ 1286 MRR_RL_CAN_DET_MID_TARGET_043 "MID_Target_Discrimination";
BA_ "SignalDescription" SG_ 1286 MRR_RL_CAN_DET_Near_TARGET_043 "Near_Target_Discrimination";
BA_ "SignalDescription" SG_ 1286 MRR_RL_CAN_DET_Near_TARGET_044 "Near_Target_Discrimination";
BA_ "SignalDescription" SG_ 1286 MRR_RL_CAN_DET_Near_TARGET_045 "Near_Target_Discrimination";
BA_ "SignalDescription" SG_ 1286 MRR_RL_CAN_DET_Near_TARGET_046 "Near_Target_Discrimination";
BA_ "SignalDescription" SG_ 1286 MRR_RL_CAN_DET_Near_TARGET_047 "Near_Target_Discrimination";
BA_ "SignalDescription" SG_ 1286 MRR_RL_CAN_DET_Near_TARGET_048 "Near_Target_Discrimination";
BA_ "SignalDescription" SG_ 1286 MRR_RL_CAN_DET_Near_TARGET_049 "Near_Target_Discrimination";
BA_ "GenSigCmt" SG_ 1286 MRR_RL_CAN_DET_SUPER_RES_TA_0014 "Super resolution target ";
BA_ "SystemSignalLongSymbol" SG_ 1286 MRR_RL_CAN_DET_SUPER_RES_TA_0014 "MRR_RL_CAN_DET_SUPER_RES_TARGET_049";
BA_ "GenSigStartValue" SG_ 1286 MRR_RL_CAN_DET_ELEVATION_049 63.8646288209607;
BA_ "GenSigCmt" SG_ 1286 MRR_RL_CAN_DET_ELEVATION_049 "Detected object elevation position";
BA_ "GenSigCmt" SG_ 1286 MRR_RL_CAN_DET_HOST_VEH_CLU_0014 "Host vehicle clutter";
BA_ "SystemSignalLongSymbol" SG_ 1286 MRR_RL_CAN_DET_HOST_VEH_CLU_0014 "MRR_RL_CAN_DET_HOST_VEH_CLUTTER_049";
BA_ "GenSigCmt" SG_ 1286 MRR_RL_CAN_DET_CONFID_ELEVA_0014 "Elevation Angle Confidence";
BA_ "SystemSignalLongSymbol" SG_ 1286 MRR_RL_CAN_DET_CONFID_ELEVA_0014 "MRR_RL_CAN_DET_CONFID_ELEVATION_049";
BA_ "GenSigCmt" SG_ 1286 MRR_RL_CAN_DET_AZIMUTH_049 "Detected object azimuth position";
BA_ "GenSigStartValue" SG_ 1286 MRR_RL_CAN_DET_AZIMUTH_049 8194.05320813772;
BA_ "GenSigVtEn" SG_ 1286 MRR_RL_CAN_DET_CONFID_AZIMUTH_04 "TRUE";
BA_ "GenSigCmt" SG_ 1286 MRR_RL_CAN_DET_CONFID_AZIMUTH_04 "Signal to noise level";
BA_ "SystemSignalLongSymbol" SG_ 1286 MRR_RL_CAN_DET_CONFID_AZIMUTH_04 "MRR_RL_CAN_DET_CONFID_AZIMUTH_049";
BA_ "GenSigCmt" SG_ 1286 MRR_RL_CAN_DET_RANGE_049 "Detected object range";
BA_ "GenSigCmt" SG_ 1286 MRR_RL_CAN_SCAN_INDEX_2LSB_049 "The two LSB of scan index";
BA_ "GenSigCmt" SG_ 1286 MRR_RL_CAN_DET_RANGE_RATE_049 "Detected object range rate";
BA_ "GenSigStartValue" SG_ 1286 MRR_RL_CAN_DET_RANGE_RATE_049 8192;
BA_ "GenSigCmt" SG_ 1286 MRR_RL_CAN_DET_VALID_LEVEL_049 "Detected object valid level";
BA_ "GenSigCmt" SG_ 1286 MRR_RL_CAN_DET_AMPLITUDE_049 "Detected object amplitude";
BA_ "GenSigStartValue" SG_ 1286 MRR_RL_CAN_DET_AMPLITUDE_049 64;
BA_ "GenSigCmt" SG_ 1286 MRR_RL_CAN_DET_SUPER_RES_TA_0015 "Super resolution target ";
BA_ "SystemSignalLongSymbol" SG_ 1286 MRR_RL_CAN_DET_SUPER_RES_TA_0015 "MRR_RL_CAN_DET_SUPER_RES_TARGET_048";
BA_ "GenSigCmt" SG_ 1286 MRR_RL_CAN_DET_ELEVATION_048 "Detected object elevation position";
BA_ "GenSigStartValue" SG_ 1286 MRR_RL_CAN_DET_ELEVATION_048 63.8646288209607;
BA_ "GenSigCmt" SG_ 1286 MRR_RL_CAN_DET_HOST_VEH_CLU_0015 "Host vehicle clutter";
BA_ "SystemSignalLongSymbol" SG_ 1286 MRR_RL_CAN_DET_HOST_VEH_CLU_0015 "MRR_RL_CAN_DET_HOST_VEH_CLUTTER_048";
BA_ "GenSigCmt" SG_ 1286 MRR_RL_CAN_DET_CONFID_ELEVA_0015 "Elevation Angle Confidence";
BA_ "SystemSignalLongSymbol" SG_ 1286 MRR_RL_CAN_DET_CONFID_ELEVA_0015 "MRR_RL_CAN_DET_CONFID_ELEVATION_048";
BA_ "GenSigCmt" SG_ 1286 MRR_RL_CAN_DET_AZIMUTH_048 "Detected object azimuth position";
BA_ "GenSigStartValue" SG_ 1286 MRR_RL_CAN_DET_AZIMUTH_048 8194.05320813772;
BA_ "GenSigVtEn" SG_ 1286 MRR_RL_CAN_DET_CONFID_AZIMU_0013 "TRUE";
BA_ "GenSigCmt" SG_ 1286 MRR_RL_CAN_DET_CONFID_AZIMU_0013 "Signal to noise level";
BA_ "SystemSignalLongSymbol" SG_ 1286 MRR_RL_CAN_DET_CONFID_AZIMU_0013 "MRR_RL_CAN_DET_CONFID_AZIMUTH_048";
BA_ "GenSigCmt" SG_ 1286 MRR_RL_CAN_DET_RANGE_048 "Detected object range";
BA_ "GenSigCmt" SG_ 1286 MRR_RL_CAN_SCAN_INDEX_2LSB_048 "The two LSB of scan index";
BA_ "GenSigCmt" SG_ 1286 MRR_RL_CAN_DET_RANGE_RATE_048 "Detected object range rate";
BA_ "GenSigStartValue" SG_ 1286 MRR_RL_CAN_DET_RANGE_RATE_048 8192;
BA_ "GenSigCmt" SG_ 1286 MRR_RL_CAN_DET_VALID_LEVEL_048 "Detected object valid level";
BA_ "GenSigCmt" SG_ 1286 MRR_RL_CAN_DET_AMPLITUDE_048 "Detected object amplitude";
BA_ "GenSigStartValue" SG_ 1286 MRR_RL_CAN_DET_AMPLITUDE_048 64;
BA_ "GenSigCmt" SG_ 1286 MRR_RL_CAN_DET_SUPER_RES_TA_0016 "Super resolution target ";
BA_ "SystemSignalLongSymbol" SG_ 1286 MRR_RL_CAN_DET_SUPER_RES_TA_0016 "MRR_RL_CAN_DET_SUPER_RES_TARGET_047";
BA_ "GenSigCmt" SG_ 1286 MRR_RL_CAN_DET_ELEVATION_047 "Detected object elevation position";
BA_ "GenSigStartValue" SG_ 1286 MRR_RL_CAN_DET_ELEVATION_047 63.8646288209607;
BA_ "GenSigCmt" SG_ 1286 MRR_RL_CAN_DET_HOST_VEH_CLU_0016 "Host vehicle clutter";
BA_ "SystemSignalLongSymbol" SG_ 1286 MRR_RL_CAN_DET_HOST_VEH_CLU_0016 "MRR_RL_CAN_DET_HOST_VEH_CLUTTER_047";
BA_ "GenSigCmt" SG_ 1286 MRR_RL_CAN_DET_CONFID_ELEVA_0016 "Elevation Angle Confidence";
BA_ "SystemSignalLongSymbol" SG_ 1286 MRR_RL_CAN_DET_CONFID_ELEVA_0016 "MRR_RL_CAN_DET_CONFID_ELEVATION_047";
BA_ "GenSigCmt" SG_ 1286 MRR_RL_CAN_DET_AZIMUTH_047 "Detected object azimuth position";
BA_ "GenSigStartValue" SG_ 1286 MRR_RL_CAN_DET_AZIMUTH_047 8194.05320813772;
BA_ "GenSigVtEn" SG_ 1286 MRR_RL_CAN_DET_CONFID_AZIMU_0014 "TRUE";
BA_ "GenSigCmt" SG_ 1286 MRR_RL_CAN_DET_CONFID_AZIMU_0014 "Signal to noise level";
BA_ "SystemSignalLongSymbol" SG_ 1286 MRR_RL_CAN_DET_CONFID_AZIMU_0014 "MRR_RL_CAN_DET_CONFID_AZIMUTH_047";
BA_ "GenSigCmt" SG_ 1286 MRR_RL_CAN_DET_RANGE_047 "Detected object range";
BA_ "GenSigCmt" SG_ 1286 MRR_RL_CAN_SCAN_INDEX_2LSB_047 "The two LSB of scan index";
BA_ "GenSigCmt" SG_ 1286 MRR_RL_CAN_DET_RANGE_RATE_047 "Detected object range rate";
BA_ "GenSigStartValue" SG_ 1286 MRR_RL_CAN_DET_RANGE_RATE_047 8192;
BA_ "GenSigCmt" SG_ 1286 MRR_RL_CAN_DET_VALID_LEVEL_047 "Detected object valid level";
BA_ "GenSigCmt" SG_ 1286 MRR_RL_CAN_DET_AMPLITUDE_047 "Detected object amplitude";
BA_ "GenSigStartValue" SG_ 1286 MRR_RL_CAN_DET_AMPLITUDE_047 64;
BA_ "GenSigCmt" SG_ 1286 MRR_RL_CAN_DET_SUPER_RES_TA_0017 "Super resolution target ";
BA_ "SystemSignalLongSymbol" SG_ 1286 MRR_RL_CAN_DET_SUPER_RES_TA_0017 "MRR_RL_CAN_DET_SUPER_RES_TARGET_046";
BA_ "GenSigCmt" SG_ 1286 MRR_RL_CAN_DET_ELEVATION_046 "Detected object elevation position";
BA_ "GenSigStartValue" SG_ 1286 MRR_RL_CAN_DET_ELEVATION_046 63.8646288209607;
BA_ "GenSigCmt" SG_ 1286 MRR_RL_CAN_DET_HOST_VEH_CLU_0017 "Host vehicle clutter";
BA_ "SystemSignalLongSymbol" SG_ 1286 MRR_RL_CAN_DET_HOST_VEH_CLU_0017 "MRR_RL_CAN_DET_HOST_VEH_CLUTTER_046";
BA_ "GenSigCmt" SG_ 1286 MRR_RL_CAN_DET_CONFID_ELEVA_0017 "Elevation Angle Confidence";
BA_ "SystemSignalLongSymbol" SG_ 1286 MRR_RL_CAN_DET_CONFID_ELEVA_0017 "MRR_RL_CAN_DET_CONFID_ELEVATION_046";
BA_ "GenSigCmt" SG_ 1286 MRR_RL_CAN_DET_AZIMUTH_046 "Detected object azimuth position";
BA_ "GenSigStartValue" SG_ 1286 MRR_RL_CAN_DET_AZIMUTH_046 8194.05320813772;
BA_ "GenSigVtEn" SG_ 1286 MRR_RL_CAN_DET_CONFID_AZIMU_0015 "TRUE";
BA_ "GenSigCmt" SG_ 1286 MRR_RL_CAN_DET_CONFID_AZIMU_0015 "Signal to noise level";
BA_ "SystemSignalLongSymbol" SG_ 1286 MRR_RL_CAN_DET_CONFID_AZIMU_0015 "MRR_RL_CAN_DET_CONFID_AZIMUTH_046";
BA_ "GenSigCmt" SG_ 1286 MRR_RL_CAN_DET_RANGE_046 "Detected object range";
BA_ "GenSigCmt" SG_ 1286 MRR_RL_CAN_SCAN_INDEX_2LSB_046 "The two LSB of scan index";
BA_ "GenSigCmt" SG_ 1286 MRR_RL_CAN_DET_RANGE_RATE_046 "Detected object range rate";
BA_ "GenSigStartValue" SG_ 1286 MRR_RL_CAN_DET_RANGE_RATE_046 8192;
BA_ "GenSigCmt" SG_ 1286 MRR_RL_CAN_DET_VALID_LEVEL_046 "Detected object valid level";
BA_ "GenSigCmt" SG_ 1286 MRR_RL_CAN_DET_AMPLITUDE_046 "Detected object amplitude";
BA_ "GenSigStartValue" SG_ 1286 MRR_RL_CAN_DET_AMPLITUDE_046 64;
BA_ "GenSigCmt" SG_ 1286 MRR_RL_CAN_DET_SUPER_RES_TA_0018 "Super resolution target ";
BA_ "SystemSignalLongSymbol" SG_ 1286 MRR_RL_CAN_DET_SUPER_RES_TA_0018 "MRR_RL_CAN_DET_SUPER_RES_TARGET_045";
BA_ "GenSigCmt" SG_ 1286 MRR_RL_CAN_DET_ELEVATION_045 "Detected object elevation position";
BA_ "GenSigStartValue" SG_ 1286 MRR_RL_CAN_DET_ELEVATION_045 63.8646288209607;
BA_ "GenSigCmt" SG_ 1286 MRR_RL_CAN_DET_HOST_VEH_CLU_0018 "Host vehicle clutter";
BA_ "SystemSignalLongSymbol" SG_ 1286 MRR_RL_CAN_DET_HOST_VEH_CLU_0018 "MRR_RL_CAN_DET_HOST_VEH_CLUTTER_045";
BA_ "GenSigCmt" SG_ 1286 MRR_RL_CAN_DET_CONFID_ELEVA_0018 "Elevation Angle Confidence";
BA_ "SystemSignalLongSymbol" SG_ 1286 MRR_RL_CAN_DET_CONFID_ELEVA_0018 "MRR_RL_CAN_DET_CONFID_ELEVATION_045";
BA_ "GenSigCmt" SG_ 1286 MRR_RL_CAN_DET_AZIMUTH_045 "Detected object azimuth position";
BA_ "GenSigStartValue" SG_ 1286 MRR_RL_CAN_DET_AZIMUTH_045 8194.05320813772;
BA_ "GenSigVtEn" SG_ 1286 MRR_RL_CAN_DET_CONFID_AZIMU_0016 "TRUE";
BA_ "GenSigCmt" SG_ 1286 MRR_RL_CAN_DET_CONFID_AZIMU_0016 "Signal to noise level";
BA_ "SystemSignalLongSymbol" SG_ 1286 MRR_RL_CAN_DET_CONFID_AZIMU_0016 "MRR_RL_CAN_DET_CONFID_AZIMUTH_045";
BA_ "GenSigCmt" SG_ 1286 MRR_RL_CAN_DET_RANGE_045 "Detected object range";
BA_ "GenSigCmt" SG_ 1286 MRR_RL_CAN_SCAN_INDEX_2LSB_045 "The two LSB of scan index";
BA_ "GenSigCmt" SG_ 1286 MRR_RL_CAN_DET_RANGE_RATE_045 "Detected object range rate";
BA_ "GenSigStartValue" SG_ 1286 MRR_RL_CAN_DET_RANGE_RATE_045 8192;
BA_ "GenSigCmt" SG_ 1286 MRR_RL_CAN_DET_VALID_LEVEL_045 "Detected object valid level";
BA_ "GenSigCmt" SG_ 1286 MRR_RL_CAN_DET_AMPLITUDE_045 "Detected object amplitude";
BA_ "GenSigStartValue" SG_ 1286 MRR_RL_CAN_DET_AMPLITUDE_045 64;
BA_ "GenSigCmt" SG_ 1286 MRR_RL_CAN_DET_SUPER_RES_TA_0019 "Super resolution target ";
BA_ "SystemSignalLongSymbol" SG_ 1286 MRR_RL_CAN_DET_SUPER_RES_TA_0019 "MRR_RL_CAN_DET_SUPER_RES_TARGET_044";
BA_ "GenSigCmt" SG_ 1286 MRR_RL_CAN_DET_ELEVATION_044 "Detected object elevation position";
BA_ "GenSigStartValue" SG_ 1286 MRR_RL_CAN_DET_ELEVATION_044 63.8646288209607;
BA_ "GenSigCmt" SG_ 1286 MRR_RL_CAN_DET_HOST_VEH_CLU_0019 "Host vehicle clutter";
BA_ "SystemSignalLongSymbol" SG_ 1286 MRR_RL_CAN_DET_HOST_VEH_CLU_0019 "MRR_RL_CAN_DET_HOST_VEH_CLUTTER_044";
BA_ "GenSigCmt" SG_ 1286 MRR_RL_CAN_DET_CONFID_ELEVA_0019 "Elevation Angle Confidence";
BA_ "SystemSignalLongSymbol" SG_ 1286 MRR_RL_CAN_DET_CONFID_ELEVA_0019 "MRR_RL_CAN_DET_CONFID_ELEVATION_044";
BA_ "GenSigCmt" SG_ 1286 MRR_RL_CAN_DET_AZIMUTH_044 "Detected object azimuth position";
BA_ "GenSigStartValue" SG_ 1286 MRR_RL_CAN_DET_AZIMUTH_044 8194.05320813772;
BA_ "GenSigVtEn" SG_ 1286 MRR_RL_CAN_DET_CONFID_AZIMU_0017 "TRUE";
BA_ "GenSigCmt" SG_ 1286 MRR_RL_CAN_DET_CONFID_AZIMU_0017 "Signal to noise level";
BA_ "SystemSignalLongSymbol" SG_ 1286 MRR_RL_CAN_DET_CONFID_AZIMU_0017 "MRR_RL_CAN_DET_CONFID_AZIMUTH_044";
BA_ "GenSigCmt" SG_ 1286 MRR_RL_CAN_DET_RANGE_044 "Detected object range";
BA_ "GenSigCmt" SG_ 1286 MRR_RL_CAN_SCAN_INDEX_2LSB_044 "The two LSB of scan index";
BA_ "GenSigCmt" SG_ 1286 MRR_RL_CAN_DET_RANGE_RATE_044 "Detected object range rate";
BA_ "GenSigStartValue" SG_ 1286 MRR_RL_CAN_DET_RANGE_RATE_044 8192;
BA_ "GenSigCmt" SG_ 1286 MRR_RL_CAN_DET_VALID_LEVEL_044 "Detected object valid level";
BA_ "GenSigCmt" SG_ 1286 MRR_RL_CAN_DET_AMPLITUDE_044 "Detected object amplitude";
BA_ "GenSigStartValue" SG_ 1286 MRR_RL_CAN_DET_AMPLITUDE_044 64;
BA_ "GenSigCmt" SG_ 1286 MRR_RL_CAN_DET_SUPER_RES_TA_0020 "Super resolution target ";
BA_ "SystemSignalLongSymbol" SG_ 1286 MRR_RL_CAN_DET_SUPER_RES_TA_0020 "MRR_RL_CAN_DET_SUPER_RES_TARGET_043";
BA_ "GenSigCmt" SG_ 1286 MRR_RL_CAN_DET_ELEVATION_043 "Detected object elevation position";
BA_ "GenSigStartValue" SG_ 1286 MRR_RL_CAN_DET_ELEVATION_043 63.8646288209607;
BA_ "GenSigCmt" SG_ 1286 MRR_RL_CAN_DET_HOST_VEH_CLU_0020 "Host vehicle clutter";
BA_ "SystemSignalLongSymbol" SG_ 1286 MRR_RL_CAN_DET_HOST_VEH_CLU_0020 "MRR_RL_CAN_DET_HOST_VEH_CLUTTER_043";
BA_ "GenSigCmt" SG_ 1286 MRR_RL_CAN_DET_CONFID_ELEVA_0020 "Elevation Angle Confidence";
BA_ "SystemSignalLongSymbol" SG_ 1286 MRR_RL_CAN_DET_CONFID_ELEVA_0020 "MRR_RL_CAN_DET_CONFID_ELEVATION_043";
BA_ "GenSigCmt" SG_ 1286 MRR_RL_CAN_DET_AZIMUTH_043 "Detected object azimuth position";
BA_ "GenSigStartValue" SG_ 1286 MRR_RL_CAN_DET_AZIMUTH_043 8194.05320813772;
BA_ "GenSigVtEn" SG_ 1286 MRR_RL_CAN_DET_CONFID_AZIMU_0018 "TRUE";
BA_ "GenSigCmt" SG_ 1286 MRR_RL_CAN_DET_CONFID_AZIMU_0018 "Signal to noise level";
BA_ "SystemSignalLongSymbol" SG_ 1286 MRR_RL_CAN_DET_CONFID_AZIMU_0018 "MRR_RL_CAN_DET_CONFID_AZIMUTH_043";
BA_ "GenSigCmt" SG_ 1286 MRR_RL_CAN_DET_RANGE_043 "Detected object range";
BA_ "GenSigCmt" SG_ 1286 MRR_RL_CAN_SCAN_INDEX_2LSB_043 "The two LSB of scan index";
BA_ "GenSigCmt" SG_ 1286 MRR_RL_CAN_DET_RANGE_RATE_043 "Detected object range rate";
BA_ "GenSigStartValue" SG_ 1286 MRR_RL_CAN_DET_RANGE_RATE_043 8192;
BA_ "GenSigCmt" SG_ 1286 MRR_RL_CAN_DET_VALID_LEVEL_043 "Detected object valid level";
BA_ "GenSigCmt" SG_ 1286 MRR_RL_CAN_DET_AMPLITUDE_043 "Detected object amplitude";
BA_ "GenSigStartValue" SG_ 1286 MRR_RL_CAN_DET_AMPLITUDE_043 64;
BA_ "GenSigSendType" SG_ 1285 MRR_RL_CAN_DET_MID_TARGET_042 1;
BA_ "SignalDescription" SG_ 1285 MRR_RL_CAN_DET_MID_TARGET_042 "MID_Target_Discrimination";
BA_ "SignalDescription" SG_ 1285 MRR_RL_CAN_DET_MID_TARGET_041 "MID_Target_Discrimination";
BA_ "SignalDescription" SG_ 1285 MRR_RL_CAN_DET_MID_TARGET_040 "MID_Target_Discrimination";
BA_ "SignalDescription" SG_ 1285 MRR_RL_CAN_DET_MID_TARGET_039 "MID_Target_Discrimination";
BA_ "SignalDescription" SG_ 1285 MRR_RL_CAN_DET_MID_TARGET_038 "MID_Target_Discrimination";
BA_ "SignalDescription" SG_ 1285 MRR_RL_CAN_DET_MID_TARGET_037 "MID_Target_Discrimination";
BA_ "SignalDescription" SG_ 1285 MRR_RL_CAN_DET_MID_TARGET_036 "MID_Target_Discrimination";
BA_ "SignalDescription" SG_ 1285 MRR_RL_CAN_DET_Near_TARGET_036 "Near_Target_Discrimination";
BA_ "SignalDescription" SG_ 1285 MRR_RL_CAN_DET_Near_TARGET_037 "Near_Target_Discrimination";
BA_ "SignalDescription" SG_ 1285 MRR_RL_CAN_DET_Near_TARGET_038 "Near_Target_Discrimination";
BA_ "SignalDescription" SG_ 1285 MRR_RL_CAN_DET_Near_TARGET_039 "Near_Target_Discrimination";
BA_ "SignalDescription" SG_ 1285 MRR_RL_CAN_DET_Near_TARGET_040 "Near_Target_Discrimination";
BA_ "SignalDescription" SG_ 1285 MRR_RL_CAN_DET_Near_TARGET_041 "Near_Target_Discrimination";
BA_ "SignalDescription" SG_ 1285 MRR_RL_CAN_DET_Near_TARGET_042 "Near_Target_Discrimination";
BA_ "GenSigCmt" SG_ 1285 MRR_RL_CAN_DET_SUPER_RES_TA_0021 "Super resolution target";
BA_ "SystemSignalLongSymbol" SG_ 1285 MRR_RL_CAN_DET_SUPER_RES_TA_0021 "MRR_RL_CAN_DET_SUPER_RES_TARGET_042";
BA_ "GenSigStartValue" SG_ 1285 MRR_RL_CAN_DET_ELEVATION_042 63.8646288209607;
BA_ "GenSigCmt" SG_ 1285 MRR_RL_CAN_DET_ELEVATION_042 "Detected object elevation position";
BA_ "GenSigCmt" SG_ 1285 MRR_RL_CAN_DET_HOST_VEH_CLU_0021 "Host vehicle clutter";
BA_ "SystemSignalLongSymbol" SG_ 1285 MRR_RL_CAN_DET_HOST_VEH_CLU_0021 "MRR_RL_CAN_DET_HOST_VEH_CLUTTER_042";
BA_ "GenSigCmt" SG_ 1285 MRR_RL_CAN_DET_CONFID_ELEVA_0021 "Elevation Angle Confidence";
BA_ "SystemSignalLongSymbol" SG_ 1285 MRR_RL_CAN_DET_CONFID_ELEVA_0021 "MRR_RL_CAN_DET_CONFID_ELEVATION_042";
BA_ "GenSigCmt" SG_ 1285 MRR_RL_CAN_DET_AZIMUTH_042 "Detected object azimuth position";
BA_ "GenSigStartValue" SG_ 1285 MRR_RL_CAN_DET_AZIMUTH_042 8194.05320813772;
BA_ "GenSigVtEn" SG_ 1285 MRR_RL_CAN_DET_CONFID_AZIMU_0019 "TRUE";
BA_ "GenSigCmt" SG_ 1285 MRR_RL_CAN_DET_CONFID_AZIMU_0019 "Signal to noise level";
BA_ "SystemSignalLongSymbol" SG_ 1285 MRR_RL_CAN_DET_CONFID_AZIMU_0019 "MRR_RL_CAN_DET_CONFID_AZIMUTH_042";
BA_ "GenSigCmt" SG_ 1285 MRR_RL_CAN_DET_RANGE_042 "Detected object range";
BA_ "GenSigCmt" SG_ 1285 MRR_RL_CAN_SCAN_INDEX_2LSB_042 "The two LSB of scan index";
BA_ "GenSigCmt" SG_ 1285 MRR_RL_CAN_DET_RANGE_RATE_042 "Detected object range rate";
BA_ "GenSigStartValue" SG_ 1285 MRR_RL_CAN_DET_RANGE_RATE_042 8192;
BA_ "GenSigCmt" SG_ 1285 MRR_RL_CAN_DET_VALID_LEVEL_042 "Detected object valid level";
BA_ "GenSigCmt" SG_ 1285 MRR_RL_CAN_DET_AMPLITUDE_042 "Detected object amplitude";
BA_ "GenSigStartValue" SG_ 1285 MRR_RL_CAN_DET_AMPLITUDE_042 64;
BA_ "GenSigCmt" SG_ 1285 MRR_RL_CAN_DET_SUPER_RES_TA_0022 "Super resolution target";
BA_ "SystemSignalLongSymbol" SG_ 1285 MRR_RL_CAN_DET_SUPER_RES_TA_0022 "MRR_RL_CAN_DET_SUPER_RES_TARGET_041";
BA_ "GenSigCmt" SG_ 1285 MRR_RL_CAN_DET_ELEVATION_041 "Detected object elevation position";
BA_ "GenSigStartValue" SG_ 1285 MRR_RL_CAN_DET_ELEVATION_041 63.8646288209607;
BA_ "GenSigCmt" SG_ 1285 MRR_RL_CAN_DET_HOST_VEH_CLU_0022 "Host vehicle clutter";
BA_ "SystemSignalLongSymbol" SG_ 1285 MRR_RL_CAN_DET_HOST_VEH_CLU_0022 "MRR_RL_CAN_DET_HOST_VEH_CLUTTER_041";
BA_ "GenSigCmt" SG_ 1285 MRR_RL_CAN_DET_CONFID_ELEVA_0022 "Elevation Angle Confidence";
BA_ "SystemSignalLongSymbol" SG_ 1285 MRR_RL_CAN_DET_CONFID_ELEVA_0022 "MRR_RL_CAN_DET_CONFID_ELEVATION_041";
BA_ "GenSigCmt" SG_ 1285 MRR_RL_CAN_DET_AZIMUTH_041 "Detected object azimuth position";
BA_ "GenSigStartValue" SG_ 1285 MRR_RL_CAN_DET_AZIMUTH_041 8194.05320813772;
BA_ "GenSigVtEn" SG_ 1285 MRR_RL_CAN_DET_CONFID_AZIMU_0020 "TRUE";
BA_ "GenSigCmt" SG_ 1285 MRR_RL_CAN_DET_CONFID_AZIMU_0020 "Signal to noise level";
BA_ "SystemSignalLongSymbol" SG_ 1285 MRR_RL_CAN_DET_CONFID_AZIMU_0020 "MRR_RL_CAN_DET_CONFID_AZIMUTH_041";
BA_ "GenSigCmt" SG_ 1285 MRR_RL_CAN_DET_RANGE_041 "Detected object range";
BA_ "GenSigCmt" SG_ 1285 MRR_RL_CAN_SCAN_INDEX_2LSB_041 "The two LSB of scan index";
BA_ "GenSigCmt" SG_ 1285 MRR_RL_CAN_DET_RANGE_RATE_041 "Detected object range rate";
BA_ "GenSigStartValue" SG_ 1285 MRR_RL_CAN_DET_RANGE_RATE_041 8192;
BA_ "GenSigCmt" SG_ 1285 MRR_RL_CAN_DET_VALID_LEVEL_041 "Detected object valid level";
BA_ "GenSigCmt" SG_ 1285 MRR_RL_CAN_DET_AMPLITUDE_041 "Detected object amplitude";
BA_ "GenSigStartValue" SG_ 1285 MRR_RL_CAN_DET_AMPLITUDE_041 64;
BA_ "GenSigCmt" SG_ 1285 MRR_RL_CAN_DET_SUPER_RES_TA_0023 "Super resolution target";
BA_ "SystemSignalLongSymbol" SG_ 1285 MRR_RL_CAN_DET_SUPER_RES_TA_0023 "MRR_RL_CAN_DET_SUPER_RES_TARGET_040";
BA_ "GenSigCmt" SG_ 1285 MRR_RL_CAN_DET_ELEVATION_040 "Detected object elevation position";
BA_ "GenSigStartValue" SG_ 1285 MRR_RL_CAN_DET_ELEVATION_040 63.8646288209607;
BA_ "GenSigCmt" SG_ 1285 MRR_RL_CAN_DET_HOST_VEH_CLU_0023 "Host vehicle clutter";
BA_ "SystemSignalLongSymbol" SG_ 1285 MRR_RL_CAN_DET_HOST_VEH_CLU_0023 "MRR_RL_CAN_DET_HOST_VEH_CLUTTER_040";
BA_ "GenSigCmt" SG_ 1285 MRR_RL_CAN_DET_CONFID_ELEVA_0023 "Elevation Angle Confidence";
BA_ "SystemSignalLongSymbol" SG_ 1285 MRR_RL_CAN_DET_CONFID_ELEVA_0023 "MRR_RL_CAN_DET_CONFID_ELEVATION_040";
BA_ "GenSigCmt" SG_ 1285 MRR_RL_CAN_DET_AZIMUTH_040 "Detected object azimuth position";
BA_ "GenSigStartValue" SG_ 1285 MRR_RL_CAN_DET_AZIMUTH_040 8194.05320813772;
BA_ "GenSigVtEn" SG_ 1285 MRR_RL_CAN_DET_CONFID_AZIMU_0021 "TRUE";
BA_ "GenSigCmt" SG_ 1285 MRR_RL_CAN_DET_CONFID_AZIMU_0021 "Signal to noise level";
BA_ "SystemSignalLongSymbol" SG_ 1285 MRR_RL_CAN_DET_CONFID_AZIMU_0021 "MRR_RL_CAN_DET_CONFID_AZIMUTH_040";
BA_ "GenSigCmt" SG_ 1285 MRR_RL_CAN_DET_RANGE_040 "Detected object range";
BA_ "GenSigCmt" SG_ 1285 MRR_RL_CAN_SCAN_INDEX_2LSB_040 "The two LSB of scan index";
BA_ "GenSigCmt" SG_ 1285 MRR_RL_CAN_DET_RANGE_RATE_040 "Detected object range rate";
BA_ "GenSigStartValue" SG_ 1285 MRR_RL_CAN_DET_RANGE_RATE_040 8192;
BA_ "GenSigCmt" SG_ 1285 MRR_RL_CAN_DET_VALID_LEVEL_040 "Detected object valid level";
BA_ "GenSigCmt" SG_ 1285 MRR_RL_CAN_DET_AMPLITUDE_040 "Detected object amplitude";
BA_ "GenSigStartValue" SG_ 1285 MRR_RL_CAN_DET_AMPLITUDE_040 64;
BA_ "GenSigCmt" SG_ 1285 MRR_RL_CAN_DET_SUPER_RES_TA_0024 "Super resolution target";
BA_ "SystemSignalLongSymbol" SG_ 1285 MRR_RL_CAN_DET_SUPER_RES_TA_0024 "MRR_RL_CAN_DET_SUPER_RES_TARGET_039";
BA_ "GenSigCmt" SG_ 1285 MRR_RL_CAN_DET_ELEVATION_039 "Detected object elevation position";
BA_ "GenSigStartValue" SG_ 1285 MRR_RL_CAN_DET_ELEVATION_039 63.8646288209607;
BA_ "GenSigCmt" SG_ 1285 MRR_RL_CAN_DET_HOST_VEH_CLU_0024 "Host vehicle clutter";
BA_ "SystemSignalLongSymbol" SG_ 1285 MRR_RL_CAN_DET_HOST_VEH_CLU_0024 "MRR_RL_CAN_DET_HOST_VEH_CLUTTER_039";
BA_ "GenSigCmt" SG_ 1285 MRR_RL_CAN_DET_CONFID_ELEVA_0024 "Elevation Angle Confidence";
BA_ "SystemSignalLongSymbol" SG_ 1285 MRR_RL_CAN_DET_CONFID_ELEVA_0024 "MRR_RL_CAN_DET_CONFID_ELEVATION_039";
BA_ "GenSigCmt" SG_ 1285 MRR_RL_CAN_DET_AZIMUTH_039 "Detected object azimuth position";
BA_ "GenSigStartValue" SG_ 1285 MRR_RL_CAN_DET_AZIMUTH_039 8194.05320813772;
BA_ "GenSigVtEn" SG_ 1285 MRR_RL_CAN_DET_CONFID_AZIMUTH_03 "TRUE";
BA_ "GenSigCmt" SG_ 1285 MRR_RL_CAN_DET_CONFID_AZIMUTH_03 "Signal to noise level";
BA_ "SystemSignalLongSymbol" SG_ 1285 MRR_RL_CAN_DET_CONFID_AZIMUTH_03 "MRR_RL_CAN_DET_CONFID_AZIMUTH_039";
BA_ "GenSigCmt" SG_ 1285 MRR_RL_CAN_DET_RANGE_039 "Detected object range";
BA_ "GenSigCmt" SG_ 1285 MRR_RL_CAN_SCAN_INDEX_2LSB_039 "The two LSB of scan index";
BA_ "GenSigCmt" SG_ 1285 MRR_RL_CAN_DET_RANGE_RATE_039 "Detected object range rate";
BA_ "GenSigStartValue" SG_ 1285 MRR_RL_CAN_DET_RANGE_RATE_039 8192;
BA_ "GenSigCmt" SG_ 1285 MRR_RL_CAN_DET_VALID_LEVEL_039 "Detected object valid level";
BA_ "GenSigCmt" SG_ 1285 MRR_RL_CAN_DET_AMPLITUDE_039 "Detected object amplitude";
BA_ "GenSigStartValue" SG_ 1285 MRR_RL_CAN_DET_AMPLITUDE_039 64;
BA_ "GenSigCmt" SG_ 1285 MRR_RL_CAN_DET_SUPER_RES_TA_0025 "Super resolution target";
BA_ "SystemSignalLongSymbol" SG_ 1285 MRR_RL_CAN_DET_SUPER_RES_TA_0025 "MRR_RL_CAN_DET_SUPER_RES_TARGET_038";
BA_ "GenSigCmt" SG_ 1285 MRR_RL_CAN_DET_ELEVATION_038 "Detected object elevation position";
BA_ "GenSigStartValue" SG_ 1285 MRR_RL_CAN_DET_ELEVATION_038 63.8646288209607;
BA_ "GenSigCmt" SG_ 1285 MRR_RL_CAN_DET_HOST_VEH_CLU_0025 "Host vehicle clutter";
BA_ "SystemSignalLongSymbol" SG_ 1285 MRR_RL_CAN_DET_HOST_VEH_CLU_0025 "MRR_RL_CAN_DET_HOST_VEH_CLUTTER_038";
BA_ "GenSigCmt" SG_ 1285 MRR_RL_CAN_DET_CONFID_ELEVA_0025 "Elevation Angle Confidence";
BA_ "SystemSignalLongSymbol" SG_ 1285 MRR_RL_CAN_DET_CONFID_ELEVA_0025 "MRR_RL_CAN_DET_CONFID_ELEVATION_038";
BA_ "GenSigCmt" SG_ 1285 MRR_RL_CAN_DET_AZIMUTH_038 "Detected object azimuth position";
BA_ "GenSigStartValue" SG_ 1285 MRR_RL_CAN_DET_AZIMUTH_038 8194.05320813772;
BA_ "GenSigVtEn" SG_ 1285 MRR_RL_CAN_DET_CONFID_AZIMU_0022 "TRUE";
BA_ "GenSigCmt" SG_ 1285 MRR_RL_CAN_DET_CONFID_AZIMU_0022 "Signal to noise level";
BA_ "SystemSignalLongSymbol" SG_ 1285 MRR_RL_CAN_DET_CONFID_AZIMU_0022 "MRR_RL_CAN_DET_CONFID_AZIMUTH_038";
BA_ "GenSigCmt" SG_ 1285 MRR_RL_CAN_DET_RANGE_038 "Detected object range";
BA_ "GenSigCmt" SG_ 1285 MRR_RL_CAN_SCAN_INDEX_2LSB_038 "The two LSB of scan index";
BA_ "GenSigCmt" SG_ 1285 MRR_RL_CAN_DET_RANGE_RATE_038 "Detected object range rate";
BA_ "GenSigStartValue" SG_ 1285 MRR_RL_CAN_DET_RANGE_RATE_038 8192;
BA_ "GenSigCmt" SG_ 1285 MRR_RL_CAN_DET_VALID_LEVEL_038 "Detected object valid level";
BA_ "GenSigCmt" SG_ 1285 MRR_RL_CAN_DET_AMPLITUDE_038 "Detected object amplitude";
BA_ "GenSigStartValue" SG_ 1285 MRR_RL_CAN_DET_AMPLITUDE_038 64;
BA_ "GenSigCmt" SG_ 1285 MRR_RL_CAN_DET_SUPER_RES_TA_0026 "Super resolution target";
BA_ "SystemSignalLongSymbol" SG_ 1285 MRR_RL_CAN_DET_SUPER_RES_TA_0026 "MRR_RL_CAN_DET_SUPER_RES_TARGET_037";
BA_ "GenSigCmt" SG_ 1285 MRR_RL_CAN_DET_ELEVATION_037 "Detected object elevation position";
BA_ "GenSigStartValue" SG_ 1285 MRR_RL_CAN_DET_ELEVATION_037 63.8646288209607;
BA_ "GenSigCmt" SG_ 1285 MRR_RL_CAN_DET_HOST_VEH_CLU_0026 "Host vehicle clutter";
BA_ "SystemSignalLongSymbol" SG_ 1285 MRR_RL_CAN_DET_HOST_VEH_CLU_0026 "MRR_RL_CAN_DET_HOST_VEH_CLUTTER_037";
BA_ "GenSigCmt" SG_ 1285 MRR_RL_CAN_DET_CONFID_ELEVA_0026 "Elevation Angle Confidence";
BA_ "SystemSignalLongSymbol" SG_ 1285 MRR_RL_CAN_DET_CONFID_ELEVA_0026 "MRR_RL_CAN_DET_CONFID_ELEVATION_037";
BA_ "GenSigCmt" SG_ 1285 MRR_RL_CAN_DET_AZIMUTH_037 "Detected object azimuth position";
BA_ "GenSigStartValue" SG_ 1285 MRR_RL_CAN_DET_AZIMUTH_037 8194.05320813772;
BA_ "GenSigVtEn" SG_ 1285 MRR_RL_CAN_DET_CONFID_AZIMU_0023 "TRUE";
BA_ "GenSigCmt" SG_ 1285 MRR_RL_CAN_DET_CONFID_AZIMU_0023 "Signal to noise level";
BA_ "SystemSignalLongSymbol" SG_ 1285 MRR_RL_CAN_DET_CONFID_AZIMU_0023 "MRR_RL_CAN_DET_CONFID_AZIMUTH_037";
BA_ "GenSigCmt" SG_ 1285 MRR_RL_CAN_DET_RANGE_037 "Detected object range";
BA_ "GenSigCmt" SG_ 1285 MRR_RL_CAN_SCAN_INDEX_2LSB_037 "The two LSB of scan index";
BA_ "GenSigCmt" SG_ 1285 MRR_RL_CAN_DET_RANGE_RATE_037 "Detected object range rate";
BA_ "GenSigStartValue" SG_ 1285 MRR_RL_CAN_DET_RANGE_RATE_037 8192;
BA_ "GenSigCmt" SG_ 1285 MRR_RL_CAN_DET_VALID_LEVEL_037 "Detected object valid level";
BA_ "GenSigCmt" SG_ 1285 MRR_RL_CAN_DET_AMPLITUDE_037 "Detected object amplitude";
BA_ "GenSigStartValue" SG_ 1285 MRR_RL_CAN_DET_AMPLITUDE_037 64;
BA_ "GenSigCmt" SG_ 1285 MRR_RL_CAN_DET_SUPER_RES_TA_0027 "Super resolution target";
BA_ "SystemSignalLongSymbol" SG_ 1285 MRR_RL_CAN_DET_SUPER_RES_TA_0027 "MRR_RL_CAN_DET_SUPER_RES_TARGET_036";
BA_ "GenSigCmt" SG_ 1285 MRR_RL_CAN_DET_ELEVATION_036 "Detected object elevation position";
BA_ "GenSigStartValue" SG_ 1285 MRR_RL_CAN_DET_ELEVATION_036 63.8646288209607;
BA_ "GenSigCmt" SG_ 1285 MRR_RL_CAN_DET_HOST_VEH_CLU_0027 "Host vehicle clutter";
BA_ "SystemSignalLongSymbol" SG_ 1285 MRR_RL_CAN_DET_HOST_VEH_CLU_0027 "MRR_RL_CAN_DET_HOST_VEH_CLUTTER_036";
BA_ "GenSigCmt" SG_ 1285 MRR_RL_CAN_DET_CONFID_ELEVA_0027 "Elevation Angle Confidence";
BA_ "SystemSignalLongSymbol" SG_ 1285 MRR_RL_CAN_DET_CONFID_ELEVA_0027 "MRR_RL_CAN_DET_CONFID_ELEVATION_036";
BA_ "GenSigCmt" SG_ 1285 MRR_RL_CAN_DET_AZIMUTH_036 "Detected object azimuth position";
BA_ "GenSigStartValue" SG_ 1285 MRR_RL_CAN_DET_AZIMUTH_036 8194.05320813772;
BA_ "GenSigVtEn" SG_ 1285 MRR_RL_CAN_DET_CONFID_AZIMU_0024 "TRUE";
BA_ "GenSigCmt" SG_ 1285 MRR_RL_CAN_DET_CONFID_AZIMU_0024 "Signal to noise level";
BA_ "SystemSignalLongSymbol" SG_ 1285 MRR_RL_CAN_DET_CONFID_AZIMU_0024 "MRR_RL_CAN_DET_CONFID_AZIMUTH_036";
BA_ "GenSigCmt" SG_ 1285 MRR_RL_CAN_DET_RANGE_036 "Detected object range";
BA_ "GenSigCmt" SG_ 1285 MRR_RL_CAN_SCAN_INDEX_2LSB_036 "The two LSB of scan index";
BA_ "GenSigCmt" SG_ 1285 MRR_RL_CAN_DET_RANGE_RATE_036 "Detected object range rate";
BA_ "GenSigStartValue" SG_ 1285 MRR_RL_CAN_DET_RANGE_RATE_036 8192;
BA_ "GenSigCmt" SG_ 1285 MRR_RL_CAN_DET_VALID_LEVEL_036 "Detected object valid level";
BA_ "GenSigCmt" SG_ 1285 MRR_RL_CAN_DET_AMPLITUDE_036 "Detected object amplitude";
BA_ "GenSigStartValue" SG_ 1285 MRR_RL_CAN_DET_AMPLITUDE_036 64;
BA_ "GenSigSendType" SG_ 1284 MRR_RL_CAN_DET_MID_TARGET_035 1;
BA_ "SignalDescription" SG_ 1284 MRR_RL_CAN_DET_MID_TARGET_035 "MID_Target_Discrimination";
BA_ "SignalDescription" SG_ 1284 MRR_RL_CAN_DET_MID_TARGET_034 "MID_Target_Discrimination";
BA_ "SignalDescription" SG_ 1284 MRR_RL_CAN_DET_MID_TARGET_033 "MID_Target_Discrimination";
BA_ "SignalDescription" SG_ 1284 MRR_RL_CAN_DET_MID_TARGET_032 "MID_Target_Discrimination";
BA_ "SignalDescription" SG_ 1284 MRR_RL_CAN_DET_MID_TARGET_031 "MID_Target_Discrimination";
BA_ "SignalDescription" SG_ 1284 MRR_RL_CAN_DET_MID_TARGET_030 "MID_Target_Discrimination";
BA_ "SignalDescription" SG_ 1284 MRR_RL_CAN_DET_MID_TARGET_029 "MID_Target_Discrimination";
BA_ "SignalDescription" SG_ 1284 MRR_RL_CAN_DET_Near_TARGET_029 "Near_Target_Discrimination";
BA_ "SignalDescription" SG_ 1284 MRR_RL_CAN_DET_Near_TARGET_030 "Near_Target_Discrimination";
BA_ "SignalDescription" SG_ 1284 MRR_RL_CAN_DET_Near_TARGET_031 "Near_Target_Discrimination";
BA_ "SignalDescription" SG_ 1284 MRR_RL_CAN_DET_Near_TARGET_032 "Near_Target_Discrimination";
BA_ "SignalDescription" SG_ 1284 MRR_RL_CAN_DET_Near_TARGET_033 "Near_Target_Discrimination";
BA_ "SignalDescription" SG_ 1284 MRR_RL_CAN_DET_Near_TARGET_034 "Near_Target_Discrimination";
BA_ "SignalDescription" SG_ 1284 MRR_RL_CAN_DET_Near_TARGET_035 "Near_Target_Discrimination";
BA_ "GenSigCmt" SG_ 1284 MRR_RL_CAN_DET_SUPER_RES_TA_0028 "Super resolution target ";
BA_ "SystemSignalLongSymbol" SG_ 1284 MRR_RL_CAN_DET_SUPER_RES_TA_0028 "MRR_RL_CAN_DET_SUPER_RES_TARGET_035";
BA_ "GenSigStartValue" SG_ 1284 MRR_RL_CAN_DET_ELEVATION_035 63.8646288209607;
BA_ "GenSigCmt" SG_ 1284 MRR_RL_CAN_DET_ELEVATION_035 "Detected object elevation position";
BA_ "GenSigCmt" SG_ 1284 MRR_RL_CAN_DET_HOST_VEH_CLU_0028 "Host vehicle clutter";
BA_ "SystemSignalLongSymbol" SG_ 1284 MRR_RL_CAN_DET_HOST_VEH_CLU_0028 "MRR_RL_CAN_DET_HOST_VEH_CLUTTER_035";
BA_ "GenSigCmt" SG_ 1284 MRR_RL_CAN_DET_CONFID_ELEVA_0028 "Elevation Angle Confidence";
BA_ "SystemSignalLongSymbol" SG_ 1284 MRR_RL_CAN_DET_CONFID_ELEVA_0028 "MRR_RL_CAN_DET_CONFID_ELEVATION_035";
BA_ "GenSigStartValue" SG_ 1284 MRR_RL_CAN_DET_AZIMUTH_035 8194.05320813772;
BA_ "GenSigCmt" SG_ 1284 MRR_RL_CAN_DET_AZIMUTH_035 "Detected object azimuth position";
BA_ "GenSigCmt" SG_ 1284 MRR_RL_CAN_DET_CONFID_AZIMU_0025 "Signal to noise level";
BA_ "GenSigVtEn" SG_ 1284 MRR_RL_CAN_DET_CONFID_AZIMU_0025 "TRUE";
BA_ "SystemSignalLongSymbol" SG_ 1284 MRR_RL_CAN_DET_CONFID_AZIMU_0025 "MRR_RL_CAN_DET_CONFID_AZIMUTH_035";
BA_ "GenSigCmt" SG_ 1284 MRR_RL_CAN_DET_RANGE_035 "Detected object range";
BA_ "GenSigCmt" SG_ 1284 MRR_RL_CAN_SCAN_INDEX_2LSB_035 "The two LSB of scan index";
BA_ "GenSigStartValue" SG_ 1284 MRR_RL_CAN_DET_RANGE_RATE_035 8192;
BA_ "GenSigCmt" SG_ 1284 MRR_RL_CAN_DET_RANGE_RATE_035 "Detected object range rate";
BA_ "GenSigCmt" SG_ 1284 MRR_RL_CAN_DET_VALID_LEVEL_035 "Detected object valid level";
BA_ "GenSigStartValue" SG_ 1284 MRR_RL_CAN_DET_AMPLITUDE_035 64;
BA_ "GenSigCmt" SG_ 1284 MRR_RL_CAN_DET_AMPLITUDE_035 "Detected object amplitude";
BA_ "GenSigCmt" SG_ 1284 MRR_RL_CAN_DET_SUPER_RES_TA_0029 "Super resolution target ";
BA_ "SystemSignalLongSymbol" SG_ 1284 MRR_RL_CAN_DET_SUPER_RES_TA_0029 "MRR_RL_CAN_DET_SUPER_RES_TARGET_034";
BA_ "GenSigStartValue" SG_ 1284 MRR_RL_CAN_DET_ELEVATION_034 63.8646288209607;
BA_ "GenSigCmt" SG_ 1284 MRR_RL_CAN_DET_ELEVATION_034 "Detected object elevation position";
BA_ "GenSigCmt" SG_ 1284 MRR_RL_CAN_DET_HOST_VEH_CLU_0029 "Host vehicle clutter";
BA_ "SystemSignalLongSymbol" SG_ 1284 MRR_RL_CAN_DET_HOST_VEH_CLU_0029 "MRR_RL_CAN_DET_HOST_VEH_CLUTTER_034";
BA_ "GenSigCmt" SG_ 1284 MRR_RL_CAN_DET_CONFID_ELEVA_0029 "Elevation Angle Confidence";
BA_ "SystemSignalLongSymbol" SG_ 1284 MRR_RL_CAN_DET_CONFID_ELEVA_0029 "MRR_RL_CAN_DET_CONFID_ELEVATION_034";
BA_ "GenSigStartValue" SG_ 1284 MRR_RL_CAN_DET_AZIMUTH_034 8194.05320813772;
BA_ "GenSigCmt" SG_ 1284 MRR_RL_CAN_DET_AZIMUTH_034 "Detected object azimuth position";
BA_ "GenSigCmt" SG_ 1284 MRR_RL_CAN_DET_CONFID_AZIMU_0026 "Signal to noise level";
BA_ "GenSigVtEn" SG_ 1284 MRR_RL_CAN_DET_CONFID_AZIMU_0026 "TRUE";
BA_ "SystemSignalLongSymbol" SG_ 1284 MRR_RL_CAN_DET_CONFID_AZIMU_0026 "MRR_RL_CAN_DET_CONFID_AZIMUTH_034";
BA_ "GenSigCmt" SG_ 1284 MRR_RL_CAN_DET_RANGE_034 "Detected object range";
BA_ "GenSigCmt" SG_ 1284 MRR_RL_CAN_SCAN_INDEX_2LSB_034 "The two LSB of scan index";
BA_ "GenSigStartValue" SG_ 1284 MRR_RL_CAN_DET_RANGE_RATE_034 8192;
BA_ "GenSigCmt" SG_ 1284 MRR_RL_CAN_DET_RANGE_RATE_034 "Detected object range rate";
BA_ "GenSigCmt" SG_ 1284 MRR_RL_CAN_DET_VALID_LEVEL_034 "Detected object valid level";
BA_ "GenSigStartValue" SG_ 1284 MRR_RL_CAN_DET_AMPLITUDE_034 64;
BA_ "GenSigCmt" SG_ 1284 MRR_RL_CAN_DET_AMPLITUDE_034 "Detected object amplitude";
BA_ "GenSigCmt" SG_ 1284 MRR_RL_CAN_DET_SUPER_RES_TA_0030 "Super resolution target ";
BA_ "SystemSignalLongSymbol" SG_ 1284 MRR_RL_CAN_DET_SUPER_RES_TA_0030 "MRR_RL_CAN_DET_SUPER_RES_TARGET_033";
BA_ "GenSigStartValue" SG_ 1284 MRR_RL_CAN_DET_ELEVATION_033 63.8646288209607;
BA_ "GenSigCmt" SG_ 1284 MRR_RL_CAN_DET_ELEVATION_033 "Detected object elevation position";
BA_ "GenSigCmt" SG_ 1284 MRR_RL_CAN_DET_HOST_VEH_CLU_0030 "Host vehicle clutter";
BA_ "SystemSignalLongSymbol" SG_ 1284 MRR_RL_CAN_DET_HOST_VEH_CLU_0030 "MRR_RL_CAN_DET_HOST_VEH_CLUTTER_033";
BA_ "GenSigCmt" SG_ 1284 MRR_RL_CAN_DET_CONFID_ELEVA_0030 "Elevation Angle Confidence";
BA_ "SystemSignalLongSymbol" SG_ 1284 MRR_RL_CAN_DET_CONFID_ELEVA_0030 "MRR_RL_CAN_DET_CONFID_ELEVATION_033";
BA_ "GenSigStartValue" SG_ 1284 MRR_RL_CAN_DET_AZIMUTH_033 8194.05320813772;
BA_ "GenSigCmt" SG_ 1284 MRR_RL_CAN_DET_AZIMUTH_033 "Detected object azimuth position";
BA_ "GenSigCmt" SG_ 1284 MRR_RL_CAN_DET_CONFID_AZIMU_0027 "Signal to noise level";
BA_ "GenSigVtEn" SG_ 1284 MRR_RL_CAN_DET_CONFID_AZIMU_0027 "TRUE";
BA_ "SystemSignalLongSymbol" SG_ 1284 MRR_RL_CAN_DET_CONFID_AZIMU_0027 "MRR_RL_CAN_DET_CONFID_AZIMUTH_033";
BA_ "GenSigCmt" SG_ 1284 MRR_RL_CAN_DET_RANGE_033 "Detected object range";
BA_ "GenSigCmt" SG_ 1284 MRR_RL_CAN_SCAN_INDEX_2LSB_033 "The two LSB of scan index";
BA_ "GenSigStartValue" SG_ 1284 MRR_RL_CAN_DET_RANGE_RATE_033 8192;
BA_ "GenSigCmt" SG_ 1284 MRR_RL_CAN_DET_RANGE_RATE_033 "Detected object range rate";
BA_ "GenSigCmt" SG_ 1284 MRR_RL_CAN_DET_VALID_LEVEL_033 "Detected object valid level";
BA_ "GenSigStartValue" SG_ 1284 MRR_RL_CAN_DET_AMPLITUDE_033 64;
BA_ "GenSigCmt" SG_ 1284 MRR_RL_CAN_DET_AMPLITUDE_033 "Detected object amplitude";
BA_ "GenSigCmt" SG_ 1284 MRR_RL_CAN_DET_SUPER_RES_TA_0031 "Super resolution target ";
BA_ "SystemSignalLongSymbol" SG_ 1284 MRR_RL_CAN_DET_SUPER_RES_TA_0031 "MRR_RL_CAN_DET_SUPER_RES_TARGET_032";
BA_ "GenSigStartValue" SG_ 1284 MRR_RL_CAN_DET_ELEVATION_032 63.8646288209607;
BA_ "GenSigCmt" SG_ 1284 MRR_RL_CAN_DET_ELEVATION_032 "Detected object elevation position";
BA_ "GenSigCmt" SG_ 1284 MRR_RL_CAN_DET_HOST_VEH_CLU_0031 "Host vehicle clutter";
BA_ "SystemSignalLongSymbol" SG_ 1284 MRR_RL_CAN_DET_HOST_VEH_CLU_0031 "MRR_RL_CAN_DET_HOST_VEH_CLUTTER_032";
BA_ "GenSigCmt" SG_ 1284 MRR_RL_CAN_DET_CONFID_ELEVA_0031 "Elevation Angle Confidence";
BA_ "SystemSignalLongSymbol" SG_ 1284 MRR_RL_CAN_DET_CONFID_ELEVA_0031 "MRR_RL_CAN_DET_CONFID_ELEVATION_032";
BA_ "GenSigStartValue" SG_ 1284 MRR_RL_CAN_DET_AZIMUTH_032 8194.05320813772;
BA_ "GenSigCmt" SG_ 1284 MRR_RL_CAN_DET_AZIMUTH_032 "Detected object azimuth position";
BA_ "GenSigCmt" SG_ 1284 MRR_RL_CAN_DET_CONFID_AZIMU_0028 "Signal to noise level";
BA_ "GenSigVtEn" SG_ 1284 MRR_RL_CAN_DET_CONFID_AZIMU_0028 "TRUE";
BA_ "SystemSignalLongSymbol" SG_ 1284 MRR_RL_CAN_DET_CONFID_AZIMU_0028 "MRR_RL_CAN_DET_CONFID_AZIMUTH_032";
BA_ "GenSigCmt" SG_ 1284 MRR_RL_CAN_DET_RANGE_032 "Detected object range";
BA_ "GenSigCmt" SG_ 1284 MRR_RL_CAN_SCAN_INDEX_2LSB_032 "The two LSB of scan index";
BA_ "GenSigStartValue" SG_ 1284 MRR_RL_CAN_DET_RANGE_RATE_032 8192;
BA_ "GenSigCmt" SG_ 1284 MRR_RL_CAN_DET_RANGE_RATE_032 "Detected object range rate";
BA_ "GenSigCmt" SG_ 1284 MRR_RL_CAN_DET_VALID_LEVEL_032 "Detected object valid level";
BA_ "GenSigStartValue" SG_ 1284 MRR_RL_CAN_DET_AMPLITUDE_032 64;
BA_ "GenSigCmt" SG_ 1284 MRR_RL_CAN_DET_AMPLITUDE_032 "Detected object amplitude";
BA_ "GenSigCmt" SG_ 1284 MRR_RL_CAN_DET_SUPER_RES_TA_0032 "Super resolution target ";
BA_ "SystemSignalLongSymbol" SG_ 1284 MRR_RL_CAN_DET_SUPER_RES_TA_0032 "MRR_RL_CAN_DET_SUPER_RES_TARGET_031";
BA_ "GenSigStartValue" SG_ 1284 MRR_RL_CAN_DET_ELEVATION_031 63.8646288209607;
BA_ "GenSigCmt" SG_ 1284 MRR_RL_CAN_DET_ELEVATION_031 "Detected object elevation position";
BA_ "GenSigCmt" SG_ 1284 MRR_RL_CAN_DET_HOST_VEH_CLU_0032 "Host vehicle clutter";
BA_ "SystemSignalLongSymbol" SG_ 1284 MRR_RL_CAN_DET_HOST_VEH_CLU_0032 "MRR_RL_CAN_DET_HOST_VEH_CLUTTER_031";
BA_ "GenSigCmt" SG_ 1284 MRR_RL_CAN_DET_CONFID_ELEVA_0032 "Elevation Angle Confidence";
BA_ "SystemSignalLongSymbol" SG_ 1284 MRR_RL_CAN_DET_CONFID_ELEVA_0032 "MRR_RL_CAN_DET_CONFID_ELEVATION_031";
BA_ "GenSigStartValue" SG_ 1284 MRR_RL_CAN_DET_AZIMUTH_031 8194.05320813772;
BA_ "GenSigCmt" SG_ 1284 MRR_RL_CAN_DET_AZIMUTH_031 "Detected object azimuth position";
BA_ "GenSigCmt" SG_ 1284 MRR_RL_CAN_DET_CONFID_AZIMU_0029 "Signal to noise level";
BA_ "GenSigVtEn" SG_ 1284 MRR_RL_CAN_DET_CONFID_AZIMU_0029 "TRUE";
BA_ "SystemSignalLongSymbol" SG_ 1284 MRR_RL_CAN_DET_CONFID_AZIMU_0029 "MRR_RL_CAN_DET_CONFID_AZIMUTH_031";
BA_ "GenSigCmt" SG_ 1284 MRR_RL_CAN_DET_RANGE_031 "Detected object range";
BA_ "GenSigCmt" SG_ 1284 MRR_RL_CAN_SCAN_INDEX_2LSB_031 "The two LSB of scan index";
BA_ "GenSigStartValue" SG_ 1284 MRR_RL_CAN_DET_RANGE_RATE_031 8192;
BA_ "GenSigCmt" SG_ 1284 MRR_RL_CAN_DET_RANGE_RATE_031 "Detected object range rate";
BA_ "GenSigCmt" SG_ 1284 MRR_RL_CAN_DET_VALID_LEVEL_031 "Detected object valid level";
BA_ "GenSigStartValue" SG_ 1284 MRR_RL_CAN_DET_AMPLITUDE_031 64;
BA_ "GenSigCmt" SG_ 1284 MRR_RL_CAN_DET_AMPLITUDE_031 "Detected object amplitude";
BA_ "GenSigCmt" SG_ 1284 MRR_RL_CAN_DET_SUPER_RES_TA_0033 "Super resolution target ";
BA_ "SystemSignalLongSymbol" SG_ 1284 MRR_RL_CAN_DET_SUPER_RES_TA_0033 "MRR_RL_CAN_DET_SUPER_RES_TARGET_030";
BA_ "GenSigStartValue" SG_ 1284 MRR_RL_CAN_DET_ELEVATION_030 63.8646288209607;
BA_ "GenSigCmt" SG_ 1284 MRR_RL_CAN_DET_ELEVATION_030 "Detected object elevation position";
BA_ "GenSigCmt" SG_ 1284 MRR_RL_CAN_DET_HOST_VEH_CLU_0033 "Host vehicle clutter";
BA_ "SystemSignalLongSymbol" SG_ 1284 MRR_RL_CAN_DET_HOST_VEH_CLU_0033 "MRR_RL_CAN_DET_HOST_VEH_CLUTTER_030";
BA_ "GenSigCmt" SG_ 1284 MRR_RL_CAN_DET_CONFID_ELEVA_0033 "Elevation Angle Confidence";
BA_ "SystemSignalLongSymbol" SG_ 1284 MRR_RL_CAN_DET_CONFID_ELEVA_0033 "MRR_RL_CAN_DET_CONFID_ELEVATION_030";
BA_ "GenSigStartValue" SG_ 1284 MRR_RL_CAN_DET_AZIMUTH_030 8194.05320813772;
BA_ "GenSigCmt" SG_ 1284 MRR_RL_CAN_DET_AZIMUTH_030 "Detected object azimuth position";
BA_ "GenSigCmt" SG_ 1284 MRR_RL_CAN_DET_CONFID_AZIMU_0030 "Signal to noise level";
BA_ "GenSigVtEn" SG_ 1284 MRR_RL_CAN_DET_CONFID_AZIMU_0030 "TRUE";
BA_ "SystemSignalLongSymbol" SG_ 1284 MRR_RL_CAN_DET_CONFID_AZIMU_0030 "MRR_RL_CAN_DET_CONFID_AZIMUTH_030";
BA_ "GenSigCmt" SG_ 1284 MRR_RL_CAN_DET_RANGE_030 "Detected object range";
BA_ "GenSigCmt" SG_ 1284 MRR_RL_CAN_SCAN_INDEX_2LSB_030 "The two LSB of scan index";
BA_ "GenSigStartValue" SG_ 1284 MRR_RL_CAN_DET_RANGE_RATE_030 8192;
BA_ "GenSigCmt" SG_ 1284 MRR_RL_CAN_DET_RANGE_RATE_030 "Detected object range rate";
BA_ "GenSigCmt" SG_ 1284 MRR_RL_CAN_DET_VALID_LEVEL_030 "Detected object valid level";
BA_ "GenSigStartValue" SG_ 1284 MRR_RL_CAN_DET_AMPLITUDE_030 64;
BA_ "GenSigCmt" SG_ 1284 MRR_RL_CAN_DET_AMPLITUDE_030 "Detected object amplitude";
BA_ "GenSigCmt" SG_ 1284 MRR_RL_CAN_DET_SUPER_RES_TA_0034 "Super resolution target ";
BA_ "SystemSignalLongSymbol" SG_ 1284 MRR_RL_CAN_DET_SUPER_RES_TA_0034 "MRR_RL_CAN_DET_SUPER_RES_TARGET_029";
BA_ "GenSigStartValue" SG_ 1284 MRR_RL_CAN_DET_ELEVATION_029 63.8646288209607;
BA_ "GenSigCmt" SG_ 1284 MRR_RL_CAN_DET_ELEVATION_029 "Detected object elevation position";
BA_ "GenSigCmt" SG_ 1284 MRR_RL_CAN_DET_HOST_VEH_CLU_0034 "Host vehicle clutter";
BA_ "SystemSignalLongSymbol" SG_ 1284 MRR_RL_CAN_DET_HOST_VEH_CLU_0034 "MRR_RL_CAN_DET_HOST_VEH_CLUTTER_029";
BA_ "GenSigCmt" SG_ 1284 MRR_RL_CAN_DET_CONFID_ELEVA_0034 "Elevation Angle Confidence";
BA_ "SystemSignalLongSymbol" SG_ 1284 MRR_RL_CAN_DET_CONFID_ELEVA_0034 "MRR_RL_CAN_DET_CONFID_ELEVATION_029";
BA_ "GenSigStartValue" SG_ 1284 MRR_RL_CAN_DET_AZIMUTH_029 8194.05320813772;
BA_ "GenSigCmt" SG_ 1284 MRR_RL_CAN_DET_AZIMUTH_029 "Detected object azimuth position";
BA_ "GenSigCmt" SG_ 1284 MRR_RL_CAN_DET_CONFID_AZIMUTH_02 "Signal to noise level";
BA_ "GenSigVtEn" SG_ 1284 MRR_RL_CAN_DET_CONFID_AZIMUTH_02 "TRUE";
BA_ "SystemSignalLongSymbol" SG_ 1284 MRR_RL_CAN_DET_CONFID_AZIMUTH_02 "MRR_RL_CAN_DET_CONFID_AZIMUTH_029";
BA_ "GenSigCmt" SG_ 1284 MRR_RL_CAN_DET_RANGE_029 "Detected object range";
BA_ "GenSigCmt" SG_ 1284 MRR_RL_CAN_SCAN_INDEX_2LSB_029 "The two LSB of scan index";
BA_ "GenSigStartValue" SG_ 1284 MRR_RL_CAN_DET_RANGE_RATE_029 8192;
BA_ "GenSigCmt" SG_ 1284 MRR_RL_CAN_DET_RANGE_RATE_029 "Detected object range rate";
BA_ "GenSigCmt" SG_ 1284 MRR_RL_CAN_DET_VALID_LEVEL_029 "Detected object valid level";
BA_ "GenSigStartValue" SG_ 1284 MRR_RL_CAN_DET_AMPLITUDE_029 64;
BA_ "GenSigCmt" SG_ 1284 MRR_RL_CAN_DET_AMPLITUDE_029 "Detected object amplitude";
VAL_ 325 MRR_RL_Dolphin_Fault_Detection 2 "Dolphin Sensor Dead" 1 "Dolphin Start_up Error" 0 "No Faults" ;
VAL_ 1289 MRR_RL_CAN_DET_CONFID_AZIMUTH_06 3 "Low" 2 "MidLow" 1 "MidHigh" 0 "High" ;
VAL_ 1288 MRR_RL_CAN_DET_CONFID_AZIMU_0000 3 "Low" 2 "MidLow" 1 "MidHigh" 0 "High" ;
VAL_ 1288 MRR_RL_CAN_DET_CONFID_AZIMU_0001 3 "Low" 2 "MidLow" 1 "MidHigh" 0 "High" ;
VAL_ 1288 MRR_RL_CAN_DET_CONFID_AZIMU_0002 3 "Low" 2 "MidLow" 1 "MidHigh" 0 "High" ;
VAL_ 1288 MRR_RL_CAN_DET_CONFID_AZIMU_0003 3 "Low" 2 "MidLow" 1 "MidHigh" 0 "High" ;
VAL_ 1288 MRR_RL_CAN_DET_CONFID_AZIMUTH_05 3 "Low" 2 "MidLow" 1 "MidHigh" 0 "High" ;
VAL_ 1288 MRR_RL_CAN_DET_CONFID_AZIMU_0004 3 "Low" 2 "MidLow" 1 "MidHigh" 0 "High" ;
VAL_ 1288 MRR_RL_CAN_DET_CONFID_AZIMU_0005 3 "Low" 2 "MidLow" 1 "MidHigh" 0 "High" ;
VAL_ 1287 MRR_RL_CAN_DET_CONFID_AZIMU_0006 3 "Low" 2 "MidLow" 1 "MidHigh" 0 "High" ;
VAL_ 1287 MRR_RL_CAN_DET_CONFID_AZIMU_0007 3 "Low" 2 "MidLow" 1 "MidHigh" 0 "High" ;
VAL_ 1287 MRR_RL_CAN_DET_CONFID_AZIMU_0008 3 "Low" 2 "MidLow" 1 "MidHigh" 0 "High" ;
VAL_ 1287 MRR_RL_CAN_DET_CONFID_AZIMU_0009 3 "Low" 2 "MidLow" 1 "MidHigh" 0 "High" ;
VAL_ 1287 MRR_RL_CAN_DET_CONFID_AZIMU_0010 3 "Low" 2 "MidLow" 1 "MidHigh" 0 "High" ;
VAL_ 1287 MRR_RL_CAN_DET_CONFID_AZIMU_0011 3 "Low" 2 "MidLow" 1 "MidHigh" 0 "High" ;
VAL_ 1287 MRR_RL_CAN_DET_CONFID_AZIMU_0012 3 "Low" 2 "MidLow" 1 "MidHigh" 0 "High" ;
VAL_ 1286 MRR_RL_CAN_DET_CONFID_AZIMUTH_04 3 "Low" 2 "MidLow" 1 "MidHigh" 0 "High" ;
VAL_ 1286 MRR_RL_CAN_DET_CONFID_AZIMU_0013 3 "Low" 2 "MidLow" 1 "MidHigh" 0 "High" ;
VAL_ 1286 MRR_RL_CAN_DET_CONFID_AZIMU_0014 3 "Low" 2 "MidLow" 1 "MidHigh" 0 "High" ;
VAL_ 1286 MRR_RL_CAN_DET_CONFID_AZIMU_0015 3 "Low" 2 "MidLow" 1 "MidHigh" 0 "High" ;
VAL_ 1286 MRR_RL_CAN_DET_CONFID_AZIMU_0016 3 "Low" 2 "MidLow" 1 "MidHigh" 0 "High" ;
VAL_ 1286 MRR_RL_CAN_DET_CONFID_AZIMU_0017 3 "Low" 2 "MidLow" 1 "MidHigh" 0 "High" ;
VAL_ 1286 MRR_RL_CAN_DET_CONFID_AZIMU_0018 3 "Low" 2 "MidLow" 1 "MidHigh" 0 "High" ;
VAL_ 1285 MRR_RL_CAN_DET_CONFID_AZIMU_0019 3 "Low" 2 "MidLow" 1 "MidHigh" 0 "High" ;
VAL_ 1285 MRR_RL_CAN_DET_CONFID_AZIMU_0020 3 "Low" 2 "MidLow" 1 "MidHigh" 0 "High" ;
VAL_ 1285 MRR_RL_CAN_DET_CONFID_AZIMU_0021 3 "Low" 2 "MidLow" 1 "MidHigh" 0 "High" ;
VAL_ 1285 MRR_RL_CAN_DET_CONFID_AZIMUTH_03 3 "Low" 2 "MidLow" 1 "MidHigh" 0 "High" ;
VAL_ 1285 MRR_RL_CAN_DET_CONFID_AZIMU_0022 3 "Low" 2 "MidLow" 1 "MidHigh" 0 "High" ;
VAL_ 1285 MRR_RL_CAN_DET_CONFID_AZIMU_0023 3 "Low" 2 "MidLow" 1 "MidHigh" 0 "High" ;
VAL_ 1285 MRR_RL_CAN_DET_CONFID_AZIMU_0024 3 "Low" 2 "MidLow" 1 "MidHigh" 0 "High" ;
VAL_ 1284 MRR_RL_CAN_DET_CONFID_AZIMU_0025 3 "Low" 2 "MidLow" 1 "MidHigh" 0 "High" ;
VAL_ 1284 MRR_RL_CAN_DET_CONFID_AZIMU_0026 3 "Low" 2 "MidLow" 1 "MidHigh" 0 "High" ;
VAL_ 1284 MRR_RL_CAN_DET_CONFID_AZIMU_0027 3 "Low" 2 "MidLow" 1 "MidHigh" 0 "High" ;
VAL_ 1284 MRR_RL_CAN_DET_CONFID_AZIMU_0028 3 "Low" 2 "MidLow" 1 "MidHigh" 0 "High" ;
VAL_ 1284 MRR_RL_CAN_DET_CONFID_AZIMU_0029 3 "Low" 2 "MidLow" 1 "MidHigh" 0 "High" ;
VAL_ 1284 MRR_RL_CAN_DET_CONFID_AZIMU_0030 3 "Low" 2 "MidLow" 1 "MidHigh" 0 "High" ;
VAL_ 1284 MRR_RL_CAN_DET_CONFID_AZIMUTH_02 3 "Low" 2 "MidLow" 1 "MidHigh" 0 "High" ;
SIG_GROUP_ 324 MRR_RL_Active_Fault_Status 1 : MRR_RL_TO_SystemTDBlockage_Flt MRR_RL_TO_CADMSWVersion_Flt MRR_RL_TO_RADARCfgParameter_Flt MRR_RL_TO_SATCADMVIN_Flt MRR_RL_TO_CADMTracksChange_Flt MRR_RL_Active_Fault_Status_CRC MRR_RL_Active_Fault_Status_MC MRR_RL_RRUCore_Flt MRR_RL_RRUBIST_Flt MRR_RL_Core1_To_Core0_IPC_Flt MRR_RL_Core1_To_Core2_IPC_Flt MRR_RL_Core1Halted_Flt MRR_RL_v1p1_SupplyOutOfRange_Flt MRR_RL_v2p3_SupplyOutOfRange_Flt MRR_RL_v_5_SupplyOutOfRange_Flt MRR_RL_TransmitterID_Flt MRR_RL_PCANBusOff_Flt MRR_RL_InstructionSetCheck_Flt MRR_RL_StackOverflow_Flt MRR_RL_Watchdog_Flt MRR_RL_PLLLock_Flt MRR_RL_RAMMemoryTest_Flt MRR_RL_USCValidation_Flt MRR_RL_SMCChecksum_Flt MRR_RL_KeepAliveChecksum_Flt MRR_RL_Dolphin_Flt MRR_RL_MC_VehicleState_Flt MRR_RL_v1p8_SupplyOutOfRange_Flt MRR_RL_XCVRDeviceSPI_Flt MRR_RL_Core2_To_Core0_IPC_Flt MRR_RL_AlignRoutineFailed_Flt MRR_RL_v1p25_SupplyOutOfRange_Fl MRR_RL_MicroTempHigh_Flt MRR_RL_PINPosition_Flt MRR_RL_TO_CADMSgnlActlVal_Flt MRR_RL_TO_VehicleState_Flt MRR_RL_PCANDataRangeChk_Flt MRR_RL_TO_AngleAdjustmentTable_F MRR_RL_TransmitterTempHigh_Flt MRR_RL_Core2_To_Core1_IPC_Flt MRR_RL_MNRBlockage_Flt MRR_RL_Core0_To_Core2_IPC_Flt MRR_RL_DSPLoopOverrun_Flt MRR_RL_HAlignOutofRange_Flt MRR_RL_Core2Halted_Flt MRR_RL_LocalOscPower_Flt MRR_RL_TransmitterPower_Flt MRR_RL_ApplicationFlashChksum_Fl MRR_RL_Core0_To_Core1_IPC_Flt MRR_RL_TO_TrigControl_Flt MRR_RL_BatteryHigh_Flt MRR_RL_CRC_TrigControl_Flt MRR_RL_MC_TrigControl_Flt MRR_RL_CRC_AngleAdjTable_Flt MRR_RL_MC_AngleAdjTable_Flt MRR_RL_BatteryLow_Flt MRR_RL_VINSignalCompare_Flt MRR_RL_CRC_VehicleState_Flt MRR_RL_CRC_CADMSgnlActlVal_Flt MRR_RL_MC_CADMSgnlActlVal_Flt MRR_RL_CRC_RadarCfgParameter_Flt;
SIG_GROUP_ 1289 MRR_RL_Detection_064 1 : MRR_RL_CAN_DET_Near_TARGET_064 MRR_RL_CAN_DET_MID_TARGET_064 MRR_RL_DET_CRC_010 MRR_RL_DET_MC_010 MRR_RL_CAN_DET_SUPER_RES_TARGET_ MRR_RL_CAN_DET_ELEVATION_064 MRR_RL_CAN_DET_HOST_VEH_CLUTTER_ MRR_RL_CAN_DET_AZIMUTH_064 MRR_RL_CAN_DET_CONFID_ELEVATION_ MRR_RL_CAN_DET_CONFID_AZIMUTH_06 MRR_RL_CAN_SCAN_INDEX_2LSB_064 MRR_RL_CAN_DET_RANGE_064 MRR_RL_CAN_DET_RANGE_RATE_064 MRR_RL_CAN_DET_VALID_LEVEL_064 MRR_RL_CAN_DET_AMPLITUDE_064;
SIG_GROUP_ 1288 MRR_RL_Detection_057_063 1 : MRR_RL_CAN_DET_Near_TARGET_063 MRR_RL_CAN_DET_Near_TARGET_062 MRR_RL_CAN_DET_Near_TARGET_061 MRR_RL_CAN_DET_Near_TARGET_060 MRR_RL_CAN_DET_Near_TARGET_059 MRR_RL_CAN_DET_Near_TARGET_058 MRR_RL_CAN_DET_Near_TARGET_057 MRR_RL_CAN_DET_MID_TARGET_057 MRR_RL_CAN_DET_MID_TARGET_058 MRR_RL_CAN_DET_MID_TARGET_059 MRR_RL_CAN_DET_MID_TARGET_060 MRR_RL_CAN_DET_MID_TARGET_061 MRR_RL_CAN_DET_MID_TARGET_062 MRR_RL_CAN_DET_MID_TARGET_063 MRR_RL_DET_CRC_009 MRR_RL_CAN_DET_RANGE_058 MRR_RL_CAN_DET_RANGE_057 MRR_RL_DET_MC_009 MRR_RL_CAN_DET_SUPER_RES_TA_0000 MRR_RL_CAN_DET_ELEVATION_063 MRR_RL_CAN_DET_AZIMUTH_063 MRR_RL_CAN_DET_HOST_VEH_CLU_0000 MRR_RL_CAN_DET_CONFID_ELEVA_0000 MRR_RL_CAN_DET_RANGE_063 MRR_RL_CAN_DET_CONFID_AZIMU_0000 MRR_RL_CAN_DET_AMPLITUDE_063 MRR_RL_CAN_DET_RANGE_061 MRR_RL_CAN_DET_AZIMUTH_057 MRR_RL_CAN_DET_RANGE_RATE_057 MRR_RL_CAN_SCAN_INDEX_2LSB_057 MRR_RL_CAN_DET_AMPLITUDE_058 MRR_RL_CAN_DET_CONFID_ELEVA_0006 MRR_RL_CAN_DET_HOST_VEH_CLU_0006 MRR_RL_CAN_DET_ELEVATION_057 MRR_RL_CAN_DET_RANGE_RATE_061 MRR_RL_CAN_DET_SUPER_RES_TA_0003 MRR_RL_CAN_DET_RANGE_RATE_058 MRR_RL_CAN_SCAN_INDEX_2LSB_058 MRR_RL_CAN_DET_HOST_VEH_CLU_0003 MRR_RL_CAN_DET_CONFID_ELEVA_0003 MRR_RL_CAN_DET_ELEVATION_058 MRR_RL_CAN_DET_CONFID_ELEVA_0004 MRR_RL_CAN_DET_CONFID_AZIMUTH_05 MRR_RL_CAN_DET_CONFID_AZIMU_0004 MRR_RL_CAN_DET_VALID_LEVEL_060 MRR_RL_CAN_DET_SUPER_RES_TA_0005 MRR_RL_CAN_DET_RANGE_RATE_059 MRR_RL_CAN_DET_AZIMUTH_058 MRR_RL_CAN_SCAN_INDEX_2LSB_060 MRR_RL_CAN_DET_VALID_LEVEL_059 MRR_RL_CAN_SCAN_INDEX_2LSB_059 MRR_RL_CAN_DET_SUPER_RES_TA_0004 MRR_RL_CAN_DET_AZIMUTH_059 MRR_RL_CAN_DET_AMPLITUDE_059 MRR_RL_CAN_DET_CONFID_ELEVA_0005 MRR_RL_CAN_DET_HOST_VEH_CLU_0005 MRR_RL_CAN_DET_ELEVATION_059 MRR_RL_CAN_DET_VALID_LEVEL_057 MRR_RL_CAN_DET_AMPLITUDE_057 MRR_RL_CAN_DET_VALID_LEVEL_061 MRR_RL_CAN_DET_AMPLITUDE_061 MRR_RL_CAN_DET_CONFID_AZIMU_0005 MRR_RL_CAN_DET_ELEVATION_060 MRR_RL_CAN_DET_VALID_LEVEL_058 MRR_RL_CAN_DET_ELEVATION_062 MRR_RL_CAN_SCAN_INDEX_2LSB_063 MRR_RL_CAN_DET_RANGE_RATE_063 MRR_RL_CAN_DET_VALID_LEVEL_063 MRR_RL_CAN_DET_SUPER_RES_TA_0001 MRR_RL_CAN_SCAN_INDEX_2LSB_061 MRR_RL_CAN_DET_HOST_VEH_CLU_0001 MRR_RL_CAN_DET_CONFID_ELEVA_0002 MRR_RL_CAN_DET_RANGE_059 MRR_RL_CAN_DET_AMPLITUDE_060 MRR_RL_CAN_DET_AZIMUTH_061 MRR_RL_CAN_DET_CONFID_AZIMU_0002 MRR_RL_CAN_DET_HOST_VEH_CLU_0004 MRR_RL_CAN_DET_AZIMUTH_062 MRR_RL_CAN_DET_RANGE_RATE_060 MRR_RL_CAN_DET_CONFID_AZIMU_0003 MRR_RL_CAN_DET_SUPER_RES_TA_0006 MRR_RL_CAN_DET_CONFID_ELEVA_0001 MRR_RL_CAN_DET_CONFID_AZIMU_0001 MRR_RL_CAN_DET_HOST_VEH_CLU_0002 MRR_RL_CAN_DET_ELEVATION_061 MRR_RL_CAN_SCAN_INDEX_2LSB_062 MRR_RL_CAN_DET_RANGE_RATE_062 MRR_RL_CAN_DET_AMPLITUDE_062 MRR_RL_CAN_DET_AZIMUTH_060 MRR_RL_CAN_DET_SUPER_RES_TA_0002 MRR_RL_CAN_DET_VALID_LEVEL_062 MRR_RL_CAN_DET_RANGE_060 MRR_RL_CAN_DET_RANGE_062;
SIG_GROUP_ 1287 MRR_RL_Detection_050_056 1 : MRR_RL_CAN_DET_Near_TARGET_056 MRR_RL_CAN_DET_Near_TARGET_055 MRR_RL_CAN_DET_Near_TARGET_054 MRR_RL_CAN_DET_Near_TARGET_053 MRR_RL_CAN_DET_Near_TARGET_052 MRR_RL_CAN_DET_Near_TARGET_051 MRR_RL_CAN_DET_Near_TARGET_050 MRR_RL_CAN_DET_MID_TARGET_050 MRR_RL_CAN_DET_MID_TARGET_051 MRR_RL_CAN_DET_MID_TARGET_052 MRR_RL_CAN_DET_MID_TARGET_053 MRR_RL_CAN_DET_MID_TARGET_054 MRR_RL_CAN_DET_MID_TARGET_055 MRR_RL_CAN_DET_MID_TARGET_056 MRR_RL_DET_CRC_008 MRR_RL_DET_MC_008 MRR_RL_CAN_DET_SUPER_RES_TA_0007 MRR_RL_CAN_DET_ELEVATION_056 MRR_RL_CAN_DET_RANGE_056 MRR_RL_CAN_DET_RANGE_052 MRR_RL_CAN_DET_RANGE_051 MRR_RL_CAN_DET_VALID_LEVEL_050 MRR_RL_CAN_SCAN_INDEX_2LSB_050 MRR_RL_CAN_DET_RANGE_RATE_052 MRR_RL_CAN_DET_AMPLITUDE_050 MRR_RL_CAN_DET_HOST_VEH_CLU_0007 MRR_RL_CAN_DET_CONFID_ELEVA_0007 MRR_RL_CAN_DET_CONFID_AZIMU_0010 MRR_RL_CAN_DET_ELEVATION_052 MRR_RL_CAN_DET_AZIMUTH_056 MRR_RL_CAN_DET_ELEVATION_053 MRR_RL_CAN_DET_CONFID_AZIMU_0006 MRR_RL_CAN_DET_RANGE_RATE_056 MRR_RL_CAN_SCAN_INDEX_2LSB_053 MRR_RL_CAN_DET_VALID_LEVEL_056 MRR_RL_CAN_SCAN_INDEX_2LSB_056 MRR_RL_CAN_DET_CONFID_ELEVA_0010 MRR_RL_CAN_DET_HOST_VEH_CLU_0010 MRR_RL_CAN_DET_CONFID_AZIMU_0012 MRR_RL_CAN_DET_AMPLITUDE_051 MRR_RL_CAN_DET_AZIMUTH_050 MRR_RL_CAN_DET_ELEVATION_050 MRR_RL_CAN_DET_CONFID_ELEVA_0013 MRR_RL_CAN_DET_HOST_VEH_CLU_0013 MRR_RL_CAN_DET_RANGE_RATE_051 MRR_RL_CAN_DET_RANGE_050 MRR_RL_CAN_DET_CONFID_AZIMU_0011 MRR_RL_CAN_DET_ELEVATION_051 MRR_RL_CAN_DET_RANGE_RATE_050 MRR_RL_CAN_DET_SUPER_RES_TA_0012 MRR_RL_CAN_DET_HOST_VEH_CLU_0012 MRR_RL_CAN_DET_AMPLITUDE_052 MRR_RL_CAN_DET_VALID_LEVEL_052 MRR_RL_CAN_DET_VALID_LEVEL_051 MRR_RL_CAN_DET_AZIMUTH_052 MRR_RL_CAN_DET_CONFID_ELEVA_0011 MRR_RL_CAN_DET_SUPER_RES_TA_0013 MRR_RL_CAN_DET_CONFID_AZIMU_0009 MRR_RL_CAN_DET_AZIMUTH_051 MRR_RL_CAN_DET_AMPLITUDE_053 MRR_RL_CAN_DET_RANGE_RATE_053 MRR_RL_CAN_DET_VALID_LEVEL_053 MRR_RL_CAN_SCAN_INDEX_2LSB_051 MRR_RL_CAN_SCAN_INDEX_2LSB_052 MRR_RL_CAN_DET_SUPER_RES_TA_0010 MRR_RL_CAN_DET_AMPLITUDE_056 MRR_RL_CAN_DET_SUPER_RES_TA_0008 MRR_RL_CAN_DET_CONFID_ELEVA_0008 MRR_RL_CAN_DET_ELEVATION_055 MRR_RL_CAN_DET_HOST_VEH_CLU_0008 MRR_RL_CAN_DET_CONFID_ELEVA_0012 MRR_RL_CAN_SCAN_INDEX_2LSB_054 MRR_RL_CAN_DET_AZIMUTH_055 MRR_RL_CAN_SCAN_INDEX_2LSB_055 MRR_RL_CAN_DET_SUPER_RES_TA_0011 MRR_RL_CAN_DET_RANGE_055 MRR_RL_CAN_DET_CONFID_AZIMU_0007 MRR_RL_CAN_DET_RANGE_RATE_055 MRR_RL_CAN_DET_RANGE_054 MRR_RL_CAN_DET_HOST_VEH_CLU_0011 MRR_RL_CAN_DET_AMPLITUDE_054 MRR_RL_CAN_DET_VALID_LEVEL_054 MRR_RL_CAN_DET_RANGE_RATE_054 MRR_RL_CAN_DET_AZIMUTH_053 MRR_RL_CAN_DET_CONFID_AZIMU_0008 MRR_RL_CAN_DET_AZIMUTH_054 MRR_RL_CAN_DET_CONFID_ELEVA_0009 MRR_RL_CAN_DET_HOST_VEH_CLU_0009 MRR_RL_CAN_DET_ELEVATION_054 MRR_RL_CAN_DET_VALID_LEVEL_055 MRR_RL_CAN_DET_SUPER_RES_TA_0009 MRR_RL_CAN_DET_AMPLITUDE_055 MRR_RL_CAN_DET_RANGE_053;
SIG_GROUP_ 1286 MRR_RL_Detection_043_049 1 : MRR_RL_CAN_DET_Near_TARGET_049 MRR_RL_CAN_DET_Near_TARGET_048 MRR_RL_CAN_DET_Near_TARGET_047 MRR_RL_CAN_DET_Near_TARGET_046 MRR_RL_CAN_DET_Near_TARGET_045 MRR_RL_CAN_DET_Near_TARGET_044 MRR_RL_CAN_DET_Near_TARGET_043 MRR_RL_CAN_DET_MID_TARGET_043 MRR_RL_CAN_DET_MID_TARGET_044 MRR_RL_CAN_DET_MID_TARGET_045 MRR_RL_CAN_DET_MID_TARGET_046 MRR_RL_CAN_DET_MID_TARGET_047 MRR_RL_CAN_DET_MID_TARGET_048 MRR_RL_CAN_DET_MID_TARGET_049 MRR_RL_DET_CRC_007 MRR_RL_DET_MC_007 MRR_RL_CAN_DET_SUPER_RES_TA_0014 MRR_RL_CAN_DET_ELEVATION_049 MRR_RL_CAN_DET_HOST_VEH_CLU_0014 MRR_RL_CAN_DET_AZIMUTH_049 MRR_RL_CAN_DET_RANGE_049 MRR_RL_CAN_DET_AMPLITUDE_048 MRR_RL_CAN_DET_VALID_LEVEL_043 MRR_RL_CAN_DET_AMPLITUDE_043 MRR_RL_CAN_DET_CONFID_ELEVA_0014 MRR_RL_CAN_SCAN_INDEX_2LSB_049 MRR_RL_CAN_SCAN_INDEX_2LSB_048 MRR_RL_CAN_DET_RANGE_043 MRR_RL_CAN_DET_RANGE_RATE_049 MRR_RL_CAN_DET_ELEVATION_046 MRR_RL_CAN_DET_HOST_VEH_CLU_0016 MRR_RL_CAN_DET_ELEVATION_044 MRR_RL_CAN_DET_RANGE_RATE_043 MRR_RL_CAN_SCAN_INDEX_2LSB_043 MRR_RL_CAN_DET_AZIMUTH_044 MRR_RL_CAN_DET_CONFID_AZIMU_0018 MRR_RL_CAN_DET_HOST_VEH_CLU_0020 MRR_RL_CAN_DET_RANGE_048 MRR_RL_CAN_DET_AMPLITUDE_046 MRR_RL_CAN_SCAN_INDEX_2LSB_045 MRR_RL_CAN_DET_VALID_LEVEL_044 MRR_RL_CAN_DET_SUPER_RES_TA_0020 MRR_RL_CAN_DET_RANGE_RATE_044 MRR_RL_CAN_DET_AZIMUTH_043 MRR_RL_CAN_DET_ELEVATION_043 MRR_RL_CAN_SCAN_INDEX_2LSB_044 MRR_RL_CAN_DET_RANGE_044 MRR_RL_CAN_DET_CONFID_AZIMU_0017 MRR_RL_CAN_DET_AMPLITUDE_045 MRR_RL_CAN_DET_RANGE_045 MRR_RL_CAN_DET_VALID_LEVEL_045 MRR_RL_CAN_DET_RANGE_RATE_045 MRR_RL_CAN_DET_CONFID_ELEVA_0018 MRR_RL_CAN_DET_CONFID_AZIMU_0016 MRR_RL_CAN_DET_RANGE_046 MRR_RL_CAN_DET_HOST_VEH_CLU_0018 MRR_RL_CAN_DET_SUPER_RES_TA_0018 MRR_RL_CAN_DET_RANGE_RATE_046 MRR_RL_CAN_DET_AMPLITUDE_044 MRR_RL_CAN_DET_VALID_LEVEL_046 MRR_RL_CAN_DET_HOST_VEH_CLU_0019 MRR_RL_CAN_DET_AMPLITUDE_047 MRR_RL_CAN_SCAN_INDEX_2LSB_046 MRR_RL_CAN_DET_SUPER_RES_TA_0019 MRR_RL_CAN_DET_AZIMUTH_047 MRR_RL_CAN_DET_AZIMUTH_045 MRR_RL_CAN_DET_ELEVATION_047 MRR_RL_CAN_DET_CONFID_ELEVA_0019 MRR_RL_CAN_DET_CONFID_ELEVA_0017 MRR_RL_CAN_SCAN_INDEX_2LSB_047 MRR_RL_CAN_DET_CONFID_AZIMU_0015 MRR_RL_CAN_DET_VALID_LEVEL_047 MRR_RL_CAN_DET_RANGE_RATE_047 MRR_RL_CAN_DET_RANGE_047 MRR_RL_CAN_DET_CONFID_AZIMU_0014 MRR_RL_CAN_DET_CONFID_ELEVA_0016 MRR_RL_CAN_DET_SUPER_RES_TA_0016 MRR_RL_CAN_DET_RANGE_RATE_048 MRR_RL_CAN_DET_VALID_LEVEL_048 MRR_RL_CAN_DET_CONFID_ELEVA_0020 MRR_RL_CAN_DET_ELEVATION_045 MRR_RL_CAN_DET_HOST_VEH_CLU_0017 MRR_RL_CAN_DET_SUPER_RES_TA_0017 MRR_RL_CAN_DET_AZIMUTH_046 MRR_RL_CAN_DET_SUPER_RES_TA_0015 MRR_RL_CAN_DET_CONFID_AZIMU_0013 MRR_RL_CAN_DET_HOST_VEH_CLU_0015 MRR_RL_CAN_DET_AMPLITUDE_049 MRR_RL_CAN_DET_AZIMUTH_048 MRR_RL_CAN_DET_CONFID_ELEVA_0015 MRR_RL_CAN_DET_ELEVATION_048 MRR_RL_CAN_DET_VALID_LEVEL_049 MRR_RL_CAN_DET_CONFID_AZIMUTH_04;
SIG_GROUP_ 1285 MRR_RL_Detection_036_042 1 : MRR_RL_CAN_DET_Near_TARGET_042 MRR_RL_CAN_DET_Near_TARGET_041 MRR_RL_CAN_DET_Near_TARGET_040 MRR_RL_CAN_DET_Near_TARGET_039 MRR_RL_CAN_DET_Near_TARGET_038 MRR_RL_CAN_DET_Near_TARGET_037 MRR_RL_CAN_DET_Near_TARGET_036 MRR_RL_CAN_DET_MID_TARGET_036 MRR_RL_CAN_DET_MID_TARGET_037 MRR_RL_CAN_DET_MID_TARGET_038 MRR_RL_CAN_DET_MID_TARGET_039 MRR_RL_CAN_DET_MID_TARGET_040 MRR_RL_CAN_DET_MID_TARGET_041 MRR_RL_CAN_DET_MID_TARGET_042 MRR_RL_CAN_DET_ELEVATION_042 MRR_RL_DET_CRC_006 MRR_RL_DET_MC_006 MRR_RL_CAN_DET_AMPLITUDE_036 MRR_RL_CAN_DET_HOST_VEH_CLU_0021 MRR_RL_CAN_DET_CONFID_ELEVA_0021 MRR_RL_CAN_DET_VALID_LEVEL_036 MRR_RL_CAN_DET_VALID_LEVEL_042 MRR_RL_CAN_DET_RANGE_RATE_036 MRR_RL_CAN_DET_RANGE_036 MRR_RL_CAN_DET_ELEVATION_038 MRR_RL_CAN_DET_RANGE_RATE_037 MRR_RL_CAN_DET_CONFID_AZIMU_0024 MRR_RL_CAN_DET_AMPLITUDE_037 MRR_RL_CAN_SCAN_INDEX_2LSB_036 MRR_RL_CAN_DET_VALID_LEVEL_037 MRR_RL_CAN_DET_CONFID_ELEVA_0027 MRR_RL_CAN_DET_SUPER_RES_TA_0021 MRR_RL_CAN_DET_RANGE_042 MRR_RL_CAN_SCAN_INDEX_2LSB_042 MRR_RL_CAN_DET_AZIMUTH_042 MRR_RL_CAN_DET_VALID_LEVEL_039 MRR_RL_CAN_DET_SUPER_RES_TA_0022 MRR_RL_CAN_DET_AZIMUTH_041 MRR_RL_CAN_DET_ELEVATION_040 MRR_RL_CAN_DET_AZIMUTH_038 MRR_RL_CAN_DET_RANGE_037 MRR_RL_CAN_SCAN_INDEX_2LSB_037 MRR_RL_CAN_DET_AZIMUTH_036 MRR_RL_CAN_DET_HOST_VEH_CLU_0027 MRR_RL_CAN_DET_RANGE_038 MRR_RL_CAN_DET_AZIMUTH_037 MRR_RL_CAN_DET_CONFID_AZIMU_0023 MRR_RL_CAN_DET_ELEVATION_037 MRR_RL_CAN_DET_CONFID_AZIMU_0022 MRR_RL_CAN_DET_AMPLITUDE_038 MRR_RL_CAN_DET_CONFID_ELEVA_0026 MRR_RL_CAN_DET_VALID_LEVEL_038 MRR_RL_CAN_DET_RANGE_RATE_038 MRR_RL_CAN_SCAN_INDEX_2LSB_038 MRR_RL_CAN_DET_AMPLITUDE_039 MRR_RL_CAN_DET_CONFID_ELEVA_0025 MRR_RL_CAN_DET_AZIMUTH_040 MRR_RL_CAN_DET_SUPER_RES_TA_0025 MRR_RL_CAN_DET_RANGE_040 MRR_RL_CAN_DET_SUPER_RES_TA_0027 MRR_RL_CAN_DET_HOST_VEH_CLU_0025 MRR_RL_CAN_DET_SUPER_RES_TA_0026 MRR_RL_CAN_DET_VALID_LEVEL_040 MRR_RL_CAN_DET_AZIMUTH_039 MRR_RL_CAN_DET_RANGE_RATE_039 MRR_RL_CAN_SCAN_INDEX_2LSB_039 MRR_RL_CAN_DET_RANGE_039 MRR_RL_CAN_DET_RANGE_RATE_040 MRR_RL_CAN_DET_ELEVATION_036 MRR_RL_CAN_DET_HOST_VEH_CLU_0023 MRR_RL_CAN_DET_CONFID_ELEVA_0023 MRR_RL_CAN_DET_CONFID_AZIMU_0021 MRR_RL_CAN_SCAN_INDEX_2LSB_040 MRR_RL_CAN_DET_CONFID_AZIMUTH_03 MRR_RL_CAN_DET_AMPLITUDE_040 MRR_RL_CAN_DET_SUPER_RES_TA_0024 MRR_RL_CAN_DET_CONFID_ELEVA_0024 MRR_RL_CAN_DET_HOST_VEH_CLU_0024 MRR_RL_CAN_DET_ELEVATION_039 MRR_RL_CAN_DET_HOST_VEH_CLU_0026 MRR_RL_CAN_DET_CONFID_ELEVA_0022 MRR_RL_CAN_DET_HOST_VEH_CLU_0022 MRR_RL_CAN_DET_RANGE_RATE_042 MRR_RL_CAN_DET_CONFID_AZIMU_0019 MRR_RL_CAN_DET_SUPER_RES_TA_0023 MRR_RL_CAN_DET_AMPLITUDE_041 MRR_RL_CAN_DET_VALID_LEVEL_041 MRR_RL_CAN_DET_RANGE_RATE_041 MRR_RL_CAN_SCAN_INDEX_2LSB_041 MRR_RL_CAN_DET_RANGE_041 MRR_RL_CAN_DET_CONFID_AZIMU_0020 MRR_RL_CAN_DET_ELEVATION_041 MRR_RL_CAN_DET_AMPLITUDE_042;
SIG_GROUP_ 1284 MRR_RL_Detection_029_035 1 : MRR_RL_CAN_DET_Near_TARGET_035 MRR_RL_CAN_DET_Near_TARGET_034 MRR_RL_CAN_DET_Near_TARGET_033 MRR_RL_CAN_DET_Near_TARGET_032 MRR_RL_CAN_DET_Near_TARGET_031 MRR_RL_CAN_DET_Near_TARGET_030 MRR_RL_CAN_DET_Near_TARGET_029 MRR_RL_CAN_DET_MID_TARGET_029 MRR_RL_CAN_DET_MID_TARGET_030 MRR_RL_CAN_DET_MID_TARGET_031 MRR_RL_CAN_DET_MID_TARGET_032 MRR_RL_CAN_DET_MID_TARGET_033 MRR_RL_CAN_DET_MID_TARGET_034 MRR_RL_CAN_DET_MID_TARGET_035 MRR_RL_DET_CRC_005 MRR_RL_DET_MC_005 MRR_RL_CAN_DET_SUPER_RES_TA_0028 MRR_RL_CAN_DET_ELEVATION_035 MRR_RL_CAN_DET_HOST_VEH_CLU_0028 MRR_RL_CAN_DET_CONFID_ELEVA_0028 MRR_RL_CAN_DET_AZIMUTH_035 MRR_RL_CAN_DET_RANGE_035 MRR_RL_CAN_SCAN_INDEX_2LSB_030 MRR_RL_CAN_DET_HOST_VEH_CLU_0031 MRR_RL_CAN_DET_VALID_LEVEL_030 MRR_RL_CAN_DET_VALID_LEVEL_029 MRR_RL_CAN_DET_AMPLITUDE_029 MRR_RL_CAN_DET_RANGE_029 MRR_RL_CAN_DET_SUPER_RES_TA_0034 MRR_RL_CAN_DET_RANGE_RATE_029 MRR_RL_CAN_DET_HOST_VEH_CLU_0034 MRR_RL_CAN_DET_RANGE_RATE_030 MRR_RL_CAN_DET_CONFID_ELEVA_0034 MRR_RL_CAN_DET_CONFID_AZIMUTH_02 MRR_RL_CAN_DET_AZIMUTH_029 MRR_RL_CAN_DET_RANGE_RATE_035 MRR_RL_CAN_DET_CONFID_AZIMU_0030 MRR_RL_CAN_DET_CONFID_AZIMU_0025 MRR_RL_CAN_SCAN_INDEX_2LSB_035 MRR_RL_CAN_DET_CONFID_ELEVA_0033 MRR_RL_CAN_DET_VALID_LEVEL_035 MRR_RL_CAN_DET_AZIMUTH_034 MRR_RL_CAN_SCAN_INDEX_2LSB_033 MRR_RL_CAN_DET_HOST_VEH_CLU_0033 MRR_RL_CAN_DET_ELEVATION_030 MRR_RL_CAN_DET_SUPER_RES_TA_0032 MRR_RL_CAN_DET_AMPLITUDE_031 MRR_RL_CAN_DET_RANGE_030 MRR_RL_CAN_DET_VALID_LEVEL_031 MRR_RL_CAN_DET_SUPER_RES_TA_0033 MRR_RL_CAN_DET_CONFID_ELEVA_0032 MRR_RL_CAN_DET_AMPLITUDE_032 MRR_RL_CAN_DET_RANGE_031 MRR_RL_CAN_DET_ELEVATION_031 MRR_RL_CAN_DET_VALID_LEVEL_032 MRR_RL_CAN_DET_ELEVATION_032 MRR_RL_CAN_DET_RANGE_032 MRR_RL_CAN_DET_AZIMUTH_032 MRR_RL_CAN_DET_CONFID_AZIMU_0028 MRR_RL_CAN_DET_SUPER_RES_TA_0031 MRR_RL_CAN_DET_RANGE_RATE_033 MRR_RL_CAN_DET_AMPLITUDE_030 MRR_RL_CAN_DET_CONFID_ELEVA_0031 MRR_RL_CAN_DET_AZIMUTH_031 MRR_RL_CAN_DET_CONFID_ELEVA_0029 MRR_RL_CAN_DET_AMPLITUDE_035 MRR_RL_CAN_DET_SUPER_RES_TA_0029 MRR_RL_CAN_DET_ELEVATION_034 MRR_RL_CAN_DET_HOST_VEH_CLU_0029 MRR_RL_CAN_DET_AZIMUTH_030 MRR_RL_CAN_DET_AMPLITUDE_033 MRR_RL_CAN_DET_RANGE_033 MRR_RL_CAN_DET_HOST_VEH_CLU_0032 MRR_RL_CAN_DET_RANGE_RATE_031 MRR_RL_CAN_SCAN_INDEX_2LSB_031 MRR_RL_CAN_DET_RANGE_RATE_032 MRR_RL_CAN_DET_ELEVATION_033 MRR_RL_CAN_DET_CONFID_AZIMU_0026 MRR_RL_CAN_DET_CONFID_ELEVA_0030 MRR_RL_CAN_DET_CONFID_AZIMU_0027 MRR_RL_CAN_DET_AZIMUTH_033 MRR_RL_CAN_DET_ELEVATION_029 MRR_RL_CAN_DET_CONFID_AZIMU_0029 MRR_RL_CAN_DET_VALID_LEVEL_033 MRR_RL_CAN_SCAN_INDEX_2LSB_032 MRR_RL_CAN_DET_SUPER_RES_TA_0030 MRR_RL_CAN_DET_AMPLITUDE_034 MRR_RL_CAN_DET_VALID_LEVEL_034 MRR_RL_CAN_DET_RANGE_034 MRR_RL_CAN_SCAN_INDEX_2LSB_029 MRR_RL_CAN_SCAN_INDEX_2LSB_034 MRR_RL_CAN_DET_RANGE_RATE_034 MRR_RL_CAN_DET_HOST_VEH_CLU_0030;
