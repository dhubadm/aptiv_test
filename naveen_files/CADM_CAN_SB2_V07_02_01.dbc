VERSION ""

NS_ :

BS_:

BU_: MRRFR External_Tool CADM MRRFL

BO_ 775 MRR_FL_Detection_050_056: 64 MRRFL
 SG_ MRR_FL_CAN_DET_MID_TARGET_056 : 462|1@0+ (1,0) [0|1] ""  CADM
 SG_ MRR_FL_CAN_DET_MID_TARGET_055 : 461|1@0+ (1,0) [0|1] ""  CADM
 SG_ MRR_FL_CAN_DET_MID_TARGET_054 : 460|1@0+ (1,0) [0|1] ""  CADM
 SG_ MRR_FL_CAN_DET_MID_TARGET_053 : 459|1@0+ (1,0) [0|1] ""  CADM
 SG_ MRR_FL_CAN_DET_MID_TARGET_052 : 458|1@0+ (1,0) [0|1] ""  CADM
 SG_ MRR_FL_CAN_DET_MID_TARGET_051 : 457|1@0+ (1,0) [0|1] ""  CADM
 SG_ MRR_FL_CAN_DET_MID_TARGET_050 : 456|1@0+ (1,0) [0|1] ""  CADM
 SG_ MRR_FL_CAN_DET_Near_TARGET_050 : 448|1@0+ (1,0) [0|1] ""  CADM
 SG_ MRR_FL_CAN_DET_Near_TARGET_051 : 449|1@0+ (1,0) [0|1] ""  CADM
 SG_ MRR_FL_CAN_DET_Near_TARGET_052 : 450|1@0+ (1,0) [0|1] ""  CADM
 SG_ MRR_FL_CAN_DET_Near_TARGET_053 : 451|1@0+ (1,0) [0|1] ""  CADM
 SG_ MRR_FL_CAN_DET_Near_TARGET_054 : 452|1@0+ (1,0) [0|1] ""  CADM
 SG_ MRR_FL_CAN_DET_Near_TARGET_055 : 453|1@0+ (1,0) [0|1] ""  CADM
 SG_ MRR_FL_CAN_DET_Near_TARGET_056 : 454|1@0+ (1,0) [0|1] ""  CADM
 SG_ MRR_FL_CAN_DET_ELEVATION_050 : 63|7@0+ (0.002748,-0.1745) [-0.1745|0.174496] "rad"  CADM
 SG_ MRR_FL_CAN_DET_CONFID_AZIMUTH_05 : 33|2@0+ (1,0) [0|3] ""  CADM
 SG_ MRR_FL_CAN_DET_SUPER_RES_TA_0048 : 56|1@0+ (1,0) [0|1] ""  CADM
 SG_ MRR_FL_CAN_DET_CONFID_ELEVA_0048 : 49|1@0+ (1,0) [0|1] ""  CADM
 SG_ MRR_FL_CAN_DET_HOST_VEH_CLU_0048 : 48|1@0+ (1,0) [0|1] ""  CADM
 SG_ MRR_FL_CAN_DET_VALID_LEVEL_050 : 0|1@0+ (1,0) [0|1] ""  CADM
 SG_ MRR_FL_CAN_DET_AZIMUTH_050 : 47|14@0+ (0.0003834,-3.1416) [-3.1416|3.1396422] "rad"  CADM
 SG_ MRR_FL_CAN_DET_RANGE_050 : 31|14@0+ (0.015625,0) [0|255.984375] "m"  CADM
 SG_ MRR_FL_CAN_DET_RANGE_RATE_050 : 15|14@0+ (0.015625,-128) [-128|127.984375] "m/s"  CADM
 SG_ MRR_FL_CAN_DET_AMPLITUDE_050 : 7|7@0+ (1,-64) [-64|63] "dBsm"  CADM
 SG_ MRR_FL_CAN_SCAN_INDEX_2LSB_050 : 17|2@0+ (1,0) [0|3] ""  CADM
 SG_ MRR_FL_DET_MC_008 : 491|4@0+ (1,0) [0|15] ""  CADM
 SG_ MRR_FL_DET_CRC_008 : 503|16@0+ (1,0) [0|65535] ""  CADM
 SG_ MRR_FL_CAN_DET_ELEVATION_056 : 447|7@0+ (0.002748,-0.1745) [-0.1745|0.174496] "rad"  CADM
 SG_ MRR_FL_CAN_DET_SUPER_RES_TA_0049 : 440|1@0+ (1,0) [0|1] ""  CADM
 SG_ MRR_FL_CAN_DET_AZIMUTH_056 : 431|14@0+ (0.0003834,-3.1416) [-3.1416|3.1396422] "rad"  CADM
 SG_ MRR_FL_CAN_DET_CONFID_ELEVA_0049 : 433|1@0+ (1,0) [0|1] ""  CADM
 SG_ MRR_FL_CAN_DET_HOST_VEH_CLU_0049 : 432|1@0+ (1,0) [0|1] ""  CADM
 SG_ MRR_FL_CAN_DET_RANGE_056 : 415|14@0+ (0.015625,0) [0|255.984375] "m"  CADM
 SG_ MRR_FL_CAN_DET_CONFID_AZIMU_0044 : 417|2@0+ (1,0) [0|3] ""  CADM
 SG_ MRR_FL_CAN_DET_RANGE_RATE_056 : 399|14@0+ (0.015625,-128) [-128|127.984375] "m/s"  CADM
 SG_ MRR_FL_CAN_SCAN_INDEX_2LSB_056 : 401|2@0+ (1,0) [0|3] ""  CADM
 SG_ MRR_FL_CAN_DET_AMPLITUDE_056 : 391|7@0+ (1,-64) [-64|63] "dBsm"  CADM
 SG_ MRR_FL_CAN_DET_VALID_LEVEL_056 : 384|1@0+ (1,0) [0|1] ""  CADM
 SG_ MRR_FL_CAN_DET_ELEVATION_055 : 383|7@0+ (0.002748,-0.1745) [-0.1745|0.174496] "rad"  CADM
 SG_ MRR_FL_CAN_DET_SUPER_RES_TA_0050 : 376|1@0+ (1,0) [0|1] ""  CADM
 SG_ MRR_FL_CAN_DET_AZIMUTH_055 : 367|14@0+ (0.0003834,-3.1416) [-3.1416|3.1396422] "rad"  CADM
 SG_ MRR_FL_CAN_DET_CONFID_ELEVA_0050 : 369|1@0+ (1,0) [0|1] ""  CADM
 SG_ MRR_FL_CAN_DET_HOST_VEH_CLU_0050 : 368|1@0+ (1,0) [0|1] ""  CADM
 SG_ MRR_FL_CAN_DET_RANGE_055 : 351|14@0+ (0.015625,0) [0|255.984375] "m"  CADM
 SG_ MRR_FL_CAN_DET_CONFID_AZIMU_0045 : 353|2@0+ (1,0) [0|3] ""  CADM
 SG_ MRR_FL_CAN_DET_RANGE_RATE_055 : 335|14@0+ (0.015625,-128) [-128|127.984375] "m/s"  CADM
 SG_ MRR_FL_CAN_SCAN_INDEX_2LSB_055 : 337|2@0+ (1,0) [0|3] ""  CADM
 SG_ MRR_FL_CAN_DET_AMPLITUDE_055 : 327|7@0+ (1,-64) [-64|63] "dBsm"  CADM
 SG_ MRR_FL_CAN_DET_VALID_LEVEL_055 : 320|1@0+ (1,0) [0|1] ""  CADM
 SG_ MRR_FL_CAN_DET_ELEVATION_054 : 319|7@0+ (0.002748,-0.1745) [-0.1745|0.174496] "rad"  CADM
 SG_ MRR_FL_CAN_DET_SUPER_RES_TA_0051 : 312|1@0+ (1,0) [0|1] ""  CADM
 SG_ MRR_FL_CAN_DET_AZIMUTH_054 : 303|14@0+ (0.0003834,-3.1416) [-3.1416|3.1396422] "rad"  CADM
 SG_ MRR_FL_CAN_DET_CONFID_ELEVA_0051 : 305|1@0+ (1,0) [0|1] ""  CADM
 SG_ MRR_FL_CAN_DET_HOST_VEH_CLU_0051 : 304|1@0+ (1,0) [0|1] ""  CADM
 SG_ MRR_FL_CAN_DET_RANGE_054 : 287|14@0+ (0.015625,0) [0|255.984375] "m"  CADM
 SG_ MRR_FL_CAN_DET_CONFID_AZIMU_0046 : 289|2@0+ (1,0) [0|3] ""  CADM
 SG_ MRR_FL_CAN_DET_RANGE_RATE_054 : 271|14@0+ (0.015625,-128) [-128|127.984375] "m/s"  CADM
 SG_ MRR_FL_CAN_SCAN_INDEX_2LSB_054 : 273|2@0+ (1,0) [0|3] ""  CADM
 SG_ MRR_FL_CAN_DET_AMPLITUDE_054 : 263|7@0+ (1,-64) [-64|63] "dBsm"  CADM
 SG_ MRR_FL_CAN_DET_VALID_LEVEL_054 : 256|1@0+ (1,0) [0|1] ""  CADM
 SG_ MRR_FL_CAN_DET_ELEVATION_053 : 255|7@0+ (0.002748,-0.1745) [-0.1745|0.174496] "rad"  CADM
 SG_ MRR_FL_CAN_DET_SUPER_RES_TA_0052 : 248|1@0+ (1,0) [0|1] ""  CADM
 SG_ MRR_FL_CAN_DET_AZIMUTH_053 : 239|14@0+ (0.0003834,-3.1416) [-3.1416|3.1396422] "rad"  CADM
 SG_ MRR_FL_CAN_DET_CONFID_ELEVA_0052 : 241|1@0+ (1,0) [0|1] ""  CADM
 SG_ MRR_FL_CAN_DET_HOST_VEH_CLU_0052 : 240|1@0+ (1,0) [0|1] ""  CADM
 SG_ MRR_FL_CAN_DET_RANGE_053 : 223|14@0+ (0.015625,0) [0|255.984375] "m"  CADM
 SG_ MRR_FL_CAN_DET_CONFID_AZIMU_0047 : 225|2@0+ (1,0) [0|3] ""  CADM
 SG_ MRR_FL_CAN_DET_RANGE_RATE_053 : 207|14@0+ (0.015625,-128) [-128|127.984375] "m/s"  CADM
 SG_ MRR_FL_CAN_SCAN_INDEX_2LSB_053 : 209|2@0+ (1,0) [0|3] ""  CADM
 SG_ MRR_FL_CAN_DET_AMPLITUDE_053 : 199|7@0+ (1,-64) [-64|63] "dBsm"  CADM
 SG_ MRR_FL_CAN_DET_VALID_LEVEL_053 : 192|1@0+ (1,0) [0|1] ""  CADM
 SG_ MRR_FL_CAN_DET_ELEVATION_052 : 191|7@0+ (0.002748,-0.1745) [-0.1745|0.174496] "rad"  CADM
 SG_ MRR_FL_CAN_DET_SUPER_RES_TA_0053 : 184|1@0+ (1,0) [0|1] ""  CADM
 SG_ MRR_FL_CAN_DET_AZIMUTH_052 : 175|14@0+ (0.0003834,-3.1416) [-3.1416|3.1396422] "rad"  CADM
 SG_ MRR_FL_CAN_DET_CONFID_ELEVA_0053 : 177|1@0+ (1,0) [0|1] ""  CADM
 SG_ MRR_FL_CAN_DET_HOST_VEH_CLU_0053 : 176|1@0+ (1,0) [0|1] ""  CADM
 SG_ MRR_FL_CAN_DET_RANGE_052 : 159|14@0+ (0.015625,0) [0|255.984375] "m"  CADM
 SG_ MRR_FL_CAN_DET_CONFID_AZIMU_0048 : 161|2@0+ (1,0) [0|3] ""  CADM
 SG_ MRR_FL_CAN_DET_RANGE_RATE_052 : 143|14@0+ (0.015625,-128) [-128|127.984375] "m/s"  CADM
 SG_ MRR_FL_CAN_SCAN_INDEX_2LSB_052 : 145|2@0+ (1,0) [0|3] ""  CADM
 SG_ MRR_FL_CAN_DET_AMPLITUDE_052 : 135|7@0+ (1,-64) [-64|63] "dBsm"  CADM
 SG_ MRR_FL_CAN_DET_VALID_LEVEL_052 : 128|1@0+ (1,0) [0|1] ""  CADM
 SG_ MRR_FL_CAN_DET_ELEVATION_051 : 127|7@0+ (0.002748,-0.1745) [-0.1745|0.174496] "rad"  CADM
 SG_ MRR_FL_CAN_DET_SUPER_RES_TA_0054 : 120|1@0+ (1,0) [0|1] ""  CADM
 SG_ MRR_FL_CAN_DET_AZIMUTH_051 : 111|14@0+ (0.0003834,-3.1416) [-3.1416|3.1396422] "rad"  CADM
 SG_ MRR_FL_CAN_DET_CONFID_ELEVA_0054 : 113|1@0+ (1,0) [0|1] ""  CADM
 SG_ MRR_FL_CAN_DET_HOST_VEH_CLU_0054 : 112|1@0+ (1,0) [0|1] ""  CADM
 SG_ MRR_FL_CAN_DET_RANGE_051 : 95|14@0+ (0.015625,0) [0|255.984375] "m"  CADM
 SG_ MRR_FL_CAN_DET_CONFID_AZIMU_0049 : 97|2@0+ (1,0) [0|3] ""  CADM
 SG_ MRR_FL_CAN_DET_RANGE_RATE_051 : 79|14@0+ (0.015625,-128) [-128|127.984375] "m/s"  CADM
 SG_ MRR_FL_CAN_SCAN_INDEX_2LSB_051 : 81|2@0+ (1,0) [0|3] ""  CADM
 SG_ MRR_FL_CAN_DET_AMPLITUDE_051 : 71|7@0+ (1,-64) [-64|63] "dBsm"  CADM
 SG_ MRR_FL_CAN_DET_VALID_LEVEL_051 : 64|1@0+ (1,0) [0|1] ""  CADM

BO_ 776 MRR_FL_Detection_057_063: 64 MRRFL
 SG_ MRR_FL_CAN_DET_MID_TARGET_063 : 462|1@0+ (1,0) [0|1] ""  CADM
 SG_ MRR_FL_CAN_DET_MID_TARGET_062 : 461|1@0+ (1,0) [0|1] ""  CADM
 SG_ MRR_FL_CAN_DET_MID_TARGET_061 : 460|1@0+ (1,0) [0|1] ""  CADM
 SG_ MRR_FL_CAN_DET_MID_TARGET_060 : 459|1@0+ (1,0) [0|1] ""  CADM
 SG_ MRR_FL_CAN_DET_MID_TARGET_059 : 458|1@0+ (1,0) [0|1] ""  CADM
 SG_ MRR_FL_CAN_DET_MID_TARGET_058 : 457|1@0+ (1,0) [0|1] ""  CADM
 SG_ MRR_FL_CAN_DET_MID_TARGET_057 : 456|1@0+ (1,0) [0|1] ""  CADM
 SG_ MRR_FL_CAN_DET_Near_TARGET_057 : 448|1@0+ (1,0) [0|1] ""  CADM
 SG_ MRR_FL_CAN_DET_Near_TARGET_058 : 449|1@0+ (1,0) [0|1] ""  CADM
 SG_ MRR_FL_CAN_DET_Near_TARGET_059 : 450|1@0+ (1,0) [0|1] ""  CADM
 SG_ MRR_FL_CAN_DET_Near_TARGET_060 : 451|1@0+ (1,0) [0|1] ""  CADM
 SG_ MRR_FL_CAN_DET_Near_TARGET_061 : 452|1@0+ (1,0) [0|1] ""  CADM
 SG_ MRR_FL_CAN_DET_Near_TARGET_062 : 453|1@0+ (1,0) [0|1] ""  CADM
 SG_ MRR_FL_CAN_DET_Near_TARGET_063 : 454|1@0+ (1,0) [0|1] ""  CADM
 SG_ MRR_FL_CAN_DET_ELEVATION_057 : 63|7@0+ (0.002748,-0.1745) [-0.1745|0.174496] "rad"  CADM
 SG_ MRR_FL_CAN_DET_CONFID_AZIMU_0050 : 33|2@0+ (1,0) [0|3] ""  CADM
 SG_ MRR_FL_CAN_DET_SUPER_RES_TA_0055 : 56|1@0+ (1,0) [0|1] ""  CADM
 SG_ MRR_FL_CAN_DET_CONFID_ELEVA_0055 : 49|1@0+ (1,0) [0|1] ""  CADM
 SG_ MRR_FL_CAN_DET_HOST_VEH_CLU_0055 : 48|1@0+ (1,0) [0|1] ""  CADM
 SG_ MRR_FL_CAN_DET_VALID_LEVEL_057 : 0|1@0+ (1,0) [0|1] ""  CADM
 SG_ MRR_FL_CAN_DET_AZIMUTH_057 : 47|14@0+ (0.0003834,-3.1416) [-3.1416|3.1396422] "rad"  CADM
 SG_ MRR_FL_CAN_DET_RANGE_057 : 31|14@0+ (0.015625,0) [0|255.984375] "m"  CADM
 SG_ MRR_FL_CAN_DET_RANGE_RATE_057 : 15|14@0+ (0.015625,-128) [-128|127.984375] "m/s"  CADM
 SG_ MRR_FL_CAN_DET_AMPLITUDE_057 : 7|7@0+ (1,-64) [-64|63] "dBsm"  CADM
 SG_ MRR_FL_CAN_SCAN_INDEX_2LSB_057 : 17|2@0+ (1,0) [0|3] ""  CADM
 SG_ MRR_FL_DET_MC_009 : 491|4@0+ (1,0) [0|15] ""  CADM
 SG_ MRR_FL_DET_CRC_009 : 503|16@0+ (1,0) [0|65535] ""  CADM
 SG_ MRR_FL_CAN_DET_ELEVATION_063 : 447|7@0+ (0.002748,-0.1745) [-0.1745|0.174496] "rad"  CADM
 SG_ MRR_FL_CAN_DET_SUPER_RES_TA_0056 : 440|1@0+ (1,0) [0|1] ""  CADM
 SG_ MRR_FL_CAN_DET_AZIMUTH_063 : 431|14@0+ (0.0003834,-3.1416) [-3.1416|3.1396422] "rad"  CADM
 SG_ MRR_FL_CAN_DET_CONFID_ELEVA_0056 : 433|1@0+ (1,0) [0|1] ""  CADM
 SG_ MRR_FL_CAN_DET_HOST_VEH_CLU_0056 : 432|1@0+ (1,0) [0|1] ""  CADM
 SG_ MRR_FL_CAN_DET_RANGE_063 : 415|14@0+ (0.015625,0) [0|255.984375] "m"  CADM
 SG_ MRR_FL_CAN_DET_CONFID_AZIMUTH_06 : 417|2@0+ (1,0) [0|3] ""  CADM
 SG_ MRR_FL_CAN_DET_RANGE_RATE_063 : 399|14@0+ (0.015625,-128) [-128|127.984375] "m/s"  CADM
 SG_ MRR_FL_CAN_SCAN_INDEX_2LSB_063 : 401|2@0+ (1,0) [0|3] ""  CADM
 SG_ MRR_FL_CAN_DET_AMPLITUDE_063 : 391|7@0+ (1,-64) [-64|63] "dBsm"  CADM
 SG_ MRR_FL_CAN_DET_VALID_LEVEL_063 : 384|1@0+ (1,0) [0|1] ""  CADM
 SG_ MRR_FL_CAN_DET_ELEVATION_062 : 383|7@0+ (0.002748,-0.1745) [-0.1745|0.174496] "rad"  CADM
 SG_ MRR_FL_CAN_DET_SUPER_RES_TA_0057 : 376|1@0+ (1,0) [0|1] ""  CADM
 SG_ MRR_FL_CAN_DET_AZIMUTH_062 : 367|14@0+ (0.0003834,-3.1416) [-3.1416|3.1396422] "rad"  CADM
 SG_ MRR_FL_CAN_DET_CONFID_ELEVA_0057 : 369|1@0+ (1,0) [0|1] ""  CADM
 SG_ MRR_FL_CAN_DET_HOST_VEH_CLU_0057 : 368|1@0+ (1,0) [0|1] ""  CADM
 SG_ MRR_FL_CAN_DET_RANGE_062 : 351|14@0+ (0.015625,0) [0|255.984375] "m"  CADM
 SG_ MRR_FL_CAN_DET_CONFID_AZIMU_0051 : 353|2@0+ (1,0) [0|3] ""  CADM
 SG_ MRR_FL_CAN_DET_RANGE_RATE_062 : 335|14@0+ (0.015625,-128) [-128|127.984375] "m/s"  CADM
 SG_ MRR_FL_CAN_SCAN_INDEX_2LSB_062 : 337|2@0+ (1,0) [0|3] ""  CADM
 SG_ MRR_FL_CAN_DET_AMPLITUDE_062 : 327|7@0+ (1,-64) [-64|63] "dBsm"  CADM
 SG_ MRR_FL_CAN_DET_VALID_LEVEL_062 : 320|1@0+ (1,0) [0|1] ""  CADM
 SG_ MRR_FL_CAN_DET_ELEVATION_061 : 319|7@0+ (0.002748,-0.1745) [-0.1745|0.174496] "rad"  CADM
 SG_ MRR_FL_CAN_DET_SUPER_RES_TA_0058 : 312|1@0+ (1,0) [0|1] ""  CADM
 SG_ MRR_FL_CAN_DET_AZIMUTH_061 : 303|14@0+ (0.0003834,-3.1416) [-3.1416|3.1396422] "rad"  CADM
 SG_ MRR_FL_CAN_DET_CONFID_ELEVA_0058 : 305|1@0+ (1,0) [0|1] ""  CADM
 SG_ MRR_FL_CAN_DET_HOST_VEH_CLU_0058 : 304|1@0+ (1,0) [0|1] ""  CADM
 SG_ MRR_FL_CAN_DET_RANGE_061 : 287|14@0+ (0.015625,0) [0|255.984375] "m"  CADM
 SG_ MRR_FL_CAN_DET_CONFID_AZIMU_0052 : 289|2@0+ (1,0) [0|3] ""  CADM
 SG_ MRR_FL_CAN_DET_RANGE_RATE_061 : 271|14@0+ (0.015625,-128) [-128|127.984375] "m/s"  CADM
 SG_ MRR_FL_CAN_SCAN_INDEX_2LSB_061 : 273|2@0+ (1,0) [0|3] ""  CADM
 SG_ MRR_FL_CAN_DET_AMPLITUDE_061 : 263|7@0+ (1,-64) [-64|63] "dBsm"  CADM
 SG_ MRR_FL_CAN_DET_VALID_LEVEL_061 : 256|1@0+ (1,0) [0|1] ""  CADM
 SG_ MRR_FL_CAN_DET_ELEVATION_060 : 255|7@0+ (0.002748,-0.1745) [-0.1745|0.174496] "rad"  CADM
 SG_ MRR_FL_CAN_DET_SUPER_RES_TA_0059 : 248|1@0+ (1,0) [0|1] ""  CADM
 SG_ MRR_FL_CAN_DET_AZIMUTH_060 : 239|14@0+ (0.0003834,-3.1416) [-3.1416|3.1396422] "rad"  CADM
 SG_ MRR_FL_CAN_DET_CONFID_ELEVA_0059 : 241|1@0+ (1,0) [0|1] ""  CADM
 SG_ MRR_FL_CAN_DET_HOST_VEH_CLU_0059 : 240|1@0+ (1,0) [0|1] ""  CADM
 SG_ MRR_FL_CAN_DET_RANGE_060 : 223|14@0+ (0.015625,0) [0|255.984375] "m"  CADM
 SG_ MRR_FL_CAN_DET_CONFID_AZIMU_0053 : 225|2@0+ (1,0) [0|3] ""  CADM
 SG_ MRR_FL_CAN_DET_RANGE_RATE_060 : 207|14@0+ (0.015625,-128) [-128|127.984375] "m/s"  CADM
 SG_ MRR_FL_CAN_SCAN_INDEX_2LSB_060 : 209|2@0+ (1,0) [0|3] ""  CADM
 SG_ MRR_FL_CAN_DET_AMPLITUDE_060 : 199|7@0+ (1,-64) [-64|63] "dBsm"  CADM
 SG_ MRR_FL_CAN_DET_VALID_LEVEL_060 : 192|1@0+ (1,0) [0|1] ""  CADM
 SG_ MRR_FL_CAN_DET_ELEVATION_059 : 191|7@0+ (0.002748,-0.1745) [-0.1745|0.174496] "rad"  CADM
 SG_ MRR_FL_CAN_DET_SUPER_RES_TA_0060 : 184|1@0+ (1,0) [0|1] ""  CADM
 SG_ MRR_FL_CAN_DET_AZIMUTH_059 : 175|14@0+ (0.0003834,-3.1416) [-3.1416|3.1396422] "rad"  CADM
 SG_ MRR_FL_CAN_DET_CONFID_ELEVA_0060 : 177|1@0+ (1,0) [0|1] ""  CADM
 SG_ MRR_FL_CAN_DET_HOST_VEH_CLU_0060 : 176|1@0+ (1,0) [0|1] ""  CADM
 SG_ MRR_FL_CAN_DET_RANGE_059 : 159|14@0+ (0.015625,0) [0|255.984375] "m"  CADM
 SG_ MRR_FL_CAN_DET_CONFID_AZIMU_0054 : 161|2@0+ (1,0) [0|3] ""  CADM
 SG_ MRR_FL_CAN_DET_RANGE_RATE_059 : 143|14@0+ (0.015625,-128) [-128|127.984375] "m/s"  CADM
 SG_ MRR_FL_CAN_SCAN_INDEX_2LSB_059 : 145|2@0+ (1,0) [0|3] ""  CADM
 SG_ MRR_FL_CAN_DET_AMPLITUDE_059 : 135|7@0+ (1,-64) [-64|63] "dBsm"  CADM
 SG_ MRR_FL_CAN_DET_VALID_LEVEL_059 : 128|1@0+ (1,0) [0|1] ""  CADM
 SG_ MRR_FL_CAN_DET_ELEVATION_058 : 127|7@0+ (0.002748,-0.1745) [-0.1745|0.174496] "rad"  CADM
 SG_ MRR_FL_CAN_DET_SUPER_RES_TA_0061 : 120|1@0+ (1,0) [0|1] ""  CADM
 SG_ MRR_FL_CAN_DET_AZIMUTH_058 : 111|14@0+ (0.0003834,-3.1416) [-3.1416|3.1396422] "rad"  CADM
 SG_ MRR_FL_CAN_DET_CONFID_ELEVA_0061 : 113|1@0+ (1,0) [0|1] ""  CADM
 SG_ MRR_FL_CAN_DET_HOST_VEH_CLU_0061 : 112|1@0+ (1,0) [0|1] ""  CADM
 SG_ MRR_FL_CAN_DET_RANGE_058 : 95|14@0+ (0.015625,0) [0|255.984375] "m"  CADM
 SG_ MRR_FL_CAN_DET_CONFID_AZIMU_0055 : 97|2@0+ (1,0) [0|3] ""  CADM
 SG_ MRR_FL_CAN_DET_RANGE_RATE_058 : 79|14@0+ (0.015625,-128) [-128|127.984375] "m/s"  CADM
 SG_ MRR_FL_CAN_SCAN_INDEX_2LSB_058 : 81|2@0+ (1,0) [0|3] ""  CADM
 SG_ MRR_FL_CAN_DET_AMPLITUDE_058 : 71|7@0+ (1,-64) [-64|63] "dBsm"  CADM
 SG_ MRR_FL_CAN_DET_VALID_LEVEL_058 : 64|1@0+ (1,0) [0|1] ""  CADM

BO_ 777 MRR_FL_Detection_064: 12 MRRFL
 SG_ MRR_FL_CAN_DET_MID_TARGET_064 : 65|1@0+ (1,0) [0|1] ""  CADM
 SG_ MRR_FL_CAN_DET_Near_TARGET_064 : 64|1@0+ (1,0) [0|1] ""  CADM
 SG_ MRR_FL_DET_MC_010 : 75|4@0+ (1,0) [0|15] ""  CADM
 SG_ MRR_FL_DET_CRC_010 : 87|16@0+ (1,0) [0|65535] ""  CADM
 SG_ MRR_FL_CAN_DET_ELEVATION_064 : 63|7@0+ (0.002748,-0.1745) [-0.1745|0.174496] "rad"  CADM
 SG_ MRR_FL_CAN_DET_CONFID_AZIMU_0056 : 33|2@0+ (1,0) [0|3] ""  CADM
 SG_ MRR_FL_CAN_DET_SUPER_RES_TA_0062 : 56|1@0+ (1,0) [0|1] ""  CADM
 SG_ MRR_FL_CAN_DET_CONFID_ELEVA_0062 : 49|1@0+ (1,0) [0|1] ""  CADM
 SG_ MRR_FL_CAN_DET_HOST_VEH_CLU_0062 : 48|1@0+ (1,0) [0|1] ""  CADM
 SG_ MRR_FL_CAN_DET_VALID_LEVEL_064 : 0|1@0+ (1,0) [0|1] ""  CADM
 SG_ MRR_FL_CAN_DET_AZIMUTH_064 : 47|14@0+ (0.0003834,-3.1416) [-3.1416|3.1396422] "rad"  CADM
 SG_ MRR_FL_CAN_DET_RANGE_064 : 31|14@0+ (0.015625,0) [0|255.984375] "m"  CADM
 SG_ MRR_FL_CAN_DET_RANGE_RATE_064 : 15|14@0+ (0.015625,-128) [-128|127.984375] "m/s"  CADM
 SG_ MRR_FL_CAN_DET_AMPLITUDE_064 : 7|7@0+ (1,-64) [-64|63] "dBsm"  CADM
 SG_ MRR_FL_CAN_SCAN_INDEX_2LSB_064 : 17|2@0+ (1,0) [0|3] ""  CADM

BO_ 391 MRR_FL_Header_Timestamps: 20 MRRFL
 SG_ MRR_FL_Sensor_Position : 74|3@0+ (1,0) [0|7] ""  CADM
 SG_ MRR_FL_Sensor_Position_Lock : 135|1@0+ (1,0) [0|1] ""  CADM
 SG_ MRR_FL_CAN_NUMBER_OF_DET : 119|8@0+ (1,0) [0|255] ""  CADM
 SG_ MRR_FL_CAN_SCAN_INDEX_FUSED : 127|8@0+ (1,0) [0|255] ""  CADM
 SG_ MRR_FL_CAN_LOOK_ID : 76|2@0+ (1,0) [0|3] ""  CADM
 SG_ MRR_FL_CAN_LOOK_INDEX : 103|16@0+ (1,0) [0|65535] ""  CADM
 SG_ MRR_FL_CAN_DET_TIME_SINCE_MEAS : 71|11@0+ (0.1,0) [0|204.7] "ms"  CADM
 SG_ MRR_FL_TrackStatus_CRC : 151|16@0+ (1,0) [0|65535] ""  CADM
 SG_ MRR_FL_TrackStatus_MC : 139|4@0+ (1,0) [0|15] ""  CADM
 SG_ MRR_FL_CAN_ReSync_counter : 87|16@0+ (1,0) [0|65535] ""  CADM
 SG_ MRR_FL_CAN_TX_LOOK_INDEX_8 : 31|8@0+ (1,0) [0|255] ""  CADM
 SG_ MRR_FL_CAN_TX_SCAN_INDEX_TRACKER : 23|8@0+ (1,0) [0|255] ""  CADM
 SG_ MRR_FL_CAN_TX_SCN_INDEX_TRKER_FU : 7|8@0+ (1,0) [0|255] ""  CADM
 SG_ MRR_FL_CAN_TX_LOOK_TYPE : 15|1@0+ (1,0) [0|1] ""  CADM
 SG_ MRR_FL_CAN_TX_LOOK_ID : 14|7@0+ (1,0) [0|127] ""  CADM
 SG_ MRR_FL_CAN_TX_SYSTEM_TIME_STAMP : 39|32@0+ (1,0) [0|4294967295] "us"  CADM

BO_ 1024 MRR_FR_Detection_001_007: 64 MRRFR
 SG_ MRR_FR_CAN_DET_MID_TARGET_007 : 462|1@0+ (1,0) [0|1] ""  CADM
 SG_ MRR_FR_CAN_DET_MID_TARGET_006 : 461|1@0+ (1,0) [0|1] ""  CADM
 SG_ MRR_FR_CAN_DET_MID_TARGET_005 : 460|1@0+ (1,0) [0|1] ""  CADM
 SG_ MRR_FR_CAN_DET_MID_TARGET_004 : 459|1@0+ (1,0) [0|1] ""  CADM
 SG_ MRR_FR_CAN_DET_MID_TARGET_003 : 458|1@0+ (1,0) [0|1] ""  CADM
 SG_ MRR_FR_CAN_DET_MID_TARGET_002 : 457|1@0+ (1,0) [0|1] ""  CADM
 SG_ MRR_FR_CAN_DET_MID_TARGET_001 : 456|1@0+ (1,0) [0|1] ""  CADM
 SG_ MRR_FR_CAN_DET_Near_TARGET_007 : 454|1@0+ (1,0) [0|1] ""  CADM
 SG_ MRR_FR_CAN_DET_Near_TARGET_006 : 453|1@0+ (1,0) [0|1] ""  CADM
 SG_ MRR_FR_CAN_DET_Near_TARGET_005 : 452|1@0+ (1,0) [0|1] ""  CADM
 SG_ MRR_FR_CAN_DET_Near_TARGET_004 : 451|1@0+ (1,0) [0|1] ""  CADM
 SG_ MRR_FR_CAN_DET_Near_TARGET_003 : 450|1@0+ (1,0) [0|1] ""  CADM
 SG_ MRR_FR_CAN_DET_Near_TARGET_002 : 449|1@0+ (1,0) [0|1] ""  CADM
 SG_ MRR_FR_CAN_DET_Near_TARGET_001 : 448|1@0+ (1,0) [0|1] ""  CADM
 SG_ MRR_FR_DET_MC_001 : 491|4@0+ (1,0) [0|15] ""  CADM
 SG_ MRR_FR_DET_CRC_001 : 503|16@0+ (1,0) [0|65535] ""  CADM
 SG_ MRR_FR_CAN_DET_ELEVATION_007 : 447|7@0+ (0.002748,-0.1745) [-0.1745|0.174496] "rad"  CADM
 SG_ MRR_FR_CAN_DET_SUPER_RES_TARGET_ : 440|1@0+ (1,0) [0|1] ""  CADM
 SG_ MRR_FR_CAN_DET_AZIMUTH_007 : 431|14@0+ (0.0003834,-3.1416) [-3.1416|3.1396422] "rad"  CADM
 SG_ MRR_FR_CAN_DET_CONFID_ELEVATION_ : 433|1@0+ (1,0) [0|1] ""  CADM
 SG_ MRR_FR_CAN_DET_HOST_VEH_CLUTTER_ : 432|1@0+ (1,0) [0|1] ""  CADM
 SG_ MRR_FR_CAN_DET_RANGE_007 : 415|14@0+ (0.015625,0) [0|255.984375] "m"  CADM
 SG_ MRR_FR_CAN_DET_CONFID_AZIMUTH_00 : 417|2@0+ (1,0) [0|3] ""  CADM
 SG_ MRR_FR_CAN_DET_RANGE_RATE_007 : 399|14@0+ (0.015625,-128) [-128|127.984375] "m/s"  CADM
 SG_ MRR_FR_CAN_SCAN_INDEX_2LSB_007 : 401|2@0+ (1,0) [0|3] ""  CADM
 SG_ MRR_FR_CAN_DET_AMPLITUDE_007 : 391|7@0+ (1,-64) [-64|63] "dBsm"  CADM
 SG_ MRR_FR_CAN_DET_VALID_LEVEL_007 : 384|1@0+ (1,0) [0|1] ""  CADM
 SG_ MRR_FR_CAN_DET_ELEVATION_006 : 383|7@0+ (0.002748,-0.1745) [-0.1745|0.174496] "rad"  CADM
 SG_ MRR_FR_CAN_DET_SUPER_RES_TA_0000 : 376|1@0+ (1,0) [0|1] ""  CADM
 SG_ MRR_FR_CAN_DET_AZIMUTH_006 : 367|14@0+ (0.0003834,-3.1416) [-3.1416|3.1396422] "rad"  CADM
 SG_ MRR_FR_CAN_DET_CONFID_ELEVA_0000 : 369|1@0+ (1,0) [0|1] ""  CADM
 SG_ MRR_FR_CAN_DET_HOST_VEH_CLU_0000 : 368|1@0+ (1,0) [0|1] ""  CADM
 SG_ MRR_FR_CAN_DET_RANGE_006 : 351|14@0+ (0.015625,0) [0|255.984375] "m"  CADM
 SG_ MRR_FR_CAN_DET_CONFID_AZIMU_0000 : 353|2@0+ (1,0) [0|3] ""  CADM
 SG_ MRR_FR_CAN_DET_RANGE_RATE_006 : 335|14@0+ (0.015625,-128) [-128|127.984375] "m/s"  CADM
 SG_ MRR_FR_CAN_SCAN_INDEX_2LSB_006 : 337|2@0+ (1,0) [0|3] ""  CADM
 SG_ MRR_FR_CAN_DET_AMPLITUDE_006 : 327|7@0+ (1,-64) [-64|63] "dBsm"  CADM
 SG_ MRR_FR_CAN_DET_VALID_LEVEL_006 : 320|1@0+ (1,0) [0|1] ""  CADM
 SG_ MRR_FR_CAN_DET_ELEVATION_005 : 319|7@0+ (0.002748,-0.1745) [-0.1745|0.174496] "rad"  CADM
 SG_ MRR_FR_CAN_DET_SUPER_RES_TA_0001 : 312|1@0+ (1,0) [0|1] ""  CADM
 SG_ MRR_FR_CAN_DET_AZIMUTH_005 : 303|14@0+ (0.0003834,-3.1416) [-3.1416|3.1396422] "rad"  CADM
 SG_ MRR_FR_CAN_DET_CONFID_ELEVA_0001 : 305|1@0+ (1,0) [0|1] ""  CADM
 SG_ MRR_FR_CAN_DET_HOST_VEH_CLU_0001 : 304|1@0+ (1,0) [0|1] ""  CADM
 SG_ MRR_FR_CAN_DET_RANGE_005 : 287|14@0+ (0.015625,0) [0|255.984375] "m"  CADM
 SG_ MRR_FR_CAN_DET_CONFID_AZIMU_0001 : 289|2@0+ (1,0) [0|3] ""  CADM
 SG_ MRR_FR_CAN_DET_RANGE_RATE_005 : 271|14@0+ (0.015625,-128) [-128|127.984375] "m/s"  CADM
 SG_ MRR_FR_CAN_SCAN_INDEX_2LSB_005 : 273|2@0+ (1,0) [0|3] ""  CADM
 SG_ MRR_FR_CAN_DET_AMPLITUDE_005 : 263|7@0+ (1,-64) [-64|63] "dBsm"  CADM
 SG_ MRR_FR_CAN_DET_VALID_LEVEL_005 : 256|1@0+ (1,0) [0|1] ""  CADM
 SG_ MRR_FR_CAN_DET_ELEVATION_004 : 255|7@0+ (0.002748,-0.1745) [-0.1745|0.174496] "rad"  CADM
 SG_ MRR_FR_CAN_DET_SUPER_RES_TA_0002 : 248|1@0+ (1,0) [0|1] ""  CADM
 SG_ MRR_FR_CAN_DET_AZIMUTH_004 : 239|14@0+ (0.0003834,-3.1416) [-3.1416|3.1396422] "rad"  CADM
 SG_ MRR_FR_CAN_DET_CONFID_ELEVA_0002 : 241|1@0+ (1,0) [0|1] ""  CADM
 SG_ MRR_FR_CAN_DET_HOST_VEH_CLU_0002 : 240|1@0+ (1,0) [0|1] ""  CADM
 SG_ MRR_FR_CAN_DET_RANGE_004 : 223|14@0+ (0.015625,0) [0|255.984375] "m"  CADM
 SG_ MRR_FR_CAN_DET_CONFID_AZIMU_0002 : 225|2@0+ (1,0) [0|3] ""  CADM
 SG_ MRR_FR_CAN_DET_RANGE_RATE_004 : 207|14@0+ (0.015625,-128) [-128|127.984375] "m/s"  CADM
 SG_ MRR_FR_CAN_SCAN_INDEX_2LSB_004 : 209|2@0+ (1,0) [0|3] ""  CADM
 SG_ MRR_FR_CAN_DET_AMPLITUDE_004 : 199|7@0+ (1,-64) [-64|63] "dBsm"  CADM
 SG_ MRR_FR_CAN_DET_VALID_LEVEL_004 : 192|1@0+ (1,0) [0|1] ""  CADM
 SG_ MRR_FR_CAN_DET_ELEVATION_003 : 191|7@0+ (0.002748,-0.1745) [-0.1745|0.174496] "rad"  CADM
 SG_ MRR_FR_CAN_DET_SUPER_RES_TA_0003 : 184|1@0+ (1,0) [0|1] ""  CADM
 SG_ MRR_FR_CAN_DET_AZIMUTH_003 : 175|14@0+ (0.0003834,-3.1416) [-3.1416|3.1396422] "rad"  CADM
 SG_ MRR_FR_CAN_DET_CONFID_ELEVA_0003 : 177|1@0+ (1,0) [0|1] ""  CADM
 SG_ MRR_FR_CAN_DET_HOST_VEH_CLU_0003 : 176|1@0+ (1,0) [0|1] ""  CADM
 SG_ MRR_FR_CAN_DET_RANGE_003 : 159|14@0+ (0.015625,0) [0|255.984375] "m"  CADM
 SG_ MRR_FR_CAN_DET_CONFID_AZIMU_0003 : 161|2@0+ (1,0) [0|3] ""  CADM
 SG_ MRR_FR_CAN_DET_RANGE_RATE_003 : 143|14@0+ (0.015625,-128) [-128|127.984375] "m/s"  CADM
 SG_ MRR_FR_CAN_SCAN_INDEX_2LSB_003 : 145|2@0+ (1,0) [0|3] ""  CADM
 SG_ MRR_FR_CAN_DET_AMPLITUDE_003 : 135|7@0+ (1,-64) [-64|63] "dBsm"  CADM
 SG_ MRR_FR_CAN_DET_VALID_LEVEL_003 : 128|1@0+ (1,0) [0|1] ""  CADM
 SG_ MRR_FR_CAN_DET_ELEVATION_002 : 127|7@0+ (0.002748,-0.1745) [-0.1745|0.174496] "rad"  CADM
 SG_ MRR_FR_CAN_DET_SUPER_RES_TA_0004 : 120|1@0+ (1,0) [0|1] ""  CADM
 SG_ MRR_FR_CAN_DET_AZIMUTH_002 : 111|14@0+ (0.0003834,-3.1416) [-3.1416|3.1396422] "rad"  CADM
 SG_ MRR_FR_CAN_DET_CONFID_ELEVA_0004 : 113|1@0+ (1,0) [0|1] ""  CADM
 SG_ MRR_FR_CAN_DET_HOST_VEH_CLU_0004 : 112|1@0+ (1,0) [0|1] ""  CADM
 SG_ MRR_FR_CAN_DET_RANGE_002 : 95|14@0+ (0.015625,0) [0|255.984375] "m"  CADM
 SG_ MRR_FR_CAN_DET_CONFID_AZIMU_0004 : 97|2@0+ (1,0) [0|3] ""  CADM
 SG_ MRR_FR_CAN_DET_RANGE_RATE_002 : 79|14@0+ (0.015625,-128) [-128|127.984375] "m/s"  CADM
 SG_ MRR_FR_CAN_SCAN_INDEX_2LSB_002 : 81|2@0+ (1,0) [0|3] ""  CADM
 SG_ MRR_FR_CAN_DET_AMPLITUDE_002 : 71|7@0+ (1,-64) [-64|63] "dBsm"  CADM
 SG_ MRR_FR_CAN_DET_VALID_LEVEL_002 : 64|1@0+ (1,0) [0|1] ""  CADM
 SG_ MRR_FR_CAN_DET_ELEVATION_001 : 63|7@0+ (0.002748,-0.1745) [-0.1745|0.174496] "rad"  CADM
 SG_ MRR_FR_CAN_DET_CONFID_AZIMU_0005 : 33|2@0+ (1,0) [0|3] ""  CADM
 SG_ MRR_FR_CAN_DET_SUPER_RES_TA_0005 : 56|1@0+ (1,0) [0|1] ""  CADM
 SG_ MRR_FR_CAN_DET_CONFID_ELEVA_0005 : 49|1@0+ (1,0) [0|1] ""  CADM
 SG_ MRR_FR_CAN_DET_HOST_VEH_CLU_0005 : 48|1@0+ (1,0) [0|1] ""  CADM
 SG_ MRR_FR_CAN_DET_VALID_LEVEL_001 : 0|1@0+ (1,0) [0|1] ""  CADM
 SG_ MRR_FR_CAN_DET_AZIMUTH_001 : 47|14@0+ (0.0003834,-3.1416) [-3.1416|3.1396422] "rad"  CADM
 SG_ MRR_FR_CAN_DET_RANGE_001 : 31|14@0+ (0.015625,0) [0|255.984375] "m"  CADM
 SG_ MRR_FR_CAN_DET_RANGE_RATE_001 : 15|14@0+ (0.015625,-128) [-128|127.984375] "m/s"  CADM
 SG_ MRR_FR_CAN_DET_AMPLITUDE_001 : 7|7@0+ (1,-64) [-64|63] "dBsm"  CADM
 SG_ MRR_FR_CAN_SCAN_INDEX_2LSB_001 : 17|2@0+ (1,0) [0|3] ""  CADM

BO_ 1025 MRR_FR_Detection_008_014: 64 MRRFR
 SG_ MRR_FR_CAN_DET_MID_TARGET_014 : 462|1@0+ (1,0) [0|1] ""  CADM
 SG_ MRR_FR_CAN_DET_MID_TARGET_013 : 461|1@0+ (1,0) [0|1] ""  CADM
 SG_ MRR_FR_CAN_DET_MID_TARGET_012 : 460|1@0+ (1,0) [0|1] ""  CADM
 SG_ MRR_FR_CAN_DET_MID_TARGET_011 : 459|1@0+ (1,0) [0|1] ""  CADM
 SG_ MRR_FR_CAN_DET_MID_TARGET_010 : 458|1@0+ (1,0) [0|1] ""  CADM
 SG_ MRR_FR_CAN_DET_MID_TARGET_009 : 457|1@0+ (1,0) [0|1] ""  CADM
 SG_ MRR_FR_CAN_DET_MID_TARGET_008 : 456|1@0+ (1,0) [0|1] ""  CADM
 SG_ MRR_FR_CAN_DET_Near_TARGET_008 : 448|1@0+ (1,0) [0|1] ""  CADM
 SG_ MRR_FR_CAN_DET_Near_TARGET_009 : 449|1@0+ (1,0) [0|1] ""  CADM
 SG_ MRR_FR_CAN_DET_Near_TARGET_010 : 450|1@0+ (1,0) [0|1] ""  CADM
 SG_ MRR_FR_CAN_DET_Near_TARGET_011 : 451|1@0+ (1,0) [0|1] ""  CADM
 SG_ MRR_FR_CAN_DET_Near_TARGET_012 : 452|1@0+ (1,0) [0|1] ""  CADM
 SG_ MRR_FR_CAN_DET_Near_TARGET_013 : 453|1@0+ (1,0) [0|1] ""  CADM
 SG_ MRR_FR_CAN_DET_Near_TARGET_014 : 454|1@0+ (1,0) [0|1] ""  CADM
 SG_ MRR_FR_CAN_DET_ELEVATION_008 : 63|7@0+ (0.002748,-0.1745) [-0.1745|0.174496] "rad"  CADM
 SG_ MRR_FR_CAN_DET_CONFID_AZIMU_0006 : 33|2@0+ (1,0) [0|3] ""  CADM
 SG_ MRR_FR_CAN_DET_SUPER_RES_TA_0006 : 56|1@0+ (1,0) [0|1] ""  CADM
 SG_ MRR_FR_CAN_DET_CONFID_ELEVA_0006 : 49|1@0+ (1,0) [0|1] ""  CADM
 SG_ MRR_FR_CAN_DET_HOST_VEH_CLU_0006 : 48|1@0+ (1,0) [0|1] ""  CADM
 SG_ MRR_FR_CAN_DET_VALID_LEVEL_008 : 0|1@0+ (1,0) [0|1] ""  CADM
 SG_ MRR_FR_CAN_DET_AZIMUTH_008 : 47|14@0+ (0.0003834,-3.1416) [-3.1416|3.1396422] "rad"  CADM
 SG_ MRR_FR_CAN_DET_RANGE_008 : 31|14@0+ (0.015625,0) [0|255.984375] "m"  CADM
 SG_ MRR_FR_CAN_DET_RANGE_RATE_008 : 15|14@0+ (0.015625,-128) [-128|127.984375] "m/s"  CADM
 SG_ MRR_FR_CAN_DET_AMPLITUDE_008 : 7|7@0+ (1,-64) [-64|63] "dBsm"  CADM
 SG_ MRR_FR_CAN_SCAN_INDEX_2LSB_008 : 17|2@0+ (1,0) [0|3] ""  CADM
 SG_ MRR_FR_DET_MC_002 : 491|4@0+ (1,0) [0|15] ""  CADM
 SG_ MRR_FR_DET_CRC_002 : 503|16@0+ (1,0) [0|65535] ""  CADM
 SG_ MRR_FR_CAN_DET_ELEVATION_014 : 447|7@0+ (0.002748,-0.1745) [-0.1745|0.174496] "rad"  CADM
 SG_ MRR_FR_CAN_DET_SUPER_RES_TA_0007 : 440|1@0+ (1,0) [0|1] ""  CADM
 SG_ MRR_FR_CAN_DET_AZIMUTH_014 : 431|14@0+ (0.0003834,-3.1416) [-3.1416|3.1396422] "rad"  CADM
 SG_ MRR_FR_CAN_DET_CONFID_ELEVA_0007 : 433|1@0+ (1,0) [0|1] ""  CADM
 SG_ MRR_FR_CAN_DET_HOST_VEH_CLU_0007 : 432|1@0+ (1,0) [0|1] ""  CADM
 SG_ MRR_FR_CAN_DET_RANGE_014 : 415|14@0+ (0.015625,0) [0|255.984375] "m"  CADM
 SG_ MRR_FR_CAN_DET_CONFID_AZIMUTH_01 : 417|2@0+ (1,0) [0|3] ""  CADM
 SG_ MRR_FR_CAN_DET_RANGE_RATE_014 : 399|14@0+ (0.015625,-128) [-128|127.984375] "m/s"  CADM
 SG_ MRR_FR_CAN_SCAN_INDEX_2LSB_014 : 401|2@0+ (1,0) [0|3] ""  CADM
 SG_ MRR_FR_CAN_DET_AMPLITUDE_014 : 391|7@0+ (1,-64) [-64|63] "dBsm"  CADM
 SG_ MRR_FR_CAN_DET_VALID_LEVEL_014 : 384|1@0+ (1,0) [0|1] ""  CADM
 SG_ MRR_FR_CAN_DET_ELEVATION_013 : 383|7@0+ (0.002748,-0.1745) [-0.1745|0.174496] "rad"  CADM
 SG_ MRR_FR_CAN_DET_SUPER_RES_TA_0008 : 376|1@0+ (1,0) [0|1] ""  CADM
 SG_ MRR_FR_CAN_DET_AZIMUTH_013 : 367|14@0+ (0.0003834,-3.1416) [-3.1416|3.1396422] "rad"  CADM
 SG_ MRR_FR_CAN_DET_CONFID_ELEVA_0008 : 369|1@0+ (1,0) [0|1] ""  CADM
 SG_ MRR_FR_CAN_DET_HOST_VEH_CLU_0008 : 368|1@0+ (1,0) [0|1] ""  CADM
 SG_ MRR_FR_CAN_DET_RANGE_013 : 351|14@0+ (0.015625,0) [0|255.984375] "m"  CADM
 SG_ MRR_FR_CAN_DET_CONFID_AZIMU_0007 : 353|2@0+ (1,0) [0|3] ""  CADM
 SG_ MRR_FR_CAN_DET_RANGE_RATE_013 : 335|14@0+ (0.015625,-128) [-128|127.984375] "m/s"  CADM
 SG_ MRR_FR_CAN_SCAN_INDEX_2LSB_013 : 337|2@0+ (1,0) [0|3] ""  CADM
 SG_ MRR_FR_CAN_DET_AMPLITUDE_013 : 327|7@0+ (1,-64) [-64|63] "dBsm"  CADM
 SG_ MRR_FR_CAN_DET_VALID_LEVEL_013 : 320|1@0+ (1,0) [0|1] ""  CADM
 SG_ MRR_FR_CAN_DET_ELEVATION_012 : 319|7@0+ (0.002748,-0.1745) [-0.1745|0.174496] "rad"  CADM
 SG_ MRR_FR_CAN_DET_SUPER_RES_TA_0009 : 312|1@0+ (1,0) [0|1] ""  CADM
 SG_ MRR_FR_CAN_DET_AZIMUTH_012 : 303|14@0+ (0.0003834,-3.1416) [-3.1416|3.1396422] "rad"  CADM
 SG_ MRR_FR_CAN_DET_CONFID_ELEVA_0009 : 305|1@0+ (1,0) [0|1] ""  CADM
 SG_ MRR_FR_CAN_DET_HOST_VEH_CLU_0009 : 304|1@0+ (1,0) [0|1] ""  CADM
 SG_ MRR_FR_CAN_DET_RANGE_012 : 287|14@0+ (0.015625,0) [0|255.984375] "m"  CADM
 SG_ MRR_FR_CAN_DET_CONFID_AZIMU_0008 : 289|2@0+ (1,0) [0|3] ""  CADM
 SG_ MRR_FR_CAN_DET_RANGE_RATE_012 : 271|14@0+ (0.015625,-128) [-128|127.984375] "m/s"  CADM
 SG_ MRR_FR_CAN_SCAN_INDEX_2LSB_012 : 273|2@0+ (1,0) [0|3] ""  CADM
 SG_ MRR_FR_CAN_DET_AMPLITUDE_012 : 263|7@0+ (1,-64) [-64|63] "dBsm"  CADM
 SG_ MRR_FR_CAN_DET_VALID_LEVEL_012 : 256|1@0+ (1,0) [0|1] ""  CADM
 SG_ MRR_FR_CAN_DET_ELEVATION_011 : 255|7@0+ (0.002748,-0.1745) [-0.1745|0.174496] "rad"  CADM
 SG_ MRR_FR_CAN_DET_SUPER_RES_TA_0010 : 248|1@0+ (1,0) [0|1] ""  CADM
 SG_ MRR_FR_CAN_DET_AZIMUTH_011 : 239|14@0+ (0.0003834,-3.1416) [-3.1416|3.1396422] "rad"  CADM
 SG_ MRR_FR_CAN_DET_CONFID_ELEVA_0010 : 241|1@0+ (1,0) [0|1] ""  CADM
 SG_ MRR_FR_CAN_DET_HOST_VEH_CLU_0010 : 240|1@0+ (1,0) [0|1] ""  CADM
 SG_ MRR_FR_CAN_DET_RANGE_011 : 223|14@0+ (0.015625,0) [0|255.984375] "m"  CADM
 SG_ MRR_FR_CAN_DET_CONFID_AZIMU_0009 : 225|2@0+ (1,0) [0|3] ""  CADM
 SG_ MRR_FR_CAN_DET_RANGE_RATE_011 : 207|14@0+ (0.015625,-128) [-128|127.984375] "m/s"  CADM
 SG_ MRR_FR_CAN_SCAN_INDEX_2LSB_011 : 209|2@0+ (1,0) [0|3] ""  CADM
 SG_ MRR_FR_CAN_DET_AMPLITUDE_011 : 199|7@0+ (1,-64) [-64|63] "dBsm"  CADM
 SG_ MRR_FR_CAN_DET_VALID_LEVEL_011 : 192|1@0+ (1,0) [0|1] ""  CADM
 SG_ MRR_FR_CAN_DET_ELEVATION_010 : 191|7@0+ (0.002748,-0.1745) [-0.1745|0.174496] "rad"  CADM
 SG_ MRR_FR_CAN_DET_SUPER_RES_TA_0011 : 184|1@0+ (1,0) [0|1] ""  CADM
 SG_ MRR_FR_CAN_DET_AZIMUTH_010 : 175|14@0+ (0.0003834,-3.1416) [-3.1416|3.1396422] "rad"  CADM
 SG_ MRR_FR_CAN_DET_CONFID_ELEVA_0011 : 177|1@0+ (1,0) [0|1] ""  CADM
 SG_ MRR_FR_CAN_DET_HOST_VEH_CLU_0011 : 176|1@0+ (1,0) [0|1] ""  CADM
 SG_ MRR_FR_CAN_DET_RANGE_010 : 159|14@0+ (0.015625,0) [0|255.984375] "m"  CADM
 SG_ MRR_FR_CAN_DET_CONFID_AZIMU_0010 : 161|2@0+ (1,0) [0|3] ""  CADM
 SG_ MRR_FR_CAN_DET_RANGE_RATE_010 : 143|14@0+ (0.015625,-128) [-128|127.984375] "m/s"  CADM
 SG_ MRR_FR_CAN_SCAN_INDEX_2LSB_010 : 145|2@0+ (1,0) [0|3] ""  CADM
 SG_ MRR_FR_CAN_DET_AMPLITUDE_010 : 135|7@0+ (1,-64) [-64|63] "dBsm"  CADM
 SG_ MRR_FR_CAN_DET_VALID_LEVEL_010 : 128|1@0+ (1,0) [0|1] ""  CADM
 SG_ MRR_FR_CAN_DET_ELEVATION_009 : 127|7@0+ (0.002748,-0.1745) [-0.1745|0.174496] "rad"  CADM
 SG_ MRR_FR_CAN_DET_SUPER_RES_TA_0012 : 120|1@0+ (1,0) [0|1] ""  CADM
 SG_ MRR_FR_CAN_DET_AZIMUTH_009 : 111|14@0+ (0.0003834,-3.1416) [-3.1416|3.1396422] "rad"  CADM
 SG_ MRR_FR_CAN_DET_CONFID_ELEVA_0012 : 113|1@0+ (1,0) [0|1] ""  CADM
 SG_ MRR_FR_CAN_DET_HOST_VEH_CLU_0012 : 112|1@0+ (1,0) [0|1] ""  CADM
 SG_ MRR_FR_CAN_DET_RANGE_009 : 95|14@0+ (0.015625,0) [0|255.984375] "m"  CADM
 SG_ MRR_FR_CAN_DET_CONFID_AZIMU_0011 : 97|2@0+ (1,0) [0|3] ""  CADM
 SG_ MRR_FR_CAN_DET_RANGE_RATE_009 : 79|14@0+ (0.015625,-128) [-128|127.984375] "m/s"  CADM
 SG_ MRR_FR_CAN_SCAN_INDEX_2LSB_009 : 81|2@0+ (1,0) [0|3] ""  CADM
 SG_ MRR_FR_CAN_DET_AMPLITUDE_009 : 71|7@0+ (1,-64) [-64|63] "dBsm"  CADM
 SG_ MRR_FR_CAN_DET_VALID_LEVEL_009 : 64|1@0+ (1,0) [0|1] ""  CADM

BO_ 1026 MRR_FR_Detection_015_021: 64 MRRFR
 SG_ MRR_FR_CAN_DET_MID_TARGET_021 : 462|1@0+ (1,0) [0|1] ""  CADM
 SG_ MRR_FR_CAN_DET_MID_TARGET_020 : 461|1@0+ (1,0) [0|1] ""  CADM
 SG_ MRR_FR_CAN_DET_MID_TARGET_019 : 460|1@0+ (1,0) [0|1] ""  CADM
 SG_ MRR_FR_CAN_DET_MID_TARGET_018 : 459|1@0+ (1,0) [0|1] ""  CADM
 SG_ MRR_FR_CAN_DET_MID_TARGET_017 : 458|1@0+ (1,0) [0|1] ""  CADM
 SG_ MRR_FR_CAN_DET_MID_TARGET_016 : 457|1@0+ (1,0) [0|1] ""  CADM
 SG_ MRR_FR_CAN_DET_MID_TARGET_015 : 456|1@0+ (1,0) [0|1] ""  CADM
 SG_ MRR_FR_CAN_DET_Near_TARGET_015 : 448|1@0+ (1,0) [0|1] ""  CADM
 SG_ MRR_FR_CAN_DET_Near_TARGET_016 : 449|1@0+ (1,0) [0|1] ""  CADM
 SG_ MRR_FR_CAN_DET_Near_TARGET_017 : 450|1@0+ (1,0) [0|1] ""  CADM
 SG_ MRR_FR_CAN_DET_Near_TARGET_018 : 451|1@0+ (1,0) [0|1] ""  CADM
 SG_ MRR_FR_CAN_DET_Near_TARGET_019 : 452|1@0+ (1,0) [0|1] ""  CADM
 SG_ MRR_FR_CAN_DET_Near_TARGET_020 : 453|1@0+ (1,0) [0|1] ""  CADM
 SG_ MRR_FR_CAN_DET_Near_TARGET_021 : 454|1@0+ (1,0) [0|1] ""  CADM
 SG_ MRR_FR_CAN_DET_ELEVATION_015 : 63|7@0+ (0.002748,-0.1745) [-0.1745|0.174496] "rad"  CADM
 SG_ MRR_FR_CAN_DET_CONFID_AZIMU_0012 : 33|2@0+ (1,0) [0|3] ""  CADM
 SG_ MRR_FR_CAN_DET_SUPER_RES_TA_0013 : 56|1@0+ (1,0) [0|1] ""  CADM
 SG_ MRR_FR_CAN_DET_CONFID_ELEVA_0013 : 49|1@0+ (1,0) [0|1] ""  CADM
 SG_ MRR_FR_CAN_DET_HOST_VEH_CLU_0013 : 48|1@0+ (1,0) [0|1] ""  CADM
 SG_ MRR_FR_CAN_DET_VALID_LEVEL_015 : 0|1@0+ (1,0) [0|1] ""  CADM
 SG_ MRR_FR_CAN_DET_AZIMUTH_015 : 47|14@0+ (0.0003834,-3.1416) [-3.1416|3.1396422] "rad"  CADM
 SG_ MRR_FR_CAN_DET_RANGE_015 : 31|14@0+ (0.015625,0) [0|255.984375] "m"  CADM
 SG_ MRR_FR_CAN_DET_RANGE_RATE_015 : 15|14@0+ (0.015625,-128) [-128|127.984375] "m/s"  CADM
 SG_ MRR_FR_CAN_DET_AMPLITUDE_015 : 7|7@0+ (1,-64) [-64|63] "dBsm"  CADM
 SG_ MRR_FR_CAN_SCAN_INDEX_2LSB_015 : 17|2@0+ (1,0) [0|3] ""  CADM
 SG_ MRR_FR_DET_MC_003 : 491|4@0+ (1,0) [0|15] ""  CADM
 SG_ MRR_FR_DET_CRC_003 : 503|16@0+ (1,0) [0|65535] ""  CADM
 SG_ MRR_FR_CAN_DET_ELEVATION_021 : 447|7@0+ (0.002748,-0.1745) [-0.1745|0.174496] "rad"  CADM
 SG_ MRR_FR_CAN_DET_SUPER_RES_TA_0014 : 440|1@0+ (1,0) [0|1] ""  CADM
 SG_ MRR_FR_CAN_DET_AZIMUTH_021 : 431|14@0+ (0.0003834,-3.1416) [-3.1416|3.1396422] "rad"  CADM
 SG_ MRR_FR_CAN_DET_CONFID_ELEVA_0014 : 433|1@0+ (1,0) [0|1] ""  CADM
 SG_ MRR_FR_CAN_DET_HOST_VEH_CLU_0014 : 432|1@0+ (1,0) [0|1] ""  CADM
 SG_ MRR_FR_CAN_DET_RANGE_021 : 415|14@0+ (0.015625,0) [0|255.984375] "m"  CADM
 SG_ MRR_FR_CAN_DET_CONFID_AZIMUTH_02 : 417|2@0+ (1,0) [0|3] ""  CADM
 SG_ MRR_FR_CAN_DET_RANGE_RATE_021 : 399|14@0+ (0.015625,-128) [-128|127.984375] "m/s"  CADM
 SG_ MRR_FR_CAN_SCAN_INDEX_2LSB_021 : 401|2@0+ (1,0) [0|3] ""  CADM
 SG_ MRR_FR_CAN_DET_AMPLITUDE_021 : 391|7@0+ (1,-64) [-64|63] "dBsm"  CADM
 SG_ MRR_FR_CAN_DET_VALID_LEVEL_021 : 384|1@0+ (1,0) [0|1] ""  CADM
 SG_ MRR_FR_CAN_DET_ELEVATION_020 : 383|7@0+ (0.002748,-0.1745) [-0.1745|0.174496] "rad"  CADM
 SG_ MRR_FR_CAN_DET_SUPER_RES_TA_0015 : 376|1@0+ (1,0) [0|1] ""  CADM
 SG_ MRR_FR_CAN_DET_AZIMUTH_020 : 367|14@0+ (0.0003834,-3.1416) [-3.1416|3.1396422] "rad"  CADM
 SG_ MRR_FR_CAN_DET_CONFID_ELEVA_0015 : 369|1@0+ (1,0) [0|1] ""  CADM
 SG_ MRR_FR_CAN_DET_HOST_VEH_CLU_0015 : 368|1@0+ (1,0) [0|1] ""  CADM
 SG_ MRR_FR_CAN_DET_RANGE_020 : 351|14@0+ (0.015625,0) [0|255.984375] "m"  CADM
 SG_ MRR_FR_CAN_DET_CONFID_AZIMU_0013 : 353|2@0+ (1,0) [0|3] ""  CADM
 SG_ MRR_FR_CAN_DET_RANGE_RATE_020 : 335|14@0+ (0.015625,-128) [-128|127.984375] "m/s"  CADM
 SG_ MRR_FR_CAN_SCAN_INDEX_2LSB_020 : 337|2@0+ (1,0) [0|3] ""  CADM
 SG_ MRR_FR_CAN_DET_AMPLITUDE_020 : 327|7@0+ (1,-64) [-64|63] "dBsm"  CADM
 SG_ MRR_FR_CAN_DET_VALID_LEVEL_020 : 320|1@0+ (1,0) [0|1] ""  CADM
 SG_ MRR_FR_CAN_DET_ELEVATION_019 : 319|7@0+ (0.002748,-0.1745) [-0.1745|0.174496] "rad"  CADM
 SG_ MRR_FR_CAN_DET_SUPER_RES_TA_0016 : 312|1@0+ (1,0) [0|1] ""  CADM
 SG_ MRR_FR_CAN_DET_AZIMUTH_019 : 303|14@0+ (0.0003834,-3.1416) [-3.1416|3.1396422] "rad"  CADM
 SG_ MRR_FR_CAN_DET_CONFID_ELEVA_0016 : 305|1@0+ (1,0) [0|1] ""  CADM
 SG_ MRR_FR_CAN_DET_HOST_VEH_CLU_0016 : 304|1@0+ (1,0) [0|1] ""  CADM
 SG_ MRR_FR_CAN_DET_RANGE_019 : 287|14@0+ (0.015625,0) [0|255.984375] "m"  CADM
 SG_ MRR_FR_CAN_DET_CONFID_AZIMU_0014 : 289|2@0+ (1,0) [0|3] ""  CADM
 SG_ MRR_FR_CAN_DET_RANGE_RATE_019 : 271|14@0+ (0.015625,-128) [-128|127.984375] "m/s"  CADM
 SG_ MRR_FR_CAN_SCAN_INDEX_2LSB_019 : 273|2@0+ (1,0) [0|3] ""  CADM
 SG_ MRR_FR_CAN_DET_AMPLITUDE_019 : 263|7@0+ (1,-64) [-64|63] "dBsm"  CADM
 SG_ MRR_FR_CAN_DET_VALID_LEVEL_019 : 256|1@0+ (1,0) [0|1] ""  CADM
 SG_ MRR_FR_CAN_DET_ELEVATION_018 : 255|7@0+ (0.002748,-0.1745) [-0.1745|0.174496] "rad"  CADM
 SG_ MRR_FR_CAN_DET_SUPER_RES_TA_0017 : 248|1@0+ (1,0) [0|1] ""  CADM
 SG_ MRR_FR_CAN_DET_AZIMUTH_018 : 239|14@0+ (0.0003834,-3.1416) [-3.1416|3.1396422] "rad"  CADM
 SG_ MRR_FR_CAN_DET_CONFID_ELEVA_0017 : 241|1@0+ (1,0) [0|1] ""  CADM
 SG_ MRR_FR_CAN_DET_HOST_VEH_CLU_0017 : 240|1@0+ (1,0) [0|1] ""  CADM
 SG_ MRR_FR_CAN_DET_RANGE_018 : 223|14@0+ (0.015625,0) [0|255.984375] "m"  CADM
 SG_ MRR_FR_CAN_DET_CONFID_AZIMU_0015 : 225|2@0+ (1,0) [0|3] ""  CADM
 SG_ MRR_FR_CAN_DET_RANGE_RATE_018 : 207|14@0+ (0.015625,-128) [-128|127.984375] "m/s"  CADM
 SG_ MRR_FR_CAN_SCAN_INDEX_2LSB_018 : 209|2@0+ (1,0) [0|3] ""  CADM
 SG_ MRR_FR_CAN_DET_AMPLITUDE_018 : 199|7@0+ (1,-64) [-64|63] "dBsm"  CADM
 SG_ MRR_FR_CAN_DET_VALID_LEVEL_018 : 192|1@0+ (1,0) [0|1] ""  CADM
 SG_ MRR_FR_CAN_DET_ELEVATION_017 : 191|7@0+ (0.002748,-0.1745) [-0.1745|0.174496] "rad"  CADM
 SG_ MRR_FR_CAN_DET_SUPER_RES_TA_0018 : 184|1@0+ (1,0) [0|1] ""  CADM
 SG_ MRR_FR_CAN_DET_AZIMUTH_017 : 175|14@0+ (0.0003834,-3.1416) [-3.1416|3.1396422] "rad"  CADM
 SG_ MRR_FR_CAN_DET_CONFID_ELEVA_0018 : 177|1@0+ (1,0) [0|1] ""  CADM
 SG_ MRR_FR_CAN_DET_HOST_VEH_CLU_0018 : 176|1@0+ (1,0) [0|1] ""  CADM
 SG_ MRR_FR_CAN_DET_RANGE_017 : 159|14@0+ (0.015625,0) [0|255.984375] "m"  CADM
 SG_ MRR_FR_CAN_DET_CONFID_AZIMU_0016 : 161|2@0+ (1,0) [0|3] ""  CADM
 SG_ MRR_FR_CAN_DET_RANGE_RATE_017 : 143|14@0+ (0.015625,-128) [-128|127.984375] "m/s"  CADM
 SG_ MRR_FR_CAN_SCAN_INDEX_2LSB_017 : 145|2@0+ (1,0) [0|3] ""  CADM
 SG_ MRR_FR_CAN_DET_AMPLITUDE_017 : 135|7@0+ (1,-64) [-64|63] "dBsm"  CADM
 SG_ MRR_FR_CAN_DET_VALID_LEVEL_017 : 128|1@0+ (1,0) [0|1] ""  CADM
 SG_ MRR_FR_CAN_DET_ELEVATION_016 : 127|7@0+ (0.002748,-0.1745) [-0.1745|0.174496] "rad"  CADM
 SG_ MRR_FR_CAN_DET_SUPER_RES_TA_0019 : 120|1@0+ (1,0) [0|1] ""  CADM
 SG_ MRR_FR_CAN_DET_AZIMUTH_016 : 111|14@0+ (0.0003834,-3.1416) [-3.1416|3.1396422] "rad"  CADM
 SG_ MRR_FR_CAN_DET_CONFID_ELEVA_0019 : 113|1@0+ (1,0) [0|1] ""  CADM
 SG_ MRR_FR_CAN_DET_HOST_VEH_CLU_0019 : 112|1@0+ (1,0) [0|1] ""  CADM
 SG_ MRR_FR_CAN_DET_RANGE_016 : 95|14@0+ (0.015625,0) [0|255.984375] "m"  CADM
 SG_ MRR_FR_CAN_DET_CONFID_AZIMU_0017 : 97|2@0+ (1,0) [0|3] ""  CADM
 SG_ MRR_FR_CAN_DET_RANGE_RATE_016 : 79|14@0+ (0.015625,-128) [-128|127.984375] "m/s"  CADM
 SG_ MRR_FR_CAN_SCAN_INDEX_2LSB_016 : 81|2@0+ (1,0) [0|3] ""  CADM
 SG_ MRR_FR_CAN_DET_AMPLITUDE_016 : 71|7@0+ (1,-64) [-64|63] "dBsm"  CADM
 SG_ MRR_FR_CAN_DET_VALID_LEVEL_016 : 64|1@0+ (1,0) [0|1] ""  CADM

BO_ 1027 MRR_FR_Detection_022_028: 64 MRRFR
 SG_ MRR_FR_CAN_DET_MID_TARGET_028 : 462|1@0+ (1,0) [0|1] ""  CADM
 SG_ MRR_FR_CAN_DET_MID_TARGET_027 : 461|1@0+ (1,0) [0|1] ""  CADM
 SG_ MRR_FR_CAN_DET_MID_TARGET_026 : 460|1@0+ (1,0) [0|1] ""  CADM
 SG_ MRR_FR_CAN_DET_MID_TARGET_025 : 459|1@0+ (1,0) [0|1] ""  CADM
 SG_ MRR_FR_CAN_DET_MID_TARGET_024 : 458|1@0+ (1,0) [0|1] ""  CADM
 SG_ MRR_FR_CAN_DET_MID_TARGET_023 : 457|1@0+ (1,0) [0|1] ""  CADM
 SG_ MRR_FR_CAN_DET_MID_TARGET_022 : 456|1@0+ (1,0) [0|1] ""  CADM
 SG_ MRR_FR_CAN_DET_Near_TARGET_022 : 448|1@0+ (1,0) [0|1] ""  CADM
 SG_ MRR_FR_CAN_DET_Near_TARGET_023 : 449|1@0+ (1,0) [0|1] ""  CADM
 SG_ MRR_FR_CAN_DET_Near_TARGET_024 : 450|1@0+ (1,0) [0|1] ""  CADM
 SG_ MRR_FR_CAN_DET_Near_TARGET_025 : 451|1@0+ (1,0) [0|1] ""  CADM
 SG_ MRR_FR_CAN_DET_Near_TARGET_026 : 452|1@0+ (1,0) [0|1] ""  CADM
 SG_ MRR_FR_CAN_DET_Near_TARGET_027 : 453|1@0+ (1,0) [0|1] ""  CADM
 SG_ MRR_FR_CAN_DET_Near_TARGET_028 : 454|1@0+ (1,0) [0|1] ""  CADM
 SG_ MRR_FR_CAN_DET_ELEVATION_022 : 63|7@0+ (0.002748,-0.1745) [-0.1745|0.174496] "rad"  CADM
 SG_ MRR_FR_CAN_DET_CONFID_AZIMU_0018 : 33|2@0+ (1,0) [0|3] ""  CADM
 SG_ MRR_FR_CAN_DET_SUPER_RES_TA_0020 : 56|1@0+ (1,0) [0|1] ""  CADM
 SG_ MRR_FR_CAN_DET_CONFID_ELEVA_0020 : 49|1@0+ (1,0) [0|1] ""  CADM
 SG_ MRR_FR_CAN_DET_HOST_VEH_CLU_0020 : 48|1@0+ (1,0) [0|1] ""  CADM
 SG_ MRR_FR_CAN_DET_VALID_LEVEL_022 : 0|1@0+ (1,0) [0|1] ""  CADM
 SG_ MRR_FR_CAN_DET_AZIMUTH_022 : 47|14@0+ (0.0003834,-3.1416) [-3.1416|3.1396422] "rad"  CADM
 SG_ MRR_FR_CAN_DET_RANGE_022 : 31|14@0+ (0.015625,0) [0|255.984375] "m"  CADM
 SG_ MRR_FR_CAN_DET_RANGE_RATE_022 : 15|14@0+ (0.015625,-128) [-128|127.984375] "m/s"  CADM
 SG_ MRR_FR_CAN_DET_AMPLITUDE_022 : 7|7@0+ (1,-64) [-64|63] "dBsm"  CADM
 SG_ MRR_FR_CAN_SCAN_INDEX_2LSB_022 : 17|2@0+ (1,0) [0|3] ""  CADM
 SG_ MRR_FR_DET_MC_004 : 491|4@0+ (1,0) [0|15] ""  CADM
 SG_ MRR_FR_DET_CRC_004 : 503|16@0+ (1,0) [0|65535] ""  CADM
 SG_ MRR_FR_CAN_DET_ELEVATION_028 : 447|7@0+ (0.002748,-0.1745) [-0.1745|0.174496] "rad"  CADM
 SG_ MRR_FR_CAN_DET_SUPER_RES_TA_0021 : 440|1@0+ (1,0) [0|1] ""  CADM
 SG_ MRR_FR_CAN_DET_AZIMUTH_028 : 431|14@0+ (0.0003834,-3.1416) [-3.1416|3.1396422] "rad"  CADM
 SG_ MRR_FR_CAN_DET_CONFID_ELEVA_0021 : 433|1@0+ (1,0) [0|1] ""  CADM
 SG_ MRR_FR_CAN_DET_HOST_VEH_CLU_0021 : 432|1@0+ (1,0) [0|1] ""  CADM
 SG_ MRR_FR_CAN_DET_RANGE_028 : 415|14@0+ (0.015625,0) [0|255.984375] "m"  CADM
 SG_ MRR_FR_CAN_DET_CONFID_AZIMU_0019 : 417|2@0+ (1,0) [0|3] ""  CADM
 SG_ MRR_FR_CAN_DET_RANGE_RATE_028 : 399|14@0+ (0.015625,-128) [-128|127.984375] "m/s"  CADM
 SG_ MRR_FR_CAN_SCAN_INDEX_2LSB_028 : 401|2@0+ (1,0) [0|3] ""  CADM
 SG_ MRR_FR_CAN_DET_AMPLITUDE_028 : 391|7@0+ (1,-64) [-64|63] "dBsm"  CADM
 SG_ MRR_FR_CAN_DET_VALID_LEVEL_028 : 384|1@0+ (1,0) [0|1] ""  CADM
 SG_ MRR_FR_CAN_DET_ELEVATION_027 : 383|7@0+ (0.002748,-0.1745) [-0.1745|0.174496] "rad"  CADM
 SG_ MRR_FR_CAN_DET_SUPER_RES_TA_0022 : 376|1@0+ (1,0) [0|1] ""  CADM
 SG_ MRR_FR_CAN_DET_AZIMUTH_027 : 367|14@0+ (0.0003834,-3.1416) [-3.1416|3.1396422] "rad"  CADM
 SG_ MRR_FR_CAN_DET_CONFID_ELEVA_0022 : 369|1@0+ (1,0) [0|1] ""  CADM
 SG_ MRR_FR_CAN_DET_HOST_VEH_CLU_0022 : 368|1@0+ (1,0) [0|1] ""  CADM
 SG_ MRR_FR_CAN_DET_RANGE_027 : 351|14@0+ (0.015625,0) [0|255.984375] "m"  CADM
 SG_ MRR_FR_CAN_DET_CONFID_AZIMU_0020 : 353|2@0+ (1,0) [0|3] ""  CADM
 SG_ MRR_FR_CAN_DET_RANGE_RATE_027 : 335|14@0+ (0.015625,-128) [-128|127.984375] "m/s"  CADM
 SG_ MRR_FR_CAN_SCAN_INDEX_2LSB_027 : 337|2@0+ (1,0) [0|3] ""  CADM
 SG_ MRR_FR_CAN_DET_AMPLITUDE_027 : 327|7@0+ (1,-64) [-64|63] "dBsm"  CADM
 SG_ MRR_FR_CAN_DET_VALID_LEVEL_027 : 320|1@0+ (1,0) [0|1] ""  CADM
 SG_ MRR_FR_CAN_DET_ELEVATION_026 : 319|7@0+ (0.002748,-0.1745) [-0.1745|0.174496] "rad"  CADM
 SG_ MRR_FR_CAN_DET_SUPER_RES_TA_0023 : 312|1@0+ (1,0) [0|1] ""  CADM
 SG_ MRR_FR_CAN_DET_AZIMUTH_026 : 303|14@0+ (0.0003834,-3.1416) [-3.1416|3.1396422] "rad"  CADM
 SG_ MRR_FR_CAN_DET_CONFID_ELEVA_0023 : 305|1@0+ (1,0) [0|1] ""  CADM
 SG_ MRR_FR_CAN_DET_HOST_VEH_CLU_0023 : 304|1@0+ (1,0) [0|1] ""  CADM
 SG_ MRR_FR_CAN_DET_RANGE_026 : 287|14@0+ (0.015625,0) [0|255.984375] "m"  CADM
 SG_ MRR_FR_CAN_DET_CONFID_AZIMU_0021 : 289|2@0+ (1,0) [0|3] ""  CADM
 SG_ MRR_FR_CAN_DET_RANGE_RATE_026 : 271|14@0+ (0.015625,-128) [-128|127.984375] "m/s"  CADM
 SG_ MRR_FR_CAN_SCAN_INDEX_2LSB_026 : 273|2@0+ (1,0) [0|3] ""  CADM
 SG_ MRR_FR_CAN_DET_AMPLITUDE_026 : 263|7@0+ (1,-64) [-64|63] "dBsm"  CADM
 SG_ MRR_FR_CAN_DET_VALID_LEVEL_026 : 256|1@0+ (1,0) [0|1] ""  CADM
 SG_ MRR_FR_CAN_DET_ELEVATION_025 : 255|7@0+ (0.002748,-0.1745) [-0.1745|0.174496] "rad"  CADM
 SG_ MRR_FR_CAN_DET_SUPER_RES_TA_0024 : 248|1@0+ (1,0) [0|1] ""  CADM
 SG_ MRR_FR_CAN_DET_AZIMUTH_025 : 239|14@0+ (0.0003834,-3.1416) [-3.1416|3.1396422] "rad"  CADM
 SG_ MRR_FR_CAN_DET_CONFID_ELEVA_0024 : 241|1@0+ (1,0) [0|1] ""  CADM
 SG_ MRR_FR_CAN_DET_HOST_VEH_CLU_0024 : 240|1@0+ (1,0) [0|1] ""  CADM
 SG_ MRR_FR_CAN_DET_RANGE_025 : 223|14@0+ (0.015625,0) [0|255.984375] "m"  CADM
 SG_ MRR_FR_CAN_DET_CONFID_AZIMU_0022 : 225|2@0+ (1,0) [0|3] ""  CADM
 SG_ MRR_FR_CAN_DET_RANGE_RATE_025 : 207|14@0+ (0.015625,-128) [-128|127.984375] "m/s"  CADM
 SG_ MRR_FR_CAN_SCAN_INDEX_2LSB_025 : 209|2@0+ (1,0) [0|3] ""  CADM
 SG_ MRR_FR_CAN_DET_AMPLITUDE_025 : 199|7@0+ (1,-64) [-64|63] "dBsm"  CADM
 SG_ MRR_FR_CAN_DET_VALID_LEVEL_025 : 192|1@0+ (1,0) [0|1] ""  CADM
 SG_ MRR_FR_CAN_DET_ELEVATION_024 : 191|7@0+ (0.002748,-0.1745) [-0.1745|0.174496] "rad"  CADM
 SG_ MRR_FR_CAN_DET_SUPER_RES_TA_0025 : 184|1@0+ (1,0) [0|1] ""  CADM
 SG_ MRR_FR_CAN_DET_AZIMUTH_024 : 175|14@0+ (0.0003834,-3.1416) [-3.1416|3.1396422] "rad"  CADM
 SG_ MRR_FR_CAN_DET_CONFID_ELEVA_0025 : 177|1@0+ (1,0) [0|1] ""  CADM
 SG_ MRR_FR_CAN_DET_HOST_VEH_CLU_0025 : 176|1@0+ (1,0) [0|1] ""  CADM
 SG_ MRR_FR_CAN_DET_RANGE_024 : 159|14@0+ (0.015625,0) [0|255.984375] "m"  CADM
 SG_ MRR_FR_CAN_DET_CONFID_AZIMU_0023 : 161|2@0+ (1,0) [0|3] ""  CADM
 SG_ MRR_FR_CAN_DET_RANGE_RATE_024 : 143|14@0+ (0.015625,-128) [-128|127.984375] "m/s"  CADM
 SG_ MRR_FR_CAN_SCAN_INDEX_2LSB_024 : 145|2@0+ (1,0) [0|3] ""  CADM
 SG_ MRR_FR_CAN_DET_AMPLITUDE_024 : 135|7@0+ (1,-64) [-64|63] "dBsm"  CADM
 SG_ MRR_FR_CAN_DET_VALID_LEVEL_024 : 128|1@0+ (1,0) [0|1] ""  CADM
 SG_ MRR_FR_CAN_DET_ELEVATION_023 : 127|7@0+ (0.002748,-0.1745) [-0.1745|0.174496] "rad"  CADM
 SG_ MRR_FR_CAN_DET_SUPER_RES_TA_0026 : 120|1@0+ (1,0) [0|1] ""  CADM
 SG_ MRR_FR_CAN_DET_AZIMUTH_023 : 111|14@0+ (0.0003834,-3.1416) [-3.1416|3.1396422] "rad"  CADM
 SG_ MRR_FR_CAN_DET_CONFID_ELEVA_0026 : 113|1@0+ (1,0) [0|1] ""  CADM
 SG_ MRR_FR_CAN_DET_HOST_VEH_CLU_0026 : 112|1@0+ (1,0) [0|1] ""  CADM
 SG_ MRR_FR_CAN_DET_RANGE_023 : 95|14@0+ (0.015625,0) [0|255.984375] "m"  CADM
 SG_ MRR_FR_CAN_DET_CONFID_AZIMU_0024 : 97|2@0+ (1,0) [0|3] ""  CADM
 SG_ MRR_FR_CAN_DET_RANGE_RATE_023 : 79|14@0+ (0.015625,-128) [-128|127.984375] "m/s"  CADM
 SG_ MRR_FR_CAN_SCAN_INDEX_2LSB_023 : 81|2@0+ (1,0) [0|3] ""  CADM
 SG_ MRR_FR_CAN_DET_AMPLITUDE_023 : 71|7@0+ (1,-64) [-64|63] "dBsm"  CADM
 SG_ MRR_FR_CAN_DET_VALID_LEVEL_023 : 64|1@0+ (1,0) [0|1] ""  CADM

BA_DEF_ SG_  "NWM_WakeupAllowed" ENUM  "0 No","1 Yes";
BA_DEF_ BO_  "GenMsgTimeoutTime" INT 0 2500;
BA_DEF_ BO_  "WakeupMessage" ENUM  "0 No","1 Yes";
BA_DEF_ SG_  "SignalDescription" STRING ;
BA_DEF_ SG_  "GenSigTimeoutTime_ABS_ESC" INT 0 100000;
BA_DEF_ SG_  "UsedOnPgmDBC" ENUM  "No","Yes";
BA_DEF_ BO_  "VFrameFormat" ENUM  "StandardCAN","ExtendedCAN","reserved","reserved","reserved","reserved","reserved","reserved","reserved","reserved","reserved","reserved","reserved","reserved","StandardCAN_FD","ExtendedCAN_FD";
BA_DEF_ BO_  "DiagConnection" INT 0 65535;
BA_DEF_ BO_  "CanTpBs" INT 0 255;
BA_DEF_ BO_  "EventRateOfChange" INT 10 10000;
BA_DEF_ BO_  "DiagState" ENUM  "No","Yes";
BA_DEF_ BO_  "DiagRequest" ENUM  "No","Yes";
BA_DEF_ BO_  "DiagResponse" ENUM  "No","Yes";
BA_DEF_ SG_  "GenSigCycleTime" INT 0 0;
BA_DEF_ SG_  "GenSigVtName" STRING ;
BA_DEF_ SG_  "GenSigVtEn" STRING ;
BA_DEF_ SG_  "GenSigCmt" STRING ;
BA_DEF_ SG_  "GenSigSendType" ENUM  "Cyclic","OnWrite","vector_leerstring","OnChange","vector_leerstring","IfActive","vector_leerstring","NoSigSendType";
BA_DEF_ SG_  "GenSigInactiveValue" INT 0 100000;
BA_DEF_ SG_  "GenSigMissingSourceValue" INT 0 1000000000;
BA_DEF_ SG_  "GenSigStartValue" INT 0 1000000000;
BA_DEF_ BO_  "GenMsgILSupport" ENUM  "No","Yes";
BA_DEF_ BO_  "GenMsgSendType" ENUM  "FixedPeriodic","Event","EnabledPeriodic","NotUsed","NotUsed","EventPeriodic","NotUsed","NotUsed","NoMsgSendType";
BA_DEF_ BO_  "GenMsgCycleTime" INT 0 100000;
BA_DEF_ BO_  "GenMsgNrOfRepetition" INT 0 100;
BA_DEF_ SG_  "SystemSignalLongSymbol" STRING ;
BA_DEF_DEF_  "NWM_WakeupAllowed" "0 No";
BA_DEF_DEF_  "GenMsgTimeoutTime" 2500;
BA_DEF_DEF_  "WakeupMessage" "0 No";
BA_DEF_DEF_  "SignalDescription" "";
BA_DEF_DEF_  "GenSigTimeoutTime_ABS_ESC" 0;
BA_DEF_DEF_  "UsedOnPgmDBC" "Yes";
BA_DEF_DEF_  "VFrameFormat" "StandardCAN_FD";
BA_DEF_DEF_  "DiagConnection" 0;
BA_DEF_DEF_  "CanTpBs" 255;
BA_DEF_DEF_  "EventRateOfChange" 10000;
BA_DEF_DEF_  "DiagState" "No";
BA_DEF_DEF_  "DiagRequest" "No";
BA_DEF_DEF_  "DiagResponse" "No";
BA_DEF_DEF_  "GenSigCycleTime" 0;
BA_DEF_DEF_  "GenSigVtName" "";
BA_DEF_DEF_  "GenSigVtEn" "";
BA_DEF_DEF_  "GenSigCmt" "";
BA_DEF_DEF_  "GenSigSendType" "NoSigSendType";
BA_DEF_DEF_  "GenSigInactiveValue" 0;
BA_DEF_DEF_  "GenSigMissingSourceValue" 0;
BA_DEF_DEF_  "GenSigStartValue" 0;
BA_DEF_DEF_  "GenMsgILSupport" "Yes";
BA_DEF_DEF_  "GenMsgSendType" "NoMsgSendType";
BA_DEF_DEF_  "GenMsgCycleTime" 0;
BA_DEF_DEF_  "GenMsgNrOfRepetition" 0;
BA_DEF_DEF_  "SystemSignalLongSymbol" "";
BA_ "GenMsgTimeoutTime" BO_ 775 0;
BA_ "GenMsgSendType" BO_ 775 1;
BA_ "GenMsgTimeoutTime" BO_ 776 0;
BA_ "GenMsgSendType" BO_ 776 1;
BA_ "GenMsgTimeoutTime" BO_ 777 0;
BA_ "GenMsgSendType" BO_ 777 1;
BA_ "GenMsgTimeoutTime" BO_ 391 0;
BA_ "GenMsgSendType" BO_ 391 1;
BA_ "GenMsgTimeoutTime" BO_ 1024 0;
BA_ "GenMsgSendType" BO_ 1024 1;
BA_ "GenMsgTimeoutTime" BO_ 1025 0;
BA_ "GenMsgSendType" BO_ 1025 1;
BA_ "GenMsgTimeoutTime" BO_ 1026 0;
BA_ "GenMsgSendType" BO_ 1026 1;
BA_ "GenMsgTimeoutTime" BO_ 1027 0;
BA_ "GenMsgSendType" BO_ 1027 1;
BA_ "SignalDescription" SG_ 775 MRR_FL_CAN_DET_MID_TARGET_056 "MID_Target_Discrimination";
BA_ "GenSigSendType" SG_ 775 MRR_FL_CAN_DET_MID_TARGET_056 1;
BA_ "SignalDescription" SG_ 775 MRR_FL_CAN_DET_MID_TARGET_055 "MID_Target_Discrimination";
BA_ "SignalDescription" SG_ 775 MRR_FL_CAN_DET_MID_TARGET_054 "MID_Target_Discrimination";
BA_ "SignalDescription" SG_ 775 MRR_FL_CAN_DET_MID_TARGET_053 "MID_Target_Discrimination";
BA_ "SignalDescription" SG_ 775 MRR_FL_CAN_DET_MID_TARGET_052 "MID_Target_Discrimination";
BA_ "SignalDescription" SG_ 775 MRR_FL_CAN_DET_MID_TARGET_051 "MID_Target_Discrimination";
BA_ "SignalDescription" SG_ 775 MRR_FL_CAN_DET_MID_TARGET_050 "MID_Target_Discrimination";
BA_ "SignalDescription" SG_ 775 MRR_FL_CAN_DET_Near_TARGET_050 "Near_Target_Discrimination";
BA_ "SignalDescription" SG_ 775 MRR_FL_CAN_DET_Near_TARGET_051 "Near_Target_Discrimination";
BA_ "SignalDescription" SG_ 775 MRR_FL_CAN_DET_Near_TARGET_052 "Near_Target_Discrimination";
BA_ "SignalDescription" SG_ 775 MRR_FL_CAN_DET_Near_TARGET_053 "Near_Target_Discrimination";
BA_ "SignalDescription" SG_ 775 MRR_FL_CAN_DET_Near_TARGET_054 "Near_Target_Discrimination";
BA_ "SignalDescription" SG_ 775 MRR_FL_CAN_DET_Near_TARGET_055 "Near_Target_Discrimination";
BA_ "SignalDescription" SG_ 775 MRR_FL_CAN_DET_Near_TARGET_056 "Near_Target_Discrimination";
BA_ "GenSigCmt" SG_ 775 MRR_FL_CAN_DET_ELEVATION_050 "Detected object elevation position";
BA_ "GenSigStartValue" SG_ 775 MRR_FL_CAN_DET_ELEVATION_050 63.8646288209607;
BA_ "GenSigCmt" SG_ 775 MRR_FL_CAN_DET_CONFID_AZIMUTH_05 "Signal to noise level";
BA_ "GenSigVtEn" SG_ 775 MRR_FL_CAN_DET_CONFID_AZIMUTH_05 "TRUE";
BA_ "SystemSignalLongSymbol" SG_ 775 MRR_FL_CAN_DET_CONFID_AZIMUTH_05 "MRR_FL_CAN_DET_CONFID_AZIMUTH_050";
BA_ "GenSigCmt" SG_ 775 MRR_FL_CAN_DET_SUPER_RES_TA_0048 "Super resolution target";
BA_ "SystemSignalLongSymbol" SG_ 775 MRR_FL_CAN_DET_SUPER_RES_TA_0048 "MRR_FL_CAN_DET_SUPER_RES_TARGET_050";
BA_ "GenSigCmt" SG_ 775 MRR_FL_CAN_DET_CONFID_ELEVA_0048 "Elevation Angle Confidence";
BA_ "SystemSignalLongSymbol" SG_ 775 MRR_FL_CAN_DET_CONFID_ELEVA_0048 "MRR_FL_CAN_DET_CONFID_ELEVATION_050";
BA_ "GenSigCmt" SG_ 775 MRR_FL_CAN_DET_HOST_VEH_CLU_0048 "Host vehicle clutter";
BA_ "SystemSignalLongSymbol" SG_ 775 MRR_FL_CAN_DET_HOST_VEH_CLU_0048 "MRR_FL_CAN_DET_HOST_VEH_CLUTTER_050";
BA_ "GenSigCmt" SG_ 775 MRR_FL_CAN_DET_VALID_LEVEL_050 "Detected object valid level";
BA_ "GenSigCmt" SG_ 775 MRR_FL_CAN_DET_AZIMUTH_050 "Detected object azimuth position";
BA_ "GenSigStartValue" SG_ 775 MRR_FL_CAN_DET_AZIMUTH_050 8194.05320813772;
BA_ "GenSigCmt" SG_ 775 MRR_FL_CAN_DET_RANGE_050 "Detected object range";
BA_ "GenSigCmt" SG_ 775 MRR_FL_CAN_DET_RANGE_RATE_050 "Detected object range rate";
BA_ "GenSigStartValue" SG_ 775 MRR_FL_CAN_DET_RANGE_RATE_050 8192;
BA_ "GenSigCmt" SG_ 775 MRR_FL_CAN_DET_AMPLITUDE_050 "Detected object amplitude";
BA_ "GenSigStartValue" SG_ 775 MRR_FL_CAN_DET_AMPLITUDE_050 64;
BA_ "GenSigCmt" SG_ 775 MRR_FL_CAN_SCAN_INDEX_2LSB_050 "The two LSB of scan index";
BA_ "GenSigStartValue" SG_ 775 MRR_FL_CAN_DET_ELEVATION_056 63.8646288209607;
BA_ "GenSigCmt" SG_ 775 MRR_FL_CAN_DET_ELEVATION_056 "Detected object elevation position";
BA_ "GenSigCmt" SG_ 775 MRR_FL_CAN_DET_SUPER_RES_TA_0049 "Super resolution target";
BA_ "SystemSignalLongSymbol" SG_ 775 MRR_FL_CAN_DET_SUPER_RES_TA_0049 "MRR_FL_CAN_DET_SUPER_RES_TARGET_056";
BA_ "GenSigCmt" SG_ 775 MRR_FL_CAN_DET_AZIMUTH_056 "Detected object azimuth position";
BA_ "GenSigStartValue" SG_ 775 MRR_FL_CAN_DET_AZIMUTH_056 8194.05320813772;
BA_ "GenSigCmt" SG_ 775 MRR_FL_CAN_DET_CONFID_ELEVA_0049 "Elevation Angle Confidence";
BA_ "SystemSignalLongSymbol" SG_ 775 MRR_FL_CAN_DET_CONFID_ELEVA_0049 "MRR_FL_CAN_DET_CONFID_ELEVATION_056";
BA_ "GenSigCmt" SG_ 775 MRR_FL_CAN_DET_HOST_VEH_CLU_0049 "Host vehicle clutter";
BA_ "SystemSignalLongSymbol" SG_ 775 MRR_FL_CAN_DET_HOST_VEH_CLU_0049 "MRR_FL_CAN_DET_HOST_VEH_CLUTTER_056";
BA_ "GenSigCmt" SG_ 775 MRR_FL_CAN_DET_RANGE_056 "Detected object range";
BA_ "GenSigVtEn" SG_ 775 MRR_FL_CAN_DET_CONFID_AZIMU_0044 "TRUE";
BA_ "GenSigCmt" SG_ 775 MRR_FL_CAN_DET_CONFID_AZIMU_0044 "Signal to noise level";
BA_ "SystemSignalLongSymbol" SG_ 775 MRR_FL_CAN_DET_CONFID_AZIMU_0044 "MRR_FL_CAN_DET_CONFID_AZIMUTH_056";
BA_ "GenSigCmt" SG_ 775 MRR_FL_CAN_DET_RANGE_RATE_056 "Detected object range rate";
BA_ "GenSigStartValue" SG_ 775 MRR_FL_CAN_DET_RANGE_RATE_056 8192;
BA_ "GenSigCmt" SG_ 775 MRR_FL_CAN_SCAN_INDEX_2LSB_056 "The two LSB of scan index";
BA_ "GenSigCmt" SG_ 775 MRR_FL_CAN_DET_AMPLITUDE_056 "Detected object amplitude";
BA_ "GenSigStartValue" SG_ 775 MRR_FL_CAN_DET_AMPLITUDE_056 64;
BA_ "GenSigCmt" SG_ 775 MRR_FL_CAN_DET_VALID_LEVEL_056 "Detected object valid level";
BA_ "GenSigCmt" SG_ 775 MRR_FL_CAN_DET_ELEVATION_055 "Detected object elevation position";
BA_ "GenSigStartValue" SG_ 775 MRR_FL_CAN_DET_ELEVATION_055 63.8646288209607;
BA_ "GenSigCmt" SG_ 775 MRR_FL_CAN_DET_SUPER_RES_TA_0050 "Super resolution target";
BA_ "SystemSignalLongSymbol" SG_ 775 MRR_FL_CAN_DET_SUPER_RES_TA_0050 "MRR_FL_CAN_DET_SUPER_RES_TARGET_055";
BA_ "GenSigCmt" SG_ 775 MRR_FL_CAN_DET_AZIMUTH_055 "Detected object azimuth position";
BA_ "GenSigStartValue" SG_ 775 MRR_FL_CAN_DET_AZIMUTH_055 8194.05320813772;
BA_ "GenSigCmt" SG_ 775 MRR_FL_CAN_DET_CONFID_ELEVA_0050 "Elevation Angle Confidence";
BA_ "SystemSignalLongSymbol" SG_ 775 MRR_FL_CAN_DET_CONFID_ELEVA_0050 "MRR_FL_CAN_DET_CONFID_ELEVATION_055";
BA_ "GenSigCmt" SG_ 775 MRR_FL_CAN_DET_HOST_VEH_CLU_0050 "Host vehicle clutter";
BA_ "SystemSignalLongSymbol" SG_ 775 MRR_FL_CAN_DET_HOST_VEH_CLU_0050 "MRR_FL_CAN_DET_HOST_VEH_CLUTTER_055";
BA_ "GenSigCmt" SG_ 775 MRR_FL_CAN_DET_RANGE_055 "Detected object range";
BA_ "GenSigVtEn" SG_ 775 MRR_FL_CAN_DET_CONFID_AZIMU_0045 "TRUE";
BA_ "GenSigCmt" SG_ 775 MRR_FL_CAN_DET_CONFID_AZIMU_0045 "Signal to noise level";
BA_ "SystemSignalLongSymbol" SG_ 775 MRR_FL_CAN_DET_CONFID_AZIMU_0045 "MRR_FL_CAN_DET_CONFID_AZIMUTH_055";
BA_ "GenSigCmt" SG_ 775 MRR_FL_CAN_DET_RANGE_RATE_055 "Detected object range rate";
BA_ "GenSigStartValue" SG_ 775 MRR_FL_CAN_DET_RANGE_RATE_055 8192;
BA_ "GenSigCmt" SG_ 775 MRR_FL_CAN_SCAN_INDEX_2LSB_055 "The two LSB of scan index";
BA_ "GenSigCmt" SG_ 775 MRR_FL_CAN_DET_AMPLITUDE_055 "Detected object amplitude";
BA_ "GenSigStartValue" SG_ 775 MRR_FL_CAN_DET_AMPLITUDE_055 64;
BA_ "GenSigCmt" SG_ 775 MRR_FL_CAN_DET_VALID_LEVEL_055 "Detected object valid level";
BA_ "GenSigCmt" SG_ 775 MRR_FL_CAN_DET_ELEVATION_054 "Detected object elevation position";
BA_ "GenSigStartValue" SG_ 775 MRR_FL_CAN_DET_ELEVATION_054 63.8646288209607;
BA_ "GenSigCmt" SG_ 775 MRR_FL_CAN_DET_SUPER_RES_TA_0051 "Super resolution target";
BA_ "SystemSignalLongSymbol" SG_ 775 MRR_FL_CAN_DET_SUPER_RES_TA_0051 "MRR_FL_CAN_DET_SUPER_RES_TARGET_054";
BA_ "GenSigCmt" SG_ 775 MRR_FL_CAN_DET_AZIMUTH_054 "Detected object azimuth position";
BA_ "GenSigStartValue" SG_ 775 MRR_FL_CAN_DET_AZIMUTH_054 8194.05320813772;
BA_ "GenSigCmt" SG_ 775 MRR_FL_CAN_DET_CONFID_ELEVA_0051 "Elevation Angle Confidence";
BA_ "SystemSignalLongSymbol" SG_ 775 MRR_FL_CAN_DET_CONFID_ELEVA_0051 "MRR_FL_CAN_DET_CONFID_ELEVATION_054";
BA_ "GenSigCmt" SG_ 775 MRR_FL_CAN_DET_HOST_VEH_CLU_0051 "Host vehicle clutter";
BA_ "SystemSignalLongSymbol" SG_ 775 MRR_FL_CAN_DET_HOST_VEH_CLU_0051 "MRR_FL_CAN_DET_HOST_VEH_CLUTTER_054";
BA_ "GenSigCmt" SG_ 775 MRR_FL_CAN_DET_RANGE_054 "Detected object range";
BA_ "GenSigVtEn" SG_ 775 MRR_FL_CAN_DET_CONFID_AZIMU_0046 "TRUE";
BA_ "GenSigCmt" SG_ 775 MRR_FL_CAN_DET_CONFID_AZIMU_0046 "Signal to noise level";
BA_ "SystemSignalLongSymbol" SG_ 775 MRR_FL_CAN_DET_CONFID_AZIMU_0046 "MRR_FL_CAN_DET_CONFID_AZIMUTH_054";
BA_ "GenSigCmt" SG_ 775 MRR_FL_CAN_DET_RANGE_RATE_054 "Detected object range rate";
BA_ "GenSigStartValue" SG_ 775 MRR_FL_CAN_DET_RANGE_RATE_054 8192;
BA_ "GenSigCmt" SG_ 775 MRR_FL_CAN_SCAN_INDEX_2LSB_054 "The two LSB of scan index";
BA_ "GenSigCmt" SG_ 775 MRR_FL_CAN_DET_AMPLITUDE_054 "Detected object amplitude";
BA_ "GenSigStartValue" SG_ 775 MRR_FL_CAN_DET_AMPLITUDE_054 64;
BA_ "GenSigCmt" SG_ 775 MRR_FL_CAN_DET_VALID_LEVEL_054 "Detected object valid level";
BA_ "GenSigCmt" SG_ 775 MRR_FL_CAN_DET_ELEVATION_053 "Detected object elevation position";
BA_ "GenSigStartValue" SG_ 775 MRR_FL_CAN_DET_ELEVATION_053 63.8646288209607;
BA_ "GenSigCmt" SG_ 775 MRR_FL_CAN_DET_SUPER_RES_TA_0052 "Super resolution target";
BA_ "SystemSignalLongSymbol" SG_ 775 MRR_FL_CAN_DET_SUPER_RES_TA_0052 "MRR_FL_CAN_DET_SUPER_RES_TARGET_053";
BA_ "GenSigCmt" SG_ 775 MRR_FL_CAN_DET_AZIMUTH_053 "Detected object azimuth position";
BA_ "GenSigStartValue" SG_ 775 MRR_FL_CAN_DET_AZIMUTH_053 8194.05320813772;
BA_ "GenSigCmt" SG_ 775 MRR_FL_CAN_DET_CONFID_ELEVA_0052 "Elevation Angle Confidence";
BA_ "SystemSignalLongSymbol" SG_ 775 MRR_FL_CAN_DET_CONFID_ELEVA_0052 "MRR_FL_CAN_DET_CONFID_ELEVATION_053";
BA_ "GenSigCmt" SG_ 775 MRR_FL_CAN_DET_HOST_VEH_CLU_0052 "Host vehicle clutter";
BA_ "SystemSignalLongSymbol" SG_ 775 MRR_FL_CAN_DET_HOST_VEH_CLU_0052 "MRR_FL_CAN_DET_HOST_VEH_CLUTTER_053";
BA_ "GenSigCmt" SG_ 775 MRR_FL_CAN_DET_RANGE_053 "Detected object range";
BA_ "GenSigVtEn" SG_ 775 MRR_FL_CAN_DET_CONFID_AZIMU_0047 "TRUE";
BA_ "GenSigCmt" SG_ 775 MRR_FL_CAN_DET_CONFID_AZIMU_0047 "Signal to noise level";
BA_ "SystemSignalLongSymbol" SG_ 775 MRR_FL_CAN_DET_CONFID_AZIMU_0047 "MRR_FL_CAN_DET_CONFID_AZIMUTH_053";
BA_ "GenSigCmt" SG_ 775 MRR_FL_CAN_DET_RANGE_RATE_053 "Detected object range rate";
BA_ "GenSigStartValue" SG_ 775 MRR_FL_CAN_DET_RANGE_RATE_053 8192;
BA_ "GenSigCmt" SG_ 775 MRR_FL_CAN_SCAN_INDEX_2LSB_053 "The two LSB of scan index";
BA_ "GenSigCmt" SG_ 775 MRR_FL_CAN_DET_AMPLITUDE_053 "Detected object amplitude";
BA_ "GenSigStartValue" SG_ 775 MRR_FL_CAN_DET_AMPLITUDE_053 64;
BA_ "GenSigCmt" SG_ 775 MRR_FL_CAN_DET_VALID_LEVEL_053 "Detected object valid level";
BA_ "GenSigCmt" SG_ 775 MRR_FL_CAN_DET_ELEVATION_052 "Detected object elevation position";
BA_ "GenSigStartValue" SG_ 775 MRR_FL_CAN_DET_ELEVATION_052 63.8646288209607;
BA_ "GenSigCmt" SG_ 775 MRR_FL_CAN_DET_SUPER_RES_TA_0053 "Super resolution target";
BA_ "SystemSignalLongSymbol" SG_ 775 MRR_FL_CAN_DET_SUPER_RES_TA_0053 "MRR_FL_CAN_DET_SUPER_RES_TARGET_052";
BA_ "GenSigCmt" SG_ 775 MRR_FL_CAN_DET_AZIMUTH_052 "Detected object azimuth position";
BA_ "GenSigStartValue" SG_ 775 MRR_FL_CAN_DET_AZIMUTH_052 8194.05320813772;
BA_ "GenSigCmt" SG_ 775 MRR_FL_CAN_DET_CONFID_ELEVA_0053 "Elevation Angle Confidence";
BA_ "SystemSignalLongSymbol" SG_ 775 MRR_FL_CAN_DET_CONFID_ELEVA_0053 "MRR_FL_CAN_DET_CONFID_ELEVATION_052";
BA_ "GenSigCmt" SG_ 775 MRR_FL_CAN_DET_HOST_VEH_CLU_0053 "Host vehicle clutter";
BA_ "SystemSignalLongSymbol" SG_ 775 MRR_FL_CAN_DET_HOST_VEH_CLU_0053 "MRR_FL_CAN_DET_HOST_VEH_CLUTTER_052";
BA_ "GenSigCmt" SG_ 775 MRR_FL_CAN_DET_RANGE_052 "Detected object range";
BA_ "GenSigVtEn" SG_ 775 MRR_FL_CAN_DET_CONFID_AZIMU_0048 "TRUE";
BA_ "GenSigCmt" SG_ 775 MRR_FL_CAN_DET_CONFID_AZIMU_0048 "Signal to noise level";
BA_ "SystemSignalLongSymbol" SG_ 775 MRR_FL_CAN_DET_CONFID_AZIMU_0048 "MRR_FL_CAN_DET_CONFID_AZIMUTH_052";
BA_ "GenSigCmt" SG_ 775 MRR_FL_CAN_DET_RANGE_RATE_052 "Detected object range rate";
BA_ "GenSigStartValue" SG_ 775 MRR_FL_CAN_DET_RANGE_RATE_052 8192;
BA_ "GenSigCmt" SG_ 775 MRR_FL_CAN_SCAN_INDEX_2LSB_052 "The two LSB of scan index";
BA_ "GenSigCmt" SG_ 775 MRR_FL_CAN_DET_AMPLITUDE_052 "Detected object amplitude";
BA_ "GenSigStartValue" SG_ 775 MRR_FL_CAN_DET_AMPLITUDE_052 64;
BA_ "GenSigCmt" SG_ 775 MRR_FL_CAN_DET_VALID_LEVEL_052 "Detected object valid level";
BA_ "GenSigCmt" SG_ 775 MRR_FL_CAN_DET_ELEVATION_051 "Detected object elevation position";
BA_ "GenSigStartValue" SG_ 775 MRR_FL_CAN_DET_ELEVATION_051 63.8646288209607;
BA_ "GenSigCmt" SG_ 775 MRR_FL_CAN_DET_SUPER_RES_TA_0054 "Super resolution target";
BA_ "SystemSignalLongSymbol" SG_ 775 MRR_FL_CAN_DET_SUPER_RES_TA_0054 "MRR_FL_CAN_DET_SUPER_RES_TARGET_051";
BA_ "GenSigCmt" SG_ 775 MRR_FL_CAN_DET_AZIMUTH_051 "Detected object azimuth position";
BA_ "GenSigStartValue" SG_ 775 MRR_FL_CAN_DET_AZIMUTH_051 8194.05320813772;
BA_ "GenSigCmt" SG_ 775 MRR_FL_CAN_DET_CONFID_ELEVA_0054 "Elevation Angle Confidence";
BA_ "SystemSignalLongSymbol" SG_ 775 MRR_FL_CAN_DET_CONFID_ELEVA_0054 "MRR_FL_CAN_DET_CONFID_ELEVATION_051";
BA_ "GenSigCmt" SG_ 775 MRR_FL_CAN_DET_HOST_VEH_CLU_0054 "Host vehicle clutter";
BA_ "SystemSignalLongSymbol" SG_ 775 MRR_FL_CAN_DET_HOST_VEH_CLU_0054 "MRR_FL_CAN_DET_HOST_VEH_CLUTTER_051";
BA_ "GenSigCmt" SG_ 775 MRR_FL_CAN_DET_RANGE_051 "Detected object range";
BA_ "GenSigVtEn" SG_ 775 MRR_FL_CAN_DET_CONFID_AZIMU_0049 "TRUE";
BA_ "GenSigCmt" SG_ 775 MRR_FL_CAN_DET_CONFID_AZIMU_0049 "Signal to noise level";
BA_ "SystemSignalLongSymbol" SG_ 775 MRR_FL_CAN_DET_CONFID_AZIMU_0049 "MRR_FL_CAN_DET_CONFID_AZIMUTH_051";
BA_ "GenSigCmt" SG_ 775 MRR_FL_CAN_DET_RANGE_RATE_051 "Detected object range rate";
BA_ "GenSigStartValue" SG_ 775 MRR_FL_CAN_DET_RANGE_RATE_051 8192;
BA_ "GenSigCmt" SG_ 775 MRR_FL_CAN_SCAN_INDEX_2LSB_051 "The two LSB of scan index";
BA_ "GenSigCmt" SG_ 775 MRR_FL_CAN_DET_AMPLITUDE_051 "Detected object amplitude";
BA_ "GenSigStartValue" SG_ 775 MRR_FL_CAN_DET_AMPLITUDE_051 64;
BA_ "GenSigCmt" SG_ 775 MRR_FL_CAN_DET_VALID_LEVEL_051 "Detected object valid level";
BA_ "SignalDescription" SG_ 776 MRR_FL_CAN_DET_MID_TARGET_063 "MID_Target_Discrimination";
BA_ "GenSigSendType" SG_ 776 MRR_FL_CAN_DET_MID_TARGET_063 1;
BA_ "SignalDescription" SG_ 776 MRR_FL_CAN_DET_MID_TARGET_062 "MID_Target_Discrimination";
BA_ "SignalDescription" SG_ 776 MRR_FL_CAN_DET_MID_TARGET_061 "MID_Target_Discrimination";
BA_ "SignalDescription" SG_ 776 MRR_FL_CAN_DET_MID_TARGET_060 "MID_Target_Discrimination";
BA_ "SignalDescription" SG_ 776 MRR_FL_CAN_DET_MID_TARGET_059 "MID_Target_Discrimination";
BA_ "SignalDescription" SG_ 776 MRR_FL_CAN_DET_MID_TARGET_058 "MID_Target_Discrimination";
BA_ "SignalDescription" SG_ 776 MRR_FL_CAN_DET_MID_TARGET_057 "MID_Target_Discrimination";
BA_ "SignalDescription" SG_ 776 MRR_FL_CAN_DET_Near_TARGET_057 "Near_Target_Discrimination";
BA_ "SignalDescription" SG_ 776 MRR_FL_CAN_DET_Near_TARGET_058 "Near_Target_Discrimination";
BA_ "SignalDescription" SG_ 776 MRR_FL_CAN_DET_Near_TARGET_059 "Near_Target_Discrimination";
BA_ "SignalDescription" SG_ 776 MRR_FL_CAN_DET_Near_TARGET_060 "Near_Target_Discrimination";
BA_ "SignalDescription" SG_ 776 MRR_FL_CAN_DET_Near_TARGET_061 "Near_Target_Discrimination";
BA_ "SignalDescription" SG_ 776 MRR_FL_CAN_DET_Near_TARGET_062 "Near_Target_Discrimination";
BA_ "SignalDescription" SG_ 776 MRR_FL_CAN_DET_Near_TARGET_063 "Near_Target_Discrimination";
BA_ "GenSigCmt" SG_ 776 MRR_FL_CAN_DET_ELEVATION_057 "Detected object elevation position";
BA_ "GenSigStartValue" SG_ 776 MRR_FL_CAN_DET_ELEVATION_057 63.8646288209607;
BA_ "GenSigCmt" SG_ 776 MRR_FL_CAN_DET_CONFID_AZIMU_0050 "Signal to noise level";
BA_ "GenSigVtEn" SG_ 776 MRR_FL_CAN_DET_CONFID_AZIMU_0050 "TRUE";
BA_ "SystemSignalLongSymbol" SG_ 776 MRR_FL_CAN_DET_CONFID_AZIMU_0050 "MRR_FL_CAN_DET_CONFID_AZIMUTH_057";
BA_ "GenSigCmt" SG_ 776 MRR_FL_CAN_DET_SUPER_RES_TA_0055 "Super resolution target";
BA_ "SystemSignalLongSymbol" SG_ 776 MRR_FL_CAN_DET_SUPER_RES_TA_0055 "MRR_FL_CAN_DET_SUPER_RES_TARGET_057";
BA_ "GenSigCmt" SG_ 776 MRR_FL_CAN_DET_CONFID_ELEVA_0055 "Elevation Angle Confidence";
BA_ "SystemSignalLongSymbol" SG_ 776 MRR_FL_CAN_DET_CONFID_ELEVA_0055 "MRR_FL_CAN_DET_CONFID_ELEVATION_057";
BA_ "GenSigCmt" SG_ 776 MRR_FL_CAN_DET_HOST_VEH_CLU_0055 "Host vehicle clutter";
BA_ "SystemSignalLongSymbol" SG_ 776 MRR_FL_CAN_DET_HOST_VEH_CLU_0055 "MRR_FL_CAN_DET_HOST_VEH_CLUTTER_057";
BA_ "GenSigCmt" SG_ 776 MRR_FL_CAN_DET_VALID_LEVEL_057 "Detected object valid level";
BA_ "GenSigCmt" SG_ 776 MRR_FL_CAN_DET_AZIMUTH_057 "Detected object azimuth position";
BA_ "GenSigStartValue" SG_ 776 MRR_FL_CAN_DET_AZIMUTH_057 8194.05320813772;
BA_ "GenSigCmt" SG_ 776 MRR_FL_CAN_DET_RANGE_057 "Detected object range";
BA_ "GenSigCmt" SG_ 776 MRR_FL_CAN_DET_RANGE_RATE_057 "Detected object range rate";
BA_ "GenSigStartValue" SG_ 776 MRR_FL_CAN_DET_RANGE_RATE_057 8192;
BA_ "GenSigCmt" SG_ 776 MRR_FL_CAN_DET_AMPLITUDE_057 "Detected object amplitude";
BA_ "GenSigStartValue" SG_ 776 MRR_FL_CAN_DET_AMPLITUDE_057 64;
BA_ "GenSigCmt" SG_ 776 MRR_FL_CAN_SCAN_INDEX_2LSB_057 "The two LSB of scan index";
BA_ "GenSigStartValue" SG_ 776 MRR_FL_CAN_DET_ELEVATION_063 63.8646288209607;
BA_ "GenSigCmt" SG_ 776 MRR_FL_CAN_DET_ELEVATION_063 "Detected object elevation position";
BA_ "GenSigCmt" SG_ 776 MRR_FL_CAN_DET_SUPER_RES_TA_0056 "Super resolution target";
BA_ "SystemSignalLongSymbol" SG_ 776 MRR_FL_CAN_DET_SUPER_RES_TA_0056 "MRR_FL_CAN_DET_SUPER_RES_TARGET_063";
BA_ "GenSigCmt" SG_ 776 MRR_FL_CAN_DET_AZIMUTH_063 "Detected object azimuth position";
BA_ "GenSigStartValue" SG_ 776 MRR_FL_CAN_DET_AZIMUTH_063 8194.05320813772;
BA_ "GenSigCmt" SG_ 776 MRR_FL_CAN_DET_CONFID_ELEVA_0056 "Elevation Angle Confidence";
BA_ "SystemSignalLongSymbol" SG_ 776 MRR_FL_CAN_DET_CONFID_ELEVA_0056 "MRR_FL_CAN_DET_CONFID_ELEVATION_063";
BA_ "GenSigCmt" SG_ 776 MRR_FL_CAN_DET_HOST_VEH_CLU_0056 "Host vehicle clutter";
BA_ "SystemSignalLongSymbol" SG_ 776 MRR_FL_CAN_DET_HOST_VEH_CLU_0056 "MRR_FL_CAN_DET_HOST_VEH_CLUTTER_063";
BA_ "GenSigCmt" SG_ 776 MRR_FL_CAN_DET_RANGE_063 "Detected object range";
BA_ "GenSigVtEn" SG_ 776 MRR_FL_CAN_DET_CONFID_AZIMUTH_06 "TRUE";
BA_ "GenSigCmt" SG_ 776 MRR_FL_CAN_DET_CONFID_AZIMUTH_06 "Signal to noise level";
BA_ "SystemSignalLongSymbol" SG_ 776 MRR_FL_CAN_DET_CONFID_AZIMUTH_06 "MRR_FL_CAN_DET_CONFID_AZIMUTH_063";
BA_ "GenSigCmt" SG_ 776 MRR_FL_CAN_DET_RANGE_RATE_063 "Detected object range rate";
BA_ "GenSigStartValue" SG_ 776 MRR_FL_CAN_DET_RANGE_RATE_063 8192;
BA_ "GenSigCmt" SG_ 776 MRR_FL_CAN_SCAN_INDEX_2LSB_063 "The two LSB of scan index";
BA_ "GenSigCmt" SG_ 776 MRR_FL_CAN_DET_AMPLITUDE_063 "Detected object amplitude";
BA_ "GenSigStartValue" SG_ 776 MRR_FL_CAN_DET_AMPLITUDE_063 64;
BA_ "GenSigCmt" SG_ 776 MRR_FL_CAN_DET_VALID_LEVEL_063 "Detected object valid level";
BA_ "GenSigCmt" SG_ 776 MRR_FL_CAN_DET_ELEVATION_062 "Detected object elevation position";
BA_ "GenSigStartValue" SG_ 776 MRR_FL_CAN_DET_ELEVATION_062 63.8646288209607;
BA_ "GenSigCmt" SG_ 776 MRR_FL_CAN_DET_SUPER_RES_TA_0057 "Super resolution target";
BA_ "SystemSignalLongSymbol" SG_ 776 MRR_FL_CAN_DET_SUPER_RES_TA_0057 "MRR_FL_CAN_DET_SUPER_RES_TARGET_062";
BA_ "GenSigCmt" SG_ 776 MRR_FL_CAN_DET_AZIMUTH_062 "Detected object azimuth position";
BA_ "GenSigStartValue" SG_ 776 MRR_FL_CAN_DET_AZIMUTH_062 8194.05320813772;
BA_ "GenSigCmt" SG_ 776 MRR_FL_CAN_DET_CONFID_ELEVA_0057 "Elevation Angle Confidence";
BA_ "SystemSignalLongSymbol" SG_ 776 MRR_FL_CAN_DET_CONFID_ELEVA_0057 "MRR_FL_CAN_DET_CONFID_ELEVATION_062";
BA_ "GenSigCmt" SG_ 776 MRR_FL_CAN_DET_HOST_VEH_CLU_0057 "Host vehicle clutter";
BA_ "SystemSignalLongSymbol" SG_ 776 MRR_FL_CAN_DET_HOST_VEH_CLU_0057 "MRR_FL_CAN_DET_HOST_VEH_CLUTTER_062";
BA_ "GenSigCmt" SG_ 776 MRR_FL_CAN_DET_RANGE_062 "Detected object range";
BA_ "GenSigVtEn" SG_ 776 MRR_FL_CAN_DET_CONFID_AZIMU_0051 "TRUE";
BA_ "GenSigCmt" SG_ 776 MRR_FL_CAN_DET_CONFID_AZIMU_0051 "Signal to noise level";
BA_ "SystemSignalLongSymbol" SG_ 776 MRR_FL_CAN_DET_CONFID_AZIMU_0051 "MRR_FL_CAN_DET_CONFID_AZIMUTH_062";
BA_ "GenSigCmt" SG_ 776 MRR_FL_CAN_DET_RANGE_RATE_062 "Detected object range rate";
BA_ "GenSigStartValue" SG_ 776 MRR_FL_CAN_DET_RANGE_RATE_062 8192;
BA_ "GenSigCmt" SG_ 776 MRR_FL_CAN_SCAN_INDEX_2LSB_062 "The two LSB of scan index";
BA_ "GenSigCmt" SG_ 776 MRR_FL_CAN_DET_AMPLITUDE_062 "Detected object amplitude";
BA_ "GenSigStartValue" SG_ 776 MRR_FL_CAN_DET_AMPLITUDE_062 64;
BA_ "GenSigCmt" SG_ 776 MRR_FL_CAN_DET_VALID_LEVEL_062 "Detected object valid level";
BA_ "GenSigCmt" SG_ 776 MRR_FL_CAN_DET_ELEVATION_061 "Detected object elevation position";
BA_ "GenSigStartValue" SG_ 776 MRR_FL_CAN_DET_ELEVATION_061 63.8646288209607;
BA_ "GenSigCmt" SG_ 776 MRR_FL_CAN_DET_SUPER_RES_TA_0058 "Super resolution target";
BA_ "SystemSignalLongSymbol" SG_ 776 MRR_FL_CAN_DET_SUPER_RES_TA_0058 "MRR_FL_CAN_DET_SUPER_RES_TARGET_061";
BA_ "GenSigCmt" SG_ 776 MRR_FL_CAN_DET_AZIMUTH_061 "Detected object azimuth position";
BA_ "GenSigStartValue" SG_ 776 MRR_FL_CAN_DET_AZIMUTH_061 8194.05320813772;
BA_ "GenSigCmt" SG_ 776 MRR_FL_CAN_DET_CONFID_ELEVA_0058 "Elevation Angle Confidence";
BA_ "SystemSignalLongSymbol" SG_ 776 MRR_FL_CAN_DET_CONFID_ELEVA_0058 "MRR_FL_CAN_DET_CONFID_ELEVATION_061";
BA_ "GenSigCmt" SG_ 776 MRR_FL_CAN_DET_HOST_VEH_CLU_0058 "Host vehicle clutter";
BA_ "SystemSignalLongSymbol" SG_ 776 MRR_FL_CAN_DET_HOST_VEH_CLU_0058 "MRR_FL_CAN_DET_HOST_VEH_CLUTTER_061";
BA_ "GenSigCmt" SG_ 776 MRR_FL_CAN_DET_RANGE_061 "Detected object range";
BA_ "GenSigVtEn" SG_ 776 MRR_FL_CAN_DET_CONFID_AZIMU_0052 "TRUE";
BA_ "GenSigCmt" SG_ 776 MRR_FL_CAN_DET_CONFID_AZIMU_0052 "Signal to noise level";
BA_ "SystemSignalLongSymbol" SG_ 776 MRR_FL_CAN_DET_CONFID_AZIMU_0052 "MRR_FL_CAN_DET_CONFID_AZIMUTH_061";
BA_ "GenSigCmt" SG_ 776 MRR_FL_CAN_DET_RANGE_RATE_061 "Detected object range rate";
BA_ "GenSigStartValue" SG_ 776 MRR_FL_CAN_DET_RANGE_RATE_061 8192;
BA_ "GenSigCmt" SG_ 776 MRR_FL_CAN_SCAN_INDEX_2LSB_061 "The two LSB of scan index";
BA_ "GenSigCmt" SG_ 776 MRR_FL_CAN_DET_AMPLITUDE_061 "Detected object amplitude";
BA_ "GenSigStartValue" SG_ 776 MRR_FL_CAN_DET_AMPLITUDE_061 64;
BA_ "GenSigCmt" SG_ 776 MRR_FL_CAN_DET_VALID_LEVEL_061 "Detected object valid level";
BA_ "GenSigCmt" SG_ 776 MRR_FL_CAN_DET_ELEVATION_060 "Detected object elevation position";
BA_ "GenSigStartValue" SG_ 776 MRR_FL_CAN_DET_ELEVATION_060 63.8646288209607;
BA_ "GenSigCmt" SG_ 776 MRR_FL_CAN_DET_SUPER_RES_TA_0059 "Super resolution target";
BA_ "SystemSignalLongSymbol" SG_ 776 MRR_FL_CAN_DET_SUPER_RES_TA_0059 "MRR_FL_CAN_DET_SUPER_RES_TARGET_060";
BA_ "GenSigCmt" SG_ 776 MRR_FL_CAN_DET_AZIMUTH_060 "Detected object azimuth position";
BA_ "GenSigStartValue" SG_ 776 MRR_FL_CAN_DET_AZIMUTH_060 8194.05320813772;
BA_ "GenSigCmt" SG_ 776 MRR_FL_CAN_DET_CONFID_ELEVA_0059 "Elevation Angle Confidence";
BA_ "SystemSignalLongSymbol" SG_ 776 MRR_FL_CAN_DET_CONFID_ELEVA_0059 "MRR_FL_CAN_DET_CONFID_ELEVATION_060";
BA_ "GenSigCmt" SG_ 776 MRR_FL_CAN_DET_HOST_VEH_CLU_0059 "Host vehicle clutter";
BA_ "SystemSignalLongSymbol" SG_ 776 MRR_FL_CAN_DET_HOST_VEH_CLU_0059 "MRR_FL_CAN_DET_HOST_VEH_CLUTTER_060";
BA_ "GenSigCmt" SG_ 776 MRR_FL_CAN_DET_RANGE_060 "Detected object range";
BA_ "GenSigVtEn" SG_ 776 MRR_FL_CAN_DET_CONFID_AZIMU_0053 "TRUE";
BA_ "GenSigCmt" SG_ 776 MRR_FL_CAN_DET_CONFID_AZIMU_0053 "Signal to noise level";
BA_ "SystemSignalLongSymbol" SG_ 776 MRR_FL_CAN_DET_CONFID_AZIMU_0053 "MRR_FL_CAN_DET_CONFID_AZIMUTH_060";
BA_ "GenSigCmt" SG_ 776 MRR_FL_CAN_DET_RANGE_RATE_060 "Detected object range rate";
BA_ "GenSigStartValue" SG_ 776 MRR_FL_CAN_DET_RANGE_RATE_060 8192;
BA_ "GenSigCmt" SG_ 776 MRR_FL_CAN_SCAN_INDEX_2LSB_060 "The two LSB of scan index";
BA_ "GenSigCmt" SG_ 776 MRR_FL_CAN_DET_AMPLITUDE_060 "Detected object amplitude";
BA_ "GenSigStartValue" SG_ 776 MRR_FL_CAN_DET_AMPLITUDE_060 64;
BA_ "GenSigCmt" SG_ 776 MRR_FL_CAN_DET_VALID_LEVEL_060 "Detected object valid level";
BA_ "GenSigCmt" SG_ 776 MRR_FL_CAN_DET_ELEVATION_059 "Detected object elevation position";
BA_ "GenSigStartValue" SG_ 776 MRR_FL_CAN_DET_ELEVATION_059 63.8646288209607;
BA_ "GenSigCmt" SG_ 776 MRR_FL_CAN_DET_SUPER_RES_TA_0060 "Super resolution target";
BA_ "SystemSignalLongSymbol" SG_ 776 MRR_FL_CAN_DET_SUPER_RES_TA_0060 "MRR_FL_CAN_DET_SUPER_RES_TARGET_059";
BA_ "GenSigCmt" SG_ 776 MRR_FL_CAN_DET_AZIMUTH_059 "Detected object azimuth position";
BA_ "GenSigStartValue" SG_ 776 MRR_FL_CAN_DET_AZIMUTH_059 8194.05320813772;
BA_ "GenSigCmt" SG_ 776 MRR_FL_CAN_DET_CONFID_ELEVA_0060 "Elevation Angle Confidence";
BA_ "SystemSignalLongSymbol" SG_ 776 MRR_FL_CAN_DET_CONFID_ELEVA_0060 "MRR_FL_CAN_DET_CONFID_ELEVATION_059";
BA_ "GenSigCmt" SG_ 776 MRR_FL_CAN_DET_HOST_VEH_CLU_0060 "Host vehicle clutter";
BA_ "SystemSignalLongSymbol" SG_ 776 MRR_FL_CAN_DET_HOST_VEH_CLU_0060 "MRR_FL_CAN_DET_HOST_VEH_CLUTTER_059";
BA_ "GenSigCmt" SG_ 776 MRR_FL_CAN_DET_RANGE_059 "Detected object range";
BA_ "GenSigVtEn" SG_ 776 MRR_FL_CAN_DET_CONFID_AZIMU_0054 "TRUE";
BA_ "GenSigCmt" SG_ 776 MRR_FL_CAN_DET_CONFID_AZIMU_0054 "Signal to noise level";
BA_ "SystemSignalLongSymbol" SG_ 776 MRR_FL_CAN_DET_CONFID_AZIMU_0054 "MRR_FL_CAN_DET_CONFID_AZIMUTH_059";
BA_ "GenSigCmt" SG_ 776 MRR_FL_CAN_DET_RANGE_RATE_059 "Detected object range rate";
BA_ "GenSigStartValue" SG_ 776 MRR_FL_CAN_DET_RANGE_RATE_059 8192;
BA_ "GenSigCmt" SG_ 776 MRR_FL_CAN_SCAN_INDEX_2LSB_059 "The two LSB of scan index";
BA_ "GenSigCmt" SG_ 776 MRR_FL_CAN_DET_AMPLITUDE_059 "Detected object amplitude";
BA_ "GenSigStartValue" SG_ 776 MRR_FL_CAN_DET_AMPLITUDE_059 64;
BA_ "GenSigCmt" SG_ 776 MRR_FL_CAN_DET_VALID_LEVEL_059 "Detected object valid level";
BA_ "GenSigCmt" SG_ 776 MRR_FL_CAN_DET_ELEVATION_058 "Detected object elevation position";
BA_ "GenSigStartValue" SG_ 776 MRR_FL_CAN_DET_ELEVATION_058 63.8646288209607;
BA_ "GenSigCmt" SG_ 776 MRR_FL_CAN_DET_SUPER_RES_TA_0061 "Super resolution target";
BA_ "SystemSignalLongSymbol" SG_ 776 MRR_FL_CAN_DET_SUPER_RES_TA_0061 "MRR_FL_CAN_DET_SUPER_RES_TARGET_058";
BA_ "GenSigCmt" SG_ 776 MRR_FL_CAN_DET_AZIMUTH_058 "Detected object azimuth position";
BA_ "GenSigStartValue" SG_ 776 MRR_FL_CAN_DET_AZIMUTH_058 8194.05320813772;
BA_ "GenSigCmt" SG_ 776 MRR_FL_CAN_DET_CONFID_ELEVA_0061 "Elevation Angle Confidence";
BA_ "SystemSignalLongSymbol" SG_ 776 MRR_FL_CAN_DET_CONFID_ELEVA_0061 "MRR_FL_CAN_DET_CONFID_ELEVATION_058";
BA_ "GenSigCmt" SG_ 776 MRR_FL_CAN_DET_HOST_VEH_CLU_0061 "Host vehicle clutter";
BA_ "SystemSignalLongSymbol" SG_ 776 MRR_FL_CAN_DET_HOST_VEH_CLU_0061 "MRR_FL_CAN_DET_HOST_VEH_CLUTTER_058";
BA_ "GenSigCmt" SG_ 776 MRR_FL_CAN_DET_RANGE_058 "Detected object range";
BA_ "GenSigVtEn" SG_ 776 MRR_FL_CAN_DET_CONFID_AZIMU_0055 "TRUE";
BA_ "GenSigCmt" SG_ 776 MRR_FL_CAN_DET_CONFID_AZIMU_0055 "Signal to noise level";
BA_ "SystemSignalLongSymbol" SG_ 776 MRR_FL_CAN_DET_CONFID_AZIMU_0055 "MRR_FL_CAN_DET_CONFID_AZIMUTH_058";
BA_ "GenSigCmt" SG_ 776 MRR_FL_CAN_DET_RANGE_RATE_058 "Detected object range rate";
BA_ "GenSigStartValue" SG_ 776 MRR_FL_CAN_DET_RANGE_RATE_058 8192;
BA_ "GenSigCmt" SG_ 776 MRR_FL_CAN_SCAN_INDEX_2LSB_058 "The two LSB of scan index";
BA_ "GenSigCmt" SG_ 776 MRR_FL_CAN_DET_AMPLITUDE_058 "Detected object amplitude";
BA_ "GenSigStartValue" SG_ 776 MRR_FL_CAN_DET_AMPLITUDE_058 64;
BA_ "GenSigCmt" SG_ 776 MRR_FL_CAN_DET_VALID_LEVEL_058 "Detected object valid level";
BA_ "SignalDescription" SG_ 777 MRR_FL_CAN_DET_MID_TARGET_064 "MID_Target_Discrimination";
BA_ "GenSigSendType" SG_ 777 MRR_FL_CAN_DET_MID_TARGET_064 1;
BA_ "SignalDescription" SG_ 777 MRR_FL_CAN_DET_Near_TARGET_064 "Near_Target_Discrimination";
BA_ "GenSigStartValue" SG_ 777 MRR_FL_CAN_DET_ELEVATION_064 63.8646288209607;
BA_ "GenSigCmt" SG_ 777 MRR_FL_CAN_DET_ELEVATION_064 "Detected object elevation position";
BA_ "GenSigCmt" SG_ 777 MRR_FL_CAN_DET_CONFID_AZIMU_0056 "Signal to noise level";
BA_ "GenSigVtEn" SG_ 777 MRR_FL_CAN_DET_CONFID_AZIMU_0056 "TRUE";
BA_ "SystemSignalLongSymbol" SG_ 777 MRR_FL_CAN_DET_CONFID_AZIMU_0056 "MRR_FL_CAN_DET_CONFID_AZIMUTH_064";
BA_ "GenSigCmt" SG_ 777 MRR_FL_CAN_DET_SUPER_RES_TA_0062 "Super resolution target";
BA_ "SystemSignalLongSymbol" SG_ 777 MRR_FL_CAN_DET_SUPER_RES_TA_0062 "MRR_FL_CAN_DET_SUPER_RES_TARGET_064";
BA_ "GenSigCmt" SG_ 777 MRR_FL_CAN_DET_CONFID_ELEVA_0062 "Elevation Angle Confidence";
BA_ "SystemSignalLongSymbol" SG_ 777 MRR_FL_CAN_DET_CONFID_ELEVA_0062 "MRR_FL_CAN_DET_CONFID_ELEVATION_064";
BA_ "GenSigCmt" SG_ 777 MRR_FL_CAN_DET_HOST_VEH_CLU_0062 "Host vehicle clutter";
BA_ "SystemSignalLongSymbol" SG_ 777 MRR_FL_CAN_DET_HOST_VEH_CLU_0062 "MRR_FL_CAN_DET_HOST_VEH_CLUTTER_064";
BA_ "GenSigCmt" SG_ 777 MRR_FL_CAN_DET_VALID_LEVEL_064 "Detected object valid level";
BA_ "GenSigCmt" SG_ 777 MRR_FL_CAN_DET_AZIMUTH_064 "Detected object azimuth position";
BA_ "GenSigStartValue" SG_ 777 MRR_FL_CAN_DET_AZIMUTH_064 8194.05320813772;
BA_ "GenSigCmt" SG_ 777 MRR_FL_CAN_DET_RANGE_064 "Detected object range";
BA_ "GenSigCmt" SG_ 777 MRR_FL_CAN_DET_RANGE_RATE_064 "Detected object range rate";
BA_ "GenSigStartValue" SG_ 777 MRR_FL_CAN_DET_RANGE_RATE_064 8192;
BA_ "GenSigCmt" SG_ 777 MRR_FL_CAN_DET_AMPLITUDE_064 "Detected object amplitude";
BA_ "GenSigStartValue" SG_ 777 MRR_FL_CAN_DET_AMPLITUDE_064 64;
BA_ "GenSigCmt" SG_ 777 MRR_FL_CAN_SCAN_INDEX_2LSB_064 "The two LSB of scan index";
BA_ "GenSigSendType" SG_ 391 MRR_FL_Sensor_Position_Lock 1;
BA_ "SystemSignalLongSymbol" SG_ 391 MRR_FL_CAN_TX_SCAN_INDEX_TRACKER "MRR_FL_CAN_TX_SCAN_INDEX_TRACKER_OWN";
BA_ "SystemSignalLongSymbol" SG_ 391 MRR_FL_CAN_TX_SCN_INDEX_TRKER_FU "MRR_FL_CAN_TX_SCN_INDEX_TRKER_FUSED";
BA_ "SignalDescription" SG_ 1024 MRR_FR_CAN_DET_MID_TARGET_007 "MID_Target_Discrimination";
BA_ "GenSigSendType" SG_ 1024 MRR_FR_CAN_DET_MID_TARGET_007 1;
BA_ "SignalDescription" SG_ 1024 MRR_FR_CAN_DET_MID_TARGET_006 "MID_Target_Discrimination";
BA_ "SignalDescription" SG_ 1024 MRR_FR_CAN_DET_MID_TARGET_005 "MID_Target_Discrimination";
BA_ "SignalDescription" SG_ 1024 MRR_FR_CAN_DET_MID_TARGET_004 "MID_Target_Discrimination";
BA_ "SignalDescription" SG_ 1024 MRR_FR_CAN_DET_MID_TARGET_003 "MID_Target_Discrimination";
BA_ "SignalDescription" SG_ 1024 MRR_FR_CAN_DET_MID_TARGET_002 "MID_Target_Discrimination";
BA_ "SignalDescription" SG_ 1024 MRR_FR_CAN_DET_MID_TARGET_001 "MID_Target_Discrimination";
BA_ "SignalDescription" SG_ 1024 MRR_FR_CAN_DET_Near_TARGET_007 "Near_Target_Discrimination";
BA_ "SignalDescription" SG_ 1024 MRR_FR_CAN_DET_Near_TARGET_006 "Near_Target_Discrimination";
BA_ "SignalDescription" SG_ 1024 MRR_FR_CAN_DET_Near_TARGET_005 "Near_Target_Discrimination";
BA_ "SignalDescription" SG_ 1024 MRR_FR_CAN_DET_Near_TARGET_004 "Near_Target_Discrimination";
BA_ "SignalDescription" SG_ 1024 MRR_FR_CAN_DET_Near_TARGET_003 "Near_Target_Discrimination";
BA_ "SignalDescription" SG_ 1024 MRR_FR_CAN_DET_Near_TARGET_002 "Near_Target_Discrimination";
BA_ "SignalDescription" SG_ 1024 MRR_FR_CAN_DET_Near_TARGET_001 "Near_Target_Discrimination";
BA_ "GenSigStartValue" SG_ 1024 MRR_FR_CAN_DET_ELEVATION_007 63.8646288209607;
BA_ "GenSigCmt" SG_ 1024 MRR_FR_CAN_DET_ELEVATION_007 "Detected object elevation position";
BA_ "GenSigCmt" SG_ 1024 MRR_FR_CAN_DET_SUPER_RES_TARGET_ "Super resolution target";
BA_ "SystemSignalLongSymbol" SG_ 1024 MRR_FR_CAN_DET_SUPER_RES_TARGET_ "MRR_FR_CAN_DET_SUPER_RES_TARGET_007";
BA_ "GenSigCmt" SG_ 1024 MRR_FR_CAN_DET_AZIMUTH_007 "Detected object azimuth position";
BA_ "GenSigStartValue" SG_ 1024 MRR_FR_CAN_DET_AZIMUTH_007 8194.05320813772;
BA_ "GenSigCmt" SG_ 1024 MRR_FR_CAN_DET_CONFID_ELEVATION_ "Elevation Angle Confidence";
BA_ "SystemSignalLongSymbol" SG_ 1024 MRR_FR_CAN_DET_CONFID_ELEVATION_ "MRR_FR_CAN_DET_CONFID_ELEVATION_007";
BA_ "GenSigCmt" SG_ 1024 MRR_FR_CAN_DET_HOST_VEH_CLUTTER_ "Host vehicle clutter";
BA_ "SystemSignalLongSymbol" SG_ 1024 MRR_FR_CAN_DET_HOST_VEH_CLUTTER_ "MRR_FR_CAN_DET_HOST_VEH_CLUTTER_007";
BA_ "GenSigCmt" SG_ 1024 MRR_FR_CAN_DET_RANGE_007 "Detected object range";
BA_ "GenSigCmt" SG_ 1024 MRR_FR_CAN_DET_CONFID_AZIMUTH_00 "Signal to noise level";
BA_ "GenSigVtEn" SG_ 1024 MRR_FR_CAN_DET_CONFID_AZIMUTH_00 "TRUE";
BA_ "SystemSignalLongSymbol" SG_ 1024 MRR_FR_CAN_DET_CONFID_AZIMUTH_00 "MRR_FR_CAN_DET_CONFID_AZIMUTH_007";
BA_ "GenSigCmt" SG_ 1024 MRR_FR_CAN_DET_RANGE_RATE_007 "Detected object range rate";
BA_ "GenSigStartValue" SG_ 1024 MRR_FR_CAN_DET_RANGE_RATE_007 8192;
BA_ "GenSigCmt" SG_ 1024 MRR_FR_CAN_SCAN_INDEX_2LSB_007 "The two LSB of scan index";
BA_ "GenSigCmt" SG_ 1024 MRR_FR_CAN_DET_AMPLITUDE_007 "Detected object amplitude";
BA_ "GenSigStartValue" SG_ 1024 MRR_FR_CAN_DET_AMPLITUDE_007 64;
BA_ "GenSigCmt" SG_ 1024 MRR_FR_CAN_DET_VALID_LEVEL_007 "Detected object valid level";
BA_ "GenSigCmt" SG_ 1024 MRR_FR_CAN_DET_ELEVATION_006 "Detected object elevation position";
BA_ "GenSigStartValue" SG_ 1024 MRR_FR_CAN_DET_ELEVATION_006 63.8646288209607;
BA_ "GenSigCmt" SG_ 1024 MRR_FR_CAN_DET_SUPER_RES_TA_0000 "Super resolution target";
BA_ "SystemSignalLongSymbol" SG_ 1024 MRR_FR_CAN_DET_SUPER_RES_TA_0000 "MRR_FR_CAN_DET_SUPER_RES_TARGET_006";
BA_ "GenSigCmt" SG_ 1024 MRR_FR_CAN_DET_AZIMUTH_006 "Detected object azimuth position";
BA_ "GenSigStartValue" SG_ 1024 MRR_FR_CAN_DET_AZIMUTH_006 8194.05320813772;
BA_ "GenSigCmt" SG_ 1024 MRR_FR_CAN_DET_CONFID_ELEVA_0000 "Elevation Angle Confidence";
BA_ "SystemSignalLongSymbol" SG_ 1024 MRR_FR_CAN_DET_CONFID_ELEVA_0000 "MRR_FR_CAN_DET_CONFID_ELEVATION_006";
BA_ "GenSigCmt" SG_ 1024 MRR_FR_CAN_DET_HOST_VEH_CLU_0000 "Host vehicle clutter";
BA_ "SystemSignalLongSymbol" SG_ 1024 MRR_FR_CAN_DET_HOST_VEH_CLU_0000 "MRR_FR_CAN_DET_HOST_VEH_CLUTTER_006";
BA_ "GenSigCmt" SG_ 1024 MRR_FR_CAN_DET_RANGE_006 "Detected object range";
BA_ "GenSigCmt" SG_ 1024 MRR_FR_CAN_DET_CONFID_AZIMU_0000 "Signal to noise level";
BA_ "GenSigVtEn" SG_ 1024 MRR_FR_CAN_DET_CONFID_AZIMU_0000 "TRUE";
BA_ "SystemSignalLongSymbol" SG_ 1024 MRR_FR_CAN_DET_CONFID_AZIMU_0000 "MRR_FR_CAN_DET_CONFID_AZIMUTH_006";
BA_ "GenSigCmt" SG_ 1024 MRR_FR_CAN_DET_RANGE_RATE_006 "Detected object range rate";
BA_ "GenSigStartValue" SG_ 1024 MRR_FR_CAN_DET_RANGE_RATE_006 8192;
BA_ "GenSigCmt" SG_ 1024 MRR_FR_CAN_SCAN_INDEX_2LSB_006 "The two LSB of scan index";
BA_ "GenSigCmt" SG_ 1024 MRR_FR_CAN_DET_AMPLITUDE_006 "Detected object amplitude";
BA_ "GenSigStartValue" SG_ 1024 MRR_FR_CAN_DET_AMPLITUDE_006 64;
BA_ "GenSigCmt" SG_ 1024 MRR_FR_CAN_DET_VALID_LEVEL_006 "Detected object valid level";
BA_ "GenSigCmt" SG_ 1024 MRR_FR_CAN_DET_ELEVATION_005 "Detected object elevation position";
BA_ "GenSigStartValue" SG_ 1024 MRR_FR_CAN_DET_ELEVATION_005 63.8646288209607;
BA_ "GenSigCmt" SG_ 1024 MRR_FR_CAN_DET_SUPER_RES_TA_0001 "Super resolution target";
BA_ "SystemSignalLongSymbol" SG_ 1024 MRR_FR_CAN_DET_SUPER_RES_TA_0001 "MRR_FR_CAN_DET_SUPER_RES_TARGET_005";
BA_ "GenSigCmt" SG_ 1024 MRR_FR_CAN_DET_AZIMUTH_005 "Detected object azimuth position";
BA_ "GenSigStartValue" SG_ 1024 MRR_FR_CAN_DET_AZIMUTH_005 8194.05320813772;
BA_ "GenSigCmt" SG_ 1024 MRR_FR_CAN_DET_CONFID_ELEVA_0001 "Elevation Angle Confidence";
BA_ "SystemSignalLongSymbol" SG_ 1024 MRR_FR_CAN_DET_CONFID_ELEVA_0001 "MRR_FR_CAN_DET_CONFID_ELEVATION_005";
BA_ "GenSigCmt" SG_ 1024 MRR_FR_CAN_DET_HOST_VEH_CLU_0001 "Host vehicle clutter";
BA_ "SystemSignalLongSymbol" SG_ 1024 MRR_FR_CAN_DET_HOST_VEH_CLU_0001 "MRR_FR_CAN_DET_HOST_VEH_CLUTTER_005";
BA_ "GenSigCmt" SG_ 1024 MRR_FR_CAN_DET_RANGE_005 "Detected object range";
BA_ "GenSigCmt" SG_ 1024 MRR_FR_CAN_DET_CONFID_AZIMU_0001 "Signal to noise level";
BA_ "GenSigVtEn" SG_ 1024 MRR_FR_CAN_DET_CONFID_AZIMU_0001 "TRUE";
BA_ "SystemSignalLongSymbol" SG_ 1024 MRR_FR_CAN_DET_CONFID_AZIMU_0001 "MRR_FR_CAN_DET_CONFID_AZIMUTH_005";
BA_ "GenSigCmt" SG_ 1024 MRR_FR_CAN_DET_RANGE_RATE_005 "Detected object range rate";
BA_ "GenSigStartValue" SG_ 1024 MRR_FR_CAN_DET_RANGE_RATE_005 8192;
BA_ "GenSigCmt" SG_ 1024 MRR_FR_CAN_SCAN_INDEX_2LSB_005 "The two LSB of scan index";
BA_ "GenSigCmt" SG_ 1024 MRR_FR_CAN_DET_AMPLITUDE_005 "Detected object amplitude";
BA_ "GenSigStartValue" SG_ 1024 MRR_FR_CAN_DET_AMPLITUDE_005 64;
BA_ "GenSigCmt" SG_ 1024 MRR_FR_CAN_DET_VALID_LEVEL_005 "Detected object valid level";
BA_ "GenSigCmt" SG_ 1024 MRR_FR_CAN_DET_ELEVATION_004 "Detected object elevation position";
BA_ "GenSigStartValue" SG_ 1024 MRR_FR_CAN_DET_ELEVATION_004 63.8646288209607;
BA_ "GenSigCmt" SG_ 1024 MRR_FR_CAN_DET_SUPER_RES_TA_0002 "Super resolution target";
BA_ "SystemSignalLongSymbol" SG_ 1024 MRR_FR_CAN_DET_SUPER_RES_TA_0002 "MRR_FR_CAN_DET_SUPER_RES_TARGET_004";
BA_ "GenSigCmt" SG_ 1024 MRR_FR_CAN_DET_AZIMUTH_004 "Detected object azimuth position";
BA_ "GenSigStartValue" SG_ 1024 MRR_FR_CAN_DET_AZIMUTH_004 8194.05320813772;
BA_ "GenSigCmt" SG_ 1024 MRR_FR_CAN_DET_CONFID_ELEVA_0002 "Elevation Angle Confidence";
BA_ "SystemSignalLongSymbol" SG_ 1024 MRR_FR_CAN_DET_CONFID_ELEVA_0002 "MRR_FR_CAN_DET_CONFID_ELEVATION_004";
BA_ "GenSigCmt" SG_ 1024 MRR_FR_CAN_DET_HOST_VEH_CLU_0002 "Host vehicle clutter";
BA_ "SystemSignalLongSymbol" SG_ 1024 MRR_FR_CAN_DET_HOST_VEH_CLU_0002 "MRR_FR_CAN_DET_HOST_VEH_CLUTTER_004";
BA_ "GenSigCmt" SG_ 1024 MRR_FR_CAN_DET_RANGE_004 "Detected object range";
BA_ "GenSigCmt" SG_ 1024 MRR_FR_CAN_DET_CONFID_AZIMU_0002 "Signal to noise level";
BA_ "GenSigVtEn" SG_ 1024 MRR_FR_CAN_DET_CONFID_AZIMU_0002 "TRUE";
BA_ "SystemSignalLongSymbol" SG_ 1024 MRR_FR_CAN_DET_CONFID_AZIMU_0002 "MRR_FR_CAN_DET_CONFID_AZIMUTH_004";
BA_ "GenSigCmt" SG_ 1024 MRR_FR_CAN_DET_RANGE_RATE_004 "Detected object range rate";
BA_ "GenSigStartValue" SG_ 1024 MRR_FR_CAN_DET_RANGE_RATE_004 8192;
BA_ "GenSigCmt" SG_ 1024 MRR_FR_CAN_SCAN_INDEX_2LSB_004 "The two LSB of scan index";
BA_ "GenSigCmt" SG_ 1024 MRR_FR_CAN_DET_AMPLITUDE_004 "Detected object amplitude";
BA_ "GenSigStartValue" SG_ 1024 MRR_FR_CAN_DET_AMPLITUDE_004 64;
BA_ "GenSigCmt" SG_ 1024 MRR_FR_CAN_DET_VALID_LEVEL_004 "Detected object valid level";
BA_ "GenSigCmt" SG_ 1024 MRR_FR_CAN_DET_ELEVATION_003 "Detected object elevation position";
BA_ "GenSigStartValue" SG_ 1024 MRR_FR_CAN_DET_ELEVATION_003 63.8646288209607;
BA_ "GenSigCmt" SG_ 1024 MRR_FR_CAN_DET_SUPER_RES_TA_0003 "Super resolution target";
BA_ "SystemSignalLongSymbol" SG_ 1024 MRR_FR_CAN_DET_SUPER_RES_TA_0003 "MRR_FR_CAN_DET_SUPER_RES_TARGET_003";
BA_ "GenSigCmt" SG_ 1024 MRR_FR_CAN_DET_AZIMUTH_003 "Detected object azimuth position";
BA_ "GenSigStartValue" SG_ 1024 MRR_FR_CAN_DET_AZIMUTH_003 8194.05320813772;
BA_ "GenSigCmt" SG_ 1024 MRR_FR_CAN_DET_CONFID_ELEVA_0003 "Elevation Angle Confidence";
BA_ "SystemSignalLongSymbol" SG_ 1024 MRR_FR_CAN_DET_CONFID_ELEVA_0003 "MRR_FR_CAN_DET_CONFID_ELEVATION_003";
BA_ "GenSigCmt" SG_ 1024 MRR_FR_CAN_DET_HOST_VEH_CLU_0003 "Host vehicle clutter";
BA_ "SystemSignalLongSymbol" SG_ 1024 MRR_FR_CAN_DET_HOST_VEH_CLU_0003 "MRR_FR_CAN_DET_HOST_VEH_CLUTTER_003";
BA_ "GenSigCmt" SG_ 1024 MRR_FR_CAN_DET_RANGE_003 "Detected object range";
BA_ "GenSigCmt" SG_ 1024 MRR_FR_CAN_DET_CONFID_AZIMU_0003 "Signal to noise level";
BA_ "GenSigVtEn" SG_ 1024 MRR_FR_CAN_DET_CONFID_AZIMU_0003 "TRUE";
BA_ "SystemSignalLongSymbol" SG_ 1024 MRR_FR_CAN_DET_CONFID_AZIMU_0003 "MRR_FR_CAN_DET_CONFID_AZIMUTH_003";
BA_ "GenSigCmt" SG_ 1024 MRR_FR_CAN_DET_RANGE_RATE_003 "Detected object range rate";
BA_ "GenSigStartValue" SG_ 1024 MRR_FR_CAN_DET_RANGE_RATE_003 8192;
BA_ "GenSigCmt" SG_ 1024 MRR_FR_CAN_SCAN_INDEX_2LSB_003 "The two LSB of scan index";
BA_ "GenSigCmt" SG_ 1024 MRR_FR_CAN_DET_AMPLITUDE_003 "Detected object amplitude";
BA_ "GenSigStartValue" SG_ 1024 MRR_FR_CAN_DET_AMPLITUDE_003 64;
BA_ "GenSigCmt" SG_ 1024 MRR_FR_CAN_DET_VALID_LEVEL_003 "Detected object valid level";
BA_ "GenSigCmt" SG_ 1024 MRR_FR_CAN_DET_ELEVATION_002 "Detected object elevation position";
BA_ "GenSigStartValue" SG_ 1024 MRR_FR_CAN_DET_ELEVATION_002 63.8646288209607;
BA_ "GenSigCmt" SG_ 1024 MRR_FR_CAN_DET_SUPER_RES_TA_0004 "Super resolution target";
BA_ "SystemSignalLongSymbol" SG_ 1024 MRR_FR_CAN_DET_SUPER_RES_TA_0004 "MRR_FR_CAN_DET_SUPER_RES_TARGET_002";
BA_ "GenSigCmt" SG_ 1024 MRR_FR_CAN_DET_AZIMUTH_002 "Detected object azimuth position";
BA_ "GenSigStartValue" SG_ 1024 MRR_FR_CAN_DET_AZIMUTH_002 8194.05320813772;
BA_ "GenSigCmt" SG_ 1024 MRR_FR_CAN_DET_CONFID_ELEVA_0004 "Elevation Angle Confidence";
BA_ "SystemSignalLongSymbol" SG_ 1024 MRR_FR_CAN_DET_CONFID_ELEVA_0004 "MRR_FR_CAN_DET_CONFID_ELEVATION_002";
BA_ "GenSigCmt" SG_ 1024 MRR_FR_CAN_DET_HOST_VEH_CLU_0004 "Host vehicle clutter";
BA_ "SystemSignalLongSymbol" SG_ 1024 MRR_FR_CAN_DET_HOST_VEH_CLU_0004 "MRR_FR_CAN_DET_HOST_VEH_CLUTTER_002";
BA_ "GenSigCmt" SG_ 1024 MRR_FR_CAN_DET_RANGE_002 "Detected object range";
BA_ "GenSigCmt" SG_ 1024 MRR_FR_CAN_DET_CONFID_AZIMU_0004 "Signal to noise level";
BA_ "GenSigVtEn" SG_ 1024 MRR_FR_CAN_DET_CONFID_AZIMU_0004 "TRUE";
BA_ "SystemSignalLongSymbol" SG_ 1024 MRR_FR_CAN_DET_CONFID_AZIMU_0004 "MRR_FR_CAN_DET_CONFID_AZIMUTH_002";
BA_ "GenSigCmt" SG_ 1024 MRR_FR_CAN_DET_RANGE_RATE_002 "Detected object range rate";
BA_ "GenSigStartValue" SG_ 1024 MRR_FR_CAN_DET_RANGE_RATE_002 8192;
BA_ "GenSigCmt" SG_ 1024 MRR_FR_CAN_SCAN_INDEX_2LSB_002 "The two LSB of scan index";
BA_ "GenSigCmt" SG_ 1024 MRR_FR_CAN_DET_AMPLITUDE_002 "Detected object amplitude";
BA_ "GenSigStartValue" SG_ 1024 MRR_FR_CAN_DET_AMPLITUDE_002 64;
BA_ "GenSigCmt" SG_ 1024 MRR_FR_CAN_DET_VALID_LEVEL_002 "Detected object valid level";
BA_ "GenSigCmt" SG_ 1024 MRR_FR_CAN_DET_ELEVATION_001 "Detected object elevation position";
BA_ "GenSigStartValue" SG_ 1024 MRR_FR_CAN_DET_ELEVATION_001 63.8646288209607;
BA_ "GenSigCmt" SG_ 1024 MRR_FR_CAN_DET_CONFID_AZIMU_0005 "Signal to noise level";
BA_ "GenSigVtEn" SG_ 1024 MRR_FR_CAN_DET_CONFID_AZIMU_0005 "TRUE";
BA_ "SystemSignalLongSymbol" SG_ 1024 MRR_FR_CAN_DET_CONFID_AZIMU_0005 "MRR_FR_CAN_DET_CONFID_AZIMUTH_001";
BA_ "GenSigCmt" SG_ 1024 MRR_FR_CAN_DET_SUPER_RES_TA_0005 "Super resolution target";
BA_ "SystemSignalLongSymbol" SG_ 1024 MRR_FR_CAN_DET_SUPER_RES_TA_0005 "MRR_FR_CAN_DET_SUPER_RES_TARGET_001";
BA_ "GenSigCmt" SG_ 1024 MRR_FR_CAN_DET_CONFID_ELEVA_0005 "Elevation Angle Confidence";
BA_ "SystemSignalLongSymbol" SG_ 1024 MRR_FR_CAN_DET_CONFID_ELEVA_0005 "MRR_FR_CAN_DET_CONFID_ELEVATION_001";
BA_ "GenSigCmt" SG_ 1024 MRR_FR_CAN_DET_HOST_VEH_CLU_0005 "Host vehicle clutter";
BA_ "SystemSignalLongSymbol" SG_ 1024 MRR_FR_CAN_DET_HOST_VEH_CLU_0005 "MRR_FR_CAN_DET_HOST_VEH_CLUTTER_001";
BA_ "GenSigCmt" SG_ 1024 MRR_FR_CAN_DET_VALID_LEVEL_001 "Detected object valid level";
BA_ "GenSigCmt" SG_ 1024 MRR_FR_CAN_DET_AZIMUTH_001 "Detected object azimuth position";
BA_ "GenSigStartValue" SG_ 1024 MRR_FR_CAN_DET_AZIMUTH_001 8194.05320813772;
BA_ "GenSigCmt" SG_ 1024 MRR_FR_CAN_DET_RANGE_001 "Detected object range";
BA_ "GenSigCmt" SG_ 1024 MRR_FR_CAN_DET_RANGE_RATE_001 "Detected object range rate";
BA_ "GenSigStartValue" SG_ 1024 MRR_FR_CAN_DET_RANGE_RATE_001 8192;
BA_ "GenSigCmt" SG_ 1024 MRR_FR_CAN_DET_AMPLITUDE_001 "Detected object amplitude";
BA_ "GenSigStartValue" SG_ 1024 MRR_FR_CAN_DET_AMPLITUDE_001 64;
BA_ "GenSigCmt" SG_ 1024 MRR_FR_CAN_SCAN_INDEX_2LSB_001 "The two LSB of scan index";
BA_ "SignalDescription" SG_ 1025 MRR_FR_CAN_DET_MID_TARGET_014 "MID_Target_Discrimination";
BA_ "GenSigSendType" SG_ 1025 MRR_FR_CAN_DET_MID_TARGET_014 1;
BA_ "SignalDescription" SG_ 1025 MRR_FR_CAN_DET_MID_TARGET_013 "MID_Target_Discrimination";
BA_ "SignalDescription" SG_ 1025 MRR_FR_CAN_DET_MID_TARGET_012 "MID_Target_Discrimination";
BA_ "SignalDescription" SG_ 1025 MRR_FR_CAN_DET_MID_TARGET_011 "MID_Target_Discrimination";
BA_ "SignalDescription" SG_ 1025 MRR_FR_CAN_DET_MID_TARGET_010 "MID_Target_Discrimination";
BA_ "SignalDescription" SG_ 1025 MRR_FR_CAN_DET_MID_TARGET_009 "MID_Target_Discrimination";
BA_ "SignalDescription" SG_ 1025 MRR_FR_CAN_DET_MID_TARGET_008 "MID_Target_Discrimination";
BA_ "SignalDescription" SG_ 1025 MRR_FR_CAN_DET_Near_TARGET_008 "Near_Target_Discrimination";
BA_ "SignalDescription" SG_ 1025 MRR_FR_CAN_DET_Near_TARGET_009 "Near_Target_Discrimination";
BA_ "SignalDescription" SG_ 1025 MRR_FR_CAN_DET_Near_TARGET_010 "Near_Target_Discrimination";
BA_ "SignalDescription" SG_ 1025 MRR_FR_CAN_DET_Near_TARGET_011 "Near_Target_Discrimination";
BA_ "SignalDescription" SG_ 1025 MRR_FR_CAN_DET_Near_TARGET_012 "Near_Target_Discrimination";
BA_ "SignalDescription" SG_ 1025 MRR_FR_CAN_DET_Near_TARGET_013 "Near_Target_Discrimination";
BA_ "SignalDescription" SG_ 1025 MRR_FR_CAN_DET_Near_TARGET_014 "Near_Target_Discrimination";
BA_ "GenSigCmt" SG_ 1025 MRR_FR_CAN_DET_ELEVATION_008 "Detected object elevation position";
BA_ "GenSigStartValue" SG_ 1025 MRR_FR_CAN_DET_ELEVATION_008 63.8646288209607;
BA_ "GenSigCmt" SG_ 1025 MRR_FR_CAN_DET_CONFID_AZIMU_0006 "Signal to noise level";
BA_ "GenSigVtEn" SG_ 1025 MRR_FR_CAN_DET_CONFID_AZIMU_0006 "TRUE";
BA_ "SystemSignalLongSymbol" SG_ 1025 MRR_FR_CAN_DET_CONFID_AZIMU_0006 "MRR_FR_CAN_DET_CONFID_AZIMUTH_008";
BA_ "GenSigCmt" SG_ 1025 MRR_FR_CAN_DET_SUPER_RES_TA_0006 "Super resolution target";
BA_ "SystemSignalLongSymbol" SG_ 1025 MRR_FR_CAN_DET_SUPER_RES_TA_0006 "MRR_FR_CAN_DET_SUPER_RES_TARGET_008";
BA_ "GenSigCmt" SG_ 1025 MRR_FR_CAN_DET_CONFID_ELEVA_0006 "Elevation Angle Confidence";
BA_ "SystemSignalLongSymbol" SG_ 1025 MRR_FR_CAN_DET_CONFID_ELEVA_0006 "MRR_FR_CAN_DET_CONFID_ELEVATION_008";
BA_ "GenSigCmt" SG_ 1025 MRR_FR_CAN_DET_HOST_VEH_CLU_0006 "Host vehicle clutter";
BA_ "SystemSignalLongSymbol" SG_ 1025 MRR_FR_CAN_DET_HOST_VEH_CLU_0006 "MRR_FR_CAN_DET_HOST_VEH_CLUTTER_008";
BA_ "GenSigCmt" SG_ 1025 MRR_FR_CAN_DET_VALID_LEVEL_008 "Detected object valid level";
BA_ "GenSigCmt" SG_ 1025 MRR_FR_CAN_DET_AZIMUTH_008 "Detected object azimuth position";
BA_ "GenSigStartValue" SG_ 1025 MRR_FR_CAN_DET_AZIMUTH_008 8194.05320813772;
BA_ "GenSigCmt" SG_ 1025 MRR_FR_CAN_DET_RANGE_008 "Detected object range";
BA_ "GenSigCmt" SG_ 1025 MRR_FR_CAN_DET_RANGE_RATE_008 "Detected object range rate";
BA_ "GenSigStartValue" SG_ 1025 MRR_FR_CAN_DET_RANGE_RATE_008 8192;
BA_ "GenSigCmt" SG_ 1025 MRR_FR_CAN_DET_AMPLITUDE_008 "Detected object amplitude";
BA_ "GenSigStartValue" SG_ 1025 MRR_FR_CAN_DET_AMPLITUDE_008 64;
BA_ "GenSigCmt" SG_ 1025 MRR_FR_CAN_SCAN_INDEX_2LSB_008 "The two LSB of scan index";
BA_ "GenSigStartValue" SG_ 1025 MRR_FR_CAN_DET_ELEVATION_014 63.8646288209607;
BA_ "GenSigCmt" SG_ 1025 MRR_FR_CAN_DET_ELEVATION_014 "Detected object elevation position";
BA_ "GenSigCmt" SG_ 1025 MRR_FR_CAN_DET_SUPER_RES_TA_0007 "Super resolution target";
BA_ "SystemSignalLongSymbol" SG_ 1025 MRR_FR_CAN_DET_SUPER_RES_TA_0007 "MRR_FR_CAN_DET_SUPER_RES_TARGET_014";
BA_ "GenSigCmt" SG_ 1025 MRR_FR_CAN_DET_AZIMUTH_014 "Detected object azimuth position";
BA_ "GenSigStartValue" SG_ 1025 MRR_FR_CAN_DET_AZIMUTH_014 8194.05320813772;
BA_ "GenSigCmt" SG_ 1025 MRR_FR_CAN_DET_CONFID_ELEVA_0007 "Elevation Angle Confidence";
BA_ "SystemSignalLongSymbol" SG_ 1025 MRR_FR_CAN_DET_CONFID_ELEVA_0007 "MRR_FR_CAN_DET_CONFID_ELEVATION_014";
BA_ "GenSigCmt" SG_ 1025 MRR_FR_CAN_DET_HOST_VEH_CLU_0007 "Host vehicle clutter";
BA_ "SystemSignalLongSymbol" SG_ 1025 MRR_FR_CAN_DET_HOST_VEH_CLU_0007 "MRR_FR_CAN_DET_HOST_VEH_CLUTTER_014";
BA_ "GenSigCmt" SG_ 1025 MRR_FR_CAN_DET_RANGE_014 "Detected object range";
BA_ "GenSigCmt" SG_ 1025 MRR_FR_CAN_DET_CONFID_AZIMUTH_01 "Signal to noise level";
BA_ "GenSigVtEn" SG_ 1025 MRR_FR_CAN_DET_CONFID_AZIMUTH_01 "TRUE";
BA_ "SystemSignalLongSymbol" SG_ 1025 MRR_FR_CAN_DET_CONFID_AZIMUTH_01 "MRR_FR_CAN_DET_CONFID_AZIMUTH_014";
BA_ "GenSigCmt" SG_ 1025 MRR_FR_CAN_DET_RANGE_RATE_014 "Detected object range rate";
BA_ "GenSigStartValue" SG_ 1025 MRR_FR_CAN_DET_RANGE_RATE_014 8192;
BA_ "GenSigCmt" SG_ 1025 MRR_FR_CAN_SCAN_INDEX_2LSB_014 "The two LSB of scan index";
BA_ "GenSigCmt" SG_ 1025 MRR_FR_CAN_DET_AMPLITUDE_014 "Detected object amplitude";
BA_ "GenSigStartValue" SG_ 1025 MRR_FR_CAN_DET_AMPLITUDE_014 64;
BA_ "GenSigCmt" SG_ 1025 MRR_FR_CAN_DET_VALID_LEVEL_014 "Detected object valid level";
BA_ "GenSigCmt" SG_ 1025 MRR_FR_CAN_DET_ELEVATION_013 "Detected object elevation position";
BA_ "GenSigStartValue" SG_ 1025 MRR_FR_CAN_DET_ELEVATION_013 63.8646288209607;
BA_ "GenSigCmt" SG_ 1025 MRR_FR_CAN_DET_SUPER_RES_TA_0008 "Super resolution target";
BA_ "SystemSignalLongSymbol" SG_ 1025 MRR_FR_CAN_DET_SUPER_RES_TA_0008 "MRR_FR_CAN_DET_SUPER_RES_TARGET_013";
BA_ "GenSigCmt" SG_ 1025 MRR_FR_CAN_DET_AZIMUTH_013 "Detected object azimuth position";
BA_ "GenSigStartValue" SG_ 1025 MRR_FR_CAN_DET_AZIMUTH_013 8194.05320813772;
BA_ "GenSigCmt" SG_ 1025 MRR_FR_CAN_DET_CONFID_ELEVA_0008 "Elevation Angle Confidence";
BA_ "SystemSignalLongSymbol" SG_ 1025 MRR_FR_CAN_DET_CONFID_ELEVA_0008 "MRR_FR_CAN_DET_CONFID_ELEVATION_013";
BA_ "GenSigCmt" SG_ 1025 MRR_FR_CAN_DET_HOST_VEH_CLU_0008 "Host vehicle clutter";
BA_ "SystemSignalLongSymbol" SG_ 1025 MRR_FR_CAN_DET_HOST_VEH_CLU_0008 "MRR_FR_CAN_DET_HOST_VEH_CLUTTER_013";
BA_ "GenSigCmt" SG_ 1025 MRR_FR_CAN_DET_RANGE_013 "Detected object range";
BA_ "GenSigCmt" SG_ 1025 MRR_FR_CAN_DET_CONFID_AZIMU_0007 "Signal to noise level";
BA_ "GenSigVtEn" SG_ 1025 MRR_FR_CAN_DET_CONFID_AZIMU_0007 "TRUE";
BA_ "SystemSignalLongSymbol" SG_ 1025 MRR_FR_CAN_DET_CONFID_AZIMU_0007 "MRR_FR_CAN_DET_CONFID_AZIMUTH_013";
BA_ "GenSigCmt" SG_ 1025 MRR_FR_CAN_DET_RANGE_RATE_013 "Detected object range rate";
BA_ "GenSigStartValue" SG_ 1025 MRR_FR_CAN_DET_RANGE_RATE_013 8192;
BA_ "GenSigCmt" SG_ 1025 MRR_FR_CAN_SCAN_INDEX_2LSB_013 "The two LSB of scan index";
BA_ "GenSigCmt" SG_ 1025 MRR_FR_CAN_DET_AMPLITUDE_013 "Detected object amplitude";
BA_ "GenSigStartValue" SG_ 1025 MRR_FR_CAN_DET_AMPLITUDE_013 64;
BA_ "GenSigCmt" SG_ 1025 MRR_FR_CAN_DET_VALID_LEVEL_013 "Detected object valid level";
BA_ "GenSigCmt" SG_ 1025 MRR_FR_CAN_DET_ELEVATION_012 "Detected object elevation position";
BA_ "GenSigStartValue" SG_ 1025 MRR_FR_CAN_DET_ELEVATION_012 63.8646288209607;
BA_ "GenSigCmt" SG_ 1025 MRR_FR_CAN_DET_SUPER_RES_TA_0009 "Super resolution target";
BA_ "SystemSignalLongSymbol" SG_ 1025 MRR_FR_CAN_DET_SUPER_RES_TA_0009 "MRR_FR_CAN_DET_SUPER_RES_TARGET_012";
BA_ "GenSigCmt" SG_ 1025 MRR_FR_CAN_DET_AZIMUTH_012 "Detected object azimuth position";
BA_ "GenSigStartValue" SG_ 1025 MRR_FR_CAN_DET_AZIMUTH_012 8194.05320813772;
BA_ "GenSigCmt" SG_ 1025 MRR_FR_CAN_DET_CONFID_ELEVA_0009 "Elevation Angle Confidence";
BA_ "SystemSignalLongSymbol" SG_ 1025 MRR_FR_CAN_DET_CONFID_ELEVA_0009 "MRR_FR_CAN_DET_CONFID_ELEVATION_012";
BA_ "GenSigCmt" SG_ 1025 MRR_FR_CAN_DET_HOST_VEH_CLU_0009 "Host vehicle clutter";
BA_ "SystemSignalLongSymbol" SG_ 1025 MRR_FR_CAN_DET_HOST_VEH_CLU_0009 "MRR_FR_CAN_DET_HOST_VEH_CLUTTER_012";
BA_ "GenSigCmt" SG_ 1025 MRR_FR_CAN_DET_RANGE_012 "Detected object range";
BA_ "GenSigCmt" SG_ 1025 MRR_FR_CAN_DET_CONFID_AZIMU_0008 "Signal to noise level";
BA_ "GenSigVtEn" SG_ 1025 MRR_FR_CAN_DET_CONFID_AZIMU_0008 "TRUE";
BA_ "SystemSignalLongSymbol" SG_ 1025 MRR_FR_CAN_DET_CONFID_AZIMU_0008 "MRR_FR_CAN_DET_CONFID_AZIMUTH_012";
BA_ "GenSigCmt" SG_ 1025 MRR_FR_CAN_DET_RANGE_RATE_012 "Detected object range rate";
BA_ "GenSigStartValue" SG_ 1025 MRR_FR_CAN_DET_RANGE_RATE_012 8192;
BA_ "GenSigCmt" SG_ 1025 MRR_FR_CAN_SCAN_INDEX_2LSB_012 "The two LSB of scan index";
BA_ "GenSigCmt" SG_ 1025 MRR_FR_CAN_DET_AMPLITUDE_012 "Detected object amplitude";
BA_ "GenSigStartValue" SG_ 1025 MRR_FR_CAN_DET_AMPLITUDE_012 64;
BA_ "GenSigCmt" SG_ 1025 MRR_FR_CAN_DET_VALID_LEVEL_012 "Detected object valid level";
BA_ "GenSigCmt" SG_ 1025 MRR_FR_CAN_DET_ELEVATION_011 "Detected object elevation position";
BA_ "GenSigStartValue" SG_ 1025 MRR_FR_CAN_DET_ELEVATION_011 63.8646288209607;
BA_ "GenSigCmt" SG_ 1025 MRR_FR_CAN_DET_SUPER_RES_TA_0010 "Super resolution target";
BA_ "SystemSignalLongSymbol" SG_ 1025 MRR_FR_CAN_DET_SUPER_RES_TA_0010 "MRR_FR_CAN_DET_SUPER_RES_TARGET_011";
BA_ "GenSigCmt" SG_ 1025 MRR_FR_CAN_DET_AZIMUTH_011 "Detected object azimuth position";
BA_ "GenSigStartValue" SG_ 1025 MRR_FR_CAN_DET_AZIMUTH_011 8194.05320813772;
BA_ "GenSigCmt" SG_ 1025 MRR_FR_CAN_DET_CONFID_ELEVA_0010 "Elevation Angle Confidence";
BA_ "SystemSignalLongSymbol" SG_ 1025 MRR_FR_CAN_DET_CONFID_ELEVA_0010 "MRR_FR_CAN_DET_CONFID_ELEVATION_011";
BA_ "GenSigCmt" SG_ 1025 MRR_FR_CAN_DET_HOST_VEH_CLU_0010 "Host vehicle clutter";
BA_ "SystemSignalLongSymbol" SG_ 1025 MRR_FR_CAN_DET_HOST_VEH_CLU_0010 "MRR_FR_CAN_DET_HOST_VEH_CLUTTER_011";
BA_ "GenSigCmt" SG_ 1025 MRR_FR_CAN_DET_RANGE_011 "Detected object range";
BA_ "GenSigCmt" SG_ 1025 MRR_FR_CAN_DET_CONFID_AZIMU_0009 "Signal to noise level";
BA_ "GenSigVtEn" SG_ 1025 MRR_FR_CAN_DET_CONFID_AZIMU_0009 "TRUE";
BA_ "SystemSignalLongSymbol" SG_ 1025 MRR_FR_CAN_DET_CONFID_AZIMU_0009 "MRR_FR_CAN_DET_CONFID_AZIMUTH_011";
BA_ "GenSigCmt" SG_ 1025 MRR_FR_CAN_DET_RANGE_RATE_011 "Detected object range rate";
BA_ "GenSigStartValue" SG_ 1025 MRR_FR_CAN_DET_RANGE_RATE_011 8192;
BA_ "GenSigCmt" SG_ 1025 MRR_FR_CAN_SCAN_INDEX_2LSB_011 "The two LSB of scan index";
BA_ "GenSigCmt" SG_ 1025 MRR_FR_CAN_DET_AMPLITUDE_011 "Detected object amplitude";
BA_ "GenSigStartValue" SG_ 1025 MRR_FR_CAN_DET_AMPLITUDE_011 64;
BA_ "GenSigCmt" SG_ 1025 MRR_FR_CAN_DET_VALID_LEVEL_011 "Detected object valid level";
BA_ "GenSigCmt" SG_ 1025 MRR_FR_CAN_DET_ELEVATION_010 "Detected object elevation position";
BA_ "GenSigStartValue" SG_ 1025 MRR_FR_CAN_DET_ELEVATION_010 63.8646288209607;
BA_ "GenSigCmt" SG_ 1025 MRR_FR_CAN_DET_SUPER_RES_TA_0011 "Super resolution target";
BA_ "SystemSignalLongSymbol" SG_ 1025 MRR_FR_CAN_DET_SUPER_RES_TA_0011 "MRR_FR_CAN_DET_SUPER_RES_TARGET_010";
BA_ "GenSigCmt" SG_ 1025 MRR_FR_CAN_DET_AZIMUTH_010 "Detected object azimuth position";
BA_ "GenSigStartValue" SG_ 1025 MRR_FR_CAN_DET_AZIMUTH_010 8194.05320813772;
BA_ "GenSigCmt" SG_ 1025 MRR_FR_CAN_DET_CONFID_ELEVA_0011 "Elevation Angle Confidence";
BA_ "SystemSignalLongSymbol" SG_ 1025 MRR_FR_CAN_DET_CONFID_ELEVA_0011 "MRR_FR_CAN_DET_CONFID_ELEVATION_010";
BA_ "GenSigCmt" SG_ 1025 MRR_FR_CAN_DET_HOST_VEH_CLU_0011 "Host vehicle clutter";
BA_ "SystemSignalLongSymbol" SG_ 1025 MRR_FR_CAN_DET_HOST_VEH_CLU_0011 "MRR_FR_CAN_DET_HOST_VEH_CLUTTER_010";
BA_ "GenSigCmt" SG_ 1025 MRR_FR_CAN_DET_RANGE_010 "Detected object range";
BA_ "GenSigCmt" SG_ 1025 MRR_FR_CAN_DET_CONFID_AZIMU_0010 "Signal to noise level";
BA_ "GenSigVtEn" SG_ 1025 MRR_FR_CAN_DET_CONFID_AZIMU_0010 "TRUE";
BA_ "SystemSignalLongSymbol" SG_ 1025 MRR_FR_CAN_DET_CONFID_AZIMU_0010 "MRR_FR_CAN_DET_CONFID_AZIMUTH_010";
BA_ "GenSigCmt" SG_ 1025 MRR_FR_CAN_DET_RANGE_RATE_010 "Detected object range rate";
BA_ "GenSigStartValue" SG_ 1025 MRR_FR_CAN_DET_RANGE_RATE_010 8192;
BA_ "GenSigCmt" SG_ 1025 MRR_FR_CAN_SCAN_INDEX_2LSB_010 "The two LSB of scan index";
BA_ "GenSigCmt" SG_ 1025 MRR_FR_CAN_DET_AMPLITUDE_010 "Detected object amplitude";
BA_ "GenSigStartValue" SG_ 1025 MRR_FR_CAN_DET_AMPLITUDE_010 64;
BA_ "GenSigCmt" SG_ 1025 MRR_FR_CAN_DET_VALID_LEVEL_010 "Detected object valid level";
BA_ "GenSigCmt" SG_ 1025 MRR_FR_CAN_DET_ELEVATION_009 "Detected object elevation position";
BA_ "GenSigStartValue" SG_ 1025 MRR_FR_CAN_DET_ELEVATION_009 63.8646288209607;
BA_ "GenSigCmt" SG_ 1025 MRR_FR_CAN_DET_SUPER_RES_TA_0012 "Super resolution target";
BA_ "SystemSignalLongSymbol" SG_ 1025 MRR_FR_CAN_DET_SUPER_RES_TA_0012 "MRR_FR_CAN_DET_SUPER_RES_TARGET_009";
BA_ "GenSigCmt" SG_ 1025 MRR_FR_CAN_DET_AZIMUTH_009 "Detected object azimuth position";
BA_ "GenSigStartValue" SG_ 1025 MRR_FR_CAN_DET_AZIMUTH_009 8194.05320813772;
BA_ "GenSigCmt" SG_ 1025 MRR_FR_CAN_DET_CONFID_ELEVA_0012 "Elevation Angle Confidence";
BA_ "SystemSignalLongSymbol" SG_ 1025 MRR_FR_CAN_DET_CONFID_ELEVA_0012 "MRR_FR_CAN_DET_CONFID_ELEVATION_009";
BA_ "GenSigCmt" SG_ 1025 MRR_FR_CAN_DET_HOST_VEH_CLU_0012 "Host vehicle clutter";
BA_ "SystemSignalLongSymbol" SG_ 1025 MRR_FR_CAN_DET_HOST_VEH_CLU_0012 "MRR_FR_CAN_DET_HOST_VEH_CLUTTER_009";
BA_ "GenSigCmt" SG_ 1025 MRR_FR_CAN_DET_RANGE_009 "Detected object range";
BA_ "GenSigCmt" SG_ 1025 MRR_FR_CAN_DET_CONFID_AZIMU_0011 "Signal to noise level";
BA_ "GenSigVtEn" SG_ 1025 MRR_FR_CAN_DET_CONFID_AZIMU_0011 "TRUE";
BA_ "SystemSignalLongSymbol" SG_ 1025 MRR_FR_CAN_DET_CONFID_AZIMU_0011 "MRR_FR_CAN_DET_CONFID_AZIMUTH_009";
BA_ "GenSigCmt" SG_ 1025 MRR_FR_CAN_DET_RANGE_RATE_009 "Detected object range rate";
BA_ "GenSigStartValue" SG_ 1025 MRR_FR_CAN_DET_RANGE_RATE_009 8192;
BA_ "GenSigCmt" SG_ 1025 MRR_FR_CAN_SCAN_INDEX_2LSB_009 "The two LSB of scan index";
BA_ "GenSigCmt" SG_ 1025 MRR_FR_CAN_DET_AMPLITUDE_009 "Detected object amplitude";
BA_ "GenSigStartValue" SG_ 1025 MRR_FR_CAN_DET_AMPLITUDE_009 64;
BA_ "GenSigCmt" SG_ 1025 MRR_FR_CAN_DET_VALID_LEVEL_009 "Detected object valid level";
BA_ "SignalDescription" SG_ 1026 MRR_FR_CAN_DET_MID_TARGET_021 "MID_Target_Discrimination";
BA_ "GenSigSendType" SG_ 1026 MRR_FR_CAN_DET_MID_TARGET_021 1;
BA_ "SignalDescription" SG_ 1026 MRR_FR_CAN_DET_MID_TARGET_020 "MID_Target_Discrimination";
BA_ "SignalDescription" SG_ 1026 MRR_FR_CAN_DET_MID_TARGET_019 "MID_Target_Discrimination";
BA_ "SignalDescription" SG_ 1026 MRR_FR_CAN_DET_MID_TARGET_018 "MID_Target_Discrimination";
BA_ "SignalDescription" SG_ 1026 MRR_FR_CAN_DET_MID_TARGET_017 "MID_Target_Discrimination";
BA_ "SignalDescription" SG_ 1026 MRR_FR_CAN_DET_MID_TARGET_016 "MID_Target_Discrimination";
BA_ "SignalDescription" SG_ 1026 MRR_FR_CAN_DET_MID_TARGET_015 "MID_Target_Discrimination";
BA_ "SignalDescription" SG_ 1026 MRR_FR_CAN_DET_Near_TARGET_015 "Near_Target_Discrimination";
BA_ "SignalDescription" SG_ 1026 MRR_FR_CAN_DET_Near_TARGET_016 "Near_Target_Discrimination";
BA_ "SignalDescription" SG_ 1026 MRR_FR_CAN_DET_Near_TARGET_017 "Near_Target_Discrimination";
BA_ "SignalDescription" SG_ 1026 MRR_FR_CAN_DET_Near_TARGET_018 "Near_Target_Discrimination";
BA_ "SignalDescription" SG_ 1026 MRR_FR_CAN_DET_Near_TARGET_019 "Near_Target_Discrimination";
BA_ "SignalDescription" SG_ 1026 MRR_FR_CAN_DET_Near_TARGET_020 "Near_Target_Discrimination";
BA_ "SignalDescription" SG_ 1026 MRR_FR_CAN_DET_Near_TARGET_021 "Near_Target_Discrimination";
BA_ "GenSigCmt" SG_ 1026 MRR_FR_CAN_DET_ELEVATION_015 "Detected object elevation position";
BA_ "GenSigStartValue" SG_ 1026 MRR_FR_CAN_DET_ELEVATION_015 63.8646288209607;
BA_ "GenSigCmt" SG_ 1026 MRR_FR_CAN_DET_CONFID_AZIMU_0012 "Signal to noise level";
BA_ "GenSigVtEn" SG_ 1026 MRR_FR_CAN_DET_CONFID_AZIMU_0012 "TRUE";
BA_ "SystemSignalLongSymbol" SG_ 1026 MRR_FR_CAN_DET_CONFID_AZIMU_0012 "MRR_FR_CAN_DET_CONFID_AZIMUTH_015";
BA_ "GenSigCmt" SG_ 1026 MRR_FR_CAN_DET_SUPER_RES_TA_0013 "Super resolution target";
BA_ "SystemSignalLongSymbol" SG_ 1026 MRR_FR_CAN_DET_SUPER_RES_TA_0013 "MRR_FR_CAN_DET_SUPER_RES_TARGET_015";
BA_ "GenSigCmt" SG_ 1026 MRR_FR_CAN_DET_CONFID_ELEVA_0013 "Elevation Angle Confidence";
BA_ "SystemSignalLongSymbol" SG_ 1026 MRR_FR_CAN_DET_CONFID_ELEVA_0013 "MRR_FR_CAN_DET_CONFID_ELEVATION_015";
BA_ "GenSigCmt" SG_ 1026 MRR_FR_CAN_DET_HOST_VEH_CLU_0013 "Host vehicle clutter";
BA_ "SystemSignalLongSymbol" SG_ 1026 MRR_FR_CAN_DET_HOST_VEH_CLU_0013 "MRR_FR_CAN_DET_HOST_VEH_CLUTTER_015";
BA_ "GenSigCmt" SG_ 1026 MRR_FR_CAN_DET_VALID_LEVEL_015 "Detected object valid level";
BA_ "GenSigCmt" SG_ 1026 MRR_FR_CAN_DET_AZIMUTH_015 "Detected object azimuth position";
BA_ "GenSigStartValue" SG_ 1026 MRR_FR_CAN_DET_AZIMUTH_015 8194.05320813772;
BA_ "GenSigCmt" SG_ 1026 MRR_FR_CAN_DET_RANGE_015 "Detected object range";
BA_ "GenSigCmt" SG_ 1026 MRR_FR_CAN_DET_RANGE_RATE_015 "Detected object range rate";
BA_ "GenSigStartValue" SG_ 1026 MRR_FR_CAN_DET_RANGE_RATE_015 8192;
BA_ "GenSigCmt" SG_ 1026 MRR_FR_CAN_DET_AMPLITUDE_015 "Detected object amplitude";
BA_ "GenSigStartValue" SG_ 1026 MRR_FR_CAN_DET_AMPLITUDE_015 64;
BA_ "GenSigCmt" SG_ 1026 MRR_FR_CAN_SCAN_INDEX_2LSB_015 "The two LSB of scan index";
BA_ "GenSigStartValue" SG_ 1026 MRR_FR_CAN_DET_ELEVATION_021 63.8646288209607;
BA_ "GenSigCmt" SG_ 1026 MRR_FR_CAN_DET_ELEVATION_021 "Detected object elevation position";
BA_ "GenSigCmt" SG_ 1026 MRR_FR_CAN_DET_SUPER_RES_TA_0014 "Super resolution target";
BA_ "SystemSignalLongSymbol" SG_ 1026 MRR_FR_CAN_DET_SUPER_RES_TA_0014 "MRR_FR_CAN_DET_SUPER_RES_TARGET_021";
BA_ "GenSigCmt" SG_ 1026 MRR_FR_CAN_DET_AZIMUTH_021 "Detected object azimuth position";
BA_ "GenSigStartValue" SG_ 1026 MRR_FR_CAN_DET_AZIMUTH_021 8194.05320813772;
BA_ "GenSigCmt" SG_ 1026 MRR_FR_CAN_DET_CONFID_ELEVA_0014 "Elevation Angle Confidence";
BA_ "SystemSignalLongSymbol" SG_ 1026 MRR_FR_CAN_DET_CONFID_ELEVA_0014 "MRR_FR_CAN_DET_CONFID_ELEVATION_021";
BA_ "GenSigCmt" SG_ 1026 MRR_FR_CAN_DET_HOST_VEH_CLU_0014 "Host vehicle clutter";
BA_ "SystemSignalLongSymbol" SG_ 1026 MRR_FR_CAN_DET_HOST_VEH_CLU_0014 "MRR_FR_CAN_DET_HOST_VEH_CLUTTER_021";
BA_ "GenSigCmt" SG_ 1026 MRR_FR_CAN_DET_RANGE_021 "Detected object range";
BA_ "GenSigCmt" SG_ 1026 MRR_FR_CAN_DET_CONFID_AZIMUTH_02 "Signal to noise level";
BA_ "GenSigVtEn" SG_ 1026 MRR_FR_CAN_DET_CONFID_AZIMUTH_02 "TRUE";
BA_ "SystemSignalLongSymbol" SG_ 1026 MRR_FR_CAN_DET_CONFID_AZIMUTH_02 "MRR_FR_CAN_DET_CONFID_AZIMUTH_021";
BA_ "GenSigCmt" SG_ 1026 MRR_FR_CAN_DET_RANGE_RATE_021 "Detected object range rate";
BA_ "GenSigStartValue" SG_ 1026 MRR_FR_CAN_DET_RANGE_RATE_021 8192;
BA_ "GenSigCmt" SG_ 1026 MRR_FR_CAN_SCAN_INDEX_2LSB_021 "The two LSB of scan index";
BA_ "GenSigCmt" SG_ 1026 MRR_FR_CAN_DET_AMPLITUDE_021 "Detected object amplitude";
BA_ "GenSigStartValue" SG_ 1026 MRR_FR_CAN_DET_AMPLITUDE_021 64;
BA_ "GenSigCmt" SG_ 1026 MRR_FR_CAN_DET_VALID_LEVEL_021 "Detected object valid level";
BA_ "GenSigCmt" SG_ 1026 MRR_FR_CAN_DET_ELEVATION_020 "Detected object elevation position";
BA_ "GenSigStartValue" SG_ 1026 MRR_FR_CAN_DET_ELEVATION_020 63.8646288209607;
BA_ "GenSigCmt" SG_ 1026 MRR_FR_CAN_DET_SUPER_RES_TA_0015 "Super resolution target";
BA_ "SystemSignalLongSymbol" SG_ 1026 MRR_FR_CAN_DET_SUPER_RES_TA_0015 "MRR_FR_CAN_DET_SUPER_RES_TARGET_020";
BA_ "GenSigCmt" SG_ 1026 MRR_FR_CAN_DET_AZIMUTH_020 "Detected object azimuth position";
BA_ "GenSigStartValue" SG_ 1026 MRR_FR_CAN_DET_AZIMUTH_020 8194.05320813772;
BA_ "GenSigCmt" SG_ 1026 MRR_FR_CAN_DET_CONFID_ELEVA_0015 "Elevation Angle Confidence";
BA_ "SystemSignalLongSymbol" SG_ 1026 MRR_FR_CAN_DET_CONFID_ELEVA_0015 "MRR_FR_CAN_DET_CONFID_ELEVATION_020";
BA_ "GenSigCmt" SG_ 1026 MRR_FR_CAN_DET_HOST_VEH_CLU_0015 "Host vehicle clutter";
BA_ "SystemSignalLongSymbol" SG_ 1026 MRR_FR_CAN_DET_HOST_VEH_CLU_0015 "MRR_FR_CAN_DET_HOST_VEH_CLUTTER_020";
BA_ "GenSigCmt" SG_ 1026 MRR_FR_CAN_DET_RANGE_020 "Detected object range";
BA_ "GenSigCmt" SG_ 1026 MRR_FR_CAN_DET_CONFID_AZIMU_0013 "Signal to noise level";
BA_ "GenSigVtEn" SG_ 1026 MRR_FR_CAN_DET_CONFID_AZIMU_0013 "TRUE";
BA_ "SystemSignalLongSymbol" SG_ 1026 MRR_FR_CAN_DET_CONFID_AZIMU_0013 "MRR_FR_CAN_DET_CONFID_AZIMUTH_020";
BA_ "GenSigCmt" SG_ 1026 MRR_FR_CAN_DET_RANGE_RATE_020 "Detected object range rate";
BA_ "GenSigStartValue" SG_ 1026 MRR_FR_CAN_DET_RANGE_RATE_020 8192;
BA_ "GenSigCmt" SG_ 1026 MRR_FR_CAN_SCAN_INDEX_2LSB_020 "The two LSB of scan index";
BA_ "GenSigCmt" SG_ 1026 MRR_FR_CAN_DET_AMPLITUDE_020 "Detected object amplitude";
BA_ "GenSigStartValue" SG_ 1026 MRR_FR_CAN_DET_AMPLITUDE_020 64;
BA_ "GenSigCmt" SG_ 1026 MRR_FR_CAN_DET_VALID_LEVEL_020 "Detected object valid level";
BA_ "GenSigCmt" SG_ 1026 MRR_FR_CAN_DET_ELEVATION_019 "Detected object elevation position";
BA_ "GenSigStartValue" SG_ 1026 MRR_FR_CAN_DET_ELEVATION_019 63.8646288209607;
BA_ "GenSigCmt" SG_ 1026 MRR_FR_CAN_DET_SUPER_RES_TA_0016 "Super resolution target";
BA_ "SystemSignalLongSymbol" SG_ 1026 MRR_FR_CAN_DET_SUPER_RES_TA_0016 "MRR_FR_CAN_DET_SUPER_RES_TARGET_019";
BA_ "GenSigCmt" SG_ 1026 MRR_FR_CAN_DET_AZIMUTH_019 "Detected object azimuth position";
BA_ "GenSigStartValue" SG_ 1026 MRR_FR_CAN_DET_AZIMUTH_019 8194.05320813772;
BA_ "GenSigCmt" SG_ 1026 MRR_FR_CAN_DET_CONFID_ELEVA_0016 "Elevation Angle Confidence";
BA_ "SystemSignalLongSymbol" SG_ 1026 MRR_FR_CAN_DET_CONFID_ELEVA_0016 "MRR_FR_CAN_DET_CONFID_ELEVATION_019";
BA_ "GenSigCmt" SG_ 1026 MRR_FR_CAN_DET_HOST_VEH_CLU_0016 "Host vehicle clutter";
BA_ "SystemSignalLongSymbol" SG_ 1026 MRR_FR_CAN_DET_HOST_VEH_CLU_0016 "MRR_FR_CAN_DET_HOST_VEH_CLUTTER_019";
BA_ "GenSigCmt" SG_ 1026 MRR_FR_CAN_DET_RANGE_019 "Detected object range";
BA_ "GenSigCmt" SG_ 1026 MRR_FR_CAN_DET_CONFID_AZIMU_0014 "Signal to noise level";
BA_ "GenSigVtEn" SG_ 1026 MRR_FR_CAN_DET_CONFID_AZIMU_0014 "TRUE";
BA_ "SystemSignalLongSymbol" SG_ 1026 MRR_FR_CAN_DET_CONFID_AZIMU_0014 "MRR_FR_CAN_DET_CONFID_AZIMUTH_019";
BA_ "GenSigCmt" SG_ 1026 MRR_FR_CAN_DET_RANGE_RATE_019 "Detected object range rate";
BA_ "GenSigStartValue" SG_ 1026 MRR_FR_CAN_DET_RANGE_RATE_019 8192;
BA_ "GenSigCmt" SG_ 1026 MRR_FR_CAN_SCAN_INDEX_2LSB_019 "The two LSB of scan index";
BA_ "GenSigCmt" SG_ 1026 MRR_FR_CAN_DET_AMPLITUDE_019 "Detected object amplitude";
BA_ "GenSigStartValue" SG_ 1026 MRR_FR_CAN_DET_AMPLITUDE_019 64;
BA_ "GenSigCmt" SG_ 1026 MRR_FR_CAN_DET_VALID_LEVEL_019 "Detected object valid level";
BA_ "GenSigCmt" SG_ 1026 MRR_FR_CAN_DET_ELEVATION_018 "Detected object elevation position";
BA_ "GenSigStartValue" SG_ 1026 MRR_FR_CAN_DET_ELEVATION_018 63.8646288209607;
BA_ "GenSigCmt" SG_ 1026 MRR_FR_CAN_DET_SUPER_RES_TA_0017 "Super resolution target";
BA_ "SystemSignalLongSymbol" SG_ 1026 MRR_FR_CAN_DET_SUPER_RES_TA_0017 "MRR_FR_CAN_DET_SUPER_RES_TARGET_018";
BA_ "GenSigCmt" SG_ 1026 MRR_FR_CAN_DET_AZIMUTH_018 "Detected object azimuth position";
BA_ "GenSigStartValue" SG_ 1026 MRR_FR_CAN_DET_AZIMUTH_018 8194.05320813772;
BA_ "GenSigCmt" SG_ 1026 MRR_FR_CAN_DET_CONFID_ELEVA_0017 "Elevation Angle Confidence";
BA_ "SystemSignalLongSymbol" SG_ 1026 MRR_FR_CAN_DET_CONFID_ELEVA_0017 "MRR_FR_CAN_DET_CONFID_ELEVATION_018";
BA_ "GenSigCmt" SG_ 1026 MRR_FR_CAN_DET_HOST_VEH_CLU_0017 "Host vehicle clutter";
BA_ "SystemSignalLongSymbol" SG_ 1026 MRR_FR_CAN_DET_HOST_VEH_CLU_0017 "MRR_FR_CAN_DET_HOST_VEH_CLUTTER_018";
BA_ "GenSigCmt" SG_ 1026 MRR_FR_CAN_DET_RANGE_018 "Detected object range";
BA_ "GenSigCmt" SG_ 1026 MRR_FR_CAN_DET_CONFID_AZIMU_0015 "Signal to noise level";
BA_ "GenSigVtEn" SG_ 1026 MRR_FR_CAN_DET_CONFID_AZIMU_0015 "TRUE";
BA_ "SystemSignalLongSymbol" SG_ 1026 MRR_FR_CAN_DET_CONFID_AZIMU_0015 "MRR_FR_CAN_DET_CONFID_AZIMUTH_018";
BA_ "GenSigCmt" SG_ 1026 MRR_FR_CAN_DET_RANGE_RATE_018 "Detected object range rate";
BA_ "GenSigStartValue" SG_ 1026 MRR_FR_CAN_DET_RANGE_RATE_018 8192;
BA_ "GenSigCmt" SG_ 1026 MRR_FR_CAN_SCAN_INDEX_2LSB_018 "The two LSB of scan index";
BA_ "GenSigCmt" SG_ 1026 MRR_FR_CAN_DET_AMPLITUDE_018 "Detected object amplitude";
BA_ "GenSigStartValue" SG_ 1026 MRR_FR_CAN_DET_AMPLITUDE_018 64;
BA_ "GenSigCmt" SG_ 1026 MRR_FR_CAN_DET_VALID_LEVEL_018 "Detected object valid level";
BA_ "GenSigCmt" SG_ 1026 MRR_FR_CAN_DET_ELEVATION_017 "Detected object elevation position";
BA_ "GenSigStartValue" SG_ 1026 MRR_FR_CAN_DET_ELEVATION_017 63.8646288209607;
BA_ "GenSigCmt" SG_ 1026 MRR_FR_CAN_DET_SUPER_RES_TA_0018 "Super resolution target";
BA_ "SystemSignalLongSymbol" SG_ 1026 MRR_FR_CAN_DET_SUPER_RES_TA_0018 "MRR_FR_CAN_DET_SUPER_RES_TARGET_017";
BA_ "GenSigCmt" SG_ 1026 MRR_FR_CAN_DET_AZIMUTH_017 "Detected object azimuth position";
BA_ "GenSigStartValue" SG_ 1026 MRR_FR_CAN_DET_AZIMUTH_017 8194.05320813772;
BA_ "GenSigCmt" SG_ 1026 MRR_FR_CAN_DET_CONFID_ELEVA_0018 "Elevation Angle Confidence";
BA_ "SystemSignalLongSymbol" SG_ 1026 MRR_FR_CAN_DET_CONFID_ELEVA_0018 "MRR_FR_CAN_DET_CONFID_ELEVATION_017";
BA_ "GenSigCmt" SG_ 1026 MRR_FR_CAN_DET_HOST_VEH_CLU_0018 "Host vehicle clutter";
BA_ "SystemSignalLongSymbol" SG_ 1026 MRR_FR_CAN_DET_HOST_VEH_CLU_0018 "MRR_FR_CAN_DET_HOST_VEH_CLUTTER_017";
BA_ "GenSigCmt" SG_ 1026 MRR_FR_CAN_DET_RANGE_017 "Detected object range";
BA_ "GenSigCmt" SG_ 1026 MRR_FR_CAN_DET_CONFID_AZIMU_0016 "Signal to noise level";
BA_ "GenSigVtEn" SG_ 1026 MRR_FR_CAN_DET_CONFID_AZIMU_0016 "TRUE";
BA_ "SystemSignalLongSymbol" SG_ 1026 MRR_FR_CAN_DET_CONFID_AZIMU_0016 "MRR_FR_CAN_DET_CONFID_AZIMUTH_017";
BA_ "GenSigCmt" SG_ 1026 MRR_FR_CAN_DET_RANGE_RATE_017 "Detected object range rate";
BA_ "GenSigStartValue" SG_ 1026 MRR_FR_CAN_DET_RANGE_RATE_017 8192;
BA_ "GenSigCmt" SG_ 1026 MRR_FR_CAN_SCAN_INDEX_2LSB_017 "The two LSB of scan index";
BA_ "GenSigCmt" SG_ 1026 MRR_FR_CAN_DET_AMPLITUDE_017 "Detected object amplitude";
BA_ "GenSigStartValue" SG_ 1026 MRR_FR_CAN_DET_AMPLITUDE_017 64;
BA_ "GenSigCmt" SG_ 1026 MRR_FR_CAN_DET_VALID_LEVEL_017 "Detected object valid level";
BA_ "GenSigCmt" SG_ 1026 MRR_FR_CAN_DET_ELEVATION_016 "Detected object elevation position";
BA_ "GenSigStartValue" SG_ 1026 MRR_FR_CAN_DET_ELEVATION_016 63.8646288209607;
BA_ "GenSigCmt" SG_ 1026 MRR_FR_CAN_DET_SUPER_RES_TA_0019 "Super resolution target";
BA_ "SystemSignalLongSymbol" SG_ 1026 MRR_FR_CAN_DET_SUPER_RES_TA_0019 "MRR_FR_CAN_DET_SUPER_RES_TARGET_016";
BA_ "GenSigCmt" SG_ 1026 MRR_FR_CAN_DET_AZIMUTH_016 "Detected object azimuth position";
BA_ "GenSigStartValue" SG_ 1026 MRR_FR_CAN_DET_AZIMUTH_016 8194.05320813772;
BA_ "GenSigCmt" SG_ 1026 MRR_FR_CAN_DET_CONFID_ELEVA_0019 "Elevation Angle Confidence";
BA_ "SystemSignalLongSymbol" SG_ 1026 MRR_FR_CAN_DET_CONFID_ELEVA_0019 "MRR_FR_CAN_DET_CONFID_ELEVATION_016";
BA_ "GenSigCmt" SG_ 1026 MRR_FR_CAN_DET_HOST_VEH_CLU_0019 "Host vehicle clutter";
BA_ "SystemSignalLongSymbol" SG_ 1026 MRR_FR_CAN_DET_HOST_VEH_CLU_0019 "MRR_FR_CAN_DET_HOST_VEH_CLUTTER_016";
BA_ "GenSigCmt" SG_ 1026 MRR_FR_CAN_DET_RANGE_016 "Detected object range";
BA_ "GenSigCmt" SG_ 1026 MRR_FR_CAN_DET_CONFID_AZIMU_0017 "Signal to noise level";
BA_ "GenSigVtEn" SG_ 1026 MRR_FR_CAN_DET_CONFID_AZIMU_0017 "TRUE";
BA_ "SystemSignalLongSymbol" SG_ 1026 MRR_FR_CAN_DET_CONFID_AZIMU_0017 "MRR_FR_CAN_DET_CONFID_AZIMUTH_016";
BA_ "GenSigCmt" SG_ 1026 MRR_FR_CAN_DET_RANGE_RATE_016 "Detected object range rate";
BA_ "GenSigStartValue" SG_ 1026 MRR_FR_CAN_DET_RANGE_RATE_016 8192;
BA_ "GenSigCmt" SG_ 1026 MRR_FR_CAN_SCAN_INDEX_2LSB_016 "The two LSB of scan index";
BA_ "GenSigCmt" SG_ 1026 MRR_FR_CAN_DET_AMPLITUDE_016 "Detected object amplitude";
BA_ "GenSigStartValue" SG_ 1026 MRR_FR_CAN_DET_AMPLITUDE_016 64;
BA_ "GenSigCmt" SG_ 1026 MRR_FR_CAN_DET_VALID_LEVEL_016 "Detected object valid level";
BA_ "SignalDescription" SG_ 1027 MRR_FR_CAN_DET_MID_TARGET_028 "MID_Target_Discrimination";
BA_ "GenSigSendType" SG_ 1027 MRR_FR_CAN_DET_MID_TARGET_028 1;
BA_ "SignalDescription" SG_ 1027 MRR_FR_CAN_DET_MID_TARGET_027 "MID_Target_Discrimination";
BA_ "SignalDescription" SG_ 1027 MRR_FR_CAN_DET_MID_TARGET_026 "MID_Target_Discrimination";
BA_ "SignalDescription" SG_ 1027 MRR_FR_CAN_DET_MID_TARGET_025 "MID_Target_Discrimination";
BA_ "SignalDescription" SG_ 1027 MRR_FR_CAN_DET_MID_TARGET_024 "MID_Target_Discrimination";
BA_ "SignalDescription" SG_ 1027 MRR_FR_CAN_DET_MID_TARGET_023 "MID_Target_Discrimination";
BA_ "SignalDescription" SG_ 1027 MRR_FR_CAN_DET_MID_TARGET_022 "MID_Target_Discrimination";
BA_ "SignalDescription" SG_ 1027 MRR_FR_CAN_DET_Near_TARGET_022 "Near_Target_Discrimination";
BA_ "SignalDescription" SG_ 1027 MRR_FR_CAN_DET_Near_TARGET_023 "Near_Target_Discrimination";
BA_ "SignalDescription" SG_ 1027 MRR_FR_CAN_DET_Near_TARGET_024 "Near_Target_Discrimination";
BA_ "SignalDescription" SG_ 1027 MRR_FR_CAN_DET_Near_TARGET_025 "Near_Target_Discrimination";
BA_ "SignalDescription" SG_ 1027 MRR_FR_CAN_DET_Near_TARGET_026 "Near_Target_Discrimination";
BA_ "SignalDescription" SG_ 1027 MRR_FR_CAN_DET_Near_TARGET_027 "Near_Target_Discrimination";
BA_ "SignalDescription" SG_ 1027 MRR_FR_CAN_DET_Near_TARGET_028 "Near_Target_Discrimination";
BA_ "GenSigCmt" SG_ 1027 MRR_FR_CAN_DET_ELEVATION_022 "Detected object elevation position";
BA_ "GenSigStartValue" SG_ 1027 MRR_FR_CAN_DET_ELEVATION_022 63.8646288209607;
BA_ "GenSigCmt" SG_ 1027 MRR_FR_CAN_DET_CONFID_AZIMU_0018 "Signal to noise level";
BA_ "GenSigVtEn" SG_ 1027 MRR_FR_CAN_DET_CONFID_AZIMU_0018 "TRUE";
BA_ "SystemSignalLongSymbol" SG_ 1027 MRR_FR_CAN_DET_CONFID_AZIMU_0018 "MRR_FR_CAN_DET_CONFID_AZIMUTH_022";
BA_ "GenSigCmt" SG_ 1027 MRR_FR_CAN_DET_SUPER_RES_TA_0020 "Super resolution target";
BA_ "SystemSignalLongSymbol" SG_ 1027 MRR_FR_CAN_DET_SUPER_RES_TA_0020 "MRR_FR_CAN_DET_SUPER_RES_TARGET_022";
BA_ "GenSigCmt" SG_ 1027 MRR_FR_CAN_DET_CONFID_ELEVA_0020 "Elevation Angle Confidence";
BA_ "SystemSignalLongSymbol" SG_ 1027 MRR_FR_CAN_DET_CONFID_ELEVA_0020 "MRR_FR_CAN_DET_CONFID_ELEVATION_022";
BA_ "GenSigCmt" SG_ 1027 MRR_FR_CAN_DET_HOST_VEH_CLU_0020 "Host vehicle clutter";
BA_ "SystemSignalLongSymbol" SG_ 1027 MRR_FR_CAN_DET_HOST_VEH_CLU_0020 "MRR_FR_CAN_DET_HOST_VEH_CLUTTER_022";
BA_ "GenSigCmt" SG_ 1027 MRR_FR_CAN_DET_VALID_LEVEL_022 "Detected object valid level";
BA_ "GenSigCmt" SG_ 1027 MRR_FR_CAN_DET_AZIMUTH_022 "Detected object azimuth position";
BA_ "GenSigStartValue" SG_ 1027 MRR_FR_CAN_DET_AZIMUTH_022 8194.05320813772;
BA_ "GenSigCmt" SG_ 1027 MRR_FR_CAN_DET_RANGE_022 "Detected object range";
BA_ "GenSigCmt" SG_ 1027 MRR_FR_CAN_DET_RANGE_RATE_022 "Detected object range rate";
BA_ "GenSigStartValue" SG_ 1027 MRR_FR_CAN_DET_RANGE_RATE_022 8192;
BA_ "GenSigCmt" SG_ 1027 MRR_FR_CAN_DET_AMPLITUDE_022 "Detected object amplitude";
BA_ "GenSigStartValue" SG_ 1027 MRR_FR_CAN_DET_AMPLITUDE_022 64;
BA_ "GenSigCmt" SG_ 1027 MRR_FR_CAN_SCAN_INDEX_2LSB_022 "The two LSB of scan index";
BA_ "GenSigStartValue" SG_ 1027 MRR_FR_CAN_DET_ELEVATION_028 63.8646288209607;
BA_ "GenSigCmt" SG_ 1027 MRR_FR_CAN_DET_ELEVATION_028 "Detected object elevation position";
BA_ "GenSigCmt" SG_ 1027 MRR_FR_CAN_DET_SUPER_RES_TA_0021 "Super resolution target";
BA_ "SystemSignalLongSymbol" SG_ 1027 MRR_FR_CAN_DET_SUPER_RES_TA_0021 "MRR_FR_CAN_DET_SUPER_RES_TARGET_028";
BA_ "GenSigCmt" SG_ 1027 MRR_FR_CAN_DET_AZIMUTH_028 "Detected object azimuth position";
BA_ "GenSigStartValue" SG_ 1027 MRR_FR_CAN_DET_AZIMUTH_028 8194.05320813772;
BA_ "GenSigCmt" SG_ 1027 MRR_FR_CAN_DET_CONFID_ELEVA_0021 "Elevation Angle Confidence";
BA_ "SystemSignalLongSymbol" SG_ 1027 MRR_FR_CAN_DET_CONFID_ELEVA_0021 "MRR_FR_CAN_DET_CONFID_ELEVATION_028";
BA_ "GenSigCmt" SG_ 1027 MRR_FR_CAN_DET_HOST_VEH_CLU_0021 "Host vehicle clutter";
BA_ "SystemSignalLongSymbol" SG_ 1027 MRR_FR_CAN_DET_HOST_VEH_CLU_0021 "MRR_FR_CAN_DET_HOST_VEH_CLUTTER_028";
BA_ "GenSigCmt" SG_ 1027 MRR_FR_CAN_DET_RANGE_028 "Detected object range";
BA_ "GenSigCmt" SG_ 1027 MRR_FR_CAN_DET_CONFID_AZIMU_0019 "Signal to noise level";
BA_ "GenSigVtEn" SG_ 1027 MRR_FR_CAN_DET_CONFID_AZIMU_0019 "TRUE";
BA_ "SystemSignalLongSymbol" SG_ 1027 MRR_FR_CAN_DET_CONFID_AZIMU_0019 "MRR_FR_CAN_DET_CONFID_AZIMUTH_028";
BA_ "GenSigCmt" SG_ 1027 MRR_FR_CAN_DET_RANGE_RATE_028 "Detected object range rate";
BA_ "GenSigStartValue" SG_ 1027 MRR_FR_CAN_DET_RANGE_RATE_028 8192;
BA_ "GenSigCmt" SG_ 1027 MRR_FR_CAN_SCAN_INDEX_2LSB_028 "The two LSB of scan index";
BA_ "GenSigCmt" SG_ 1027 MRR_FR_CAN_DET_AMPLITUDE_028 "Detected object amplitude";
BA_ "GenSigStartValue" SG_ 1027 MRR_FR_CAN_DET_AMPLITUDE_028 64;
BA_ "GenSigCmt" SG_ 1027 MRR_FR_CAN_DET_VALID_LEVEL_028 "Detected object valid level";
BA_ "GenSigCmt" SG_ 1027 MRR_FR_CAN_DET_ELEVATION_027 "Detected object elevation position";
BA_ "GenSigStartValue" SG_ 1027 MRR_FR_CAN_DET_ELEVATION_027 63.8646288209607;
BA_ "GenSigCmt" SG_ 1027 MRR_FR_CAN_DET_SUPER_RES_TA_0022 "Super resolution target";
BA_ "SystemSignalLongSymbol" SG_ 1027 MRR_FR_CAN_DET_SUPER_RES_TA_0022 "MRR_FR_CAN_DET_SUPER_RES_TARGET_027";
BA_ "GenSigCmt" SG_ 1027 MRR_FR_CAN_DET_AZIMUTH_027 "Detected object azimuth position";
BA_ "GenSigStartValue" SG_ 1027 MRR_FR_CAN_DET_AZIMUTH_027 8194.05320813772;
BA_ "GenSigCmt" SG_ 1027 MRR_FR_CAN_DET_CONFID_ELEVA_0022 "Elevation Angle Confidence";
BA_ "SystemSignalLongSymbol" SG_ 1027 MRR_FR_CAN_DET_CONFID_ELEVA_0022 "MRR_FR_CAN_DET_CONFID_ELEVATION_027";
BA_ "GenSigCmt" SG_ 1027 MRR_FR_CAN_DET_HOST_VEH_CLU_0022 "Host vehicle clutter";
BA_ "SystemSignalLongSymbol" SG_ 1027 MRR_FR_CAN_DET_HOST_VEH_CLU_0022 "MRR_FR_CAN_DET_HOST_VEH_CLUTTER_027";
BA_ "GenSigCmt" SG_ 1027 MRR_FR_CAN_DET_RANGE_027 "Detected object range";
BA_ "GenSigCmt" SG_ 1027 MRR_FR_CAN_DET_CONFID_AZIMU_0020 "Signal to noise level";
BA_ "GenSigVtEn" SG_ 1027 MRR_FR_CAN_DET_CONFID_AZIMU_0020 "TRUE";
BA_ "SystemSignalLongSymbol" SG_ 1027 MRR_FR_CAN_DET_CONFID_AZIMU_0020 "MRR_FR_CAN_DET_CONFID_AZIMUTH_027";
BA_ "GenSigCmt" SG_ 1027 MRR_FR_CAN_DET_RANGE_RATE_027 "Detected object range rate";
BA_ "GenSigStartValue" SG_ 1027 MRR_FR_CAN_DET_RANGE_RATE_027 8192;
BA_ "GenSigCmt" SG_ 1027 MRR_FR_CAN_SCAN_INDEX_2LSB_027 "The two LSB of scan index";
BA_ "GenSigCmt" SG_ 1027 MRR_FR_CAN_DET_AMPLITUDE_027 "Detected object amplitude";
BA_ "GenSigStartValue" SG_ 1027 MRR_FR_CAN_DET_AMPLITUDE_027 64;
BA_ "GenSigCmt" SG_ 1027 MRR_FR_CAN_DET_VALID_LEVEL_027 "Detected object valid level";
BA_ "GenSigCmt" SG_ 1027 MRR_FR_CAN_DET_ELEVATION_026 "Detected object elevation position";
BA_ "GenSigStartValue" SG_ 1027 MRR_FR_CAN_DET_ELEVATION_026 63.8646288209607;
BA_ "GenSigCmt" SG_ 1027 MRR_FR_CAN_DET_SUPER_RES_TA_0023 "Super resolution target";
BA_ "SystemSignalLongSymbol" SG_ 1027 MRR_FR_CAN_DET_SUPER_RES_TA_0023 "MRR_FR_CAN_DET_SUPER_RES_TARGET_026";
BA_ "GenSigCmt" SG_ 1027 MRR_FR_CAN_DET_AZIMUTH_026 "Detected object azimuth position";
BA_ "GenSigStartValue" SG_ 1027 MRR_FR_CAN_DET_AZIMUTH_026 8194.05320813772;
BA_ "GenSigCmt" SG_ 1027 MRR_FR_CAN_DET_CONFID_ELEVA_0023 "Elevation Angle Confidence";
BA_ "SystemSignalLongSymbol" SG_ 1027 MRR_FR_CAN_DET_CONFID_ELEVA_0023 "MRR_FR_CAN_DET_CONFID_ELEVATION_026";
BA_ "GenSigCmt" SG_ 1027 MRR_FR_CAN_DET_HOST_VEH_CLU_0023 "Host vehicle clutter";
BA_ "SystemSignalLongSymbol" SG_ 1027 MRR_FR_CAN_DET_HOST_VEH_CLU_0023 "MRR_FR_CAN_DET_HOST_VEH_CLUTTER_026";
BA_ "GenSigCmt" SG_ 1027 MRR_FR_CAN_DET_RANGE_026 "Detected object range";
BA_ "GenSigCmt" SG_ 1027 MRR_FR_CAN_DET_CONFID_AZIMU_0021 "Signal to noise level";
BA_ "GenSigVtEn" SG_ 1027 MRR_FR_CAN_DET_CONFID_AZIMU_0021 "TRUE";
BA_ "SystemSignalLongSymbol" SG_ 1027 MRR_FR_CAN_DET_CONFID_AZIMU_0021 "MRR_FR_CAN_DET_CONFID_AZIMUTH_026";
BA_ "GenSigCmt" SG_ 1027 MRR_FR_CAN_DET_RANGE_RATE_026 "Detected object range rate";
BA_ "GenSigStartValue" SG_ 1027 MRR_FR_CAN_DET_RANGE_RATE_026 8192;
BA_ "GenSigCmt" SG_ 1027 MRR_FR_CAN_SCAN_INDEX_2LSB_026 "The two LSB of scan index";
BA_ "GenSigCmt" SG_ 1027 MRR_FR_CAN_DET_AMPLITUDE_026 "Detected object amplitude";
BA_ "GenSigStartValue" SG_ 1027 MRR_FR_CAN_DET_AMPLITUDE_026 64;
BA_ "GenSigCmt" SG_ 1027 MRR_FR_CAN_DET_VALID_LEVEL_026 "Detected object valid level";
BA_ "GenSigCmt" SG_ 1027 MRR_FR_CAN_DET_ELEVATION_025 "Detected object elevation position";
BA_ "GenSigStartValue" SG_ 1027 MRR_FR_CAN_DET_ELEVATION_025 63.8646288209607;
BA_ "GenSigCmt" SG_ 1027 MRR_FR_CAN_DET_SUPER_RES_TA_0024 "Super resolution target";
BA_ "SystemSignalLongSymbol" SG_ 1027 MRR_FR_CAN_DET_SUPER_RES_TA_0024 "MRR_FR_CAN_DET_SUPER_RES_TARGET_025";
BA_ "GenSigCmt" SG_ 1027 MRR_FR_CAN_DET_AZIMUTH_025 "Detected object azimuth position";
BA_ "GenSigStartValue" SG_ 1027 MRR_FR_CAN_DET_AZIMUTH_025 8194.05320813772;
BA_ "GenSigCmt" SG_ 1027 MRR_FR_CAN_DET_CONFID_ELEVA_0024 "Elevation Angle Confidence";
BA_ "SystemSignalLongSymbol" SG_ 1027 MRR_FR_CAN_DET_CONFID_ELEVA_0024 "MRR_FR_CAN_DET_CONFID_ELEVATION_025";
BA_ "GenSigCmt" SG_ 1027 MRR_FR_CAN_DET_HOST_VEH_CLU_0024 "Host vehicle clutter";
BA_ "SystemSignalLongSymbol" SG_ 1027 MRR_FR_CAN_DET_HOST_VEH_CLU_0024 "MRR_FR_CAN_DET_HOST_VEH_CLUTTER_025";
BA_ "GenSigCmt" SG_ 1027 MRR_FR_CAN_DET_RANGE_025 "Detected object range";
BA_ "GenSigCmt" SG_ 1027 MRR_FR_CAN_DET_CONFID_AZIMU_0022 "Signal to noise level";
BA_ "GenSigVtEn" SG_ 1027 MRR_FR_CAN_DET_CONFID_AZIMU_0022 "TRUE";
BA_ "SystemSignalLongSymbol" SG_ 1027 MRR_FR_CAN_DET_CONFID_AZIMU_0022 "MRR_FR_CAN_DET_CONFID_AZIMUTH_025";
BA_ "GenSigCmt" SG_ 1027 MRR_FR_CAN_DET_RANGE_RATE_025 "Detected object range rate";
BA_ "GenSigStartValue" SG_ 1027 MRR_FR_CAN_DET_RANGE_RATE_025 8192;
BA_ "GenSigCmt" SG_ 1027 MRR_FR_CAN_SCAN_INDEX_2LSB_025 "The two LSB of scan index";
BA_ "GenSigCmt" SG_ 1027 MRR_FR_CAN_DET_AMPLITUDE_025 "Detected object amplitude";
BA_ "GenSigStartValue" SG_ 1027 MRR_FR_CAN_DET_AMPLITUDE_025 64;
BA_ "GenSigCmt" SG_ 1027 MRR_FR_CAN_DET_VALID_LEVEL_025 "Detected object valid level";
BA_ "GenSigCmt" SG_ 1027 MRR_FR_CAN_DET_ELEVATION_024 "Detected object elevation position";
BA_ "GenSigStartValue" SG_ 1027 MRR_FR_CAN_DET_ELEVATION_024 63.8646288209607;
BA_ "GenSigCmt" SG_ 1027 MRR_FR_CAN_DET_SUPER_RES_TA_0025 "Super resolution target";
BA_ "SystemSignalLongSymbol" SG_ 1027 MRR_FR_CAN_DET_SUPER_RES_TA_0025 "MRR_FR_CAN_DET_SUPER_RES_TARGET_024";
BA_ "GenSigCmt" SG_ 1027 MRR_FR_CAN_DET_AZIMUTH_024 "Detected object azimuth position";
BA_ "GenSigStartValue" SG_ 1027 MRR_FR_CAN_DET_AZIMUTH_024 8194.05320813772;
BA_ "GenSigCmt" SG_ 1027 MRR_FR_CAN_DET_CONFID_ELEVA_0025 "Elevation Angle Confidence";
BA_ "SystemSignalLongSymbol" SG_ 1027 MRR_FR_CAN_DET_CONFID_ELEVA_0025 "MRR_FR_CAN_DET_CONFID_ELEVATION_024";
BA_ "GenSigCmt" SG_ 1027 MRR_FR_CAN_DET_HOST_VEH_CLU_0025 "Host vehicle clutter";
BA_ "SystemSignalLongSymbol" SG_ 1027 MRR_FR_CAN_DET_HOST_VEH_CLU_0025 "MRR_FR_CAN_DET_HOST_VEH_CLUTTER_024";
BA_ "GenSigCmt" SG_ 1027 MRR_FR_CAN_DET_RANGE_024 "Detected object range";
BA_ "GenSigCmt" SG_ 1027 MRR_FR_CAN_DET_CONFID_AZIMU_0023 "Signal to noise level";
BA_ "GenSigVtEn" SG_ 1027 MRR_FR_CAN_DET_CONFID_AZIMU_0023 "TRUE";
BA_ "SystemSignalLongSymbol" SG_ 1027 MRR_FR_CAN_DET_CONFID_AZIMU_0023 "MRR_FR_CAN_DET_CONFID_AZIMUTH_024";
BA_ "GenSigCmt" SG_ 1027 MRR_FR_CAN_DET_RANGE_RATE_024 "Detected object range rate";
BA_ "GenSigStartValue" SG_ 1027 MRR_FR_CAN_DET_RANGE_RATE_024 8192;
BA_ "GenSigCmt" SG_ 1027 MRR_FR_CAN_SCAN_INDEX_2LSB_024 "The two LSB of scan index";
BA_ "GenSigCmt" SG_ 1027 MRR_FR_CAN_DET_AMPLITUDE_024 "Detected object amplitude";
BA_ "GenSigStartValue" SG_ 1027 MRR_FR_CAN_DET_AMPLITUDE_024 64;
BA_ "GenSigCmt" SG_ 1027 MRR_FR_CAN_DET_VALID_LEVEL_024 "Detected object valid level";
BA_ "GenSigCmt" SG_ 1027 MRR_FR_CAN_DET_ELEVATION_023 "Detected object elevation position";
BA_ "GenSigStartValue" SG_ 1027 MRR_FR_CAN_DET_ELEVATION_023 63.8646288209607;
BA_ "GenSigCmt" SG_ 1027 MRR_FR_CAN_DET_SUPER_RES_TA_0026 "Super resolution target";
BA_ "SystemSignalLongSymbol" SG_ 1027 MRR_FR_CAN_DET_SUPER_RES_TA_0026 "MRR_FR_CAN_DET_SUPER_RES_TARGET_023";
BA_ "GenSigCmt" SG_ 1027 MRR_FR_CAN_DET_AZIMUTH_023 "Detected object azimuth position";
BA_ "GenSigStartValue" SG_ 1027 MRR_FR_CAN_DET_AZIMUTH_023 8194.05320813772;
BA_ "GenSigCmt" SG_ 1027 MRR_FR_CAN_DET_CONFID_ELEVA_0026 "Elevation Angle Confidence";
BA_ "SystemSignalLongSymbol" SG_ 1027 MRR_FR_CAN_DET_CONFID_ELEVA_0026 "MRR_FR_CAN_DET_CONFID_ELEVATION_023";
BA_ "GenSigCmt" SG_ 1027 MRR_FR_CAN_DET_HOST_VEH_CLU_0026 "Host vehicle clutter";
BA_ "SystemSignalLongSymbol" SG_ 1027 MRR_FR_CAN_DET_HOST_VEH_CLU_0026 "MRR_FR_CAN_DET_HOST_VEH_CLUTTER_023";
BA_ "GenSigCmt" SG_ 1027 MRR_FR_CAN_DET_RANGE_023 "Detected object range";
BA_ "GenSigCmt" SG_ 1027 MRR_FR_CAN_DET_CONFID_AZIMU_0024 "Signal to noise level";
BA_ "GenSigVtEn" SG_ 1027 MRR_FR_CAN_DET_CONFID_AZIMU_0024 "TRUE";
BA_ "SystemSignalLongSymbol" SG_ 1027 MRR_FR_CAN_DET_CONFID_AZIMU_0024 "MRR_FR_CAN_DET_CONFID_AZIMUTH_023";
BA_ "GenSigCmt" SG_ 1027 MRR_FR_CAN_DET_RANGE_RATE_023 "Detected object range rate";
BA_ "GenSigStartValue" SG_ 1027 MRR_FR_CAN_DET_RANGE_RATE_023 8192;
BA_ "GenSigCmt" SG_ 1027 MRR_FR_CAN_SCAN_INDEX_2LSB_023 "The two LSB of scan index";
BA_ "GenSigCmt" SG_ 1027 MRR_FR_CAN_DET_AMPLITUDE_023 "Detected object amplitude";
BA_ "GenSigStartValue" SG_ 1027 MRR_FR_CAN_DET_AMPLITUDE_023 64;
BA_ "GenSigCmt" SG_ 1027 MRR_FR_CAN_DET_VALID_LEVEL_023 "Detected object valid level";
VAL_ 775 MRR_FL_CAN_DET_CONFID_AZIMUTH_05 3 "Low" 2 "MidLow" 1 "MidHigh" 0 "High" ;
VAL_ 775 MRR_FL_CAN_DET_CONFID_AZIMU_0044 3 "Low" 2 "MidLow" 1 "MidHigh" 0 "High" ;
VAL_ 775 MRR_FL_CAN_DET_CONFID_AZIMU_0045 3 "Low" 2 "MidLow" 1 "MidHigh" 0 "High" ;
VAL_ 775 MRR_FL_CAN_DET_CONFID_AZIMU_0046 3 "Low" 2 "MidLow" 1 "MidHigh" 0 "High" ;
VAL_ 775 MRR_FL_CAN_DET_CONFID_AZIMU_0047 3 "Low" 2 "MidLow" 1 "MidHigh" 0 "High" ;
VAL_ 775 MRR_FL_CAN_DET_CONFID_AZIMU_0048 3 "Low" 2 "MidLow" 1 "MidHigh" 0 "High" ;
VAL_ 775 MRR_FL_CAN_DET_CONFID_AZIMU_0049 3 "Low" 2 "MidLow" 1 "MidHigh" 0 "High" ;
VAL_ 776 MRR_FL_CAN_DET_CONFID_AZIMU_0050 3 "Low" 2 "MidLow" 1 "MidHigh" 0 "High" ;
VAL_ 776 MRR_FL_CAN_DET_CONFID_AZIMUTH_06 3 "Low" 2 "MidLow" 1 "MidHigh" 0 "High" ;
VAL_ 776 MRR_FL_CAN_DET_CONFID_AZIMU_0051 3 "Low" 2 "MidLow" 1 "MidHigh" 0 "High" ;
VAL_ 776 MRR_FL_CAN_DET_CONFID_AZIMU_0052 3 "Low" 2 "MidLow" 1 "MidHigh" 0 "High" ;
VAL_ 776 MRR_FL_CAN_DET_CONFID_AZIMU_0053 3 "Low" 2 "MidLow" 1 "MidHigh" 0 "High" ;
VAL_ 776 MRR_FL_CAN_DET_CONFID_AZIMU_0054 3 "Low" 2 "MidLow" 1 "MidHigh" 0 "High" ;
VAL_ 776 MRR_FL_CAN_DET_CONFID_AZIMU_0055 3 "Low" 2 "MidLow" 1 "MidHigh" 0 "High" ;
VAL_ 777 MRR_FL_CAN_DET_CONFID_AZIMU_0056 3 "Low" 2 "MidLow" 1 "MidHigh" 0 "High" ;
VAL_ 391 MRR_FL_Sensor_Position 4 "Rear Left" 3 "Rear Right" 2 "Front Left" 1 "Front Right" 0 "Unknown" ;
VAL_ 391 MRR_FL_Sensor_Position_Lock 1 "Unlocked" 0 "Locked" ;
VAL_ 391 MRR_FL_CAN_LOOK_ID 3 "MRML" 2 "MRLL" 1 "LRML" 0 "LRLL" ;
VAL_ 1024 MRR_FR_CAN_DET_CONFID_AZIMUTH_00 3 "Low" 2 "MidLow" 1 "MidHigh" 0 "High" ;
VAL_ 1024 MRR_FR_CAN_DET_CONFID_AZIMU_0000 3 "Low" 2 "MidLow" 1 "MidHigh" 0 "High" ;
VAL_ 1024 MRR_FR_CAN_DET_CONFID_AZIMU_0001 3 "Low" 2 "MidLow" 1 "MidHigh" 0 "High" ;
VAL_ 1024 MRR_FR_CAN_DET_CONFID_AZIMU_0002 3 "Low" 2 "MidLow" 1 "MidHigh" 0 "High" ;
VAL_ 1024 MRR_FR_CAN_DET_CONFID_AZIMU_0003 3 "Low" 2 "MidLow" 1 "MidHigh" 0 "High" ;
VAL_ 1024 MRR_FR_CAN_DET_CONFID_AZIMU_0004 3 "Low" 2 "MidLow" 1 "MidHigh" 0 "High" ;
VAL_ 1024 MRR_FR_CAN_DET_CONFID_AZIMU_0005 3 "Low" 2 "MidLow" 1 "MidHigh" 0 "High" ;
VAL_ 1025 MRR_FR_CAN_DET_CONFID_AZIMU_0006 3 "Low" 2 "MidLow" 1 "MidHigh" 0 "High" ;
VAL_ 1025 MRR_FR_CAN_DET_CONFID_AZIMUTH_01 3 "Low" 2 "MidLow" 1 "MidHigh" 0 "High" ;
VAL_ 1025 MRR_FR_CAN_DET_CONFID_AZIMU_0007 3 "Low" 2 "MidLow" 1 "MidHigh" 0 "High" ;
VAL_ 1025 MRR_FR_CAN_DET_CONFID_AZIMU_0008 3 "Low" 2 "MidLow" 1 "MidHigh" 0 "High" ;
VAL_ 1025 MRR_FR_CAN_DET_CONFID_AZIMU_0009 3 "Low" 2 "MidLow" 1 "MidHigh" 0 "High" ;
VAL_ 1025 MRR_FR_CAN_DET_CONFID_AZIMU_0010 3 "Low" 2 "MidLow" 1 "MidHigh" 0 "High" ;
VAL_ 1025 MRR_FR_CAN_DET_CONFID_AZIMU_0011 3 "Low" 2 "MidLow" 1 "MidHigh" 0 "High" ;
VAL_ 1026 MRR_FR_CAN_DET_CONFID_AZIMU_0012 3 "Low" 2 "MidLow" 1 "MidHigh" 0 "High" ;
VAL_ 1026 MRR_FR_CAN_DET_CONFID_AZIMUTH_02 3 "Low" 2 "MidLow" 1 "MidHigh" 0 "High" ;
VAL_ 1026 MRR_FR_CAN_DET_CONFID_AZIMU_0013 3 "Low" 2 "MidLow" 1 "MidHigh" 0 "High" ;
VAL_ 1026 MRR_FR_CAN_DET_CONFID_AZIMU_0014 3 "Low" 2 "MidLow" 1 "MidHigh" 0 "High" ;
VAL_ 1026 MRR_FR_CAN_DET_CONFID_AZIMU_0015 3 "Low" 2 "MidLow" 1 "MidHigh" 0 "High" ;
VAL_ 1026 MRR_FR_CAN_DET_CONFID_AZIMU_0016 3 "Low" 2 "MidLow" 1 "MidHigh" 0 "High" ;
VAL_ 1026 MRR_FR_CAN_DET_CONFID_AZIMU_0017 3 "Low" 2 "MidLow" 1 "MidHigh" 0 "High" ;
VAL_ 1027 MRR_FR_CAN_DET_CONFID_AZIMU_0018 3 "Low" 2 "MidLow" 1 "MidHigh" 0 "High" ;
VAL_ 1027 MRR_FR_CAN_DET_CONFID_AZIMU_0019 3 "Low" 2 "MidLow" 1 "MidHigh" 0 "High" ;
VAL_ 1027 MRR_FR_CAN_DET_CONFID_AZIMU_0020 3 "Low" 2 "MidLow" 1 "MidHigh" 0 "High" ;
VAL_ 1027 MRR_FR_CAN_DET_CONFID_AZIMU_0021 3 "Low" 2 "MidLow" 1 "MidHigh" 0 "High" ;
VAL_ 1027 MRR_FR_CAN_DET_CONFID_AZIMU_0022 3 "Low" 2 "MidLow" 1 "MidHigh" 0 "High" ;
VAL_ 1027 MRR_FR_CAN_DET_CONFID_AZIMU_0023 3 "Low" 2 "MidLow" 1 "MidHigh" 0 "High" ;
VAL_ 1027 MRR_FR_CAN_DET_CONFID_AZIMU_0024 0 "High" 1 "MidHigh" 2 "MidLow" 3 "Low" ;
SIG_GROUP_ 775 MRR_FL_Detection_050_056 1 : MRR_FL_CAN_DET_Near_TARGET_056 MRR_FL_CAN_DET_Near_TARGET_055 MRR_FL_CAN_DET_Near_TARGET_054 MRR_FL_CAN_DET_Near_TARGET_053 MRR_FL_CAN_DET_Near_TARGET_052 MRR_FL_CAN_DET_Near_TARGET_051 MRR_FL_CAN_DET_Near_TARGET_050 MRR_FL_CAN_DET_MID_TARGET_050 MRR_FL_CAN_DET_MID_TARGET_051 MRR_FL_CAN_DET_MID_TARGET_052 MRR_FL_CAN_DET_MID_TARGET_053 MRR_FL_CAN_DET_MID_TARGET_054 MRR_FL_CAN_DET_MID_TARGET_055 MRR_FL_CAN_DET_MID_TARGET_056 MRR_FL_CAN_DET_ELEVATION_050 MRR_FL_CAN_DET_CONFID_AZIMUTH_05 MRR_FL_CAN_DET_SUPER_RES_TA_0048 MRR_FL_CAN_DET_CONFID_ELEVA_0048 MRR_FL_CAN_DET_HOST_VEH_CLU_0048 MRR_FL_CAN_DET_VALID_LEVEL_050 MRR_FL_CAN_DET_AMPLITUDE_050 MRR_FL_CAN_DET_ELEVATION_054 MRR_FL_CAN_DET_RANGE_RATE_054 MRR_FL_CAN_DET_RANGE_053 MRR_FL_CAN_DET_RANGE_RATE_053 MRR_FL_CAN_DET_AMPLITUDE_052 MRR_FL_CAN_DET_RANGE_051 MRR_FL_CAN_DET_RANGE_RATE_051 MRR_FL_CAN_DET_AMPLITUDE_051 MRR_FL_CAN_DET_CONFID_AZIMU_0049 MRR_FL_CAN_SCAN_INDEX_2LSB_053 MRR_FL_CAN_DET_AMPLITUDE_053 MRR_FL_CAN_DET_VALID_LEVEL_054 MRR_FL_CAN_DET_AZIMUTH_051 MRR_FL_CAN_DET_RANGE_RATE_052 MRR_FL_CAN_DET_VALID_LEVEL_052 MRR_FL_CAN_DET_HOST_VEH_CLU_0054 MRR_FL_CAN_DET_CONFID_ELEVA_0054 MRR_FL_CAN_DET_SUPER_RES_TA_0054 MRR_FL_CAN_DET_CONFID_ELEVA_0053 MRR_FL_CAN_DET_AZIMUTH_052 MRR_FL_CAN_DET_ELEVATION_051 MRR_FL_CAN_DET_RANGE_052 MRR_FL_CAN_DET_CONFID_AZIMU_0048 MRR_FL_CAN_DET_HOST_VEH_CLU_0052 MRR_FL_CAN_DET_CONFID_AZIMU_0047 MRR_FL_CAN_DET_ELEVATION_052 MRR_FL_CAN_DET_HOST_VEH_CLU_0053 MRR_FL_CAN_DET_VALID_LEVEL_053 MRR_FL_CAN_DET_CONFID_ELEVA_0052 MRR_FL_DET_MC_008 MRR_FL_CAN_DET_AZIMUTH_050 MRR_FL_CAN_DET_RANGE_050 MRR_FL_CAN_DET_RANGE_RATE_050 MRR_FL_CAN_DET_AZIMUTH_053 MRR_FL_CAN_DET_AMPLITUDE_055 MRR_FL_CAN_SCAN_INDEX_2LSB_050 MRR_FL_CAN_DET_HOST_VEH_CLU_0051 MRR_FL_CAN_DET_SUPER_RES_TA_0052 MRR_FL_CAN_DET_RANGE_054 MRR_FL_CAN_DET_AMPLITUDE_054 MRR_FL_CAN_DET_ELEVATION_053 MRR_FL_CAN_DET_CONFID_AZIMU_0046 MRR_FL_CAN_DET_RANGE_055 MRR_FL_CAN_DET_CONFID_AZIMU_0045 MRR_FL_CAN_SCAN_INDEX_2LSB_055 MRR_FL_CAN_DET_AZIMUTH_054 MRR_FL_CAN_DET_SUPER_RES_TA_0051 MRR_FL_CAN_DET_VALID_LEVEL_055 MRR_FL_CAN_DET_RANGE_RATE_055 MRR_FL_CAN_SCAN_INDEX_2LSB_054 MRR_FL_CAN_DET_AZIMUTH_056 MRR_FL_DET_CRC_008 MRR_FL_CAN_DET_ELEVATION_056 MRR_FL_CAN_DET_SUPER_RES_TA_0049 MRR_FL_CAN_DET_SUPER_RES_TA_0053 MRR_FL_CAN_DET_AZIMUTH_055 MRR_FL_CAN_DET_CONFID_ELEVA_0049 MRR_FL_CAN_DET_HOST_VEH_CLU_0049 MRR_FL_CAN_DET_HOST_VEH_CLU_0050 MRR_FL_CAN_DET_CONFID_ELEVA_0050 MRR_FL_CAN_SCAN_INDEX_2LSB_051 MRR_FL_CAN_DET_AMPLITUDE_056 MRR_FL_CAN_DET_RANGE_056 MRR_FL_CAN_DET_VALID_LEVEL_056 MRR_FL_CAN_DET_SUPER_RES_TA_0050 MRR_FL_CAN_DET_ELEVATION_055 MRR_FL_CAN_DET_CONFID_ELEVA_0051 MRR_FL_CAN_DET_CONFID_AZIMU_0044 MRR_FL_CAN_DET_RANGE_RATE_056 MRR_FL_CAN_SCAN_INDEX_2LSB_056 MRR_FL_CAN_SCAN_INDEX_2LSB_052 MRR_FL_CAN_DET_VALID_LEVEL_051;
SIG_GROUP_ 776 MRR_FL_Detection_057_063 1 : MRR_FL_CAN_DET_Near_TARGET_063 MRR_FL_CAN_DET_Near_TARGET_062 MRR_FL_CAN_DET_Near_TARGET_061 MRR_FL_CAN_DET_Near_TARGET_060 MRR_FL_CAN_DET_Near_TARGET_059 MRR_FL_CAN_DET_Near_TARGET_058 MRR_FL_CAN_DET_Near_TARGET_057 MRR_FL_CAN_DET_MID_TARGET_057 MRR_FL_CAN_DET_MID_TARGET_058 MRR_FL_CAN_DET_MID_TARGET_059 MRR_FL_CAN_DET_MID_TARGET_060 MRR_FL_CAN_DET_MID_TARGET_061 MRR_FL_CAN_DET_MID_TARGET_062 MRR_FL_CAN_DET_MID_TARGET_063 MRR_FL_CAN_DET_ELEVATION_057 MRR_FL_CAN_DET_CONFID_AZIMU_0050 MRR_FL_CAN_DET_SUPER_RES_TA_0055 MRR_FL_CAN_DET_RANGE_057 MRR_FL_CAN_DET_AMPLITUDE_059 MRR_FL_CAN_DET_RANGE_058 MRR_FL_CAN_SCAN_INDEX_2LSB_058 MRR_FL_CAN_DET_AMPLITUDE_058 MRR_FL_CAN_DET_VALID_LEVEL_058 MRR_FL_CAN_DET_CONFID_ELEVA_0055 MRR_FL_CAN_DET_RANGE_RATE_060 MRR_FL_CAN_DET_CONFID_AZIMU_0055 MRR_FL_CAN_DET_SUPER_RES_TA_0061 MRR_FL_CAN_DET_RANGE_RATE_059 MRR_FL_CAN_DET_ELEVATION_058 MRR_FL_CAN_DET_VALID_LEVEL_059 MRR_FL_CAN_DET_RANGE_RATE_058 MRR_FL_CAN_DET_HOST_VEH_CLU_0061 MRR_FL_CAN_DET_AZIMUTH_058 MRR_FL_CAN_DET_VALID_LEVEL_057 MRR_FL_CAN_DET_AMPLITUDE_060 MRR_FL_CAN_DET_RANGE_059 MRR_FL_CAN_DET_RANGE_061 MRR_FL_CAN_SCAN_INDEX_2LSB_057 MRR_FL_CAN_SCAN_INDEX_2LSB_062 MRR_FL_CAN_DET_HOST_VEH_CLU_0055 MRR_FL_CAN_DET_AZIMUTH_057 MRR_FL_CAN_DET_HOST_VEH_CLU_0060 MRR_FL_CAN_DET_AZIMUTH_060 MRR_FL_CAN_DET_AZIMUTH_059 MRR_FL_CAN_DET_AZIMUTH_063 MRR_FL_CAN_DET_RANGE_RATE_062 MRR_FL_CAN_DET_RANGE_063 MRR_FL_CAN_DET_CONFID_AZIMU_0053 MRR_FL_CAN_DET_AZIMUTH_061 MRR_FL_DET_MC_009 MRR_FL_CAN_DET_RANGE_RATE_057 MRR_FL_DET_CRC_009 MRR_FL_CAN_DET_ELEVATION_060 MRR_FL_CAN_DET_RANGE_060 MRR_FL_CAN_DET_AMPLITUDE_057 MRR_FL_CAN_DET_SUPER_RES_TA_0059 MRR_FL_CAN_SCAN_INDEX_2LSB_061 MRR_FL_CAN_SCAN_INDEX_2LSB_059 MRR_FL_CAN_DET_CONFID_ELEVA_0060 MRR_FL_CAN_DET_CONFID_ELEVA_0059 MRR_FL_CAN_DET_AMPLITUDE_062 MRR_FL_CAN_DET_ELEVATION_059 MRR_FL_CAN_DET_CONFID_AZIMU_0052 MRR_FL_CAN_DET_CONFID_ELEVA_0058 MRR_FL_CAN_DET_HOST_VEH_CLU_0059 MRR_FL_CAN_DET_CONFID_AZIMU_0054 MRR_FL_CAN_DET_HOST_VEH_CLU_0056 MRR_FL_CAN_DET_SUPER_RES_TA_0060 MRR_FL_CAN_DET_ELEVATION_063 MRR_FL_CAN_DET_SUPER_RES_TA_0056 MRR_FL_CAN_DET_CONFID_ELEVA_0056 MRR_FL_CAN_DET_CONFID_ELEVA_0061 MRR_FL_CAN_SCAN_INDEX_2LSB_060 MRR_FL_CAN_DET_SUPER_RES_TA_0058 MRR_FL_CAN_DET_ELEVATION_061 MRR_FL_CAN_DET_VALID_LEVEL_062 MRR_FL_CAN_DET_VALID_LEVEL_060 MRR_FL_CAN_DET_HOST_VEH_CLU_0057 MRR_FL_CAN_DET_CONFID_ELEVA_0057 MRR_FL_CAN_DET_ELEVATION_062 MRR_FL_CAN_DET_VALID_LEVEL_063 MRR_FL_CAN_DET_CONFID_AZIMUTH_06 MRR_FL_CAN_DET_RANGE_062 MRR_FL_CAN_DET_CONFID_AZIMU_0051 MRR_FL_CAN_DET_AMPLITUDE_061 MRR_FL_CAN_DET_HOST_VEH_CLU_0058 MRR_FL_CAN_DET_RANGE_RATE_063 MRR_FL_CAN_SCAN_INDEX_2LSB_063 MRR_FL_CAN_DET_AMPLITUDE_063 MRR_FL_CAN_DET_RANGE_RATE_061 MRR_FL_CAN_DET_SUPER_RES_TA_0057 MRR_FL_CAN_DET_AZIMUTH_062 MRR_FL_CAN_DET_VALID_LEVEL_061;
SIG_GROUP_ 777 MRR_FL_Detection_064 1 : MRR_FL_CAN_DET_Near_TARGET_064 MRR_FL_CAN_DET_MID_TARGET_064 MRR_FL_DET_MC_010 MRR_FL_DET_CRC_010 MRR_FL_CAN_DET_ELEVATION_064 MRR_FL_CAN_DET_CONFID_AZIMU_0056 MRR_FL_CAN_DET_SUPER_RES_TA_0062 MRR_FL_CAN_DET_CONFID_ELEVA_0062 MRR_FL_CAN_DET_HOST_VEH_CLU_0062 MRR_FL_CAN_DET_VALID_LEVEL_064 MRR_FL_CAN_DET_AZIMUTH_064 MRR_FL_CAN_DET_RANGE_064 MRR_FL_CAN_DET_RANGE_RATE_064 MRR_FL_CAN_DET_AMPLITUDE_064 MRR_FL_CAN_SCAN_INDEX_2LSB_064;
SIG_GROUP_ 391 MRR_FL_Header_Timestamps 1 : MRR_FL_Sensor_Position MRR_FL_Sensor_Position_Lock MRR_FL_CAN_NUMBER_OF_DET MRR_FL_CAN_SCAN_INDEX_FUSED MRR_FL_CAN_LOOK_ID MRR_FL_CAN_LOOK_INDEX MRR_FL_CAN_DET_TIME_SINCE_MEAS MRR_FL_TrackStatus_CRC MRR_FL_TrackStatus_MC MRR_FL_CAN_ReSync_counter MRR_FL_CAN_TX_LOOK_INDEX_8 MRR_FL_CAN_TX_SCAN_INDEX_TRACKER MRR_FL_CAN_TX_SCN_INDEX_TRKER_FU MRR_FL_CAN_TX_LOOK_TYPE MRR_FL_CAN_TX_LOOK_ID MRR_FL_CAN_TX_SYSTEM_TIME_STAMP;
SIG_GROUP_ 1024 MRR_FR_Detection_001_007 1 : MRR_FR_CAN_DET_Near_TARGET_001 MRR_FR_CAN_DET_Near_TARGET_002 MRR_FR_CAN_DET_Near_TARGET_003 MRR_FR_CAN_DET_Near_TARGET_004 MRR_FR_CAN_DET_Near_TARGET_005 MRR_FR_CAN_DET_Near_TARGET_006 MRR_FR_CAN_DET_Near_TARGET_007 MRR_FR_CAN_DET_MID_TARGET_001 MRR_FR_CAN_DET_MID_TARGET_002 MRR_FR_CAN_DET_MID_TARGET_003 MRR_FR_CAN_DET_MID_TARGET_004 MRR_FR_CAN_DET_MID_TARGET_005 MRR_FR_CAN_DET_MID_TARGET_006 MRR_FR_CAN_DET_MID_TARGET_007 MRR_FR_DET_MC_001 MRR_FR_DET_CRC_001 MRR_FR_CAN_DET_ELEVATION_007 MRR_FR_CAN_DET_VALID_LEVEL_001 MRR_FR_CAN_DET_HOST_VEH_CLUTTER_ MRR_FR_CAN_DET_RANGE_007 MRR_FR_CAN_DET_SUPER_RES_TARGET_ MRR_FR_CAN_DET_AZIMUTH_007 MRR_FR_CAN_DET_CONFID_ELEVATION_ MRR_FR_CAN_DET_AMPLITUDE_001 MRR_FR_CAN_SCAN_INDEX_2LSB_001 MRR_FR_CAN_DET_RANGE_RATE_001 MRR_FR_CAN_DET_CONFID_AZIMU_0004 MRR_FR_CAN_DET_CONFID_AZIMUTH_00 MRR_FR_CAN_DET_RANGE_RATE_007 MRR_FR_CAN_DET_AZIMUTH_001 MRR_FR_CAN_DET_HOST_VEH_CLU_0005 MRR_FR_CAN_DET_ELEVATION_002 MRR_FR_CAN_DET_VALID_LEVEL_002 MRR_FR_CAN_DET_ELEVATION_001 MRR_FR_CAN_DET_AMPLITUDE_002 MRR_FR_CAN_DET_RANGE_004 MRR_FR_CAN_DET_ELEVATION_004 MRR_FR_CAN_DET_AZIMUTH_002 MRR_FR_CAN_SCAN_INDEX_2LSB_007 MRR_FR_CAN_DET_AZIMUTH_004 MRR_FR_CAN_DET_RANGE_002 MRR_FR_CAN_DET_AZIMUTH_003 MRR_FR_CAN_DET_CONFID_ELEVA_0005 MRR_FR_CAN_DET_CONFID_ELEVA_0004 MRR_FR_CAN_DET_SUPER_RES_TA_0004 MRR_FR_CAN_DET_HOST_VEH_CLU_0004 MRR_FR_CAN_DET_SUPER_RES_TA_0005 MRR_FR_CAN_DET_RANGE_001 MRR_FR_CAN_DET_VALID_LEVEL_005 MRR_FR_CAN_DET_CONFID_ELEVA_0002 MRR_FR_CAN_SCAN_INDEX_2LSB_003 MRR_FR_CAN_DET_RANGE_RATE_003 MRR_FR_CAN_DET_SUPER_RES_TA_0003 MRR_FR_CAN_DET_CONFID_AZIMU_0005 MRR_FR_CAN_DET_HOST_VEH_CLU_0003 MRR_FR_CAN_SCAN_INDEX_2LSB_002 MRR_FR_CAN_DET_VALID_LEVEL_003 MRR_FR_CAN_DET_RANGE_RATE_002 MRR_FR_CAN_DET_ELEVATION_003 MRR_FR_CAN_DET_CONFID_AZIMU_0003 MRR_FR_CAN_DET_CONFID_ELEVA_0003 MRR_FR_CAN_DET_RANGE_RATE_004 MRR_FR_CAN_SCAN_INDEX_2LSB_004 MRR_FR_CAN_DET_RANGE_003 MRR_FR_CAN_DET_SUPER_RES_TA_0002 MRR_FR_CAN_DET_AMPLITUDE_005 MRR_FR_CAN_DET_AMPLITUDE_007 MRR_FR_CAN_DET_VALID_LEVEL_007 MRR_FR_CAN_DET_ELEVATION_006 MRR_FR_CAN_DET_SUPER_RES_TA_0000 MRR_FR_CAN_DET_RANGE_RATE_006 MRR_FR_CAN_DET_AZIMUTH_006 MRR_FR_CAN_DET_VALID_LEVEL_006 MRR_FR_CAN_DET_SUPER_RES_TA_0001 MRR_FR_CAN_DET_RANGE_005 MRR_FR_CAN_SCAN_INDEX_2LSB_005 MRR_FR_CAN_DET_RANGE_RATE_005 MRR_FR_CAN_DET_CONFID_AZIMU_0001 MRR_FR_CAN_DET_VALID_LEVEL_004 MRR_FR_CAN_DET_AMPLITUDE_004 MRR_FR_CAN_DET_AZIMUTH_005 MRR_FR_CAN_DET_CONFID_AZIMU_0002 MRR_FR_CAN_DET_HOST_VEH_CLU_0001 MRR_FR_CAN_DET_CONFID_ELEVA_0001 MRR_FR_CAN_DET_HOST_VEH_CLU_0002 MRR_FR_CAN_DET_ELEVATION_005 MRR_FR_CAN_DET_AMPLITUDE_006 MRR_FR_CAN_DET_RANGE_006 MRR_FR_CAN_SCAN_INDEX_2LSB_006 MRR_FR_CAN_DET_CONFID_AZIMU_0000 MRR_FR_CAN_DET_CONFID_ELEVA_0000 MRR_FR_CAN_DET_HOST_VEH_CLU_0000 MRR_FR_CAN_DET_AMPLITUDE_003;
SIG_GROUP_ 1025 MRR_FR_Detection_008_014 1 : MRR_FR_CAN_DET_Near_TARGET_014 MRR_FR_CAN_DET_Near_TARGET_013 MRR_FR_CAN_DET_Near_TARGET_012 MRR_FR_CAN_DET_Near_TARGET_011 MRR_FR_CAN_DET_Near_TARGET_010 MRR_FR_CAN_DET_Near_TARGET_009 MRR_FR_CAN_DET_Near_TARGET_008 MRR_FR_CAN_DET_MID_TARGET_008 MRR_FR_CAN_DET_MID_TARGET_009 MRR_FR_CAN_DET_MID_TARGET_010 MRR_FR_CAN_DET_MID_TARGET_011 MRR_FR_CAN_DET_MID_TARGET_012 MRR_FR_CAN_DET_MID_TARGET_013 MRR_FR_CAN_DET_MID_TARGET_014 MRR_FR_CAN_DET_AZIMUTH_008 MRR_FR_CAN_DET_ELEVATION_008 MRR_FR_CAN_DET_CONFID_AZIMU_0006 MRR_FR_CAN_DET_SUPER_RES_TA_0006 MRR_FR_CAN_DET_RANGE_008 MRR_FR_CAN_DET_RANGE_RATE_008 MRR_FR_CAN_DET_VALID_LEVEL_008 MRR_FR_CAN_DET_CONFID_ELEVA_0006 MRR_FR_CAN_DET_HOST_VEH_CLU_0006 MRR_FR_CAN_DET_AMPLITUDE_008 MRR_FR_CAN_SCAN_INDEX_2LSB_008 MRR_FR_DET_MC_002 MRR_FR_CAN_DET_AZIMUTH_012 MRR_FR_CAN_DET_RANGE_012 MRR_FR_CAN_DET_AMPLITUDE_012 MRR_FR_CAN_DET_VALID_LEVEL_012 MRR_FR_CAN_DET_RANGE_RATE_011 MRR_FR_CAN_SCAN_INDEX_2LSB_011 MRR_FR_CAN_DET_AMPLITUDE_011 MRR_FR_CAN_DET_ELEVATION_010 MRR_FR_CAN_DET_RANGE_010 MRR_FR_CAN_DET_RANGE_RATE_010 MRR_FR_CAN_SCAN_INDEX_2LSB_010 MRR_FR_CAN_DET_RANGE_009 MRR_FR_CAN_DET_ELEVATION_009 MRR_FR_CAN_DET_HOST_VEH_CLU_0011 MRR_FR_CAN_DET_RANGE_011 MRR_FR_CAN_DET_AZIMUTH_010 MRR_FR_CAN_DET_VALID_LEVEL_010 MRR_FR_CAN_DET_CONFID_AZIMU_0009 MRR_FR_CAN_DET_ELEVATION_011 MRR_FR_CAN_DET_RANGE_RATE_012 MRR_FR_CAN_DET_AZIMUTH_009 MRR_FR_CAN_DET_AZIMUTH_011 MRR_FR_CAN_DET_RANGE_014 MRR_FR_CAN_DET_ELEVATION_012 MRR_FR_CAN_DET_CONFID_ELEVA_0012 MRR_FR_CAN_DET_CONFID_AZIMU_0011 MRR_FR_CAN_DET_CONFID_AZIMU_0010 MRR_FR_CAN_DET_RANGE_RATE_009 MRR_FR_CAN_SCAN_INDEX_2LSB_009 MRR_FR_CAN_DET_SUPER_RES_TA_0012 MRR_FR_CAN_DET_AMPLITUDE_009 MRR_FR_CAN_DET_VALID_LEVEL_009 MRR_FR_CAN_DET_CONFID_ELEVA_0011 MRR_FR_CAN_DET_HOST_VEH_CLU_0012 MRR_FR_CAN_DET_VALID_LEVEL_011 MRR_FR_CAN_DET_CONFID_ELEVA_0010 MRR_FR_CAN_DET_HOST_VEH_CLU_0010 MRR_FR_CAN_DET_SUPER_RES_TA_0010 MRR_FR_CAN_DET_CONFID_AZIMU_0008 MRR_FR_CAN_DET_SUPER_RES_TA_0007 MRR_FR_CAN_SCAN_INDEX_2LSB_013 MRR_FR_CAN_DET_AMPLITUDE_013 MRR_FR_CAN_DET_VALID_LEVEL_013 MRR_FR_CAN_DET_SUPER_RES_TA_0009 MRR_FR_CAN_DET_AMPLITUDE_010 MRR_FR_DET_CRC_002 MRR_FR_CAN_DET_ELEVATION_014 MRR_FR_CAN_DET_AZIMUTH_014 MRR_FR_CAN_DET_CONFID_ELEVA_0007 MRR_FR_CAN_DET_HOST_VEH_CLU_0007 MRR_FR_CAN_DET_CONFID_AZIMUTH_01 MRR_FR_CAN_DET_RANGE_RATE_014 MRR_FR_CAN_DET_VALID_LEVEL_014 MRR_FR_CAN_DET_RANGE_013 MRR_FR_CAN_DET_RANGE_RATE_013 MRR_FR_CAN_DET_ELEVATION_013 MRR_FR_CAN_DET_SUPER_RES_TA_0011 MRR_FR_CAN_DET_CONFID_AZIMU_0007 MRR_FR_CAN_DET_CONFID_ELEVA_0009 MRR_FR_CAN_DET_AZIMUTH_013 MRR_FR_CAN_DET_HOST_VEH_CLU_0009 MRR_FR_CAN_DET_HOST_VEH_CLU_0008 MRR_FR_CAN_DET_CONFID_ELEVA_0008 MRR_FR_CAN_DET_SUPER_RES_TA_0008 MRR_FR_CAN_SCAN_INDEX_2LSB_014 MRR_FR_CAN_DET_AMPLITUDE_014 MRR_FR_CAN_SCAN_INDEX_2LSB_012;
SIG_GROUP_ 1026 MRR_FR_Detection_015_021 1 : MRR_FR_CAN_DET_Near_TARGET_021 MRR_FR_CAN_DET_Near_TARGET_020 MRR_FR_CAN_DET_Near_TARGET_019 MRR_FR_CAN_DET_Near_TARGET_018 MRR_FR_CAN_DET_Near_TARGET_017 MRR_FR_CAN_DET_Near_TARGET_016 MRR_FR_CAN_DET_Near_TARGET_015 MRR_FR_CAN_DET_MID_TARGET_015 MRR_FR_CAN_DET_MID_TARGET_016 MRR_FR_CAN_DET_MID_TARGET_017 MRR_FR_CAN_DET_MID_TARGET_018 MRR_FR_CAN_DET_MID_TARGET_019 MRR_FR_CAN_DET_MID_TARGET_020 MRR_FR_CAN_DET_MID_TARGET_021 MRR_FR_CAN_DET_CONFID_AZIMU_0012 MRR_FR_CAN_DET_ELEVATION_015 MRR_FR_CAN_DET_SUPER_RES_TA_0013 MRR_FR_CAN_DET_CONFID_ELEVA_0013 MRR_FR_CAN_DET_HOST_VEH_CLU_0013 MRR_FR_DET_MC_003 MRR_FR_DET_CRC_003 MRR_FR_CAN_DET_AMPLITUDE_017 MRR_FR_CAN_DET_AMPLITUDE_016 MRR_FR_CAN_DET_VALID_LEVEL_016 MRR_FR_CAN_DET_RANGE_019 MRR_FR_CAN_DET_AZIMUTH_017 MRR_FR_CAN_DET_RANGE_RATE_020 MRR_FR_CAN_DET_AZIMUTH_020 MRR_FR_CAN_DET_AMPLITUDE_019 MRR_FR_CAN_DET_SUPER_RES_TA_0015 MRR_FR_CAN_DET_ELEVATION_020 MRR_FR_CAN_DET_RANGE_017 MRR_FR_CAN_DET_RANGE_RATE_017 MRR_FR_CAN_SCAN_INDEX_2LSB_016 MRR_FR_CAN_DET_AZIMUTH_018 MRR_FR_CAN_DET_RANGE_016 MRR_FR_CAN_DET_RANGE_020 MRR_FR_CAN_DET_ELEVATION_019 MRR_FR_CAN_DET_RANGE_RATE_019 MRR_FR_CAN_DET_ELEVATION_016 MRR_FR_CAN_DET_CONFID_AZIMU_0016 MRR_FR_CAN_SCAN_INDEX_2LSB_017 MRR_FR_CAN_DET_SUPER_RES_TA_0019 MRR_FR_CAN_DET_CONFID_ELEVA_0019 MRR_FR_CAN_DET_RANGE_RATE_016 MRR_FR_CAN_DET_VALID_LEVEL_017 MRR_FR_CAN_DET_AZIMUTH_016 MRR_FR_CAN_DET_CONFID_AZIMU_0017 MRR_FR_CAN_DET_VALID_LEVEL_018 MRR_FR_CAN_DET_ELEVATION_018 MRR_FR_CAN_DET_SUPER_RES_TA_0018 MRR_FR_CAN_SCAN_INDEX_2LSB_018 MRR_FR_CAN_DET_CONFID_ELEVA_0017 MRR_FR_CAN_DET_HOST_VEH_CLU_0017 MRR_FR_CAN_DET_RANGE_RATE_018 MRR_FR_CAN_DET_CONFID_AZIMU_0015 MRR_FR_CAN_DET_RANGE_018 MRR_FR_CAN_DET_CONFID_ELEVA_0018 MRR_FR_CAN_SCAN_INDEX_2LSB_019 MRR_FR_CAN_DET_HOST_VEH_CLU_0018 MRR_FR_CAN_DET_ELEVATION_017 MRR_FR_CAN_DET_CONFID_AZIMU_0014 MRR_FR_CAN_DET_HOST_VEH_CLU_0019 MRR_FR_CAN_DET_VALID_LEVEL_019 MRR_FR_CAN_DET_SUPER_RES_TA_0017 MRR_FR_CAN_DET_HOST_VEH_CLU_0015 MRR_FR_CAN_DET_CONFID_ELEVA_0015 MRR_FR_CAN_DET_HOST_VEH_CLU_0016 MRR_FR_CAN_DET_CONFID_ELEVA_0016 MRR_FR_CAN_SCAN_INDEX_2LSB_020 MRR_FR_CAN_DET_CONFID_AZIMU_0013 MRR_FR_CAN_DET_AMPLITUDE_020 MRR_FR_CAN_DET_SUPER_RES_TA_0016 MRR_FR_CAN_DET_AZIMUTH_019 MRR_FR_CAN_DET_AMPLITUDE_018 MRR_FR_CAN_DET_VALID_LEVEL_015 MRR_FR_CAN_DET_RANGE_015 MRR_FR_CAN_DET_AZIMUTH_015 MRR_FR_CAN_DET_RANGE_RATE_015 MRR_FR_CAN_DET_AMPLITUDE_015 MRR_FR_CAN_SCAN_INDEX_2LSB_015 MRR_FR_CAN_DET_ELEVATION_021 MRR_FR_CAN_DET_AZIMUTH_021 MRR_FR_CAN_DET_SUPER_RES_TA_0014 MRR_FR_CAN_DET_CONFID_ELEVA_0014 MRR_FR_CAN_DET_RANGE_021 MRR_FR_CAN_DET_HOST_VEH_CLU_0014 MRR_FR_CAN_DET_CONFID_AZIMUTH_02 MRR_FR_CAN_SCAN_INDEX_2LSB_021 MRR_FR_CAN_DET_RANGE_RATE_021 MRR_FR_CAN_DET_VALID_LEVEL_021 MRR_FR_CAN_DET_AMPLITUDE_021 MRR_FR_CAN_DET_VALID_LEVEL_020;
SIG_GROUP_ 1027 MRR_FR_Detection_022_028 1 : MRR_FR_CAN_DET_Near_TARGET_028 MRR_FR_CAN_DET_Near_TARGET_027 MRR_FR_CAN_DET_Near_TARGET_026 MRR_FR_CAN_DET_Near_TARGET_025 MRR_FR_CAN_DET_Near_TARGET_024 MRR_FR_CAN_DET_Near_TARGET_023 MRR_FR_CAN_DET_Near_TARGET_022 MRR_FR_CAN_DET_MID_TARGET_022 MRR_FR_CAN_DET_MID_TARGET_023 MRR_FR_CAN_DET_MID_TARGET_024 MRR_FR_CAN_DET_MID_TARGET_025 MRR_FR_CAN_DET_MID_TARGET_026 MRR_FR_CAN_DET_MID_TARGET_027 MRR_FR_CAN_DET_MID_TARGET_028 MRR_FR_CAN_DET_ELEVATION_022 MRR_FR_CAN_DET_VALID_LEVEL_023 MRR_FR_CAN_DET_CONFID_AZIMU_0018 MRR_FR_CAN_DET_AMPLITUDE_023 MRR_FR_CAN_DET_RANGE_022 MRR_FR_CAN_DET_SUPER_RES_TA_0020 MRR_FR_CAN_DET_AZIMUTH_022 MRR_FR_CAN_DET_CONFID_ELEVA_0020 MRR_FR_CAN_DET_RANGE_RATE_023 MRR_FR_CAN_DET_RANGE_RATE_022 MRR_FR_CAN_SCAN_INDEX_2LSB_023 MRR_FR_CAN_DET_AZIMUTH_027 MRR_FR_CAN_DET_AZIMUTH_026 MRR_FR_CAN_DET_RANGE_026 MRR_FR_CAN_DET_CONFID_ELEVA_0023 MRR_FR_CAN_DET_AMPLITUDE_024 MRR_FR_CAN_DET_ELEVATION_025 MRR_FR_CAN_DET_RANGE_023 MRR_FR_CAN_DET_CONFID_AZIMU_0024 MRR_FR_CAN_DET_CONFID_ELEVA_0026 MRR_FR_CAN_DET_HOST_VEH_CLU_0026 MRR_FR_CAN_DET_SUPER_RES_TA_0026 MRR_FR_CAN_DET_AZIMUTH_025 MRR_FR_CAN_DET_RANGE_025 MRR_FR_CAN_DET_VALID_LEVEL_024 MRR_FR_CAN_DET_ELEVATION_023 MRR_FR_CAN_DET_ELEVATION_024 MRR_FR_CAN_DET_RANGE_RATE_025 MRR_FR_CAN_SCAN_INDEX_2LSB_025 MRR_FR_CAN_DET_AZIMUTH_024 MRR_FR_CAN_DET_AMPLITUDE_025 MRR_FR_CAN_DET_RANGE_024 MRR_FR_CAN_SCAN_INDEX_2LSB_024 MRR_FR_CAN_DET_RANGE_RATE_024 MRR_FR_CAN_DET_AZIMUTH_023 MRR_FR_CAN_DET_VALID_LEVEL_026 MRR_FR_CAN_DET_AMPLITUDE_027 MRR_FR_CAN_DET_RANGE_RATE_027 MRR_FR_CAN_SCAN_INDEX_2LSB_027 MRR_FR_CAN_DET_ELEVATION_026 MRR_FR_CAN_DET_HOST_VEH_CLU_0020 MRR_FR_CAN_DET_RANGE_027 MRR_FR_CAN_DET_VALID_LEVEL_022 MRR_FR_CAN_DET_SUPER_RES_TA_0025 MRR_FR_CAN_DET_CONFID_ELEVA_0024 MRR_FR_CAN_SCAN_INDEX_2LSB_026 MRR_FR_CAN_DET_CONFID_AZIMU_0022 MRR_FR_CAN_DET_HOST_VEH_CLU_0023 MRR_FR_CAN_DET_RANGE_RATE_026 MRR_FR_CAN_DET_AMPLITUDE_026 MRR_FR_CAN_DET_HOST_VEH_CLU_0025 MRR_FR_DET_MC_004 MRR_FR_DET_CRC_004 MRR_FR_CAN_DET_RANGE_028 MRR_FR_CAN_DET_AMPLITUDE_022 MRR_FR_CAN_DET_SUPER_RES_TA_0021 MRR_FR_CAN_SCAN_INDEX_2LSB_022 MRR_FR_CAN_DET_ELEVATION_028 MRR_FR_CAN_DET_AZIMUTH_028 MRR_FR_CAN_DET_HOST_VEH_CLU_0021 MRR_FR_CAN_DET_CONFID_ELEVA_0021 MRR_FR_CAN_DET_CONFID_ELEVA_0025 MRR_FR_CAN_DET_HOST_VEH_CLU_0024 MRR_FR_CAN_DET_SUPER_RES_TA_0023 MRR_FR_CAN_DET_VALID_LEVEL_027 MRR_FR_CAN_DET_SUPER_RES_TA_0024 MRR_FR_CAN_DET_CONFID_AZIMU_0021 MRR_FR_CAN_DET_CONFID_AZIMU_0020 MRR_FR_CAN_DET_HOST_VEH_CLU_0022 MRR_FR_CAN_DET_CONFID_ELEVA_0022 MRR_FR_CAN_DET_CONFID_AZIMU_0023 MRR_FR_CAN_DET_CONFID_AZIMU_0019 MRR_FR_CAN_DET_RANGE_RATE_028 MRR_FR_CAN_DET_AMPLITUDE_028 MRR_FR_CAN_SCAN_INDEX_2LSB_028 MRR_FR_CAN_DET_VALID_LEVEL_028 MRR_FR_CAN_DET_ELEVATION_027 MRR_FR_CAN_DET_SUPER_RES_TA_0022 MRR_FR_CAN_DET_VALID_LEVEL_025;
